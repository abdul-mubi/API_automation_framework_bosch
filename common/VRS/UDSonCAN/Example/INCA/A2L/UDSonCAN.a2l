ASAP2_VERSION 1 61
/begin PROJECT HWA_UDSonCAN_ReferenceSystem "Modified for UDSonCAN Tests with new CalMeasure Mapping"
/begin HEADER "" VERSION "000" PROJECT_NO ASD /end HEADER
/begin MODULE HWA_UDSonCAN_ReferenceSystem "Modified for UDSonCAN Tests with new CalMeasure Mapping"
/begin MOD_COMMON "2013-05-06 09:52:20	create by ETASHexVirtualAddressTableHeaderV2" BYTE_ORDER MSB_FIRST ALIGNMENT_BYTE 1 ALIGNMENT_WORD 2 ALIGNMENT_LONG 4 ALIGNMENT_FLOAT32_IEEE 4 ALIGNMENT_FLOAT64_IEEE 8 /end MOD_COMMON
/begin CHARACTERISTIC P_Curve_in_x.Axis_Input.CURVE_Axis "" VALUE 0x1D0054 STANDARD_VALUE_U16 0.0 ident 0 65535 /end CHARACTERISTIC
/begin CHARACTERISTIC P_Do_Active_Grp.GRP_float32_float32_float32.All_Maps_GRP.Maps_Raster_3 "" VALUE 0x1D6D8C STANDARD_VALUE_S8 0.0 ident 0 1 BIT_MASK 0x1 /end CHARACTERISTIC
/begin CHARACTERISTIC P_Do_Active_Grp.GRP_sint16_sint16_sint16.All_Maps_GRP.Maps_Raster_3 "" VALUE 0x1D6F84 STANDARD_VALUE_U8 0.0 ident 0 1 BIT_MASK 0x1 /end CHARACTERISTIC
/begin CHARACTERISTIC P_Do_Active_Grp.GRP_sint32_sint32_sint32.All_Maps_GRP.Maps_Raster_3 "" VALUE 0x1D708C STANDARD_VALUE_U8 0.0 ident 0 1 BIT_MASK 0x1 /end CHARACTERISTIC
/begin CHARACTERISTIC P_Do_Active_Grp.GRP_sint8_sint8_sint8.All_Maps_GRP.Maps_Raster_3 "" VALUE 0x1D7280 STANDARD_VALUE_U8 0.0 ident 0 1 BIT_MASK 0x1 /end CHARACTERISTIC
/begin CHARACTERISTIC P_Do_Active_Grp.GRP_uint16_uint16_uint16.All_Maps_GRP.Maps_Raster_3 "" VALUE 0x1D730C STANDARD_VALUE_U8 0.0 ident 0 1 BIT_MASK 0x1 /end CHARACTERISTIC
/begin CHARACTERISTIC P_Do_Active_Grp.GRP_uint32_uint32_uint32.All_Maps_GRP.Maps_Raster_3 "" VALUE 0x1D7414 STANDARD_VALUE_U8 0.0 ident 0 1 BIT_MASK 0x1 /end CHARACTERISTIC
/begin CHARACTERISTIC P_Do_Active_Grp.GRP_uint8_uint8_uint8.All_Maps_GRP.Maps_Raster_3 "" VALUE 0x1D7608 STANDARD_VALUE_U8 0.0 ident 0 1 BIT_MASK 0x1 /end CHARACTERISTIC
/begin CHARACTERISTIC P_Do_Active_Std.STD_float32_float32_float32.All_Maps_STD.Maps_Raster_1 "" VALUE 0x1D4310 STANDARD_VALUE_U8 0.0 ident 0 1 BIT_MASK 0x1 /end CHARACTERISTIC
/begin CHARACTERISTIC P_Do_Active_Std.STD_float32_float32_float32.All_Maps_STD.Maps_Raster_2 "" VALUE 0x1D5CD4 STANDARD_VALUE_U8 0.0 ident 0 1 BIT_MASK 0x1 /end CHARACTERISTIC
/begin CHARACTERISTIC P_Do_Active_Std.STD_float32_float32_float32.All_Maps_STD.Maps_Raster_3 "" VALUE 0x1D7698 STANDARD_VALUE_U8 0.0 ident 0 1 BIT_MASK 0x1 /end CHARACTERISTIC
/begin CHARACTERISTIC P_Do_Active_Std.STD_sint16_sint16_sint16.All_Maps_STD.Maps_Raster_1 "" VALUE 0x1D4500 STANDARD_VALUE_U8 0.0 ident 0 1 BIT_MASK 0x1 /end CHARACTERISTIC
/begin CHARACTERISTIC P_Do_Active_Std.STD_sint16_sint16_sint16.All_Maps_STD.Maps_Raster_2 "" VALUE 0x1D5EC4 STANDARD_VALUE_U8 0.0 ident 0 1 BIT_MASK 0x1 /end CHARACTERISTIC
/begin CHARACTERISTIC P_Do_Active_Std.STD_sint16_sint16_sint16.All_Maps_STD.Maps_Raster_3 "" VALUE 0x1D7888 STANDARD_VALUE_U8 0.0 ident 0 1 BIT_MASK 0x1 /end CHARACTERISTIC
/begin CHARACTERISTIC P_Do_Active_Std.STD_sint32_sint32_sint32.All_Maps_STD.Maps_Raster_1 "" VALUE 0x1D4604 STANDARD_VALUE_U8 0.0 ident 0 1 BIT_MASK 0x1 /end CHARACTERISTIC
/begin CHARACTERISTIC P_Do_Active_Std.STD_sint32_sint32_sint32.All_Maps_STD.Maps_Raster_2 "" VALUE 0x1D5FC8 STANDARD_VALUE_U8 0.0 ident 0 1 BIT_MASK 0x1 /end CHARACTERISTIC
/begin CHARACTERISTIC P_Do_Active_Std.STD_sint32_sint32_sint32.All_Maps_STD.Maps_Raster_3 "" VALUE 0x1D798C STANDARD_VALUE_U8 0.0 ident 0 1 BIT_MASK 0x1 /end CHARACTERISTIC
/begin CHARACTERISTIC P_Do_Active_Std.STD_sint8_sint8_sint8.All_Maps_STD.Maps_Raster_1 "" VALUE 0x1D47F0 STANDARD_VALUE_U8 0.0 ident 0 1 BIT_MASK 0x1 /end CHARACTERISTIC
/begin CHARACTERISTIC P_Do_Active_Std.STD_sint8_sint8_sint8.All_Maps_STD.Maps_Raster_2 "" VALUE 0x1D61B4 STANDARD_VALUE_U8 0.0 ident 0 1 BIT_MASK 0x1 /end CHARACTERISTIC
/begin CHARACTERISTIC P_Do_Active_Std.STD_sint8_sint8_sint8.All_Maps_STD.Maps_Raster_3 "" VALUE 0x1D7B78 STANDARD_VALUE_U8 0.0 ident 0 1 BIT_MASK 0x1 /end CHARACTERISTIC
/begin CHARACTERISTIC P_Do_Active_Std.STD_uint16_uint16_uint16.All_Maps_STD.Maps_Raster_1 "" VALUE 0x1D4878 STANDARD_VALUE_U8 0.0 ident 0 1 BIT_MASK 0x1 /end CHARACTERISTIC
/begin CHARACTERISTIC P_Do_Active_Std.STD_uint16_uint16_uint16.All_Maps_STD.Maps_Raster_2 "" VALUE 0x1D623C STANDARD_VALUE_U8 0.0 ident 0 1 BIT_MASK 0x1 /end CHARACTERISTIC
/begin CHARACTERISTIC P_Do_Active_Std.STD_uint16_uint16_uint16.All_Maps_STD.Maps_Raster_3 "" VALUE 0x1D7C00 STANDARD_VALUE_U8 0.0 ident 0 1 BIT_MASK 0x1 /end CHARACTERISTIC
/begin CHARACTERISTIC P_Do_Active_Std.STD_uint32_uint32_uint32.All_Maps_STD.Maps_Raster_1 "" VALUE 0x1D497C STANDARD_VALUE_U8 0.0 ident 0 1 BIT_MASK 0x1 /end CHARACTERISTIC
/begin CHARACTERISTIC P_Do_Active_Std.STD_uint32_uint32_uint32.All_Maps_STD.Maps_Raster_2 "" VALUE 0x1D6340 STANDARD_VALUE_U8 0.0 ident 0 1 BIT_MASK 0x1 /end CHARACTERISTIC
/begin CHARACTERISTIC P_Do_Active_Std.STD_uint32_uint32_uint32.All_Maps_STD.Maps_Raster_3 "" VALUE 0x1D7D04 STANDARD_VALUE_U8 0.0 ident 0 1 BIT_MASK 0x1 /end CHARACTERISTIC
/begin CHARACTERISTIC P_Do_Active_Std.STD_uint8_uint8_uint8.All_Maps_STD.Maps_Raster_1 "" VALUE 0x1D4B68 STANDARD_VALUE_U8 0.0 ident 0 1 BIT_MASK 0x1 /end CHARACTERISTIC
/begin CHARACTERISTIC P_Do_Active_Std.STD_uint8_uint8_uint8.All_Maps_STD.Maps_Raster_2 "" VALUE 0x1D652C STANDARD_VALUE_U8 0.0 ident 0 1 BIT_MASK 0x1 /end CHARACTERISTIC
/begin CHARACTERISTIC P_Do_Active_Std.STD_uint8_uint8_uint8.All_Maps_STD.Maps_Raster_3 "" VALUE 0x1D7EF0 STANDARD_VALUE_U8 0.0 ident 0 1 BIT_MASK 0x1 /end CHARACTERISTIC
/begin CHARACTERISTIC P_Do_All_GRP_Maps.All_Maps_GRP.Maps_Raster_3 "" VALUE 0x1D6D78 STANDARD_VALUE_U8 0.0 ident 0 1 BIT_MASK 0x1 /end CHARACTERISTIC
/begin CHARACTERISTIC P_Do_All_STD_Maps.All_Maps_STD.Maps_Raster_1 "" VALUE 0x1D4300 STANDARD_VALUE_U8 0.0 ident 0 1 BIT_MASK 0x1 /end CHARACTERISTIC
/begin CHARACTERISTIC P_Do_All_STD_Maps.All_Maps_STD.Maps_Raster_2 "" VALUE 0x1D5CC4 STANDARD_VALUE_U8 0.0 ident 0 1 BIT_MASK 0x1 /end CHARACTERISTIC
/begin CHARACTERISTIC P_Do_All_STD_Maps.All_Maps_STD.Maps_Raster_3 "" VALUE 0x1D7688 STANDARD_VALUE_U8 0.0 ident 0 1 BIT_MASK 0x1 /end CHARACTERISTIC
/begin CHARACTERISTIC P_Do_GET.GRP_float32_float32_float32.All_Maps_GRP.Maps_Raster_3 "" VALUE 0x1D6D8D STANDARD_VALUE_S8 0.0 ident 0 1 BIT_MASK 0x1 /end CHARACTERISTIC
/begin CHARACTERISTIC P_Do_GET.GRP_sint16_sint16_sint16.All_Maps_GRP.Maps_Raster_3 "" VALUE 0x1D6F85 STANDARD_VALUE_S8 0.0 ident 0 1 BIT_MASK 0x1 /end CHARACTERISTIC
/begin CHARACTERISTIC P_Do_GET.GRP_sint32_sint32_sint32.All_Maps_GRP.Maps_Raster_3 "" VALUE 0x1D708D STANDARD_VALUE_U8 0.0 ident 0 1 BIT_MASK 0x1 /end CHARACTERISTIC
/begin CHARACTERISTIC P_Do_GET.GRP_sint8_sint8_sint8.All_Maps_GRP.Maps_Raster_3 "" VALUE 0x1D7281 STANDARD_VALUE_S8 0.0 ident 0 1 BIT_MASK 0x1 /end CHARACTERISTIC
/begin CHARACTERISTIC P_Do_GET.GRP_uint16_uint16_uint16.All_Maps_GRP.Maps_Raster_3 "" VALUE 0x1D730D STANDARD_VALUE_S8 0.0 ident 0 1 BIT_MASK 0x1 /end CHARACTERISTIC
/begin CHARACTERISTIC P_Do_GET.GRP_uint32_uint32_uint32.All_Maps_GRP.Maps_Raster_3 "" VALUE 0x1D7415 STANDARD_VALUE_S8 0.0 ident 0 1 BIT_MASK 0x1 /end CHARACTERISTIC
/begin CHARACTERISTIC P_Do_GET.GRP_uint8_uint8_uint8.All_Maps_GRP.Maps_Raster_3 "" VALUE 0x1D7609 STANDARD_VALUE_S8 0.0 ident 0 1 BIT_MASK 0x1 /end CHARACTERISTIC
/begin CHARACTERISTIC P_Do_X_SET.GRP_float32_float32_float32.All_Maps_GRP.Maps_Raster_3 "" VALUE 0x1D6D8E STANDARD_VALUE_S8 0.0 ident 0 1 BIT_MASK 0x1 /end CHARACTERISTIC
/begin CHARACTERISTIC P_Do_X_SET.GRP_sint16_sint16_sint16.All_Maps_GRP.Maps_Raster_3 "" VALUE 0x1D6F86 STANDARD_VALUE_S8 0.0 ident 0 1 BIT_MASK 0x1 /end CHARACTERISTIC
/begin CHARACTERISTIC P_Do_X_SET.GRP_sint32_sint32_sint32.All_Maps_GRP.Maps_Raster_3 "" VALUE 0x1D708E STANDARD_VALUE_U8 0.0 ident 0 1 BIT_MASK 0x1 /end CHARACTERISTIC
/begin CHARACTERISTIC P_Do_X_SET.GRP_sint8_sint8_sint8.All_Maps_GRP.Maps_Raster_3 "" VALUE 0x1D7282 STANDARD_VALUE_S8 0.0 ident 0 1 BIT_MASK 0x1 /end CHARACTERISTIC
/begin CHARACTERISTIC P_Do_X_SET.GRP_uint16_uint16_uint16.All_Maps_GRP.Maps_Raster_3 "" VALUE 0x1D730E STANDARD_VALUE_S8 0.0 ident 0 1 BIT_MASK 0x1 /end CHARACTERISTIC
/begin CHARACTERISTIC P_Do_X_SET.GRP_uint32_uint32_uint32.All_Maps_GRP.Maps_Raster_3 "" VALUE 0x1D7416 STANDARD_VALUE_S8 0.0 ident 0 1 BIT_MASK 0x1 /end CHARACTERISTIC
/begin CHARACTERISTIC P_Do_X_SET.GRP_uint8_uint8_uint8.All_Maps_GRP.Maps_Raster_3 "" VALUE 0x1D760A STANDARD_VALUE_S8 0.0 ident 0 1 BIT_MASK 0x1 /end CHARACTERISTIC
/begin CHARACTERISTIC P_Do_Y_SET.GRP_float32_float32_float32.All_Maps_GRP.Maps_Raster_3 "" VALUE 0x1D6D8F STANDARD_VALUE_S8 0.0 ident 0 1 BIT_MASK 0x1 /end CHARACTERISTIC
/begin CHARACTERISTIC P_Do_Y_SET.GRP_sint16_sint16_sint16.All_Maps_GRP.Maps_Raster_3 "" VALUE 0x1D6F87 STANDARD_VALUE_S8 0.0 ident 0 1 BIT_MASK 0x1 /end CHARACTERISTIC
/begin CHARACTERISTIC P_Do_Y_SET.GRP_sint32_sint32_sint32.All_Maps_GRP.Maps_Raster_3 "" VALUE 0x1D708F STANDARD_VALUE_U8 0.0 ident 0 1 BIT_MASK 0x1 /end CHARACTERISTIC
/begin CHARACTERISTIC P_Do_Y_SET.GRP_sint8_sint8_sint8.All_Maps_GRP.Maps_Raster_3 "" VALUE 0x1D7283 STANDARD_VALUE_S8 0.0 ident 0 1 BIT_MASK 0x1 /end CHARACTERISTIC
/begin CHARACTERISTIC P_Do_Y_SET.GRP_uint16_uint16_uint16.All_Maps_GRP.Maps_Raster_3 "" VALUE 0x1D730F STANDARD_VALUE_S8 0.0 ident 0 1 BIT_MASK 0x1 /end CHARACTERISTIC
/begin CHARACTERISTIC P_Do_Y_SET.GRP_uint32_uint32_uint32.All_Maps_GRP.Maps_Raster_3 "" VALUE 0x1D7417 STANDARD_VALUE_S8 0.0 ident 0 1 BIT_MASK 0x1 /end CHARACTERISTIC
/begin CHARACTERISTIC P_Do_Y_SET.GRP_uint8_uint8_uint8.All_Maps_GRP.Maps_Raster_3 "" VALUE 0x1D760B STANDARD_VALUE_S8 0.0 ident 0 1 BIT_MASK 0x1 /end CHARACTERISTIC
/begin CHARACTERISTIC P_In_X.GRP_float32_float32_float32.All_Maps_GRP.Maps_Raster_3 "" VALUE 0x1D6D84 STANDARD_VALUE_R32 0.0 ident -1.e+037 1.e+037 /end CHARACTERISTIC
/begin CHARACTERISTIC P_In_X.GRP_sint16_sint16_sint16.All_Maps_GRP.Maps_Raster_3 "" VALUE 0x1D6F80 STANDARD_VALUE_S16 0.0 ident -32768.0 32767.0 /end CHARACTERISTIC
/begin CHARACTERISTIC P_In_X.GRP_sint32_sint32_sint32.All_Maps_GRP.Maps_Raster_3 "" VALUE 0x1D7084 STANDARD_VALUE_S32 0.0 ident -2147483648.0 2147483647.0 /end CHARACTERISTIC
/begin CHARACTERISTIC P_In_X.GRP_sint8_sint8_sint8.All_Maps_GRP.Maps_Raster_3 "" VALUE 0x1D7284 STANDARD_VALUE_S8 0.0 ident -128.0 127.0 /end CHARACTERISTIC
/begin CHARACTERISTIC P_In_X.GRP_uint16_uint16_uint16.All_Maps_GRP.Maps_Raster_3 "" VALUE 0x1D7308 STANDARD_VALUE_U16 0.0 ident 0.0 65535.0 /end CHARACTERISTIC
/begin CHARACTERISTIC P_In_X.GRP_uint32_uint32_uint32.All_Maps_GRP.Maps_Raster_3 "" VALUE 0x1D740C STANDARD_VALUE_U32 0.0 ident 0.0 4294967295.0 /end CHARACTERISTIC
/begin CHARACTERISTIC P_In_X.GRP_uint8_uint8_uint8.All_Maps_GRP.Maps_Raster_3 "" VALUE 0x1D760C STANDARD_VALUE_U8 0.0 ident 0.0 255.0 /end CHARACTERISTIC
/begin CHARACTERISTIC P_In_X.STD_float32_float32_float32.All_Maps_STD.Maps_Raster_1 "" VALUE 0x1D4308 STANDARD_VALUE_R32 0.0 ident -1.e+037 1.e+037 /end CHARACTERISTIC
/begin CHARACTERISTIC P_In_X.STD_float32_float32_float32.All_Maps_STD.Maps_Raster_2 "" VALUE 0x1D5CCC STANDARD_VALUE_R32 0.0 ident -1.e+037 1.e+037 /end CHARACTERISTIC
/begin CHARACTERISTIC P_In_X.STD_float32_float32_float32.All_Maps_STD.Maps_Raster_3 "" VALUE 0x1D7690 STANDARD_VALUE_R32 0.0 ident -1.e+037 1.e+037 /end CHARACTERISTIC
/begin CHARACTERISTIC P_In_X.STD_sint16_sint16_sint16.All_Maps_STD.Maps_Raster_1 "" VALUE 0x1D44FC STANDARD_VALUE_S16 0.0 ident -32768.0 32767.0 /end CHARACTERISTIC
/begin CHARACTERISTIC P_In_X.STD_sint16_sint16_sint16.All_Maps_STD.Maps_Raster_2 "" VALUE 0x1D5EC0 STANDARD_VALUE_S16 0.0 ident -32768.0 32767.0 /end CHARACTERISTIC
/begin CHARACTERISTIC P_In_X.STD_sint16_sint16_sint16.All_Maps_STD.Maps_Raster_3 "" VALUE 0x1D7884 STANDARD_VALUE_S16 0.0 ident -32768.0 32767.0 /end CHARACTERISTIC
/begin CHARACTERISTIC P_In_X.STD_sint32_sint32_sint32.All_Maps_STD.Maps_Raster_1 "" VALUE 0x1D45FC STANDARD_VALUE_S32 0.0 ident -2147483648.0 2147483647.0 /end CHARACTERISTIC
/begin CHARACTERISTIC P_In_X.STD_sint32_sint32_sint32.All_Maps_STD.Maps_Raster_2 "" VALUE 0x1D5FC0 STANDARD_VALUE_S32 0.0 ident -2147483648.0 2147483647.0 /end CHARACTERISTIC
/begin CHARACTERISTIC P_In_X.STD_sint32_sint32_sint32.All_Maps_STD.Maps_Raster_3 "" VALUE 0x1D7984 STANDARD_VALUE_S32 0.0 ident -2147483648.0 2147483647.0 /end CHARACTERISTIC
/begin CHARACTERISTIC P_In_X.STD_sint8_sint8_sint8.All_Maps_STD.Maps_Raster_1 "" VALUE 0x1D47F1 STANDARD_VALUE_S8 0.0 ident -128.0 127.0 /end CHARACTERISTIC
/begin CHARACTERISTIC P_In_X.STD_sint8_sint8_sint8.All_Maps_STD.Maps_Raster_2 "" VALUE 0x1D61B5 STANDARD_VALUE_S8 0.0 ident -128.0 127.0 /end CHARACTERISTIC
/begin CHARACTERISTIC P_In_X.STD_sint8_sint8_sint8.All_Maps_STD.Maps_Raster_3 "" VALUE 0x1D7B79 STANDARD_VALUE_S8 0.0 ident -128.0 127.0 /end CHARACTERISTIC
/begin CHARACTERISTIC P_In_X.STD_uint16_uint16_uint16.All_Maps_STD.Maps_Raster_1 "" VALUE 0x1D4874 STANDARD_VALUE_U16 0.0 ident 0.0 65535.0 /end CHARACTERISTIC
/begin CHARACTERISTIC P_In_X.STD_uint16_uint16_uint16.All_Maps_STD.Maps_Raster_2 "" VALUE 0x1D6238 STANDARD_VALUE_U16 0.0 ident 0.0 65535.0 /end CHARACTERISTIC
/begin CHARACTERISTIC P_In_X.STD_uint16_uint16_uint16.All_Maps_STD.Maps_Raster_3 "" VALUE 0x1D7BFC STANDARD_VALUE_U16 0.0 ident 0.0 65535.0 /end CHARACTERISTIC
/begin CHARACTERISTIC P_In_X.STD_uint32_uint32_uint32.All_Maps_STD.Maps_Raster_1 "" VALUE 0x1D4974 STANDARD_VALUE_U32 0.0 ident 0.0 4294967295.0 /end CHARACTERISTIC
/begin CHARACTERISTIC P_In_X.STD_uint32_uint32_uint32.All_Maps_STD.Maps_Raster_2 "" VALUE 0x1D6338 STANDARD_VALUE_U32 0.0 ident 0.0 4294967295.0 /end CHARACTERISTIC
/begin CHARACTERISTIC P_In_X.STD_uint32_uint32_uint32.All_Maps_STD.Maps_Raster_3 "" VALUE 0x1D7CFC STANDARD_VALUE_U32 0.0 ident 0.0 4294967295.0 /end CHARACTERISTIC
/begin CHARACTERISTIC P_In_X.STD_uint8_uint8_uint8.All_Maps_STD.Maps_Raster_1 "" VALUE 0x1D4B69 STANDARD_VALUE_U8 0.0 ident 0.0 255.0 /end CHARACTERISTIC
/begin CHARACTERISTIC P_In_X.STD_uint8_uint8_uint8.All_Maps_STD.Maps_Raster_2 "" VALUE 0x1D652D STANDARD_VALUE_U8 0.0 ident 0.0 255.0 /end CHARACTERISTIC
/begin CHARACTERISTIC P_In_X.STD_uint8_uint8_uint8.All_Maps_STD.Maps_Raster_3 "" VALUE 0x1D7EF1 STANDARD_VALUE_U8 0.0 ident 0.0 255.0 /end CHARACTERISTIC
/begin CHARACTERISTIC P_In_Y.GRP_float32_float32_float32.All_Maps_GRP.Maps_Raster_3 "" VALUE 0x1D6D88 STANDARD_VALUE_R32 0.0 ident -1.e+037 1.e+037 /end CHARACTERISTIC
/begin CHARACTERISTIC P_In_Y.GRP_sint16_sint16_sint16.All_Maps_GRP.Maps_Raster_3 "" VALUE 0x1D6F82 STANDARD_VALUE_S16 0.0 ident -32768.0 32767.0 /end CHARACTERISTIC
/begin CHARACTERISTIC P_In_Y.GRP_sint32_sint32_sint32.All_Maps_GRP.Maps_Raster_3 "" VALUE 0x1D7088 STANDARD_VALUE_S32 0.0 ident -2147483648.0 2147483647.0 /end CHARACTERISTIC
/begin CHARACTERISTIC P_In_Y.GRP_sint8_sint8_sint8.All_Maps_GRP.Maps_Raster_3 "" VALUE 0x1D7285 STANDARD_VALUE_S8 0.0 ident -128.0 127.0 /end CHARACTERISTIC
/begin CHARACTERISTIC P_In_Y.GRP_uint16_uint16_uint16.All_Maps_GRP.Maps_Raster_3 "" VALUE 0x1D730A STANDARD_VALUE_U16 0.0 ident 0.0 65535.0 /end CHARACTERISTIC
/begin CHARACTERISTIC P_In_Y.GRP_uint32_uint32_uint32.All_Maps_GRP.Maps_Raster_3 "" VALUE 0x1D7410 STANDARD_VALUE_U32 0.0 ident 0.0 4294967295.0 /end CHARACTERISTIC
/begin CHARACTERISTIC P_In_Y.GRP_uint8_uint8_uint8.All_Maps_GRP.Maps_Raster_3 "" VALUE 0x1D760D STANDARD_VALUE_U8 0.0 ident 0.0 255.0 /end CHARACTERISTIC
/begin CHARACTERISTIC P_In_Y.STD_float32_float32_float32.All_Maps_STD.Maps_Raster_1 "" VALUE 0x1D430C STANDARD_VALUE_R32 0.0 ident -1.e+037 1.e+037 /end CHARACTERISTIC
/begin CHARACTERISTIC P_In_Y.STD_float32_float32_float32.All_Maps_STD.Maps_Raster_2 "" VALUE 0x1D5CD0 STANDARD_VALUE_R32 0.0 ident -1.e+037 1.e+037 /end CHARACTERISTIC
/begin CHARACTERISTIC P_In_Y.STD_float32_float32_float32.All_Maps_STD.Maps_Raster_3 "" VALUE 0x1D7694 STANDARD_VALUE_R32 0.0 ident -1.e+037 1.e+037 /end CHARACTERISTIC
/begin CHARACTERISTIC P_In_Y.STD_sint16_sint16_sint16.All_Maps_STD.Maps_Raster_1 "" VALUE 0x1D44FE STANDARD_VALUE_S16 0.0 ident -32768.0 32767.0 /end CHARACTERISTIC
/begin CHARACTERISTIC P_In_Y.STD_sint16_sint16_sint16.All_Maps_STD.Maps_Raster_2 "" VALUE 0x1D5EC2 STANDARD_VALUE_S16 0.0 ident -32768.0 32767.0 /end CHARACTERISTIC
/begin CHARACTERISTIC P_In_Y.STD_sint16_sint16_sint16.All_Maps_STD.Maps_Raster_3 "" VALUE 0x1D7886 STANDARD_VALUE_S16 0.0 ident -32768.0 32767.0 /end CHARACTERISTIC
/begin CHARACTERISTIC P_In_Y.STD_sint32_sint32_sint32.All_Maps_STD.Maps_Raster_1 "" VALUE 0x1D4600 STANDARD_VALUE_S32 0.0 ident -2147483648.0 2147483647.0 /end CHARACTERISTIC
/begin CHARACTERISTIC P_In_Y.STD_sint32_sint32_sint32.All_Maps_STD.Maps_Raster_2 "" VALUE 0x1D5FC4 STANDARD_VALUE_S32 0.0 ident -2147483648.0 2147483647.0 /end CHARACTERISTIC
/begin CHARACTERISTIC P_In_Y.STD_sint32_sint32_sint32.All_Maps_STD.Maps_Raster_3 "" VALUE 0x1D7988 STANDARD_VALUE_S32 0.0 ident -2147483648.0 2147483647.0 /end CHARACTERISTIC
/begin CHARACTERISTIC P_In_Y.STD_sint8_sint8_sint8.All_Maps_STD.Maps_Raster_1 "" VALUE 0x1D47F2 STANDARD_VALUE_S8 0.0 ident -128.0 127.0 /end CHARACTERISTIC
/begin CHARACTERISTIC P_In_Y.STD_sint8_sint8_sint8.All_Maps_STD.Maps_Raster_2 "" VALUE 0x1D61B6 STANDARD_VALUE_S8 0.0 ident -128.0 127.0 /end CHARACTERISTIC
/begin CHARACTERISTIC P_In_Y.STD_sint8_sint8_sint8.All_Maps_STD.Maps_Raster_3 "" VALUE 0x1D7B7A STANDARD_VALUE_S8 0.0 ident -128.0 127.0 /end CHARACTERISTIC
/begin CHARACTERISTIC P_In_Y.STD_uint16_uint16_uint16.All_Maps_STD.Maps_Raster_1 "" VALUE 0x1D4876 STANDARD_VALUE_U16 0.0 ident 0.0 65535.0 /end CHARACTERISTIC
/begin CHARACTERISTIC P_In_Y.STD_uint16_uint16_uint16.All_Maps_STD.Maps_Raster_2 "" VALUE 0x1D623A STANDARD_VALUE_U16 0.0 ident 0.0 65535.0 /end CHARACTERISTIC
/begin CHARACTERISTIC P_In_Y.STD_uint16_uint16_uint16.All_Maps_STD.Maps_Raster_3 "" VALUE 0x1D7BFE STANDARD_VALUE_U16 0.0 ident 0.0 65535.0 /end CHARACTERISTIC
/begin CHARACTERISTIC P_In_Y.STD_uint32_uint32_uint32.All_Maps_STD.Maps_Raster_1 "" VALUE 0x1D4978 STANDARD_VALUE_U32 0.0 ident 0.0 4294967295.0 /end CHARACTERISTIC
/begin CHARACTERISTIC P_In_Y.STD_uint32_uint32_uint32.All_Maps_STD.Maps_Raster_2 "" VALUE 0x1D633C STANDARD_VALUE_U32 0.0 ident 0.0 4294967295.0 /end CHARACTERISTIC
/begin CHARACTERISTIC P_In_Y.STD_uint32_uint32_uint32.All_Maps_STD.Maps_Raster_3 "" VALUE 0x1D7D00 STANDARD_VALUE_U32 0.0 ident 0.0 4294967295.0 /end CHARACTERISTIC
/begin CHARACTERISTIC P_In_Y.STD_uint8_uint8_uint8.All_Maps_STD.Maps_Raster_1 "" VALUE 0x1D4B6A STANDARD_VALUE_U8 0.0 ident 0.0 255.0 /end CHARACTERISTIC
/begin CHARACTERISTIC P_In_Y.STD_uint8_uint8_uint8.All_Maps_STD.Maps_Raster_2 "" VALUE 0x1D652E STANDARD_VALUE_U8 0.0 ident 0.0 255.0 /end CHARACTERISTIC
/begin CHARACTERISTIC P_In_Y.STD_uint8_uint8_uint8.All_Maps_STD.Maps_Raster_3 "" VALUE 0x1D7EF2 STANDARD_VALUE_U8 0.0 ident 0.0 255.0 /end CHARACTERISTIC
/begin CHARACTERISTIC P_Map_in_x.Axis_Input.CURVE_Axis "" VALUE 0x1D0056 STANDARD_VALUE_S16 0.0 ident -32768 32767 /end CHARACTERISTIC
/begin CHARACTERISTIC P_Map_in_y.Axis_Input.CURVE_Axis "" VALUE 0x1D0058 STANDARD_VALUE_S16 0.0 ident -32768 32767 /end CHARACTERISTIC
/begin CHARACTERISTIC Two_D.GRP_float32_float32_float32.All_Maps_GRP.Maps_Raster_3 "" MAP 0x1D6D90 STANDARD_GROUP_R32 0.0 ident -1.e+037 1.e+037
 /begin AXIS_DESCR COM_AXIS M_In_X.GRP_float32_float32_float32.All_Maps_GRP.Maps_Raster_3 ident 10 -1.e+037 1.e+037 AXIS_PTS_REF distrib_X.GRP_float32_float32_float32.All_Maps_GRP.Maps_Raster_3 /end AXIS_DESCR
 /begin AXIS_DESCR COM_AXIS M_In_Y.GRP_float32_float32_float32.All_Maps_GRP.Maps_Raster_3 ident 10 -1.e+037 1.e+037 AXIS_PTS_REF distrib_Y.GRP_float32_float32_float32.All_Maps_GRP.Maps_Raster_3 /end AXIS_DESCR
/end CHARACTERISTIC
/begin CHARACTERISTIC Two_D.GRP_sint16_sint16_sint16.All_Maps_GRP.Maps_Raster_3 "" MAP 0x1D6F88 STANDARD_GROUP_S16 0.0 ident -32768.0 32767.0
 /begin AXIS_DESCR COM_AXIS M_In_X.GRP_sint16_sint16_sint16.All_Maps_GRP.Maps_Raster_3 ident 10 -32768.0 32767.0 AXIS_PTS_REF distrib_X.GRP_sint16_sint16_sint16.All_Maps_GRP.Maps_Raster_3 /end AXIS_DESCR
 /begin AXIS_DESCR COM_AXIS M_In_Y.GRP_sint16_sint16_sint16.All_Maps_GRP.Maps_Raster_3 ident 10 -32768.0 32767.0 AXIS_PTS_REF distrib_Y.GRP_sint16_sint16_sint16.All_Maps_GRP.Maps_Raster_3 /end AXIS_DESCR
/end CHARACTERISTIC
/begin CHARACTERISTIC Two_D.GRP_sint32_sint32_sint32.All_Maps_GRP.Maps_Raster_3 "" MAP 0x1D7090 STANDARD_GROUP_S32 0.0 ident -2147483648.0 2147483647.0
 /begin AXIS_DESCR COM_AXIS M_In_X.GRP_sint32_sint32_sint32.All_Maps_GRP.Maps_Raster_3 ident 10 -2147483648.0 2147483647.0 AXIS_PTS_REF distrib_X.GRP_sint32_sint32_sint32.All_Maps_GRP.Maps_Raster_3 /end AXIS_DESCR
 /begin AXIS_DESCR COM_AXIS M_In_Y.GRP_sint32_sint32_sint32.All_Maps_GRP.Maps_Raster_3 ident 10 -2147483648.0 2147483647.0 AXIS_PTS_REF distrib_Y.GRP_sint32_sint32_sint32.All_Maps_GRP.Maps_Raster_3 /end AXIS_DESCR
/end CHARACTERISTIC
/begin CHARACTERISTIC Two_D.GRP_sint8_sint8_sint8.All_Maps_GRP.Maps_Raster_3 "" MAP 0x1D7286 STANDARD_GROUP_S8 0.0 ident -128.0 127.0
 /begin AXIS_DESCR COM_AXIS M_In_X.GRP_sint8_sint8_sint8.All_Maps_GRP.Maps_Raster_3 ident 10 -128.0 127.0 AXIS_PTS_REF distrib_X.GRP_sint8_sint8_sint8.All_Maps_GRP.Maps_Raster_3 /end AXIS_DESCR
 /begin AXIS_DESCR COM_AXIS M_In_Y.GRP_sint8_sint8_sint8.All_Maps_GRP.Maps_Raster_3 ident 10 -128.0 127.0 AXIS_PTS_REF distrib_Y.GRP_sint8_sint8_sint8.All_Maps_GRP.Maps_Raster_3 /end AXIS_DESCR
/end CHARACTERISTIC
/begin CHARACTERISTIC Two_D.GRP_uint16_uint16_uint16.All_Maps_GRP.Maps_Raster_3 "" MAP 0x1D7310 STANDARD_GROUP_U16 0.0 ident 0.0 65535.0
 /begin AXIS_DESCR COM_AXIS M_In_X.GRP_uint16_uint16_uint16.All_Maps_GRP.Maps_Raster_3 ident 10 0.0 65535.0 AXIS_PTS_REF distrib_X.GRP_uint16_uint16_uint16.All_Maps_GRP.Maps_Raster_3 /end AXIS_DESCR
 /begin AXIS_DESCR COM_AXIS M_In_Y.GRP_uint16_uint16_uint16.All_Maps_GRP.Maps_Raster_3 ident 10 0.0 65535.0 AXIS_PTS_REF distrib_Y.GRP_uint16_uint16_uint16.All_Maps_GRP.Maps_Raster_3 /end AXIS_DESCR
/end CHARACTERISTIC
/begin CHARACTERISTIC Two_D.GRP_uint32_uint32_uint32.All_Maps_GRP.Maps_Raster_3 "" MAP 0x1D7418 STANDARD_GROUP_U32 0.0 ident 0.0 4294967295.0
 /begin AXIS_DESCR COM_AXIS M_In_X.GRP_uint32_uint32_uint32.All_Maps_GRP.Maps_Raster_3 ident 10 0.0 4294967295.0 AXIS_PTS_REF distrib_X.GRP_uint32_uint32_uint32.All_Maps_GRP.Maps_Raster_3 /end AXIS_DESCR
 /begin AXIS_DESCR COM_AXIS M_In_Y.GRP_uint32_uint32_uint32.All_Maps_GRP.Maps_Raster_3 ident 10 0.0 4294967295.0 AXIS_PTS_REF distrib_Y.GRP_uint32_uint32_uint32.All_Maps_GRP.Maps_Raster_3 /end AXIS_DESCR
/end CHARACTERISTIC
/begin CHARACTERISTIC Two_D.GRP_uint8_uint8_uint8.All_Maps_GRP.Maps_Raster_3 "" MAP 0x1D760E STANDARD_GROUP_U8 0.0 ident 0.0 255.0
 /begin AXIS_DESCR COM_AXIS M_In_X.GRP_uint8_uint8_uint8.All_Maps_GRP.Maps_Raster_3 ident 10 0.0 255.0 AXIS_PTS_REF distrib_X.GRP_uint8_uint8_uint8.All_Maps_GRP.Maps_Raster_3 /end AXIS_DESCR
 /begin AXIS_DESCR COM_AXIS M_In_Y.GRP_uint8_uint8_uint8.All_Maps_GRP.Maps_Raster_3 ident 10 0.0 255.0 AXIS_PTS_REF distrib_Y.GRP_uint8_uint8_uint8.All_Maps_GRP.Maps_Raster_3 /end AXIS_DESCR
/end CHARACTERISTIC
/begin CHARACTERISTIC Two_D.STD_float32_float32_float32.All_Maps_STD.Maps_Raster_1 "" MAP 0x1D4314 STANDARD_MAP_R32R32R32 0.0 ident -1.e+037 1.e+037
 /begin AXIS_DESCR STD_AXIS M_In_X.STD_float32_float32_float32.All_Maps_STD.Maps_Raster_1 ident 10 -1.e+037 1.e+037 /end AXIS_DESCR
 /begin AXIS_DESCR STD_AXIS M_In_Y.STD_float32_float32_float32.All_Maps_STD.Maps_Raster_1 ident 10 -1.e+037 1.e+037 /end AXIS_DESCR
/end CHARACTERISTIC
/begin CHARACTERISTIC Two_D.STD_float32_float32_float32.All_Maps_STD.Maps_Raster_2 "" MAP 0x1D5CD8 STANDARD_MAP_R32R32R32 0.0 ident -1.e+037 1.e+037
 /begin AXIS_DESCR STD_AXIS M_In_X.STD_float32_float32_float32.All_Maps_STD.Maps_Raster_2 ident 10 -1.e+037 1.e+037 /end AXIS_DESCR
 /begin AXIS_DESCR STD_AXIS M_In_Y.STD_float32_float32_float32.All_Maps_STD.Maps_Raster_2 ident 10 -1.e+037 1.e+037 /end AXIS_DESCR
/end CHARACTERISTIC
/begin CHARACTERISTIC Two_D.STD_float32_float32_float32.All_Maps_STD.Maps_Raster_3 "" MAP 0x1D769C STANDARD_MAP_R32R32R32 0.0 ident -1.e+037 1.e+037
 /begin AXIS_DESCR STD_AXIS M_In_X.STD_float32_float32_float32.All_Maps_STD.Maps_Raster_3 ident 10 -1.e+037 1.e+037 /end AXIS_DESCR
 /begin AXIS_DESCR STD_AXIS M_In_Y.STD_float32_float32_float32.All_Maps_STD.Maps_Raster_3 ident 10 -1.e+037 1.e+037 /end AXIS_DESCR
/end CHARACTERISTIC
/begin CHARACTERISTIC Two_D.STD_sint16_sint16_sint16.All_Maps_STD.Maps_Raster_1 "" MAP 0x1D4502 STANDARD_MAP_S16S16S16 0.0 ident -32768.0 32767.0
 /begin AXIS_DESCR STD_AXIS M_In_X.STD_sint16_sint16_sint16.All_Maps_STD.Maps_Raster_1 ident 10 -32768.0 32767.0 /end AXIS_DESCR
 /begin AXIS_DESCR STD_AXIS M_In_Y.STD_sint16_sint16_sint16.All_Maps_STD.Maps_Raster_1 ident 10 -32768.0 32767.0 /end AXIS_DESCR
/end CHARACTERISTIC
/begin CHARACTERISTIC Two_D.STD_sint16_sint16_sint16.All_Maps_STD.Maps_Raster_2 "" MAP 0x1D5EC6 STANDARD_MAP_S16S16S16 0.0 ident -32768.0 32767.0
 /begin AXIS_DESCR STD_AXIS M_In_X.STD_sint16_sint16_sint16.All_Maps_STD.Maps_Raster_2 ident 10 -32768.0 32767.0 /end AXIS_DESCR
 /begin AXIS_DESCR STD_AXIS M_In_Y.STD_sint16_sint16_sint16.All_Maps_STD.Maps_Raster_2 ident 10 -32768.0 32767.0 /end AXIS_DESCR
/end CHARACTERISTIC
/begin CHARACTERISTIC Two_D.STD_sint16_sint16_sint16.All_Maps_STD.Maps_Raster_3 "" MAP 0x1D788A STANDARD_MAP_S16S16S16 0.0 ident -32768.0 32767.0
 /begin AXIS_DESCR STD_AXIS M_In_X.STD_sint16_sint16_sint16.All_Maps_STD.Maps_Raster_3 ident 10 -32768.0 32767.0 /end AXIS_DESCR
 /begin AXIS_DESCR STD_AXIS M_In_Y.STD_sint16_sint16_sint16.All_Maps_STD.Maps_Raster_3 ident 10 -32768.0 32767.0 /end AXIS_DESCR
/end CHARACTERISTIC
/begin CHARACTERISTIC Two_D.STD_sint32_sint32_sint32.All_Maps_STD.Maps_Raster_1 "" MAP 0x1D4608 STANDARD_MAP_S32S32S32 0.0 ident -2147483648.0 2147483647.0
 /begin AXIS_DESCR STD_AXIS M_In_X.STD_sint32_sint32_sint32.All_Maps_STD.Maps_Raster_1 ident 10 -2147483648.0 2147483647.0 /end AXIS_DESCR
 /begin AXIS_DESCR STD_AXIS M_In_Y.STD_sint32_sint32_sint32.All_Maps_STD.Maps_Raster_1 ident 10 -2147483648.0 2147483647.0 /end AXIS_DESCR
/end CHARACTERISTIC
/begin CHARACTERISTIC Two_D.STD_sint32_sint32_sint32.All_Maps_STD.Maps_Raster_2 "" MAP 0x1D5FCC STANDARD_MAP_S32S32S32 0.0 ident -2147483648.0 2147483647.0
 /begin AXIS_DESCR STD_AXIS M_In_X.STD_sint32_sint32_sint32.All_Maps_STD.Maps_Raster_2 ident 10 -2147483648.0 2147483647.0 /end AXIS_DESCR
 /begin AXIS_DESCR STD_AXIS M_In_Y.STD_sint32_sint32_sint32.All_Maps_STD.Maps_Raster_2 ident 10 -2147483648.0 2147483647.0 /end AXIS_DESCR
/end CHARACTERISTIC
/begin CHARACTERISTIC Two_D.STD_sint32_sint32_sint32.All_Maps_STD.Maps_Raster_3 "" MAP 0x1D7990 STANDARD_MAP_S32S32S32 0.0 ident -2147483648.0 2147483647.0
 /begin AXIS_DESCR STD_AXIS M_In_X.STD_sint32_sint32_sint32.All_Maps_STD.Maps_Raster_3 ident 10 -2147483648.0 2147483647.0 /end AXIS_DESCR
 /begin AXIS_DESCR STD_AXIS M_In_Y.STD_sint32_sint32_sint32.All_Maps_STD.Maps_Raster_3 ident 10 -2147483648.0 2147483647.0 /end AXIS_DESCR
/end CHARACTERISTIC
/begin CHARACTERISTIC Two_D.STD_sint8_sint8_sint8.All_Maps_STD.Maps_Raster_1 "" MAP 0x1D47F3 STANDARD_MAP_S8S8S8 0.0 ident -128.0 127.0
 /begin AXIS_DESCR STD_AXIS M_In_X.STD_sint8_sint8_sint8.All_Maps_STD.Maps_Raster_1 ident 10 -128.0 127.0 /end AXIS_DESCR
 /begin AXIS_DESCR STD_AXIS M_In_Y.STD_sint8_sint8_sint8.All_Maps_STD.Maps_Raster_1 ident 10 -128.0 127.0 /end AXIS_DESCR
/end CHARACTERISTIC
/begin CHARACTERISTIC Two_D.STD_sint8_sint8_sint8.All_Maps_STD.Maps_Raster_2 "" MAP 0x1D61B7 STANDARD_MAP_S8S8S8 0.0 ident -128.0 127.0
 /begin AXIS_DESCR STD_AXIS M_In_X.STD_sint8_sint8_sint8.All_Maps_STD.Maps_Raster_2 ident 10 -128.0 127.0 /end AXIS_DESCR
 /begin AXIS_DESCR STD_AXIS M_In_Y.STD_sint8_sint8_sint8.All_Maps_STD.Maps_Raster_2 ident 10 -128.0 127.0 /end AXIS_DESCR
/end CHARACTERISTIC
/begin CHARACTERISTIC Two_D.STD_sint8_sint8_sint8.All_Maps_STD.Maps_Raster_3 "" MAP 0x1D7B7B STANDARD_MAP_S8S8S8 0.0 ident -128.0 127.0
 /begin AXIS_DESCR STD_AXIS M_In_X.STD_sint8_sint8_sint8.All_Maps_STD.Maps_Raster_3 ident 10 -128.0 127.0 /end AXIS_DESCR
 /begin AXIS_DESCR STD_AXIS M_In_Y.STD_sint8_sint8_sint8.All_Maps_STD.Maps_Raster_3 ident 10 -128.0 127.0 /end AXIS_DESCR
/end CHARACTERISTIC
/begin CHARACTERISTIC Two_D.STD_uint16_uint16_uint16.All_Maps_STD.Maps_Raster_1 "" MAP 0x1D487A STANDARD_MAP_U16U16U16 0.0 ident 0.0 65535.0
 /begin AXIS_DESCR STD_AXIS M_In_X.STD_uint16_uint16_uint16.All_Maps_STD.Maps_Raster_1 ident 10 0.0 65535.0 /end AXIS_DESCR
 /begin AXIS_DESCR STD_AXIS M_In_Y.STD_uint16_uint16_uint16.All_Maps_STD.Maps_Raster_1 ident 10 0.0 65535.0 /end AXIS_DESCR
/end CHARACTERISTIC
/begin CHARACTERISTIC Two_D.STD_uint16_uint16_uint16.All_Maps_STD.Maps_Raster_2 "" MAP 0x1D623E STANDARD_MAP_U16U16U16 0.0 ident 0.0 65535.0
 /begin AXIS_DESCR STD_AXIS M_In_X.STD_uint16_uint16_uint16.All_Maps_STD.Maps_Raster_2 ident 10 0.0 65535.0 /end AXIS_DESCR
 /begin AXIS_DESCR STD_AXIS M_In_Y.STD_uint16_uint16_uint16.All_Maps_STD.Maps_Raster_2 ident 10 0.0 65535.0 /end AXIS_DESCR
/end CHARACTERISTIC
/begin CHARACTERISTIC Two_D.STD_uint16_uint16_uint16.All_Maps_STD.Maps_Raster_3 "" MAP 0x1D7C02 STANDARD_MAP_U16U16U16 0.0 ident 0.0 65535.0
 /begin AXIS_DESCR STD_AXIS M_In_X.STD_uint16_uint16_uint16.All_Maps_STD.Maps_Raster_3 ident 10 0.0 65535.0 /end AXIS_DESCR
 /begin AXIS_DESCR STD_AXIS M_In_Y.STD_uint16_uint16_uint16.All_Maps_STD.Maps_Raster_3 ident 10 0.0 65535.0 /end AXIS_DESCR
/end CHARACTERISTIC
/begin CHARACTERISTIC Two_D.STD_uint32_uint32_uint32.All_Maps_STD.Maps_Raster_1 "" MAP 0x1D4980 STANDARD_MAP_U32U32U32 0.0 ident 0.0 4294967295.0
 /begin AXIS_DESCR STD_AXIS M_In_X.STD_uint32_uint32_uint32.All_Maps_STD.Maps_Raster_1 ident 10 0.0 4294967295.0 /end AXIS_DESCR
 /begin AXIS_DESCR STD_AXIS M_In_Y.STD_uint32_uint32_uint32.All_Maps_STD.Maps_Raster_1 ident 10 0.0 4294967295.0 /end AXIS_DESCR
/end CHARACTERISTIC
/begin CHARACTERISTIC Two_D.STD_uint32_uint32_uint32.All_Maps_STD.Maps_Raster_2 "" MAP 0x1D6344 STANDARD_MAP_U32U32U32 0.0 ident 0.0 4294967295.0
 /begin AXIS_DESCR STD_AXIS M_In_X.STD_uint32_uint32_uint32.All_Maps_STD.Maps_Raster_2 ident 10 0.0 4294967295.0 /end AXIS_DESCR
 /begin AXIS_DESCR STD_AXIS M_In_Y.STD_uint32_uint32_uint32.All_Maps_STD.Maps_Raster_2 ident 10 0.0 4294967295.0 /end AXIS_DESCR
/end CHARACTERISTIC
/begin CHARACTERISTIC Two_D.STD_uint32_uint32_uint32.All_Maps_STD.Maps_Raster_3 "" MAP 0x1D7D08 STANDARD_MAP_U32U32U32 0.0 ident 0.0 4294967295.0
 /begin AXIS_DESCR STD_AXIS M_In_X.STD_uint32_uint32_uint32.All_Maps_STD.Maps_Raster_3 ident 10 0.0 4294967295.0 /end AXIS_DESCR
 /begin AXIS_DESCR STD_AXIS M_In_Y.STD_uint32_uint32_uint32.All_Maps_STD.Maps_Raster_3 ident 10 0.0 4294967295.0 /end AXIS_DESCR
/end CHARACTERISTIC
/begin CHARACTERISTIC Two_D.STD_uint8_uint8_uint8.All_Maps_STD.Maps_Raster_1 "" MAP 0x1D4B6B STANDARD_MAP_U8U8U8 0.0 ident 0.0 255.0
 /begin AXIS_DESCR STD_AXIS M_In_X.STD_uint8_uint8_uint8.All_Maps_STD.Maps_Raster_1 ident 10 0.0 255.0 /end AXIS_DESCR
 /begin AXIS_DESCR STD_AXIS M_In_Y.STD_uint8_uint8_uint8.All_Maps_STD.Maps_Raster_1 ident 10 0.0 255.0 /end AXIS_DESCR
/end CHARACTERISTIC
/begin CHARACTERISTIC Two_D.STD_uint8_uint8_uint8.All_Maps_STD.Maps_Raster_2 "" MAP 0x1D652F STANDARD_MAP_U8U8U8 0.0 ident 0.0 255.0
 /begin AXIS_DESCR STD_AXIS M_In_X.STD_uint8_uint8_uint8.All_Maps_STD.Maps_Raster_2 ident 10 0.0 255.0 /end AXIS_DESCR
 /begin AXIS_DESCR STD_AXIS M_In_Y.STD_uint8_uint8_uint8.All_Maps_STD.Maps_Raster_2 ident 10 0.0 255.0 /end AXIS_DESCR
/end CHARACTERISTIC
/begin CHARACTERISTIC Two_D.STD_uint8_uint8_uint8.All_Maps_STD.Maps_Raster_3 "" MAP 0x1D7EF3 STANDARD_MAP_U8U8U8 0.0 ident 0.0 255.0
 /begin AXIS_DESCR STD_AXIS M_In_X.STD_uint8_uint8_uint8.All_Maps_STD.Maps_Raster_3 ident 10 0.0 255.0 /end AXIS_DESCR
 /begin AXIS_DESCR STD_AXIS M_In_Y.STD_uint8_uint8_uint8.All_Maps_STD.Maps_Raster_3 ident 10 0.0 255.0 /end AXIS_DESCR
/end CHARACTERISTIC
/begin AXIS_PTS distrib_X.GRP_float32_float32_float32.All_Maps_GRP.Maps_Raster_3 "" 0x1D6F20 M_In_X.GRP_float32_float32_float32.All_Maps_GRP.Maps_Raster_3 STANDARD_DIST_R32 0.0 ident 10 -1.e+037 1.e+037 /end AXIS_PTS
/begin AXIS_PTS distrib_X.GRP_sint16_sint16_sint16.All_Maps_GRP.Maps_Raster_3 "" 0x1D7050 M_In_X.GRP_sint16_sint16_sint16.All_Maps_GRP.Maps_Raster_3 STANDARD_DIST_S16 0.0 ident 10 -32768.0 32767.0 /end AXIS_PTS
/begin AXIS_PTS distrib_X.GRP_sint32_sint32_sint32.All_Maps_GRP.Maps_Raster_3 "" 0x1D7220 M_In_X.GRP_sint32_sint32_sint32.All_Maps_GRP.Maps_Raster_3 STANDARD_DIST_S32 0.0 ident 10 -2147483648.0 2147483647.0 /end AXIS_PTS
/begin AXIS_PTS distrib_X.GRP_sint8_sint8_sint8.All_Maps_GRP.Maps_Raster_3 "" 0x1D72EA M_In_X.GRP_sint8_sint8_sint8.All_Maps_GRP.Maps_Raster_3 STANDARD_DIST_S8 0.0 ident 10 -128.0 127.0 /end AXIS_PTS
/begin AXIS_PTS distrib_X.GRP_uint16_uint16_uint16.All_Maps_GRP.Maps_Raster_3 "" 0x1D73D8 M_In_X.GRP_uint16_uint16_uint16.All_Maps_GRP.Maps_Raster_3 STANDARD_DIST_U16 0.0 ident 10 0.0 65535.0 /end AXIS_PTS
/begin AXIS_PTS distrib_X.GRP_uint32_uint32_uint32.All_Maps_GRP.Maps_Raster_3 "" 0x1D75A8 M_In_X.GRP_uint32_uint32_uint32.All_Maps_GRP.Maps_Raster_3 STANDARD_DIST_U32 0.0 ident 10 0.0 4294967295.0 /end AXIS_PTS
/begin AXIS_PTS distrib_X.GRP_uint8_uint8_uint8.All_Maps_GRP.Maps_Raster_3 "" 0x1D7672 M_In_X.GRP_uint8_uint8_uint8.All_Maps_GRP.Maps_Raster_3 STANDARD_DIST_U8 0.0 ident 10 0.0 255.0 /end AXIS_PTS
/begin AXIS_PTS distrib_Y.GRP_float32_float32_float32.All_Maps_GRP.Maps_Raster_3 "" 0x1D6F4C M_In_Y.GRP_float32_float32_float32.All_Maps_GRP.Maps_Raster_3 STANDARD_DIST_R32 0.0 ident 10 -1.e+037 1.e+037 /end AXIS_PTS
/begin AXIS_PTS distrib_Y.GRP_sint16_sint16_sint16.All_Maps_GRP.Maps_Raster_3 "" 0x1D7066 M_In_Y.GRP_sint16_sint16_sint16.All_Maps_GRP.Maps_Raster_3 STANDARD_DIST_S16 0.0 ident 10 -32768.0 32767.0 /end AXIS_PTS
/begin AXIS_PTS distrib_Y.GRP_sint32_sint32_sint32.All_Maps_GRP.Maps_Raster_3 "" 0x1D724C M_In_Y.GRP_sint32_sint32_sint32.All_Maps_GRP.Maps_Raster_3 STANDARD_DIST_S32 0.0 ident 10 -2147483648.0 2147483647.0 /end AXIS_PTS
/begin AXIS_PTS distrib_Y.GRP_sint8_sint8_sint8.All_Maps_GRP.Maps_Raster_3 "" 0x1D72F5 M_In_Y.GRP_sint8_sint8_sint8.All_Maps_GRP.Maps_Raster_3 STANDARD_DIST_S8 0.0 ident 10 -128.0 127.0 /end AXIS_PTS
/begin AXIS_PTS distrib_Y.GRP_uint16_uint16_uint16.All_Maps_GRP.Maps_Raster_3 "" 0x1D73EE M_In_Y.GRP_uint16_uint16_uint16.All_Maps_GRP.Maps_Raster_3 STANDARD_DIST_U16 0.0 ident 10 0.0 65535.0 /end AXIS_PTS
/begin AXIS_PTS distrib_Y.GRP_uint32_uint32_uint32.All_Maps_GRP.Maps_Raster_3 "" 0x1D75D4 M_In_Y.GRP_uint32_uint32_uint32.All_Maps_GRP.Maps_Raster_3 STANDARD_DIST_U32 0.0 ident 10 0.0 4294967295.0 /end AXIS_PTS
/begin AXIS_PTS distrib_Y.GRP_uint8_uint8_uint8.All_Maps_GRP.Maps_Raster_3 "" 0x1D767D M_In_Y.GRP_uint8_uint8_uint8.All_Maps_GRP.Maps_Raster_3 STANDARD_DIST_U8 0.0 ident 10 0.0 255.0 /end AXIS_PTS
/begin MEASUREMENT Calculated.GRP_float32_float32_float32.All_Maps_GRP.Maps_Raster_3 "" SBYTE ident 1 100 0 1 BIT_MASK 0x1 ECU_ADDRESS 0x7F8BD0 /end MEASUREMENT
/begin MEASUREMENT Calculated.GRP_sint16_sint16_sint16.All_Maps_GRP.Maps_Raster_3 "" UBYTE ident 1 100 0 1 BIT_MASK 0x1 ECU_ADDRESS 0x7F8BDA /end MEASUREMENT
/begin MEASUREMENT Calculated.GRP_sint32_sint32_sint32.All_Maps_GRP.Maps_Raster_3 "" UBYTE ident 1 100 0 1 BIT_MASK 0x1 ECU_ADDRESS 0x7F8BE8 /end MEASUREMENT
/begin MEASUREMENT Calculated.GRP_sint8_sint8_sint8.All_Maps_GRP.Maps_Raster_3 "" UBYTE ident 1 100 0 1 BIT_MASK 0x1 ECU_ADDRESS 0x7F8BEC /end MEASUREMENT
/begin MEASUREMENT Calculated.GRP_uint16_uint16_uint16.All_Maps_GRP.Maps_Raster_3 "" UBYTE ident 1 100 0 1 BIT_MASK 0x1 ECU_ADDRESS 0x7F8BF6 /end MEASUREMENT
/begin MEASUREMENT Calculated.GRP_uint32_uint32_uint32.All_Maps_GRP.Maps_Raster_3 "" UBYTE ident 1 100 0 1 BIT_MASK 0x1 ECU_ADDRESS 0x7F8C04 /end MEASUREMENT
/begin MEASUREMENT Calculated.GRP_uint8_uint8_uint8.All_Maps_GRP.Maps_Raster_3 "" UBYTE ident 1 100 0 1 BIT_MASK 0x1 ECU_ADDRESS 0x7F8C08 /end MEASUREMENT
/begin MEASUREMENT Calculated.STD_float32_float32_float32.All_Maps_STD.Maps_Raster_1 "" UBYTE ident 1 100 0 1 BIT_MASK 0x1 ECU_ADDRESS 0x7F8A68 /end MEASUREMENT
/begin MEASUREMENT Calculated.STD_float32_float32_float32.All_Maps_STD.Maps_Raster_2 "" UBYTE ident 1 100 0 1 BIT_MASK 0x1 ECU_ADDRESS 0x7F8B40 /end MEASUREMENT
/begin MEASUREMENT Calculated.STD_float32_float32_float32.All_Maps_STD.Maps_Raster_3 "" UBYTE ident 1 100 0 1 BIT_MASK 0x1 ECU_ADDRESS 0x7F8C18 /end MEASUREMENT
/begin MEASUREMENT Calculated.STD_sint16_sint16_sint16.All_Maps_STD.Maps_Raster_1 "" UBYTE ident 1 100 0 1 BIT_MASK 0x1 ECU_ADDRESS 0x7F8A72 /end MEASUREMENT
/begin MEASUREMENT Calculated.STD_sint16_sint16_sint16.All_Maps_STD.Maps_Raster_2 "" UBYTE ident 1 100 0 1 BIT_MASK 0x1 ECU_ADDRESS 0x7F8B4A /end MEASUREMENT
/begin MEASUREMENT Calculated.STD_sint16_sint16_sint16.All_Maps_STD.Maps_Raster_3 "" UBYTE ident 1 100 0 1 BIT_MASK 0x1 ECU_ADDRESS 0x7F8C22 /end MEASUREMENT
/begin MEASUREMENT Calculated.STD_sint32_sint32_sint32.All_Maps_STD.Maps_Raster_1 "" UBYTE ident 1 100 0 1 BIT_MASK 0x1 ECU_ADDRESS 0x7F8A80 /end MEASUREMENT
/begin MEASUREMENT Calculated.STD_sint32_sint32_sint32.All_Maps_STD.Maps_Raster_2 "" UBYTE ident 1 100 0 1 BIT_MASK 0x1 ECU_ADDRESS 0x7F8B58 /end MEASUREMENT
/begin MEASUREMENT Calculated.STD_sint32_sint32_sint32.All_Maps_STD.Maps_Raster_3 "" UBYTE ident 1 100 0 1 BIT_MASK 0x1 ECU_ADDRESS 0x7F8C30 /end MEASUREMENT
/begin MEASUREMENT Calculated.STD_sint8_sint8_sint8.All_Maps_STD.Maps_Raster_1 "" UBYTE ident 1 100 0 1 BIT_MASK 0x1 ECU_ADDRESS 0x7F8A84 /end MEASUREMENT
/begin MEASUREMENT Calculated.STD_sint8_sint8_sint8.All_Maps_STD.Maps_Raster_2 "" UBYTE ident 1 100 0 1 BIT_MASK 0x1 ECU_ADDRESS 0x7F8B5C /end MEASUREMENT
/begin MEASUREMENT Calculated.STD_sint8_sint8_sint8.All_Maps_STD.Maps_Raster_3 "" UBYTE ident 1 100 0 1 BIT_MASK 0x1 ECU_ADDRESS 0x7F8C34 /end MEASUREMENT
/begin MEASUREMENT Calculated.STD_uint16_uint16_uint16.All_Maps_STD.Maps_Raster_1 "" UBYTE ident 1 100 0 1 BIT_MASK 0x1 ECU_ADDRESS 0x7F8A8E /end MEASUREMENT
/begin MEASUREMENT Calculated.STD_uint16_uint16_uint16.All_Maps_STD.Maps_Raster_2 "" UBYTE ident 1 100 0 1 BIT_MASK 0x1 ECU_ADDRESS 0x7F8B66 /end MEASUREMENT
/begin MEASUREMENT Calculated.STD_uint16_uint16_uint16.All_Maps_STD.Maps_Raster_3 "" UBYTE ident 1 100 0 1 BIT_MASK 0x1 ECU_ADDRESS 0x7F8C3E /end MEASUREMENT
/begin MEASUREMENT Calculated.STD_uint32_uint32_uint32.All_Maps_STD.Maps_Raster_1 "" UBYTE ident 1 100 0 1 BIT_MASK 0x1 ECU_ADDRESS 0x7F8A9C /end MEASUREMENT
/begin MEASUREMENT Calculated.STD_uint32_uint32_uint32.All_Maps_STD.Maps_Raster_2 "" UBYTE ident 1 100 0 1 BIT_MASK 0x1 ECU_ADDRESS 0x7F8B74 /end MEASUREMENT
/begin MEASUREMENT Calculated.STD_uint32_uint32_uint32.All_Maps_STD.Maps_Raster_3 "" UBYTE ident 1 100 0 1 BIT_MASK 0x1 ECU_ADDRESS 0x7F8C4C /end MEASUREMENT
/begin MEASUREMENT Calculated.STD_uint8_uint8_uint8.All_Maps_STD.Maps_Raster_1 "" UBYTE ident 1 100 0 1 BIT_MASK 0x1 ECU_ADDRESS 0x7F8AA0 /end MEASUREMENT
/begin MEASUREMENT Calculated.STD_uint8_uint8_uint8.All_Maps_STD.Maps_Raster_2 "" UBYTE ident 1 100 0 1 BIT_MASK 0x1 ECU_ADDRESS 0x7F8B78 /end MEASUREMENT
/begin MEASUREMENT Calculated.STD_uint8_uint8_uint8.All_Maps_STD.Maps_Raster_3 "" UBYTE ident 1 100 0 1 BIT_MASK 0x1 ECU_ADDRESS 0x7F8C50 /end MEASUREMENT
/begin MEASUREMENT M_Curve_in_x.Axis_Input.CURVE_Axis "" UWORD ident 1 100 0 65535 ECU_ADDRESS 0x7FB308 /end MEASUREMENT
/begin MEASUREMENT M_In_X.GRP_float32_float32_float32.All_Maps_GRP.Maps_Raster_3 "" FLOAT32_IEEE ident 1 100 -1.e+037 1.e+037 ECU_ADDRESS 0x7F8BC4 /end MEASUREMENT
/begin MEASUREMENT M_In_X.GRP_sint16_sint16_sint16.All_Maps_GRP.Maps_Raster_3 "" SWORD ident 1 100 -32768.0 32767.0 ECU_ADDRESS 0x7F8BD4 /end MEASUREMENT
/begin MEASUREMENT M_In_X.GRP_sint32_sint32_sint32.All_Maps_GRP.Maps_Raster_3 "" SLONG ident 1 100 -2147483648.0 2147483647.0 ECU_ADDRESS 0x7F8BDC /end MEASUREMENT
/begin MEASUREMENT M_In_X.GRP_sint8_sint8_sint8.All_Maps_GRP.Maps_Raster_3 "" SBYTE ident 1 100 -128.0 127.0 ECU_ADDRESS 0x7F8BED /end MEASUREMENT
/begin MEASUREMENT M_In_X.GRP_uint16_uint16_uint16.All_Maps_GRP.Maps_Raster_3 "" UWORD ident 1 100 0.0 65535.0 ECU_ADDRESS 0x7F8BF0 /end MEASUREMENT
/begin MEASUREMENT M_In_X.GRP_uint32_uint32_uint32.All_Maps_GRP.Maps_Raster_3 "" ULONG ident 1 100 0.0 4294967295.0 ECU_ADDRESS 0x7F8BF8 /end MEASUREMENT
/begin MEASUREMENT M_In_X.GRP_uint8_uint8_uint8.All_Maps_GRP.Maps_Raster_3 "" UBYTE ident 1 100 0.0 255.0 ECU_ADDRESS 0x7F8C09 /end MEASUREMENT
/begin MEASUREMENT M_In_X.STD_float32_float32_float32.All_Maps_STD.Maps_Raster_1 "" FLOAT32_IEEE ident 1 100 -1.e+037 1.e+037 ECU_ADDRESS 0x7F8A5C /end MEASUREMENT
/begin MEASUREMENT M_In_X.STD_float32_float32_float32.All_Maps_STD.Maps_Raster_2 "" FLOAT32_IEEE ident 1 100 -1.e+037 1.e+037 ECU_ADDRESS 0x7F8B34 /end MEASUREMENT
/begin MEASUREMENT M_In_X.STD_float32_float32_float32.All_Maps_STD.Maps_Raster_3 "" FLOAT32_IEEE ident 1 100 -1.e+037 1.e+037 ECU_ADDRESS 0x7F8C0C /end MEASUREMENT
/begin MEASUREMENT M_In_X.STD_sint16_sint16_sint16.All_Maps_STD.Maps_Raster_1 "" SWORD ident 1 100 -32768.0 32767.0 ECU_ADDRESS 0x7F8A6C /end MEASUREMENT
/begin MEASUREMENT M_In_X.STD_sint16_sint16_sint16.All_Maps_STD.Maps_Raster_2 "" SWORD ident 1 100 -32768.0 32767.0 ECU_ADDRESS 0x7F8B44 /end MEASUREMENT
/begin MEASUREMENT M_In_X.STD_sint16_sint16_sint16.All_Maps_STD.Maps_Raster_3 "" SWORD ident 1 100 -32768.0 32767.0 ECU_ADDRESS 0x7F8C1C /end MEASUREMENT
/begin MEASUREMENT M_In_X.STD_sint32_sint32_sint32.All_Maps_STD.Maps_Raster_1 "" SLONG ident 1 100 -2147483648.0 2147483647.0 ECU_ADDRESS 0x7F8A74 /end MEASUREMENT
/begin MEASUREMENT M_In_X.STD_sint32_sint32_sint32.All_Maps_STD.Maps_Raster_2 "" SLONG ident 1 100 -2147483648.0 2147483647.0 ECU_ADDRESS 0x7F8B4C /end MEASUREMENT
/begin MEASUREMENT M_In_X.STD_sint32_sint32_sint32.All_Maps_STD.Maps_Raster_3 "" SLONG ident 1 100 -2147483648.0 2147483647.0 ECU_ADDRESS 0x7F8C24 /end MEASUREMENT
/begin MEASUREMENT M_In_X.STD_sint8_sint8_sint8.All_Maps_STD.Maps_Raster_1 "" SBYTE ident 1 100 -128.0 127.0 ECU_ADDRESS 0x7F8A85 /end MEASUREMENT
/begin MEASUREMENT M_In_X.STD_sint8_sint8_sint8.All_Maps_STD.Maps_Raster_2 "" SBYTE ident 1 100 -128.0 127.0 ECU_ADDRESS 0x7F8B5D /end MEASUREMENT
/begin MEASUREMENT M_In_X.STD_sint8_sint8_sint8.All_Maps_STD.Maps_Raster_3 "" SBYTE ident 1 100 -128.0 127.0 ECU_ADDRESS 0x7F8C35 /end MEASUREMENT
/begin MEASUREMENT M_In_X.STD_uint16_uint16_uint16.All_Maps_STD.Maps_Raster_1 "" UWORD ident 1 100 0.0 65535.0 ECU_ADDRESS 0x7F8A88 /end MEASUREMENT
/begin MEASUREMENT M_In_X.STD_uint16_uint16_uint16.All_Maps_STD.Maps_Raster_2 "" UWORD ident 1 100 0.0 65535.0 ECU_ADDRESS 0x7F8B60 /end MEASUREMENT
/begin MEASUREMENT M_In_X.STD_uint16_uint16_uint16.All_Maps_STD.Maps_Raster_3 "" UWORD ident 1 100 0.0 65535.0 ECU_ADDRESS 0x7F8C38 /end MEASUREMENT
/begin MEASUREMENT M_In_X.STD_uint32_uint32_uint32.All_Maps_STD.Maps_Raster_1 "" ULONG ident 1 100 0.0 4294967295.0 ECU_ADDRESS 0x7F8A90 /end MEASUREMENT
/begin MEASUREMENT M_In_X.STD_uint32_uint32_uint32.All_Maps_STD.Maps_Raster_2 "" ULONG ident 1 100 0.0 4294967295.0 ECU_ADDRESS 0x7F8B68 /end MEASUREMENT
/begin MEASUREMENT M_In_X.STD_uint32_uint32_uint32.All_Maps_STD.Maps_Raster_3 "" ULONG ident 1 100 0.0 4294967295.0 ECU_ADDRESS 0x7F8C40 /end MEASUREMENT
/begin MEASUREMENT M_In_X.STD_uint8_uint8_uint8.All_Maps_STD.Maps_Raster_1 "" UBYTE ident 1 100 0.0 255.0 ECU_ADDRESS 0x7F8AA1 /end MEASUREMENT
/begin MEASUREMENT M_In_X.STD_uint8_uint8_uint8.All_Maps_STD.Maps_Raster_2 "" UBYTE ident 1 100 0.0 255.0 ECU_ADDRESS 0x7F8B79 /end MEASUREMENT
/begin MEASUREMENT M_In_X.STD_uint8_uint8_uint8.All_Maps_STD.Maps_Raster_3 "" UBYTE ident 1 100 0.0 255.0 ECU_ADDRESS 0x7F8C51 /end MEASUREMENT
/begin MEASUREMENT M_In_Y.GRP_float32_float32_float32.All_Maps_GRP.Maps_Raster_3 "" FLOAT32_IEEE ident 1 100 -1.e+037 1.e+037 ECU_ADDRESS 0x7F8BC8 /end MEASUREMENT
/begin MEASUREMENT M_In_Y.GRP_sint16_sint16_sint16.All_Maps_GRP.Maps_Raster_3 "" SWORD ident 1 100 -32768.0 32767.0 ECU_ADDRESS 0x7F8BD6 /end MEASUREMENT
/begin MEASUREMENT M_In_Y.GRP_sint32_sint32_sint32.All_Maps_GRP.Maps_Raster_3 "" SLONG ident 1 100 -2147483648.0 2147483647.0 ECU_ADDRESS 0x7F8BE0 /end MEASUREMENT
/begin MEASUREMENT M_In_Y.GRP_sint8_sint8_sint8.All_Maps_GRP.Maps_Raster_3 "" SBYTE ident 1 100 -128.0 127.0 ECU_ADDRESS 0x7F8BEE /end MEASUREMENT
/begin MEASUREMENT M_In_Y.GRP_uint16_uint16_uint16.All_Maps_GRP.Maps_Raster_3 "" UWORD ident 1 100 0.0 65535.0 ECU_ADDRESS 0x7F8BF2 /end MEASUREMENT
/begin MEASUREMENT M_In_Y.GRP_uint32_uint32_uint32.All_Maps_GRP.Maps_Raster_3 "" ULONG ident 1 100 0.0 4294967295.0 ECU_ADDRESS 0x7F8BFC /end MEASUREMENT
/begin MEASUREMENT M_In_Y.GRP_uint8_uint8_uint8.All_Maps_GRP.Maps_Raster_3 "" UBYTE ident 1 100 0.0 255.0 ECU_ADDRESS 0x7F8C0A /end MEASUREMENT
/begin MEASUREMENT M_In_Y.STD_float32_float32_float32.All_Maps_STD.Maps_Raster_1 "" FLOAT32_IEEE ident 1 100 -1.e+037 1.e+037 ECU_ADDRESS 0x7F8A60 /end MEASUREMENT
/begin MEASUREMENT M_In_Y.STD_float32_float32_float32.All_Maps_STD.Maps_Raster_2 "" FLOAT32_IEEE ident 1 100 -1.e+037 1.e+037 ECU_ADDRESS 0x7F8B38 /end MEASUREMENT
/begin MEASUREMENT M_In_Y.STD_float32_float32_float32.All_Maps_STD.Maps_Raster_3 "" FLOAT32_IEEE ident 1 100 -1.e+037 1.e+037 ECU_ADDRESS 0x7F8C10 /end MEASUREMENT
/begin MEASUREMENT M_In_Y.STD_sint16_sint16_sint16.All_Maps_STD.Maps_Raster_1 "" SWORD ident 1 100 -32768.0 32767.0 ECU_ADDRESS 0x7F8A6E /end MEASUREMENT
/begin MEASUREMENT M_In_Y.STD_sint16_sint16_sint16.All_Maps_STD.Maps_Raster_2 "" SWORD ident 1 100 -32768.0 32767.0 ECU_ADDRESS 0x7F8B46 /end MEASUREMENT
/begin MEASUREMENT M_In_Y.STD_sint16_sint16_sint16.All_Maps_STD.Maps_Raster_3 "" SWORD ident 1 100 -32768.0 32767.0 ECU_ADDRESS 0x7F8C1E /end MEASUREMENT
/begin MEASUREMENT M_In_Y.STD_sint32_sint32_sint32.All_Maps_STD.Maps_Raster_1 "" SLONG ident 1 100 -2147483648.0 2147483647.0 ECU_ADDRESS 0x7F8A78 /end MEASUREMENT
/begin MEASUREMENT M_In_Y.STD_sint32_sint32_sint32.All_Maps_STD.Maps_Raster_2 "" SLONG ident 1 100 -2147483648.0 2147483647.0 ECU_ADDRESS 0x7F8B50 /end MEASUREMENT
/begin MEASUREMENT M_In_Y.STD_sint32_sint32_sint32.All_Maps_STD.Maps_Raster_3 "" SLONG ident 1 100 -2147483648.0 2147483647.0 ECU_ADDRESS 0x7F8C28 /end MEASUREMENT
/begin MEASUREMENT M_In_Y.STD_sint8_sint8_sint8.All_Maps_STD.Maps_Raster_1 "" SBYTE ident 1 100 -128.0 127.0 ECU_ADDRESS 0x7F8A86 /end MEASUREMENT
/begin MEASUREMENT M_In_Y.STD_sint8_sint8_sint8.All_Maps_STD.Maps_Raster_2 "" SBYTE ident 1 100 -128.0 127.0 ECU_ADDRESS 0x7F8B5E /end MEASUREMENT
/begin MEASUREMENT M_In_Y.STD_sint8_sint8_sint8.All_Maps_STD.Maps_Raster_3 "" SBYTE ident 1 100 -128.0 127.0 ECU_ADDRESS 0x7F8C36 /end MEASUREMENT
/begin MEASUREMENT M_In_Y.STD_uint16_uint16_uint16.All_Maps_STD.Maps_Raster_1 "" UWORD ident 1 100 0.0 65535.0 ECU_ADDRESS 0x7F8A8A /end MEASUREMENT
/begin MEASUREMENT M_In_Y.STD_uint16_uint16_uint16.All_Maps_STD.Maps_Raster_2 "" UWORD ident 1 100 0.0 65535.0 ECU_ADDRESS 0x7F8B62 /end MEASUREMENT
/begin MEASUREMENT M_In_Y.STD_uint16_uint16_uint16.All_Maps_STD.Maps_Raster_3 "" UWORD ident 1 100 0.0 65535.0 ECU_ADDRESS 0x7F8C3A /end MEASUREMENT
/begin MEASUREMENT M_In_Y.STD_uint32_uint32_uint32.All_Maps_STD.Maps_Raster_1 "" ULONG ident 1 100 0.0 4294967295.0 ECU_ADDRESS 0x7F8A94 /end MEASUREMENT
/begin MEASUREMENT M_In_Y.STD_uint32_uint32_uint32.All_Maps_STD.Maps_Raster_2 "" ULONG ident 1 100 0.0 4294967295.0 ECU_ADDRESS 0x7F8B6C /end MEASUREMENT
/begin MEASUREMENT M_In_Y.STD_uint32_uint32_uint32.All_Maps_STD.Maps_Raster_3 "" ULONG ident 1 100 0.0 4294967295.0 ECU_ADDRESS 0x7F8C44 /end MEASUREMENT
/begin MEASUREMENT M_In_Y.STD_uint8_uint8_uint8.All_Maps_STD.Maps_Raster_1 "" UBYTE ident 1 100 0.0 255.0 ECU_ADDRESS 0x7F8AA2 /end MEASUREMENT
/begin MEASUREMENT M_In_Y.STD_uint8_uint8_uint8.All_Maps_STD.Maps_Raster_2 "" UBYTE ident 1 100 0.0 255.0 ECU_ADDRESS 0x7F8B7A /end MEASUREMENT
/begin MEASUREMENT M_In_Y.STD_uint8_uint8_uint8.All_Maps_STD.Maps_Raster_3 "" UBYTE ident 1 100 0.0 255.0 ECU_ADDRESS 0x7F8C52 /end MEASUREMENT
/begin MEASUREMENT M_Map_in_x.Axis_Input.CURVE_Axis "" SWORD ident 1 100 -32768 32767 ECU_ADDRESS 0x7FB30A /end MEASUREMENT
/begin MEASUREMENT M_Map_in_y.Axis_Input.CURVE_Axis "" SWORD ident 1 100 -32768 32767 ECU_ADDRESS 0x7FB30C /end MEASUREMENT
/begin MEASUREMENT M_out.GRP_float32_float32_float32.All_Maps_GRP.Maps_Raster_3 "" FLOAT32_IEEE ident 1 100 -1.e+037 1.e+037 ECU_ADDRESS 0x7F8BCC /end MEASUREMENT
/begin MEASUREMENT M_out.GRP_sint16_sint16_sint16.All_Maps_GRP.Maps_Raster_3 "" SWORD ident 1 100 -32768.0 32767.0 ECU_ADDRESS 0x7F8BD8 /end MEASUREMENT
/begin MEASUREMENT M_out.GRP_sint32_sint32_sint32.All_Maps_GRP.Maps_Raster_3 "" SLONG ident 1 100 -2147483648.0 2147483647.0 ECU_ADDRESS 0x7F8BE4 /end MEASUREMENT
/begin MEASUREMENT M_out.GRP_sint8_sint8_sint8.All_Maps_GRP.Maps_Raster_3 "" SBYTE ident 1 100 -128.0 127.0 ECU_ADDRESS 0x7F8BEF /end MEASUREMENT
/begin MEASUREMENT M_out.GRP_uint16_uint16_uint16.All_Maps_GRP.Maps_Raster_3 "" UWORD ident 1 100 0.0 65535.0 ECU_ADDRESS 0x7F8BF4 /end MEASUREMENT
/begin MEASUREMENT M_out.GRP_uint32_uint32_uint32.All_Maps_GRP.Maps_Raster_3 "" ULONG ident 1 100 0.0 4294967295.0 ECU_ADDRESS 0x7F8C00 /end MEASUREMENT
/begin MEASUREMENT M_out.GRP_uint8_uint8_uint8.All_Maps_GRP.Maps_Raster_3 "" UBYTE ident 1 100 0.0 255.0 ECU_ADDRESS 0x7F8C0B /end MEASUREMENT
/begin MEASUREMENT M_out.STD_float32_float32_float32.All_Maps_STD.Maps_Raster_1 "" FLOAT32_IEEE ident 1 100 -1.e+037 1.e+037 ECU_ADDRESS 0x7F8A64 /end MEASUREMENT
/begin MEASUREMENT M_out.STD_float32_float32_float32.All_Maps_STD.Maps_Raster_2 "" FLOAT32_IEEE ident 1 100 -1.e+037 1.e+037 ECU_ADDRESS 0x7F8B3C /end MEASUREMENT
/begin MEASUREMENT M_out.STD_float32_float32_float32.All_Maps_STD.Maps_Raster_3 "" FLOAT32_IEEE ident 1 100 -1.e+037 1.e+037 ECU_ADDRESS 0x7F8C14 /end MEASUREMENT
/begin MEASUREMENT M_out.STD_sint16_sint16_sint16.All_Maps_STD.Maps_Raster_1 "" SWORD ident 1 100 -32768.0 32767.0 ECU_ADDRESS 0x7F8A70 /end MEASUREMENT
/begin MEASUREMENT M_out.STD_sint16_sint16_sint16.All_Maps_STD.Maps_Raster_2 "" SWORD ident 1 100 -32768.0 32767.0 ECU_ADDRESS 0x7F8B48 /end MEASUREMENT
/begin MEASUREMENT M_out.STD_sint16_sint16_sint16.All_Maps_STD.Maps_Raster_3 "" SWORD ident 1 100 -32768.0 32767.0 ECU_ADDRESS 0x7F8C20 /end MEASUREMENT
/begin MEASUREMENT M_out.STD_sint32_sint32_sint32.All_Maps_STD.Maps_Raster_1 "" SLONG ident 1 100 -2147483648.0 2147483647.0 ECU_ADDRESS 0x7F8A7C /end MEASUREMENT
/begin MEASUREMENT M_out.STD_sint32_sint32_sint32.All_Maps_STD.Maps_Raster_2 "" SLONG ident 1 100 -2147483648.0 2147483647.0 ECU_ADDRESS 0x7F8B54 /end MEASUREMENT
/begin MEASUREMENT M_out.STD_sint32_sint32_sint32.All_Maps_STD.Maps_Raster_3 "" SLONG ident 1 100 -2147483648.0 2147483647.0 ECU_ADDRESS 0x7F8C2C /end MEASUREMENT
/begin MEASUREMENT M_out.STD_sint8_sint8_sint8.All_Maps_STD.Maps_Raster_1 "" SBYTE ident 1 100 -128.0 127.0 ECU_ADDRESS 0x7F8A87 /end MEASUREMENT
/begin MEASUREMENT M_out.STD_sint8_sint8_sint8.All_Maps_STD.Maps_Raster_2 "" SBYTE ident 1 100 -128.0 127.0 ECU_ADDRESS 0x7F8B5F /end MEASUREMENT
/begin MEASUREMENT M_out.STD_sint8_sint8_sint8.All_Maps_STD.Maps_Raster_3 "" SBYTE ident 1 100 -128.0 127.0 ECU_ADDRESS 0x7F8C37 /end MEASUREMENT
/begin MEASUREMENT M_out.STD_uint16_uint16_uint16.All_Maps_STD.Maps_Raster_1 "" UWORD ident 1 100 0.0 65535.0 ECU_ADDRESS 0x7F8A8C /end MEASUREMENT
/begin MEASUREMENT M_out.STD_uint16_uint16_uint16.All_Maps_STD.Maps_Raster_2 "" UWORD ident 1 100 0.0 65535.0 ECU_ADDRESS 0x7F8B64 /end MEASUREMENT
/begin MEASUREMENT M_out.STD_uint16_uint16_uint16.All_Maps_STD.Maps_Raster_3 "" UWORD ident 1 100 0.0 65535.0 ECU_ADDRESS 0x7F8C3C /end MEASUREMENT
/begin MEASUREMENT M_out.STD_uint32_uint32_uint32.All_Maps_STD.Maps_Raster_1 "" ULONG ident 1 100 0.0 4294967295.0 ECU_ADDRESS 0x7F8A98 /end MEASUREMENT
/begin MEASUREMENT M_out.STD_uint32_uint32_uint32.All_Maps_STD.Maps_Raster_2 "" ULONG ident 1 100 0.0 4294967295.0 ECU_ADDRESS 0x7F8B70 /end MEASUREMENT
/begin MEASUREMENT M_out.STD_uint32_uint32_uint32.All_Maps_STD.Maps_Raster_3 "" ULONG ident 1 100 0.0 4294967295.0 ECU_ADDRESS 0x7F8C48 /end MEASUREMENT
/begin MEASUREMENT M_out.STD_uint8_uint8_uint8.All_Maps_STD.Maps_Raster_1 "" UBYTE ident 1 100 0.0 255.0 ECU_ADDRESS 0x7F8AA3 /end MEASUREMENT
/begin MEASUREMENT M_out.STD_uint8_uint8_uint8.All_Maps_STD.Maps_Raster_2 "" UBYTE ident 1 100 0.0 255.0 ECU_ADDRESS 0x7F8B7B /end MEASUREMENT
/begin MEASUREMENT M_out.STD_uint8_uint8_uint8.All_Maps_STD.Maps_Raster_3 "" UBYTE ident 1 100 0.0 255.0 ECU_ADDRESS 0x7F8C53 /end MEASUREMENT
/begin COMPU_METHOD ident "" RAT_FUNC "%12.4" "" COEFFS 0 1 0 0 0 1 /end COMPU_METHOD
/begin GROUP All_Maps_GRP.Maps_Raster_3 ""
 /begin REF_MEASUREMENT Calculated.GRP_float32_float32_float32.All_Maps_GRP.Maps_Raster_3 Calculated.GRP_sint16_sint16_sint16.All_Maps_GRP.Maps_Raster_3 Calculated.GRP_sint32_sint32_sint32.All_Maps_GRP.Maps_Raster_3 Calculated.GRP_sint8_sint8_sint8.All_Maps_GRP.Maps_Raster_3 Calculated.GRP_uint16_uint16_uint16.All_Maps_GRP.Maps_Raster_3 Calculated.GRP_uint32_uint32_uint32.All_Maps_GRP.Maps_Raster_3 Calculated.GRP_uint8_uint8_uint8.All_Maps_GRP.Maps_Raster_3 M_In_X.GRP_float32_float32_float32.All_Maps_GRP.Maps_Raster_3 M_In_X.GRP_sint16_sint16_sint16.All_Maps_GRP.Maps_Raster_3 M_In_X.GRP_sint32_sint32_sint32.All_Maps_GRP.Maps_Raster_3 M_In_X.GRP_sint8_sint8_sint8.All_Maps_GRP.Maps_Raster_3 M_In_X.GRP_uint16_uint16_uint16.All_Maps_GRP.Maps_Raster_3 M_In_X.GRP_uint32_uint32_uint32.All_Maps_GRP.Maps_Raster_3 M_In_X.GRP_uint8_uint8_uint8.All_Maps_GRP.Maps_Raster_3 M_In_Y.GRP_float32_float32_float32.All_Maps_GRP.Maps_Raster_3 M_In_Y.GRP_sint16_sint16_sint16.All_Maps_GRP.Maps_Raster_3 M_In_Y.GRP_sint32_sint32_sint32.All_Maps_GRP.Maps_Raster_3 M_In_Y.GRP_sint8_sint8_sint8.All_Maps_GRP.Maps_Raster_3 M_In_Y.GRP_uint16_uint16_uint16.All_Maps_GRP.Maps_Raster_3 M_In_Y.GRP_uint32_uint32_uint32.All_Maps_GRP.Maps_Raster_3 M_In_Y.GRP_uint8_uint8_uint8.All_Maps_GRP.Maps_Raster_3 M_out.GRP_float32_float32_float32.All_Maps_GRP.Maps_Raster_3 M_out.GRP_sint16_sint16_sint16.All_Maps_GRP.Maps_Raster_3 M_out.GRP_sint32_sint32_sint32.All_Maps_GRP.Maps_Raster_3 M_out.GRP_sint8_sint8_sint8.All_Maps_GRP.Maps_Raster_3 M_out.GRP_uint16_uint16_uint16.All_Maps_GRP.Maps_Raster_3 M_out.GRP_uint32_uint32_uint32.All_Maps_GRP.Maps_Raster_3 M_out.GRP_uint8_uint8_uint8.All_Maps_GRP.Maps_Raster_3 /end REF_MEASUREMENT
 /begin REF_CHARACTERISTIC P_Do_Active_Grp.GRP_float32_float32_float32.All_Maps_GRP.Maps_Raster_3 P_Do_Active_Grp.GRP_sint16_sint16_sint16.All_Maps_GRP.Maps_Raster_3 P_Do_Active_Grp.GRP_sint32_sint32_sint32.All_Maps_GRP.Maps_Raster_3 P_Do_Active_Grp.GRP_sint8_sint8_sint8.All_Maps_GRP.Maps_Raster_3 P_Do_Active_Grp.GRP_uint16_uint16_uint16.All_Maps_GRP.Maps_Raster_3 P_Do_Active_Grp.GRP_uint32_uint32_uint32.All_Maps_GRP.Maps_Raster_3 P_Do_Active_Grp.GRP_uint8_uint8_uint8.All_Maps_GRP.Maps_Raster_3 P_Do_All_GRP_Maps.All_Maps_GRP.Maps_Raster_3 P_Do_GET.GRP_float32_float32_float32.All_Maps_GRP.Maps_Raster_3 P_Do_GET.GRP_sint16_sint16_sint16.All_Maps_GRP.Maps_Raster_3 P_Do_GET.GRP_sint32_sint32_sint32.All_Maps_GRP.Maps_Raster_3 P_Do_GET.GRP_sint8_sint8_sint8.All_Maps_GRP.Maps_Raster_3 P_Do_GET.GRP_uint16_uint16_uint16.All_Maps_GRP.Maps_Raster_3 P_Do_GET.GRP_uint32_uint32_uint32.All_Maps_GRP.Maps_Raster_3 P_Do_GET.GRP_uint8_uint8_uint8.All_Maps_GRP.Maps_Raster_3 P_Do_X_SET.GRP_float32_float32_float32.All_Maps_GRP.Maps_Raster_3 P_Do_X_SET.GRP_sint16_sint16_sint16.All_Maps_GRP.Maps_Raster_3 P_Do_X_SET.GRP_sint32_sint32_sint32.All_Maps_GRP.Maps_Raster_3 P_Do_X_SET.GRP_sint8_sint8_sint8.All_Maps_GRP.Maps_Raster_3 P_Do_X_SET.GRP_uint16_uint16_uint16.All_Maps_GRP.Maps_Raster_3 P_Do_X_SET.GRP_uint32_uint32_uint32.All_Maps_GRP.Maps_Raster_3 P_Do_X_SET.GRP_uint8_uint8_uint8.All_Maps_GRP.Maps_Raster_3 P_Do_Y_SET.GRP_float32_float32_float32.All_Maps_GRP.Maps_Raster_3 P_Do_Y_SET.GRP_sint16_sint16_sint16.All_Maps_GRP.Maps_Raster_3 P_Do_Y_SET.GRP_sint32_sint32_sint32.All_Maps_GRP.Maps_Raster_3 P_Do_Y_SET.GRP_sint8_sint8_sint8.All_Maps_GRP.Maps_Raster_3 P_Do_Y_SET.GRP_uint16_uint16_uint16.All_Maps_GRP.Maps_Raster_3 P_Do_Y_SET.GRP_uint32_uint32_uint32.All_Maps_GRP.Maps_Raster_3 P_Do_Y_SET.GRP_uint8_uint8_uint8.All_Maps_GRP.Maps_Raster_3 P_In_X.GRP_float32_float32_float32.All_Maps_GRP.Maps_Raster_3 P_In_X.GRP_sint16_sint16_sint16.All_Maps_GRP.Maps_Raster_3 P_In_X.GRP_sint32_sint32_sint32.All_Maps_GRP.Maps_Raster_3 P_In_X.GRP_sint8_sint8_sint8.All_Maps_GRP.Maps_Raster_3 P_In_X.GRP_uint16_uint16_uint16.All_Maps_GRP.Maps_Raster_3 P_In_X.GRP_uint32_uint32_uint32.All_Maps_GRP.Maps_Raster_3 P_In_X.GRP_uint8_uint8_uint8.All_Maps_GRP.Maps_Raster_3 P_In_Y.GRP_float32_float32_float32.All_Maps_GRP.Maps_Raster_3 P_In_Y.GRP_sint16_sint16_sint16.All_Maps_GRP.Maps_Raster_3 P_In_Y.GRP_sint32_sint32_sint32.All_Maps_GRP.Maps_Raster_3 P_In_Y.GRP_sint8_sint8_sint8.All_Maps_GRP.Maps_Raster_3 P_In_Y.GRP_uint16_uint16_uint16.All_Maps_GRP.Maps_Raster_3 P_In_Y.GRP_uint32_uint32_uint32.All_Maps_GRP.Maps_Raster_3 P_In_Y.GRP_uint8_uint8_uint8.All_Maps_GRP.Maps_Raster_3 Two_D.GRP_float32_float32_float32.All_Maps_GRP.Maps_Raster_3 Two_D.GRP_sint16_sint16_sint16.All_Maps_GRP.Maps_Raster_3 Two_D.GRP_sint32_sint32_sint32.All_Maps_GRP.Maps_Raster_3 Two_D.GRP_sint8_sint8_sint8.All_Maps_GRP.Maps_Raster_3 Two_D.GRP_uint16_uint16_uint16.All_Maps_GRP.Maps_Raster_3 Two_D.GRP_uint32_uint32_uint32.All_Maps_GRP.Maps_Raster_3 Two_D.GRP_uint8_uint8_uint8.All_Maps_GRP.Maps_Raster_3 /end REF_CHARACTERISTIC
 /begin SUB_GROUP GRP_float32_float32_float32.All_Maps_GRP.Maps_Raster_3 GRP_sint16_sint16_sint16.All_Maps_GRP.Maps_Raster_3 GRP_sint32_sint32_sint32.All_Maps_GRP.Maps_Raster_3 GRP_sint8_sint8_sint8.All_Maps_GRP.Maps_Raster_3 GRP_uint16_uint16_uint16.All_Maps_GRP.Maps_Raster_3 GRP_uint32_uint32_uint32.All_Maps_GRP.Maps_Raster_3 GRP_uint8_uint8_uint8.All_Maps_GRP.Maps_Raster_3 /end SUB_GROUP
/end GROUP
/begin GROUP All_Maps_STD.Maps_Raster_1 ""
 /begin REF_MEASUREMENT Calculated.STD_float32_float32_float32.All_Maps_STD.Maps_Raster_1 Calculated.STD_sint16_sint16_sint16.All_Maps_STD.Maps_Raster_1 Calculated.STD_sint32_sint32_sint32.All_Maps_STD.Maps_Raster_1 Calculated.STD_sint8_sint8_sint8.All_Maps_STD.Maps_Raster_1 Calculated.STD_uint16_uint16_uint16.All_Maps_STD.Maps_Raster_1 Calculated.STD_uint32_uint32_uint32.All_Maps_STD.Maps_Raster_1 Calculated.STD_uint8_uint8_uint8.All_Maps_STD.Maps_Raster_1 M_In_X.STD_float32_float32_float32.All_Maps_STD.Maps_Raster_1 M_In_X.STD_sint16_sint16_sint16.All_Maps_STD.Maps_Raster_1 M_In_X.STD_sint32_sint32_sint32.All_Maps_STD.Maps_Raster_1 M_In_X.STD_sint8_sint8_sint8.All_Maps_STD.Maps_Raster_1 M_In_X.STD_uint16_uint16_uint16.All_Maps_STD.Maps_Raster_1 M_In_X.STD_uint32_uint32_uint32.All_Maps_STD.Maps_Raster_1 M_In_X.STD_uint8_uint8_uint8.All_Maps_STD.Maps_Raster_1 M_In_Y.STD_float32_float32_float32.All_Maps_STD.Maps_Raster_1 M_In_Y.STD_sint16_sint16_sint16.All_Maps_STD.Maps_Raster_1 M_In_Y.STD_sint32_sint32_sint32.All_Maps_STD.Maps_Raster_1 M_In_Y.STD_sint8_sint8_sint8.All_Maps_STD.Maps_Raster_1 M_In_Y.STD_uint16_uint16_uint16.All_Maps_STD.Maps_Raster_1 M_In_Y.STD_uint32_uint32_uint32.All_Maps_STD.Maps_Raster_1 M_In_Y.STD_uint8_uint8_uint8.All_Maps_STD.Maps_Raster_1 M_out.STD_float32_float32_float32.All_Maps_STD.Maps_Raster_1 M_out.STD_sint16_sint16_sint16.All_Maps_STD.Maps_Raster_1 M_out.STD_sint32_sint32_sint32.All_Maps_STD.Maps_Raster_1 M_out.STD_sint8_sint8_sint8.All_Maps_STD.Maps_Raster_1 M_out.STD_uint16_uint16_uint16.All_Maps_STD.Maps_Raster_1 M_out.STD_uint32_uint32_uint32.All_Maps_STD.Maps_Raster_1 M_out.STD_uint8_uint8_uint8.All_Maps_STD.Maps_Raster_1 /end REF_MEASUREMENT
 /begin REF_CHARACTERISTIC P_Do_Active_Std.STD_float32_float32_float32.All_Maps_STD.Maps_Raster_1 P_Do_Active_Std.STD_sint16_sint16_sint16.All_Maps_STD.Maps_Raster_1 P_Do_Active_Std.STD_sint32_sint32_sint32.All_Maps_STD.Maps_Raster_1 P_Do_Active_Std.STD_sint8_sint8_sint8.All_Maps_STD.Maps_Raster_1 P_Do_Active_Std.STD_uint16_uint16_uint16.All_Maps_STD.Maps_Raster_1 P_Do_Active_Std.STD_uint32_uint32_uint32.All_Maps_STD.Maps_Raster_1 P_Do_Active_Std.STD_uint8_uint8_uint8.All_Maps_STD.Maps_Raster_1 P_Do_All_STD_Maps.All_Maps_STD.Maps_Raster_1 P_In_X.STD_float32_float32_float32.All_Maps_STD.Maps_Raster_1 P_In_X.STD_sint16_sint16_sint16.All_Maps_STD.Maps_Raster_1 P_In_X.STD_sint32_sint32_sint32.All_Maps_STD.Maps_Raster_1 P_In_X.STD_sint8_sint8_sint8.All_Maps_STD.Maps_Raster_1 P_In_X.STD_uint16_uint16_uint16.All_Maps_STD.Maps_Raster_1 P_In_X.STD_uint32_uint32_uint32.All_Maps_STD.Maps_Raster_1 P_In_X.STD_uint8_uint8_uint8.All_Maps_STD.Maps_Raster_1 P_In_Y.STD_float32_float32_float32.All_Maps_STD.Maps_Raster_1 P_In_Y.STD_sint16_sint16_sint16.All_Maps_STD.Maps_Raster_1 P_In_Y.STD_sint32_sint32_sint32.All_Maps_STD.Maps_Raster_1 P_In_Y.STD_sint8_sint8_sint8.All_Maps_STD.Maps_Raster_1 P_In_Y.STD_uint16_uint16_uint16.All_Maps_STD.Maps_Raster_1 P_In_Y.STD_uint32_uint32_uint32.All_Maps_STD.Maps_Raster_1 P_In_Y.STD_uint8_uint8_uint8.All_Maps_STD.Maps_Raster_1 Two_D.STD_float32_float32_float32.All_Maps_STD.Maps_Raster_1 Two_D.STD_sint16_sint16_sint16.All_Maps_STD.Maps_Raster_1 Two_D.STD_sint32_sint32_sint32.All_Maps_STD.Maps_Raster_1 Two_D.STD_sint8_sint8_sint8.All_Maps_STD.Maps_Raster_1 Two_D.STD_uint16_uint16_uint16.All_Maps_STD.Maps_Raster_1 Two_D.STD_uint32_uint32_uint32.All_Maps_STD.Maps_Raster_1 Two_D.STD_uint8_uint8_uint8.All_Maps_STD.Maps_Raster_1 /end REF_CHARACTERISTIC
 /begin SUB_GROUP STD_float32_float32_float32.All_Maps_STD.Maps_Raster_1 STD_sint16_sint16_sint16.All_Maps_STD.Maps_Raster_1 STD_sint32_sint32_sint32.All_Maps_STD.Maps_Raster_1 STD_sint8_sint8_sint8.All_Maps_STD.Maps_Raster_1 STD_uint16_uint16_uint16.All_Maps_STD.Maps_Raster_1 STD_uint32_uint32_uint32.All_Maps_STD.Maps_Raster_1 STD_uint8_uint8_uint8.All_Maps_STD.Maps_Raster_1 /end SUB_GROUP
/end GROUP
/begin GROUP All_Maps_STD.Maps_Raster_2 ""
 /begin REF_MEASUREMENT Calculated.STD_float32_float32_float32.All_Maps_STD.Maps_Raster_2 Calculated.STD_sint16_sint16_sint16.All_Maps_STD.Maps_Raster_2 Calculated.STD_sint32_sint32_sint32.All_Maps_STD.Maps_Raster_2 Calculated.STD_sint8_sint8_sint8.All_Maps_STD.Maps_Raster_2 Calculated.STD_uint16_uint16_uint16.All_Maps_STD.Maps_Raster_2 Calculated.STD_uint32_uint32_uint32.All_Maps_STD.Maps_Raster_2 Calculated.STD_uint8_uint8_uint8.All_Maps_STD.Maps_Raster_2 M_In_X.STD_float32_float32_float32.All_Maps_STD.Maps_Raster_2 M_In_X.STD_sint16_sint16_sint16.All_Maps_STD.Maps_Raster_2 M_In_X.STD_sint32_sint32_sint32.All_Maps_STD.Maps_Raster_2 M_In_X.STD_sint8_sint8_sint8.All_Maps_STD.Maps_Raster_2 M_In_X.STD_uint16_uint16_uint16.All_Maps_STD.Maps_Raster_2 M_In_X.STD_uint32_uint32_uint32.All_Maps_STD.Maps_Raster_2 M_In_X.STD_uint8_uint8_uint8.All_Maps_STD.Maps_Raster_2 M_In_Y.STD_float32_float32_float32.All_Maps_STD.Maps_Raster_2 M_In_Y.STD_sint16_sint16_sint16.All_Maps_STD.Maps_Raster_2 M_In_Y.STD_sint32_sint32_sint32.All_Maps_STD.Maps_Raster_2 M_In_Y.STD_sint8_sint8_sint8.All_Maps_STD.Maps_Raster_2 M_In_Y.STD_uint16_uint16_uint16.All_Maps_STD.Maps_Raster_2 M_In_Y.STD_uint32_uint32_uint32.All_Maps_STD.Maps_Raster_2 M_In_Y.STD_uint8_uint8_uint8.All_Maps_STD.Maps_Raster_2 M_out.STD_float32_float32_float32.All_Maps_STD.Maps_Raster_2 M_out.STD_sint16_sint16_sint16.All_Maps_STD.Maps_Raster_2 M_out.STD_sint32_sint32_sint32.All_Maps_STD.Maps_Raster_2 M_out.STD_sint8_sint8_sint8.All_Maps_STD.Maps_Raster_2 M_out.STD_uint16_uint16_uint16.All_Maps_STD.Maps_Raster_2 M_out.STD_uint32_uint32_uint32.All_Maps_STD.Maps_Raster_2 M_out.STD_uint8_uint8_uint8.All_Maps_STD.Maps_Raster_2 /end REF_MEASUREMENT
 /begin REF_CHARACTERISTIC P_Do_Active_Std.STD_float32_float32_float32.All_Maps_STD.Maps_Raster_2 P_Do_Active_Std.STD_sint16_sint16_sint16.All_Maps_STD.Maps_Raster_2 P_Do_Active_Std.STD_sint32_sint32_sint32.All_Maps_STD.Maps_Raster_2 P_Do_Active_Std.STD_sint8_sint8_sint8.All_Maps_STD.Maps_Raster_2 P_Do_Active_Std.STD_uint16_uint16_uint16.All_Maps_STD.Maps_Raster_2 P_Do_Active_Std.STD_uint32_uint32_uint32.All_Maps_STD.Maps_Raster_2 P_Do_Active_Std.STD_uint8_uint8_uint8.All_Maps_STD.Maps_Raster_2 P_Do_All_STD_Maps.All_Maps_STD.Maps_Raster_2 P_In_X.STD_float32_float32_float32.All_Maps_STD.Maps_Raster_2 P_In_X.STD_sint16_sint16_sint16.All_Maps_STD.Maps_Raster_2 P_In_X.STD_sint32_sint32_sint32.All_Maps_STD.Maps_Raster_2 P_In_X.STD_sint8_sint8_sint8.All_Maps_STD.Maps_Raster_2 P_In_X.STD_uint16_uint16_uint16.All_Maps_STD.Maps_Raster_2 P_In_X.STD_uint32_uint32_uint32.All_Maps_STD.Maps_Raster_2 P_In_X.STD_uint8_uint8_uint8.All_Maps_STD.Maps_Raster_2 P_In_Y.STD_float32_float32_float32.All_Maps_STD.Maps_Raster_2 P_In_Y.STD_sint16_sint16_sint16.All_Maps_STD.Maps_Raster_2 P_In_Y.STD_sint32_sint32_sint32.All_Maps_STD.Maps_Raster_2 P_In_Y.STD_sint8_sint8_sint8.All_Maps_STD.Maps_Raster_2 P_In_Y.STD_uint16_uint16_uint16.All_Maps_STD.Maps_Raster_2 P_In_Y.STD_uint32_uint32_uint32.All_Maps_STD.Maps_Raster_2 P_In_Y.STD_uint8_uint8_uint8.All_Maps_STD.Maps_Raster_2 Two_D.STD_float32_float32_float32.All_Maps_STD.Maps_Raster_2 Two_D.STD_sint16_sint16_sint16.All_Maps_STD.Maps_Raster_2 Two_D.STD_sint32_sint32_sint32.All_Maps_STD.Maps_Raster_2 Two_D.STD_sint8_sint8_sint8.All_Maps_STD.Maps_Raster_2 Two_D.STD_uint16_uint16_uint16.All_Maps_STD.Maps_Raster_2 Two_D.STD_uint32_uint32_uint32.All_Maps_STD.Maps_Raster_2 Two_D.STD_uint8_uint8_uint8.All_Maps_STD.Maps_Raster_2 /end REF_CHARACTERISTIC
 /begin SUB_GROUP STD_float32_float32_float32.All_Maps_STD.Maps_Raster_2 STD_sint16_sint16_sint16.All_Maps_STD.Maps_Raster_2 STD_sint32_sint32_sint32.All_Maps_STD.Maps_Raster_2 STD_sint8_sint8_sint8.All_Maps_STD.Maps_Raster_2 STD_uint16_uint16_uint16.All_Maps_STD.Maps_Raster_2 STD_uint32_uint32_uint32.All_Maps_STD.Maps_Raster_2 STD_uint8_uint8_uint8.All_Maps_STD.Maps_Raster_2 /end SUB_GROUP
/end GROUP
/begin GROUP All_Maps_STD.Maps_Raster_3 ""
 /begin REF_MEASUREMENT Calculated.STD_float32_float32_float32.All_Maps_STD.Maps_Raster_3 Calculated.STD_sint16_sint16_sint16.All_Maps_STD.Maps_Raster_3 Calculated.STD_sint32_sint32_sint32.All_Maps_STD.Maps_Raster_3 Calculated.STD_sint8_sint8_sint8.All_Maps_STD.Maps_Raster_3 Calculated.STD_uint16_uint16_uint16.All_Maps_STD.Maps_Raster_3 Calculated.STD_uint32_uint32_uint32.All_Maps_STD.Maps_Raster_3 Calculated.STD_uint8_uint8_uint8.All_Maps_STD.Maps_Raster_3 M_In_X.STD_float32_float32_float32.All_Maps_STD.Maps_Raster_3 M_In_X.STD_sint16_sint16_sint16.All_Maps_STD.Maps_Raster_3 M_In_X.STD_sint32_sint32_sint32.All_Maps_STD.Maps_Raster_3 M_In_X.STD_sint8_sint8_sint8.All_Maps_STD.Maps_Raster_3 M_In_X.STD_uint16_uint16_uint16.All_Maps_STD.Maps_Raster_3 M_In_X.STD_uint32_uint32_uint32.All_Maps_STD.Maps_Raster_3 M_In_X.STD_uint8_uint8_uint8.All_Maps_STD.Maps_Raster_3 M_In_Y.STD_float32_float32_float32.All_Maps_STD.Maps_Raster_3 M_In_Y.STD_sint16_sint16_sint16.All_Maps_STD.Maps_Raster_3 M_In_Y.STD_sint32_sint32_sint32.All_Maps_STD.Maps_Raster_3 M_In_Y.STD_sint8_sint8_sint8.All_Maps_STD.Maps_Raster_3 M_In_Y.STD_uint16_uint16_uint16.All_Maps_STD.Maps_Raster_3 M_In_Y.STD_uint32_uint32_uint32.All_Maps_STD.Maps_Raster_3 M_In_Y.STD_uint8_uint8_uint8.All_Maps_STD.Maps_Raster_3 M_out.STD_float32_float32_float32.All_Maps_STD.Maps_Raster_3 M_out.STD_sint16_sint16_sint16.All_Maps_STD.Maps_Raster_3 M_out.STD_sint32_sint32_sint32.All_Maps_STD.Maps_Raster_3 M_out.STD_sint8_sint8_sint8.All_Maps_STD.Maps_Raster_3 M_out.STD_uint16_uint16_uint16.All_Maps_STD.Maps_Raster_3 M_out.STD_uint32_uint32_uint32.All_Maps_STD.Maps_Raster_3 M_out.STD_uint8_uint8_uint8.All_Maps_STD.Maps_Raster_3 /end REF_MEASUREMENT
 /begin REF_CHARACTERISTIC P_Do_Active_Std.STD_float32_float32_float32.All_Maps_STD.Maps_Raster_3 P_Do_Active_Std.STD_sint16_sint16_sint16.All_Maps_STD.Maps_Raster_3 P_Do_Active_Std.STD_sint32_sint32_sint32.All_Maps_STD.Maps_Raster_3 P_Do_Active_Std.STD_sint8_sint8_sint8.All_Maps_STD.Maps_Raster_3 P_Do_Active_Std.STD_uint16_uint16_uint16.All_Maps_STD.Maps_Raster_3 P_Do_Active_Std.STD_uint32_uint32_uint32.All_Maps_STD.Maps_Raster_3 P_Do_Active_Std.STD_uint8_uint8_uint8.All_Maps_STD.Maps_Raster_3 P_Do_All_STD_Maps.All_Maps_STD.Maps_Raster_3 P_In_X.STD_float32_float32_float32.All_Maps_STD.Maps_Raster_3 P_In_X.STD_sint16_sint16_sint16.All_Maps_STD.Maps_Raster_3 P_In_X.STD_sint32_sint32_sint32.All_Maps_STD.Maps_Raster_3 P_In_X.STD_sint8_sint8_sint8.All_Maps_STD.Maps_Raster_3 P_In_X.STD_uint16_uint16_uint16.All_Maps_STD.Maps_Raster_3 P_In_X.STD_uint32_uint32_uint32.All_Maps_STD.Maps_Raster_3 P_In_X.STD_uint8_uint8_uint8.All_Maps_STD.Maps_Raster_3 P_In_Y.STD_float32_float32_float32.All_Maps_STD.Maps_Raster_3 P_In_Y.STD_sint16_sint16_sint16.All_Maps_STD.Maps_Raster_3 P_In_Y.STD_sint32_sint32_sint32.All_Maps_STD.Maps_Raster_3 P_In_Y.STD_sint8_sint8_sint8.All_Maps_STD.Maps_Raster_3 P_In_Y.STD_uint16_uint16_uint16.All_Maps_STD.Maps_Raster_3 P_In_Y.STD_uint32_uint32_uint32.All_Maps_STD.Maps_Raster_3 P_In_Y.STD_uint8_uint8_uint8.All_Maps_STD.Maps_Raster_3 Two_D.STD_float32_float32_float32.All_Maps_STD.Maps_Raster_3 Two_D.STD_sint16_sint16_sint16.All_Maps_STD.Maps_Raster_3 Two_D.STD_sint32_sint32_sint32.All_Maps_STD.Maps_Raster_3 Two_D.STD_sint8_sint8_sint8.All_Maps_STD.Maps_Raster_3 Two_D.STD_uint16_uint16_uint16.All_Maps_STD.Maps_Raster_3 Two_D.STD_uint32_uint32_uint32.All_Maps_STD.Maps_Raster_3 Two_D.STD_uint8_uint8_uint8.All_Maps_STD.Maps_Raster_3 /end REF_CHARACTERISTIC
 /begin SUB_GROUP STD_float32_float32_float32.All_Maps_STD.Maps_Raster_3 STD_sint16_sint16_sint16.All_Maps_STD.Maps_Raster_3 STD_sint32_sint32_sint32.All_Maps_STD.Maps_Raster_3 STD_sint8_sint8_sint8.All_Maps_STD.Maps_Raster_3 STD_uint16_uint16_uint16.All_Maps_STD.Maps_Raster_3 STD_uint32_uint32_uint32.All_Maps_STD.Maps_Raster_3 STD_uint8_uint8_uint8.All_Maps_STD.Maps_Raster_3 /end SUB_GROUP
/end GROUP
/begin GROUP Axis_Input.CURVE_Axis ""
 /begin REF_MEASUREMENT M_Curve_in_x.Axis_Input.CURVE_Axis M_Map_in_x.Axis_Input.CURVE_Axis M_Map_in_y.Axis_Input.CURVE_Axis /end REF_MEASUREMENT
 /begin REF_CHARACTERISTIC P_Curve_in_x.Axis_Input.CURVE_Axis P_Map_in_x.Axis_Input.CURVE_Axis P_Map_in_y.Axis_Input.CURVE_Axis /end REF_CHARACTERISTIC
/end GROUP
/begin GROUP CURVE_Axis "" ROOT
 /begin REF_MEASUREMENT M_Curve_in_x.Axis_Input.CURVE_Axis M_Map_in_x.Axis_Input.CURVE_Axis M_Map_in_y.Axis_Input.CURVE_Axis /end REF_MEASUREMENT
 /begin REF_CHARACTERISTIC P_Curve_in_x.Axis_Input.CURVE_Axis P_Map_in_x.Axis_Input.CURVE_Axis P_Map_in_y.Axis_Input.CURVE_Axis /end REF_CHARACTERISTIC
/end GROUP
/begin GROUP GRP_float32_float32_float32.All_Maps_GRP.Maps_Raster_3 ""
 /begin REF_MEASUREMENT Calculated.GRP_float32_float32_float32.All_Maps_GRP.Maps_Raster_3 M_In_X.GRP_float32_float32_float32.All_Maps_GRP.Maps_Raster_3 M_In_Y.GRP_float32_float32_float32.All_Maps_GRP.Maps_Raster_3 M_out.GRP_float32_float32_float32.All_Maps_GRP.Maps_Raster_3 /end REF_MEASUREMENT
 /begin REF_CHARACTERISTIC P_Do_Active_Grp.GRP_float32_float32_float32.All_Maps_GRP.Maps_Raster_3 P_Do_GET.GRP_float32_float32_float32.All_Maps_GRP.Maps_Raster_3 P_Do_X_SET.GRP_float32_float32_float32.All_Maps_GRP.Maps_Raster_3 P_Do_Y_SET.GRP_float32_float32_float32.All_Maps_GRP.Maps_Raster_3 P_In_X.GRP_float32_float32_float32.All_Maps_GRP.Maps_Raster_3 P_In_Y.GRP_float32_float32_float32.All_Maps_GRP.Maps_Raster_3 Two_D.GRP_float32_float32_float32.All_Maps_GRP.Maps_Raster_3 /end REF_CHARACTERISTIC
/end GROUP
/begin GROUP GRP_sint16_sint16_sint16.All_Maps_GRP.Maps_Raster_3 ""
 /begin REF_MEASUREMENT Calculated.GRP_sint16_sint16_sint16.All_Maps_GRP.Maps_Raster_3 M_In_X.GRP_sint16_sint16_sint16.All_Maps_GRP.Maps_Raster_3 M_In_Y.GRP_sint16_sint16_sint16.All_Maps_GRP.Maps_Raster_3 M_out.GRP_sint16_sint16_sint16.All_Maps_GRP.Maps_Raster_3 /end REF_MEASUREMENT
 /begin REF_CHARACTERISTIC P_Do_Active_Grp.GRP_sint16_sint16_sint16.All_Maps_GRP.Maps_Raster_3 P_Do_GET.GRP_sint16_sint16_sint16.All_Maps_GRP.Maps_Raster_3 P_Do_X_SET.GRP_sint16_sint16_sint16.All_Maps_GRP.Maps_Raster_3 P_Do_Y_SET.GRP_sint16_sint16_sint16.All_Maps_GRP.Maps_Raster_3 P_In_X.GRP_sint16_sint16_sint16.All_Maps_GRP.Maps_Raster_3 P_In_Y.GRP_sint16_sint16_sint16.All_Maps_GRP.Maps_Raster_3 Two_D.GRP_sint16_sint16_sint16.All_Maps_GRP.Maps_Raster_3 /end REF_CHARACTERISTIC
/end GROUP
/begin GROUP GRP_sint32_sint32_sint32.All_Maps_GRP.Maps_Raster_3 ""
 /begin REF_MEASUREMENT Calculated.GRP_sint32_sint32_sint32.All_Maps_GRP.Maps_Raster_3 M_In_X.GRP_sint32_sint32_sint32.All_Maps_GRP.Maps_Raster_3 M_In_Y.GRP_sint32_sint32_sint32.All_Maps_GRP.Maps_Raster_3 M_out.GRP_sint32_sint32_sint32.All_Maps_GRP.Maps_Raster_3 /end REF_MEASUREMENT
 /begin REF_CHARACTERISTIC P_Do_Active_Grp.GRP_sint32_sint32_sint32.All_Maps_GRP.Maps_Raster_3 P_Do_GET.GRP_sint32_sint32_sint32.All_Maps_GRP.Maps_Raster_3 P_Do_X_SET.GRP_sint32_sint32_sint32.All_Maps_GRP.Maps_Raster_3 P_Do_Y_SET.GRP_sint32_sint32_sint32.All_Maps_GRP.Maps_Raster_3 P_In_X.GRP_sint32_sint32_sint32.All_Maps_GRP.Maps_Raster_3 P_In_Y.GRP_sint32_sint32_sint32.All_Maps_GRP.Maps_Raster_3 Two_D.GRP_sint32_sint32_sint32.All_Maps_GRP.Maps_Raster_3 /end REF_CHARACTERISTIC
/end GROUP
/begin GROUP GRP_sint8_sint8_sint8.All_Maps_GRP.Maps_Raster_3 ""
 /begin REF_MEASUREMENT Calculated.GRP_sint8_sint8_sint8.All_Maps_GRP.Maps_Raster_3 M_In_X.GRP_sint8_sint8_sint8.All_Maps_GRP.Maps_Raster_3 M_In_Y.GRP_sint8_sint8_sint8.All_Maps_GRP.Maps_Raster_3 M_out.GRP_sint8_sint8_sint8.All_Maps_GRP.Maps_Raster_3 /end REF_MEASUREMENT
 /begin REF_CHARACTERISTIC P_Do_Active_Grp.GRP_sint8_sint8_sint8.All_Maps_GRP.Maps_Raster_3 P_Do_GET.GRP_sint8_sint8_sint8.All_Maps_GRP.Maps_Raster_3 P_Do_X_SET.GRP_sint8_sint8_sint8.All_Maps_GRP.Maps_Raster_3 P_Do_Y_SET.GRP_sint8_sint8_sint8.All_Maps_GRP.Maps_Raster_3 P_In_X.GRP_sint8_sint8_sint8.All_Maps_GRP.Maps_Raster_3 P_In_Y.GRP_sint8_sint8_sint8.All_Maps_GRP.Maps_Raster_3 Two_D.GRP_sint8_sint8_sint8.All_Maps_GRP.Maps_Raster_3 /end REF_CHARACTERISTIC
/end GROUP
/begin GROUP GRP_uint16_uint16_uint16.All_Maps_GRP.Maps_Raster_3 ""
 /begin REF_MEASUREMENT Calculated.GRP_uint16_uint16_uint16.All_Maps_GRP.Maps_Raster_3 M_In_X.GRP_uint16_uint16_uint16.All_Maps_GRP.Maps_Raster_3 M_In_Y.GRP_uint16_uint16_uint16.All_Maps_GRP.Maps_Raster_3 M_out.GRP_uint16_uint16_uint16.All_Maps_GRP.Maps_Raster_3 /end REF_MEASUREMENT
 /begin REF_CHARACTERISTIC P_Do_Active_Grp.GRP_uint16_uint16_uint16.All_Maps_GRP.Maps_Raster_3 P_Do_GET.GRP_uint16_uint16_uint16.All_Maps_GRP.Maps_Raster_3 P_Do_X_SET.GRP_uint16_uint16_uint16.All_Maps_GRP.Maps_Raster_3 P_Do_Y_SET.GRP_uint16_uint16_uint16.All_Maps_GRP.Maps_Raster_3 P_In_X.GRP_uint16_uint16_uint16.All_Maps_GRP.Maps_Raster_3 P_In_Y.GRP_uint16_uint16_uint16.All_Maps_GRP.Maps_Raster_3 Two_D.GRP_uint16_uint16_uint16.All_Maps_GRP.Maps_Raster_3 /end REF_CHARACTERISTIC
/end GROUP
/begin GROUP GRP_uint32_uint32_uint32.All_Maps_GRP.Maps_Raster_3 ""
 /begin REF_MEASUREMENT Calculated.GRP_uint32_uint32_uint32.All_Maps_GRP.Maps_Raster_3 M_In_X.GRP_uint32_uint32_uint32.All_Maps_GRP.Maps_Raster_3 M_In_Y.GRP_uint32_uint32_uint32.All_Maps_GRP.Maps_Raster_3 M_out.GRP_uint32_uint32_uint32.All_Maps_GRP.Maps_Raster_3 /end REF_MEASUREMENT
 /begin REF_CHARACTERISTIC P_Do_Active_Grp.GRP_uint32_uint32_uint32.All_Maps_GRP.Maps_Raster_3 P_Do_GET.GRP_uint32_uint32_uint32.All_Maps_GRP.Maps_Raster_3 P_Do_X_SET.GRP_uint32_uint32_uint32.All_Maps_GRP.Maps_Raster_3 P_Do_Y_SET.GRP_uint32_uint32_uint32.All_Maps_GRP.Maps_Raster_3 P_In_X.GRP_uint32_uint32_uint32.All_Maps_GRP.Maps_Raster_3 P_In_Y.GRP_uint32_uint32_uint32.All_Maps_GRP.Maps_Raster_3 Two_D.GRP_uint32_uint32_uint32.All_Maps_GRP.Maps_Raster_3 /end REF_CHARACTERISTIC
/end GROUP
/begin GROUP GRP_uint8_uint8_uint8.All_Maps_GRP.Maps_Raster_3 ""
 /begin REF_MEASUREMENT Calculated.GRP_uint8_uint8_uint8.All_Maps_GRP.Maps_Raster_3 M_In_X.GRP_uint8_uint8_uint8.All_Maps_GRP.Maps_Raster_3 M_In_Y.GRP_uint8_uint8_uint8.All_Maps_GRP.Maps_Raster_3 M_out.GRP_uint8_uint8_uint8.All_Maps_GRP.Maps_Raster_3 /end REF_MEASUREMENT
 /begin REF_CHARACTERISTIC P_Do_Active_Grp.GRP_uint8_uint8_uint8.All_Maps_GRP.Maps_Raster_3 P_Do_GET.GRP_uint8_uint8_uint8.All_Maps_GRP.Maps_Raster_3 P_Do_X_SET.GRP_uint8_uint8_uint8.All_Maps_GRP.Maps_Raster_3 P_Do_Y_SET.GRP_uint8_uint8_uint8.All_Maps_GRP.Maps_Raster_3 P_In_X.GRP_uint8_uint8_uint8.All_Maps_GRP.Maps_Raster_3 P_In_Y.GRP_uint8_uint8_uint8.All_Maps_GRP.Maps_Raster_3 Two_D.GRP_uint8_uint8_uint8.All_Maps_GRP.Maps_Raster_3 /end REF_CHARACTERISTIC
/end GROUP
/begin GROUP Maps_Raster_1 "" ROOT
 /begin REF_MEASUREMENT Calculated.STD_float32_float32_float32.All_Maps_STD.Maps_Raster_1 Calculated.STD_sint16_sint16_sint16.All_Maps_STD.Maps_Raster_1 Calculated.STD_sint32_sint32_sint32.All_Maps_STD.Maps_Raster_1 Calculated.STD_sint8_sint8_sint8.All_Maps_STD.Maps_Raster_1 Calculated.STD_uint16_uint16_uint16.All_Maps_STD.Maps_Raster_1 Calculated.STD_uint32_uint32_uint32.All_Maps_STD.Maps_Raster_1 Calculated.STD_uint8_uint8_uint8.All_Maps_STD.Maps_Raster_1 M_In_X.STD_float32_float32_float32.All_Maps_STD.Maps_Raster_1 M_In_X.STD_sint16_sint16_sint16.All_Maps_STD.Maps_Raster_1 M_In_X.STD_sint32_sint32_sint32.All_Maps_STD.Maps_Raster_1 M_In_X.STD_sint8_sint8_sint8.All_Maps_STD.Maps_Raster_1 M_In_X.STD_uint16_uint16_uint16.All_Maps_STD.Maps_Raster_1 M_In_X.STD_uint32_uint32_uint32.All_Maps_STD.Maps_Raster_1 M_In_X.STD_uint8_uint8_uint8.All_Maps_STD.Maps_Raster_1 M_In_Y.STD_float32_float32_float32.All_Maps_STD.Maps_Raster_1 M_In_Y.STD_sint16_sint16_sint16.All_Maps_STD.Maps_Raster_1 M_In_Y.STD_sint32_sint32_sint32.All_Maps_STD.Maps_Raster_1 M_In_Y.STD_sint8_sint8_sint8.All_Maps_STD.Maps_Raster_1 M_In_Y.STD_uint16_uint16_uint16.All_Maps_STD.Maps_Raster_1 M_In_Y.STD_uint32_uint32_uint32.All_Maps_STD.Maps_Raster_1 M_In_Y.STD_uint8_uint8_uint8.All_Maps_STD.Maps_Raster_1 M_out.STD_float32_float32_float32.All_Maps_STD.Maps_Raster_1 M_out.STD_sint16_sint16_sint16.All_Maps_STD.Maps_Raster_1 M_out.STD_sint32_sint32_sint32.All_Maps_STD.Maps_Raster_1 M_out.STD_sint8_sint8_sint8.All_Maps_STD.Maps_Raster_1 M_out.STD_uint16_uint16_uint16.All_Maps_STD.Maps_Raster_1 M_out.STD_uint32_uint32_uint32.All_Maps_STD.Maps_Raster_1 M_out.STD_uint8_uint8_uint8.All_Maps_STD.Maps_Raster_1 /end REF_MEASUREMENT
 /begin REF_CHARACTERISTIC P_Do_Active_Std.STD_float32_float32_float32.All_Maps_STD.Maps_Raster_1 P_Do_Active_Std.STD_sint16_sint16_sint16.All_Maps_STD.Maps_Raster_1 P_Do_Active_Std.STD_sint32_sint32_sint32.All_Maps_STD.Maps_Raster_1 P_Do_Active_Std.STD_sint8_sint8_sint8.All_Maps_STD.Maps_Raster_1 P_Do_Active_Std.STD_uint16_uint16_uint16.All_Maps_STD.Maps_Raster_1 P_Do_Active_Std.STD_uint32_uint32_uint32.All_Maps_STD.Maps_Raster_1 P_Do_Active_Std.STD_uint8_uint8_uint8.All_Maps_STD.Maps_Raster_1 P_Do_All_STD_Maps.All_Maps_STD.Maps_Raster_1 P_In_X.STD_float32_float32_float32.All_Maps_STD.Maps_Raster_1 P_In_X.STD_sint16_sint16_sint16.All_Maps_STD.Maps_Raster_1 P_In_X.STD_sint32_sint32_sint32.All_Maps_STD.Maps_Raster_1 P_In_X.STD_sint8_sint8_sint8.All_Maps_STD.Maps_Raster_1 P_In_X.STD_uint16_uint16_uint16.All_Maps_STD.Maps_Raster_1 P_In_X.STD_uint32_uint32_uint32.All_Maps_STD.Maps_Raster_1 P_In_X.STD_uint8_uint8_uint8.All_Maps_STD.Maps_Raster_1 P_In_Y.STD_float32_float32_float32.All_Maps_STD.Maps_Raster_1 P_In_Y.STD_sint16_sint16_sint16.All_Maps_STD.Maps_Raster_1 P_In_Y.STD_sint32_sint32_sint32.All_Maps_STD.Maps_Raster_1 P_In_Y.STD_sint8_sint8_sint8.All_Maps_STD.Maps_Raster_1 P_In_Y.STD_uint16_uint16_uint16.All_Maps_STD.Maps_Raster_1 P_In_Y.STD_uint32_uint32_uint32.All_Maps_STD.Maps_Raster_1 P_In_Y.STD_uint8_uint8_uint8.All_Maps_STD.Maps_Raster_1 Two_D.STD_float32_float32_float32.All_Maps_STD.Maps_Raster_1 Two_D.STD_sint16_sint16_sint16.All_Maps_STD.Maps_Raster_1 Two_D.STD_sint32_sint32_sint32.All_Maps_STD.Maps_Raster_1 Two_D.STD_sint8_sint8_sint8.All_Maps_STD.Maps_Raster_1 Two_D.STD_uint16_uint16_uint16.All_Maps_STD.Maps_Raster_1 Two_D.STD_uint32_uint32_uint32.All_Maps_STD.Maps_Raster_1 Two_D.STD_uint8_uint8_uint8.All_Maps_STD.Maps_Raster_1 /end REF_CHARACTERISTIC
/end GROUP
/begin GROUP Maps_Raster_2 "" ROOT
 /begin REF_MEASUREMENT Calculated.STD_float32_float32_float32.All_Maps_STD.Maps_Raster_2 Calculated.STD_sint16_sint16_sint16.All_Maps_STD.Maps_Raster_2 Calculated.STD_sint32_sint32_sint32.All_Maps_STD.Maps_Raster_2 Calculated.STD_sint8_sint8_sint8.All_Maps_STD.Maps_Raster_2 Calculated.STD_uint16_uint16_uint16.All_Maps_STD.Maps_Raster_2 Calculated.STD_uint32_uint32_uint32.All_Maps_STD.Maps_Raster_2 Calculated.STD_uint8_uint8_uint8.All_Maps_STD.Maps_Raster_2 M_In_X.STD_float32_float32_float32.All_Maps_STD.Maps_Raster_2 M_In_X.STD_sint16_sint16_sint16.All_Maps_STD.Maps_Raster_2 M_In_X.STD_sint32_sint32_sint32.All_Maps_STD.Maps_Raster_2 M_In_X.STD_sint8_sint8_sint8.All_Maps_STD.Maps_Raster_2 M_In_X.STD_uint16_uint16_uint16.All_Maps_STD.Maps_Raster_2 M_In_X.STD_uint32_uint32_uint32.All_Maps_STD.Maps_Raster_2 M_In_X.STD_uint8_uint8_uint8.All_Maps_STD.Maps_Raster_2 M_In_Y.STD_float32_float32_float32.All_Maps_STD.Maps_Raster_2 M_In_Y.STD_sint16_sint16_sint16.All_Maps_STD.Maps_Raster_2 M_In_Y.STD_sint32_sint32_sint32.All_Maps_STD.Maps_Raster_2 M_In_Y.STD_sint8_sint8_sint8.All_Maps_STD.Maps_Raster_2 M_In_Y.STD_uint16_uint16_uint16.All_Maps_STD.Maps_Raster_2 M_In_Y.STD_uint32_uint32_uint32.All_Maps_STD.Maps_Raster_2 M_In_Y.STD_uint8_uint8_uint8.All_Maps_STD.Maps_Raster_2 M_out.STD_float32_float32_float32.All_Maps_STD.Maps_Raster_2 M_out.STD_sint16_sint16_sint16.All_Maps_STD.Maps_Raster_2 M_out.STD_sint32_sint32_sint32.All_Maps_STD.Maps_Raster_2 M_out.STD_sint8_sint8_sint8.All_Maps_STD.Maps_Raster_2 M_out.STD_uint16_uint16_uint16.All_Maps_STD.Maps_Raster_2 M_out.STD_uint32_uint32_uint32.All_Maps_STD.Maps_Raster_2 M_out.STD_uint8_uint8_uint8.All_Maps_STD.Maps_Raster_2 /end REF_MEASUREMENT
 /begin REF_CHARACTERISTIC P_Do_Active_Std.STD_float32_float32_float32.All_Maps_STD.Maps_Raster_2 P_Do_Active_Std.STD_sint16_sint16_sint16.All_Maps_STD.Maps_Raster_2 P_Do_Active_Std.STD_sint32_sint32_sint32.All_Maps_STD.Maps_Raster_2 P_Do_Active_Std.STD_sint8_sint8_sint8.All_Maps_STD.Maps_Raster_2 P_Do_Active_Std.STD_uint16_uint16_uint16.All_Maps_STD.Maps_Raster_2 P_Do_Active_Std.STD_uint32_uint32_uint32.All_Maps_STD.Maps_Raster_2 P_Do_Active_Std.STD_uint8_uint8_uint8.All_Maps_STD.Maps_Raster_2 P_Do_All_STD_Maps.All_Maps_STD.Maps_Raster_2 P_In_X.STD_float32_float32_float32.All_Maps_STD.Maps_Raster_2 P_In_X.STD_sint16_sint16_sint16.All_Maps_STD.Maps_Raster_2 P_In_X.STD_sint32_sint32_sint32.All_Maps_STD.Maps_Raster_2 P_In_X.STD_sint8_sint8_sint8.All_Maps_STD.Maps_Raster_2 P_In_X.STD_uint16_uint16_uint16.All_Maps_STD.Maps_Raster_2 P_In_X.STD_uint32_uint32_uint32.All_Maps_STD.Maps_Raster_2 P_In_X.STD_uint8_uint8_uint8.All_Maps_STD.Maps_Raster_2 P_In_Y.STD_float32_float32_float32.All_Maps_STD.Maps_Raster_2 P_In_Y.STD_sint16_sint16_sint16.All_Maps_STD.Maps_Raster_2 P_In_Y.STD_sint32_sint32_sint32.All_Maps_STD.Maps_Raster_2 P_In_Y.STD_sint8_sint8_sint8.All_Maps_STD.Maps_Raster_2 P_In_Y.STD_uint16_uint16_uint16.All_Maps_STD.Maps_Raster_2 P_In_Y.STD_uint32_uint32_uint32.All_Maps_STD.Maps_Raster_2 P_In_Y.STD_uint8_uint8_uint8.All_Maps_STD.Maps_Raster_2 Two_D.STD_float32_float32_float32.All_Maps_STD.Maps_Raster_2 Two_D.STD_sint16_sint16_sint16.All_Maps_STD.Maps_Raster_2 Two_D.STD_sint32_sint32_sint32.All_Maps_STD.Maps_Raster_2 Two_D.STD_sint8_sint8_sint8.All_Maps_STD.Maps_Raster_2 Two_D.STD_uint16_uint16_uint16.All_Maps_STD.Maps_Raster_2 Two_D.STD_uint32_uint32_uint32.All_Maps_STD.Maps_Raster_2 Two_D.STD_uint8_uint8_uint8.All_Maps_STD.Maps_Raster_2 /end REF_CHARACTERISTIC
/end GROUP
/begin GROUP Maps_Raster_3 "" ROOT
 /begin REF_MEASUREMENT Calculated.GRP_float32_float32_float32.All_Maps_GRP.Maps_Raster_3 Calculated.GRP_sint16_sint16_sint16.All_Maps_GRP.Maps_Raster_3 Calculated.GRP_sint32_sint32_sint32.All_Maps_GRP.Maps_Raster_3 Calculated.GRP_sint8_sint8_sint8.All_Maps_GRP.Maps_Raster_3 Calculated.GRP_uint16_uint16_uint16.All_Maps_GRP.Maps_Raster_3 Calculated.GRP_uint32_uint32_uint32.All_Maps_GRP.Maps_Raster_3 Calculated.GRP_uint8_uint8_uint8.All_Maps_GRP.Maps_Raster_3 Calculated.STD_float32_float32_float32.All_Maps_STD.Maps_Raster_3 Calculated.STD_sint16_sint16_sint16.All_Maps_STD.Maps_Raster_3 Calculated.STD_sint32_sint32_sint32.All_Maps_STD.Maps_Raster_3 Calculated.STD_sint8_sint8_sint8.All_Maps_STD.Maps_Raster_3 Calculated.STD_uint16_uint16_uint16.All_Maps_STD.Maps_Raster_3 Calculated.STD_uint32_uint32_uint32.All_Maps_STD.Maps_Raster_3 Calculated.STD_uint8_uint8_uint8.All_Maps_STD.Maps_Raster_3 M_In_X.GRP_float32_float32_float32.All_Maps_GRP.Maps_Raster_3 M_In_X.GRP_sint16_sint16_sint16.All_Maps_GRP.Maps_Raster_3 M_In_X.GRP_sint32_sint32_sint32.All_Maps_GRP.Maps_Raster_3 M_In_X.GRP_sint8_sint8_sint8.All_Maps_GRP.Maps_Raster_3 M_In_X.GRP_uint16_uint16_uint16.All_Maps_GRP.Maps_Raster_3 M_In_X.GRP_uint32_uint32_uint32.All_Maps_GRP.Maps_Raster_3 M_In_X.GRP_uint8_uint8_uint8.All_Maps_GRP.Maps_Raster_3 M_In_X.STD_float32_float32_float32.All_Maps_STD.Maps_Raster_3 M_In_X.STD_sint16_sint16_sint16.All_Maps_STD.Maps_Raster_3 M_In_X.STD_sint32_sint32_sint32.All_Maps_STD.Maps_Raster_3 M_In_X.STD_sint8_sint8_sint8.All_Maps_STD.Maps_Raster_3 M_In_X.STD_uint16_uint16_uint16.All_Maps_STD.Maps_Raster_3 M_In_X.STD_uint32_uint32_uint32.All_Maps_STD.Maps_Raster_3 M_In_X.STD_uint8_uint8_uint8.All_Maps_STD.Maps_Raster_3 M_In_Y.GRP_float32_float32_float32.All_Maps_GRP.Maps_Raster_3 M_In_Y.GRP_sint16_sint16_sint16.All_Maps_GRP.Maps_Raster_3 M_In_Y.GRP_sint32_sint32_sint32.All_Maps_GRP.Maps_Raster_3 M_In_Y.GRP_sint8_sint8_sint8.All_Maps_GRP.Maps_Raster_3 M_In_Y.GRP_uint16_uint16_uint16.All_Maps_GRP.Maps_Raster_3 M_In_Y.GRP_uint32_uint32_uint32.All_Maps_GRP.Maps_Raster_3 M_In_Y.GRP_uint8_uint8_uint8.All_Maps_GRP.Maps_Raster_3 M_In_Y.STD_float32_float32_float32.All_Maps_STD.Maps_Raster_3 M_In_Y.STD_sint16_sint16_sint16.All_Maps_STD.Maps_Raster_3 M_In_Y.STD_sint32_sint32_sint32.All_Maps_STD.Maps_Raster_3 M_In_Y.STD_sint8_sint8_sint8.All_Maps_STD.Maps_Raster_3 M_In_Y.STD_uint16_uint16_uint16.All_Maps_STD.Maps_Raster_3 M_In_Y.STD_uint32_uint32_uint32.All_Maps_STD.Maps_Raster_3 M_In_Y.STD_uint8_uint8_uint8.All_Maps_STD.Maps_Raster_3 M_out.GRP_float32_float32_float32.All_Maps_GRP.Maps_Raster_3 M_out.GRP_sint16_sint16_sint16.All_Maps_GRP.Maps_Raster_3 M_out.GRP_sint32_sint32_sint32.All_Maps_GRP.Maps_Raster_3 M_out.GRP_sint8_sint8_sint8.All_Maps_GRP.Maps_Raster_3 M_out.GRP_uint16_uint16_uint16.All_Maps_GRP.Maps_Raster_3 M_out.GRP_uint32_uint32_uint32.All_Maps_GRP.Maps_Raster_3 M_out.GRP_uint8_uint8_uint8.All_Maps_GRP.Maps_Raster_3 M_out.STD_float32_float32_float32.All_Maps_STD.Maps_Raster_3 M_out.STD_sint16_sint16_sint16.All_Maps_STD.Maps_Raster_3 M_out.STD_sint32_sint32_sint32.All_Maps_STD.Maps_Raster_3 M_out.STD_sint8_sint8_sint8.All_Maps_STD.Maps_Raster_3 M_out.STD_uint16_uint16_uint16.All_Maps_STD.Maps_Raster_3 M_out.STD_uint32_uint32_uint32.All_Maps_STD.Maps_Raster_3 M_out.STD_uint8_uint8_uint8.All_Maps_STD.Maps_Raster_3 /end REF_MEASUREMENT
 /begin REF_CHARACTERISTIC P_Do_Active_Grp.GRP_float32_float32_float32.All_Maps_GRP.Maps_Raster_3 P_Do_Active_Grp.GRP_sint16_sint16_sint16.All_Maps_GRP.Maps_Raster_3 P_Do_Active_Grp.GRP_sint32_sint32_sint32.All_Maps_GRP.Maps_Raster_3 P_Do_Active_Grp.GRP_sint8_sint8_sint8.All_Maps_GRP.Maps_Raster_3 P_Do_Active_Grp.GRP_uint16_uint16_uint16.All_Maps_GRP.Maps_Raster_3 P_Do_Active_Grp.GRP_uint32_uint32_uint32.All_Maps_GRP.Maps_Raster_3 P_Do_Active_Grp.GRP_uint8_uint8_uint8.All_Maps_GRP.Maps_Raster_3 P_Do_Active_Std.STD_float32_float32_float32.All_Maps_STD.Maps_Raster_3 P_Do_Active_Std.STD_sint16_sint16_sint16.All_Maps_STD.Maps_Raster_3 P_Do_Active_Std.STD_sint32_sint32_sint32.All_Maps_STD.Maps_Raster_3 P_Do_Active_Std.STD_sint8_sint8_sint8.All_Maps_STD.Maps_Raster_3 P_Do_Active_Std.STD_uint16_uint16_uint16.All_Maps_STD.Maps_Raster_3 P_Do_Active_Std.STD_uint32_uint32_uint32.All_Maps_STD.Maps_Raster_3 P_Do_Active_Std.STD_uint8_uint8_uint8.All_Maps_STD.Maps_Raster_3 P_Do_All_GRP_Maps.All_Maps_GRP.Maps_Raster_3 P_Do_All_STD_Maps.All_Maps_STD.Maps_Raster_3 P_Do_GET.GRP_float32_float32_float32.All_Maps_GRP.Maps_Raster_3 P_Do_GET.GRP_sint16_sint16_sint16.All_Maps_GRP.Maps_Raster_3 P_Do_GET.GRP_sint32_sint32_sint32.All_Maps_GRP.Maps_Raster_3 P_Do_GET.GRP_sint8_sint8_sint8.All_Maps_GRP.Maps_Raster_3 P_Do_GET.GRP_uint16_uint16_uint16.All_Maps_GRP.Maps_Raster_3 P_Do_GET.GRP_uint32_uint32_uint32.All_Maps_GRP.Maps_Raster_3 P_Do_GET.GRP_uint8_uint8_uint8.All_Maps_GRP.Maps_Raster_3 P_Do_X_SET.GRP_float32_float32_float32.All_Maps_GRP.Maps_Raster_3 P_Do_X_SET.GRP_sint16_sint16_sint16.All_Maps_GRP.Maps_Raster_3 P_Do_X_SET.GRP_sint32_sint32_sint32.All_Maps_GRP.Maps_Raster_3 P_Do_X_SET.GRP_sint8_sint8_sint8.All_Maps_GRP.Maps_Raster_3 P_Do_X_SET.GRP_uint16_uint16_uint16.All_Maps_GRP.Maps_Raster_3 P_Do_X_SET.GRP_uint32_uint32_uint32.All_Maps_GRP.Maps_Raster_3 P_Do_X_SET.GRP_uint8_uint8_uint8.All_Maps_GRP.Maps_Raster_3 P_Do_Y_SET.GRP_float32_float32_float32.All_Maps_GRP.Maps_Raster_3 P_Do_Y_SET.GRP_sint16_sint16_sint16.All_Maps_GRP.Maps_Raster_3 P_Do_Y_SET.GRP_sint32_sint32_sint32.All_Maps_GRP.Maps_Raster_3 P_Do_Y_SET.GRP_sint8_sint8_sint8.All_Maps_GRP.Maps_Raster_3 P_Do_Y_SET.GRP_uint16_uint16_uint16.All_Maps_GRP.Maps_Raster_3 P_Do_Y_SET.GRP_uint32_uint32_uint32.All_Maps_GRP.Maps_Raster_3 P_Do_Y_SET.GRP_uint8_uint8_uint8.All_Maps_GRP.Maps_Raster_3 P_In_X.GRP_float32_float32_float32.All_Maps_GRP.Maps_Raster_3 P_In_X.GRP_sint16_sint16_sint16.All_Maps_GRP.Maps_Raster_3 P_In_X.GRP_sint32_sint32_sint32.All_Maps_GRP.Maps_Raster_3 P_In_X.GRP_sint8_sint8_sint8.All_Maps_GRP.Maps_Raster_3 P_In_X.GRP_uint16_uint16_uint16.All_Maps_GRP.Maps_Raster_3 P_In_X.GRP_uint32_uint32_uint32.All_Maps_GRP.Maps_Raster_3 P_In_X.GRP_uint8_uint8_uint8.All_Maps_GRP.Maps_Raster_3 P_In_X.STD_float32_float32_float32.All_Maps_STD.Maps_Raster_3 P_In_X.STD_sint16_sint16_sint16.All_Maps_STD.Maps_Raster_3 P_In_X.STD_sint32_sint32_sint32.All_Maps_STD.Maps_Raster_3 P_In_X.STD_sint8_sint8_sint8.All_Maps_STD.Maps_Raster_3 P_In_X.STD_uint16_uint16_uint16.All_Maps_STD.Maps_Raster_3 P_In_X.STD_uint32_uint32_uint32.All_Maps_STD.Maps_Raster_3 P_In_X.STD_uint8_uint8_uint8.All_Maps_STD.Maps_Raster_3 P_In_Y.GRP_float32_float32_float32.All_Maps_GRP.Maps_Raster_3 P_In_Y.GRP_sint16_sint16_sint16.All_Maps_GRP.Maps_Raster_3 P_In_Y.GRP_sint32_sint32_sint32.All_Maps_GRP.Maps_Raster_3 P_In_Y.GRP_sint8_sint8_sint8.All_Maps_GRP.Maps_Raster_3 P_In_Y.GRP_uint16_uint16_uint16.All_Maps_GRP.Maps_Raster_3 P_In_Y.GRP_uint32_uint32_uint32.All_Maps_GRP.Maps_Raster_3 P_In_Y.GRP_uint8_uint8_uint8.All_Maps_GRP.Maps_Raster_3 P_In_Y.STD_float32_float32_float32.All_Maps_STD.Maps_Raster_3 P_In_Y.STD_sint16_sint16_sint16.All_Maps_STD.Maps_Raster_3 P_In_Y.STD_sint32_sint32_sint32.All_Maps_STD.Maps_Raster_3 P_In_Y.STD_sint8_sint8_sint8.All_Maps_STD.Maps_Raster_3 P_In_Y.STD_uint16_uint16_uint16.All_Maps_STD.Maps_Raster_3 P_In_Y.STD_uint32_uint32_uint32.All_Maps_STD.Maps_Raster_3 P_In_Y.STD_uint8_uint8_uint8.All_Maps_STD.Maps_Raster_3 Two_D.GRP_float32_float32_float32.All_Maps_GRP.Maps_Raster_3 Two_D.GRP_sint16_sint16_sint16.All_Maps_GRP.Maps_Raster_3 Two_D.GRP_sint32_sint32_sint32.All_Maps_GRP.Maps_Raster_3 Two_D.GRP_sint8_sint8_sint8.All_Maps_GRP.Maps_Raster_3 Two_D.GRP_uint16_uint16_uint16.All_Maps_GRP.Maps_Raster_3 Two_D.GRP_uint32_uint32_uint32.All_Maps_GRP.Maps_Raster_3 Two_D.GRP_uint8_uint8_uint8.All_Maps_GRP.Maps_Raster_3 Two_D.STD_float32_float32_float32.All_Maps_STD.Maps_Raster_3 Two_D.STD_sint16_sint16_sint16.All_Maps_STD.Maps_Raster_3 Two_D.STD_sint32_sint32_sint32.All_Maps_STD.Maps_Raster_3 Two_D.STD_sint8_sint8_sint8.All_Maps_STD.Maps_Raster_3 Two_D.STD_uint16_uint16_uint16.All_Maps_STD.Maps_Raster_3 Two_D.STD_uint32_uint32_uint32.All_Maps_STD.Maps_Raster_3 Two_D.STD_uint8_uint8_uint8.All_Maps_STD.Maps_Raster_3 /end REF_CHARACTERISTIC
/end GROUP
/begin GROUP STD_float32_float32_float32.All_Maps_STD.Maps_Raster_1 ""
 /begin REF_MEASUREMENT Calculated.STD_float32_float32_float32.All_Maps_STD.Maps_Raster_1 M_In_X.STD_float32_float32_float32.All_Maps_STD.Maps_Raster_1 M_In_Y.STD_float32_float32_float32.All_Maps_STD.Maps_Raster_1 M_out.STD_float32_float32_float32.All_Maps_STD.Maps_Raster_1 /end REF_MEASUREMENT
 /begin REF_CHARACTERISTIC P_Do_Active_Std.STD_float32_float32_float32.All_Maps_STD.Maps_Raster_1 P_In_X.STD_float32_float32_float32.All_Maps_STD.Maps_Raster_1 P_In_Y.STD_float32_float32_float32.All_Maps_STD.Maps_Raster_1 Two_D.STD_float32_float32_float32.All_Maps_STD.Maps_Raster_1 /end REF_CHARACTERISTIC
/end GROUP
/begin GROUP STD_float32_float32_float32.All_Maps_STD.Maps_Raster_2 ""
 /begin REF_MEASUREMENT Calculated.STD_float32_float32_float32.All_Maps_STD.Maps_Raster_2 M_In_X.STD_float32_float32_float32.All_Maps_STD.Maps_Raster_2 M_In_Y.STD_float32_float32_float32.All_Maps_STD.Maps_Raster_2 M_out.STD_float32_float32_float32.All_Maps_STD.Maps_Raster_2 /end REF_MEASUREMENT
 /begin REF_CHARACTERISTIC P_Do_Active_Std.STD_float32_float32_float32.All_Maps_STD.Maps_Raster_2 P_In_X.STD_float32_float32_float32.All_Maps_STD.Maps_Raster_2 P_In_Y.STD_float32_float32_float32.All_Maps_STD.Maps_Raster_2 Two_D.STD_float32_float32_float32.All_Maps_STD.Maps_Raster_2 /end REF_CHARACTERISTIC
/end GROUP
/begin GROUP STD_float32_float32_float32.All_Maps_STD.Maps_Raster_3 ""
 /begin REF_MEASUREMENT Calculated.STD_float32_float32_float32.All_Maps_STD.Maps_Raster_3 M_In_X.STD_float32_float32_float32.All_Maps_STD.Maps_Raster_3 M_In_Y.STD_float32_float32_float32.All_Maps_STD.Maps_Raster_3 M_out.STD_float32_float32_float32.All_Maps_STD.Maps_Raster_3 /end REF_MEASUREMENT
 /begin REF_CHARACTERISTIC P_Do_Active_Std.STD_float32_float32_float32.All_Maps_STD.Maps_Raster_3 P_In_X.STD_float32_float32_float32.All_Maps_STD.Maps_Raster_3 P_In_Y.STD_float32_float32_float32.All_Maps_STD.Maps_Raster_3 Two_D.STD_float32_float32_float32.All_Maps_STD.Maps_Raster_3 /end REF_CHARACTERISTIC
/end GROUP
/begin GROUP STD_sint16_sint16_sint16.All_Maps_STD.Maps_Raster_1 ""
 /begin REF_MEASUREMENT Calculated.STD_sint16_sint16_sint16.All_Maps_STD.Maps_Raster_1 M_In_X.STD_sint16_sint16_sint16.All_Maps_STD.Maps_Raster_1 M_In_Y.STD_sint16_sint16_sint16.All_Maps_STD.Maps_Raster_1 M_out.STD_sint16_sint16_sint16.All_Maps_STD.Maps_Raster_1 /end REF_MEASUREMENT
 /begin REF_CHARACTERISTIC P_Do_Active_Std.STD_sint16_sint16_sint16.All_Maps_STD.Maps_Raster_1 P_In_X.STD_sint16_sint16_sint16.All_Maps_STD.Maps_Raster_1 P_In_Y.STD_sint16_sint16_sint16.All_Maps_STD.Maps_Raster_1 Two_D.STD_sint16_sint16_sint16.All_Maps_STD.Maps_Raster_1 /end REF_CHARACTERISTIC
/end GROUP
/begin GROUP STD_sint16_sint16_sint16.All_Maps_STD.Maps_Raster_2 ""
 /begin REF_MEASUREMENT Calculated.STD_sint16_sint16_sint16.All_Maps_STD.Maps_Raster_2 M_In_X.STD_sint16_sint16_sint16.All_Maps_STD.Maps_Raster_2 M_In_Y.STD_sint16_sint16_sint16.All_Maps_STD.Maps_Raster_2 M_out.STD_sint16_sint16_sint16.All_Maps_STD.Maps_Raster_2 /end REF_MEASUREMENT
 /begin REF_CHARACTERISTIC P_Do_Active_Std.STD_sint16_sint16_sint16.All_Maps_STD.Maps_Raster_2 P_In_X.STD_sint16_sint16_sint16.All_Maps_STD.Maps_Raster_2 P_In_Y.STD_sint16_sint16_sint16.All_Maps_STD.Maps_Raster_2 Two_D.STD_sint16_sint16_sint16.All_Maps_STD.Maps_Raster_2 /end REF_CHARACTERISTIC
/end GROUP
/begin GROUP STD_sint16_sint16_sint16.All_Maps_STD.Maps_Raster_3 ""
 /begin REF_MEASUREMENT Calculated.STD_sint16_sint16_sint16.All_Maps_STD.Maps_Raster_3 M_In_X.STD_sint16_sint16_sint16.All_Maps_STD.Maps_Raster_3 M_In_Y.STD_sint16_sint16_sint16.All_Maps_STD.Maps_Raster_3 M_out.STD_sint16_sint16_sint16.All_Maps_STD.Maps_Raster_3 /end REF_MEASUREMENT
 /begin REF_CHARACTERISTIC P_Do_Active_Std.STD_sint16_sint16_sint16.All_Maps_STD.Maps_Raster_3 P_In_X.STD_sint16_sint16_sint16.All_Maps_STD.Maps_Raster_3 P_In_Y.STD_sint16_sint16_sint16.All_Maps_STD.Maps_Raster_3 Two_D.STD_sint16_sint16_sint16.All_Maps_STD.Maps_Raster_3 /end REF_CHARACTERISTIC
/end GROUP
/begin GROUP STD_sint32_sint32_sint32.All_Maps_STD.Maps_Raster_1 ""
 /begin REF_MEASUREMENT Calculated.STD_sint32_sint32_sint32.All_Maps_STD.Maps_Raster_1 M_In_X.STD_sint32_sint32_sint32.All_Maps_STD.Maps_Raster_1 M_In_Y.STD_sint32_sint32_sint32.All_Maps_STD.Maps_Raster_1 M_out.STD_sint32_sint32_sint32.All_Maps_STD.Maps_Raster_1 /end REF_MEASUREMENT
 /begin REF_CHARACTERISTIC P_Do_Active_Std.STD_sint32_sint32_sint32.All_Maps_STD.Maps_Raster_1 P_In_X.STD_sint32_sint32_sint32.All_Maps_STD.Maps_Raster_1 P_In_Y.STD_sint32_sint32_sint32.All_Maps_STD.Maps_Raster_1 Two_D.STD_sint32_sint32_sint32.All_Maps_STD.Maps_Raster_1 /end REF_CHARACTERISTIC
/end GROUP
/begin GROUP STD_sint32_sint32_sint32.All_Maps_STD.Maps_Raster_2 ""
 /begin REF_MEASUREMENT Calculated.STD_sint32_sint32_sint32.All_Maps_STD.Maps_Raster_2 M_In_X.STD_sint32_sint32_sint32.All_Maps_STD.Maps_Raster_2 M_In_Y.STD_sint32_sint32_sint32.All_Maps_STD.Maps_Raster_2 M_out.STD_sint32_sint32_sint32.All_Maps_STD.Maps_Raster_2 /end REF_MEASUREMENT
 /begin REF_CHARACTERISTIC P_Do_Active_Std.STD_sint32_sint32_sint32.All_Maps_STD.Maps_Raster_2 P_In_X.STD_sint32_sint32_sint32.All_Maps_STD.Maps_Raster_2 P_In_Y.STD_sint32_sint32_sint32.All_Maps_STD.Maps_Raster_2 Two_D.STD_sint32_sint32_sint32.All_Maps_STD.Maps_Raster_2 /end REF_CHARACTERISTIC
/end GROUP
/begin GROUP STD_sint32_sint32_sint32.All_Maps_STD.Maps_Raster_3 ""
 /begin REF_MEASUREMENT Calculated.STD_sint32_sint32_sint32.All_Maps_STD.Maps_Raster_3 M_In_X.STD_sint32_sint32_sint32.All_Maps_STD.Maps_Raster_3 M_In_Y.STD_sint32_sint32_sint32.All_Maps_STD.Maps_Raster_3 M_out.STD_sint32_sint32_sint32.All_Maps_STD.Maps_Raster_3 /end REF_MEASUREMENT
 /begin REF_CHARACTERISTIC P_Do_Active_Std.STD_sint32_sint32_sint32.All_Maps_STD.Maps_Raster_3 P_In_X.STD_sint32_sint32_sint32.All_Maps_STD.Maps_Raster_3 P_In_Y.STD_sint32_sint32_sint32.All_Maps_STD.Maps_Raster_3 Two_D.STD_sint32_sint32_sint32.All_Maps_STD.Maps_Raster_3 /end REF_CHARACTERISTIC
/end GROUP
/begin GROUP STD_sint8_sint8_sint8.All_Maps_STD.Maps_Raster_1 ""
 /begin REF_MEASUREMENT Calculated.STD_sint8_sint8_sint8.All_Maps_STD.Maps_Raster_1 M_In_X.STD_sint8_sint8_sint8.All_Maps_STD.Maps_Raster_1 M_In_Y.STD_sint8_sint8_sint8.All_Maps_STD.Maps_Raster_1 M_out.STD_sint8_sint8_sint8.All_Maps_STD.Maps_Raster_1 /end REF_MEASUREMENT
 /begin REF_CHARACTERISTIC P_Do_Active_Std.STD_sint8_sint8_sint8.All_Maps_STD.Maps_Raster_1 P_In_X.STD_sint8_sint8_sint8.All_Maps_STD.Maps_Raster_1 P_In_Y.STD_sint8_sint8_sint8.All_Maps_STD.Maps_Raster_1 Two_D.STD_sint8_sint8_sint8.All_Maps_STD.Maps_Raster_1 /end REF_CHARACTERISTIC
/end GROUP
/begin GROUP STD_sint8_sint8_sint8.All_Maps_STD.Maps_Raster_2 ""
 /begin REF_MEASUREMENT Calculated.STD_sint8_sint8_sint8.All_Maps_STD.Maps_Raster_2 M_In_X.STD_sint8_sint8_sint8.All_Maps_STD.Maps_Raster_2 M_In_Y.STD_sint8_sint8_sint8.All_Maps_STD.Maps_Raster_2 M_out.STD_sint8_sint8_sint8.All_Maps_STD.Maps_Raster_2 /end REF_MEASUREMENT
 /begin REF_CHARACTERISTIC P_Do_Active_Std.STD_sint8_sint8_sint8.All_Maps_STD.Maps_Raster_2 P_In_X.STD_sint8_sint8_sint8.All_Maps_STD.Maps_Raster_2 P_In_Y.STD_sint8_sint8_sint8.All_Maps_STD.Maps_Raster_2 Two_D.STD_sint8_sint8_sint8.All_Maps_STD.Maps_Raster_2 /end REF_CHARACTERISTIC
/end GROUP
/begin GROUP STD_sint8_sint8_sint8.All_Maps_STD.Maps_Raster_3 ""
 /begin REF_MEASUREMENT Calculated.STD_sint8_sint8_sint8.All_Maps_STD.Maps_Raster_3 M_In_X.STD_sint8_sint8_sint8.All_Maps_STD.Maps_Raster_3 M_In_Y.STD_sint8_sint8_sint8.All_Maps_STD.Maps_Raster_3 M_out.STD_sint8_sint8_sint8.All_Maps_STD.Maps_Raster_3 /end REF_MEASUREMENT
 /begin REF_CHARACTERISTIC P_Do_Active_Std.STD_sint8_sint8_sint8.All_Maps_STD.Maps_Raster_3 P_In_X.STD_sint8_sint8_sint8.All_Maps_STD.Maps_Raster_3 P_In_Y.STD_sint8_sint8_sint8.All_Maps_STD.Maps_Raster_3 Two_D.STD_sint8_sint8_sint8.All_Maps_STD.Maps_Raster_3 /end REF_CHARACTERISTIC
/end GROUP
/begin GROUP STD_uint16_uint16_uint16.All_Maps_STD.Maps_Raster_1 ""
 /begin REF_MEASUREMENT Calculated.STD_uint16_uint16_uint16.All_Maps_STD.Maps_Raster_1 M_In_X.STD_uint16_uint16_uint16.All_Maps_STD.Maps_Raster_1 M_In_Y.STD_uint16_uint16_uint16.All_Maps_STD.Maps_Raster_1 M_out.STD_uint16_uint16_uint16.All_Maps_STD.Maps_Raster_1 /end REF_MEASUREMENT
 /begin REF_CHARACTERISTIC P_Do_Active_Std.STD_uint16_uint16_uint16.All_Maps_STD.Maps_Raster_1 P_In_X.STD_uint16_uint16_uint16.All_Maps_STD.Maps_Raster_1 P_In_Y.STD_uint16_uint16_uint16.All_Maps_STD.Maps_Raster_1 Two_D.STD_uint16_uint16_uint16.All_Maps_STD.Maps_Raster_1 /end REF_CHARACTERISTIC
/end GROUP
/begin GROUP STD_uint16_uint16_uint16.All_Maps_STD.Maps_Raster_2 ""
 /begin REF_MEASUREMENT Calculated.STD_uint16_uint16_uint16.All_Maps_STD.Maps_Raster_2 M_In_X.STD_uint16_uint16_uint16.All_Maps_STD.Maps_Raster_2 M_In_Y.STD_uint16_uint16_uint16.All_Maps_STD.Maps_Raster_2 M_out.STD_uint16_uint16_uint16.All_Maps_STD.Maps_Raster_2 /end REF_MEASUREMENT
 /begin REF_CHARACTERISTIC P_Do_Active_Std.STD_uint16_uint16_uint16.All_Maps_STD.Maps_Raster_2 P_In_X.STD_uint16_uint16_uint16.All_Maps_STD.Maps_Raster_2 P_In_Y.STD_uint16_uint16_uint16.All_Maps_STD.Maps_Raster_2 Two_D.STD_uint16_uint16_uint16.All_Maps_STD.Maps_Raster_2 /end REF_CHARACTERISTIC
/end GROUP
/begin GROUP STD_uint16_uint16_uint16.All_Maps_STD.Maps_Raster_3 ""
 /begin REF_MEASUREMENT Calculated.STD_uint16_uint16_uint16.All_Maps_STD.Maps_Raster_3 M_In_X.STD_uint16_uint16_uint16.All_Maps_STD.Maps_Raster_3 M_In_Y.STD_uint16_uint16_uint16.All_Maps_STD.Maps_Raster_3 M_out.STD_uint16_uint16_uint16.All_Maps_STD.Maps_Raster_3 /end REF_MEASUREMENT
 /begin REF_CHARACTERISTIC P_Do_Active_Std.STD_uint16_uint16_uint16.All_Maps_STD.Maps_Raster_3 P_In_X.STD_uint16_uint16_uint16.All_Maps_STD.Maps_Raster_3 P_In_Y.STD_uint16_uint16_uint16.All_Maps_STD.Maps_Raster_3 Two_D.STD_uint16_uint16_uint16.All_Maps_STD.Maps_Raster_3 /end REF_CHARACTERISTIC
/end GROUP
/begin GROUP STD_uint32_uint32_uint32.All_Maps_STD.Maps_Raster_1 ""
 /begin REF_MEASUREMENT Calculated.STD_uint32_uint32_uint32.All_Maps_STD.Maps_Raster_1 M_In_X.STD_uint32_uint32_uint32.All_Maps_STD.Maps_Raster_1 M_In_Y.STD_uint32_uint32_uint32.All_Maps_STD.Maps_Raster_1 M_out.STD_uint32_uint32_uint32.All_Maps_STD.Maps_Raster_1 /end REF_MEASUREMENT
 /begin REF_CHARACTERISTIC P_Do_Active_Std.STD_uint32_uint32_uint32.All_Maps_STD.Maps_Raster_1 P_In_X.STD_uint32_uint32_uint32.All_Maps_STD.Maps_Raster_1 P_In_Y.STD_uint32_uint32_uint32.All_Maps_STD.Maps_Raster_1 Two_D.STD_uint32_uint32_uint32.All_Maps_STD.Maps_Raster_1 /end REF_CHARACTERISTIC
/end GROUP
/begin GROUP STD_uint32_uint32_uint32.All_Maps_STD.Maps_Raster_2 ""
 /begin REF_MEASUREMENT Calculated.STD_uint32_uint32_uint32.All_Maps_STD.Maps_Raster_2 M_In_X.STD_uint32_uint32_uint32.All_Maps_STD.Maps_Raster_2 M_In_Y.STD_uint32_uint32_uint32.All_Maps_STD.Maps_Raster_2 M_out.STD_uint32_uint32_uint32.All_Maps_STD.Maps_Raster_2 /end REF_MEASUREMENT
 /begin REF_CHARACTERISTIC P_Do_Active_Std.STD_uint32_uint32_uint32.All_Maps_STD.Maps_Raster_2 P_In_X.STD_uint32_uint32_uint32.All_Maps_STD.Maps_Raster_2 P_In_Y.STD_uint32_uint32_uint32.All_Maps_STD.Maps_Raster_2 Two_D.STD_uint32_uint32_uint32.All_Maps_STD.Maps_Raster_2 /end REF_CHARACTERISTIC
/end GROUP
/begin GROUP STD_uint32_uint32_uint32.All_Maps_STD.Maps_Raster_3 ""
 /begin REF_MEASUREMENT Calculated.STD_uint32_uint32_uint32.All_Maps_STD.Maps_Raster_3 M_In_X.STD_uint32_uint32_uint32.All_Maps_STD.Maps_Raster_3 M_In_Y.STD_uint32_uint32_uint32.All_Maps_STD.Maps_Raster_3 M_out.STD_uint32_uint32_uint32.All_Maps_STD.Maps_Raster_3 /end REF_MEASUREMENT
 /begin REF_CHARACTERISTIC P_Do_Active_Std.STD_uint32_uint32_uint32.All_Maps_STD.Maps_Raster_3 P_In_X.STD_uint32_uint32_uint32.All_Maps_STD.Maps_Raster_3 P_In_Y.STD_uint32_uint32_uint32.All_Maps_STD.Maps_Raster_3 Two_D.STD_uint32_uint32_uint32.All_Maps_STD.Maps_Raster_3 /end REF_CHARACTERISTIC
/end GROUP
/begin GROUP STD_uint8_uint8_uint8.All_Maps_STD.Maps_Raster_1 ""
 /begin REF_MEASUREMENT Calculated.STD_uint8_uint8_uint8.All_Maps_STD.Maps_Raster_1 M_In_X.STD_uint8_uint8_uint8.All_Maps_STD.Maps_Raster_1 M_In_Y.STD_uint8_uint8_uint8.All_Maps_STD.Maps_Raster_1 M_out.STD_uint8_uint8_uint8.All_Maps_STD.Maps_Raster_1 /end REF_MEASUREMENT
 /begin REF_CHARACTERISTIC P_Do_Active_Std.STD_uint8_uint8_uint8.All_Maps_STD.Maps_Raster_1 P_In_X.STD_uint8_uint8_uint8.All_Maps_STD.Maps_Raster_1 P_In_Y.STD_uint8_uint8_uint8.All_Maps_STD.Maps_Raster_1 Two_D.STD_uint8_uint8_uint8.All_Maps_STD.Maps_Raster_1 /end REF_CHARACTERISTIC
/end GROUP
/begin GROUP STD_uint8_uint8_uint8.All_Maps_STD.Maps_Raster_2 ""
 /begin REF_MEASUREMENT Calculated.STD_uint8_uint8_uint8.All_Maps_STD.Maps_Raster_2 M_In_X.STD_uint8_uint8_uint8.All_Maps_STD.Maps_Raster_2 M_In_Y.STD_uint8_uint8_uint8.All_Maps_STD.Maps_Raster_2 M_out.STD_uint8_uint8_uint8.All_Maps_STD.Maps_Raster_2 /end REF_MEASUREMENT
 /begin REF_CHARACTERISTIC P_Do_Active_Std.STD_uint8_uint8_uint8.All_Maps_STD.Maps_Raster_2 P_In_X.STD_uint8_uint8_uint8.All_Maps_STD.Maps_Raster_2 P_In_Y.STD_uint8_uint8_uint8.All_Maps_STD.Maps_Raster_2 Two_D.STD_uint8_uint8_uint8.All_Maps_STD.Maps_Raster_2 /end REF_CHARACTERISTIC
/end GROUP
/begin GROUP STD_uint8_uint8_uint8.All_Maps_STD.Maps_Raster_3 ""
 /begin REF_MEASUREMENT Calculated.STD_uint8_uint8_uint8.All_Maps_STD.Maps_Raster_3 M_In_X.STD_uint8_uint8_uint8.All_Maps_STD.Maps_Raster_3 M_In_Y.STD_uint8_uint8_uint8.All_Maps_STD.Maps_Raster_3 M_out.STD_uint8_uint8_uint8.All_Maps_STD.Maps_Raster_3 /end REF_MEASUREMENT
 /begin REF_CHARACTERISTIC P_Do_Active_Std.STD_uint8_uint8_uint8.All_Maps_STD.Maps_Raster_3 P_In_X.STD_uint8_uint8_uint8.All_Maps_STD.Maps_Raster_3 P_In_Y.STD_uint8_uint8_uint8.All_Maps_STD.Maps_Raster_3 Two_D.STD_uint8_uint8_uint8.All_Maps_STD.Maps_Raster_3 /end REF_CHARACTERISTIC
/end GROUP
/begin RECORD_LAYOUT STANDARD_DIST_R32 AXIS_PTS_X 2 FLOAT32_IEEE INDEX_INCR DIRECT NO_AXIS_PTS_X 1 UWORD /end RECORD_LAYOUT
/begin RECORD_LAYOUT STANDARD_DIST_S16 AXIS_PTS_X 2 SWORD INDEX_INCR DIRECT NO_AXIS_PTS_X 1 UWORD /end RECORD_LAYOUT
/begin RECORD_LAYOUT STANDARD_DIST_S32 AXIS_PTS_X 2 SLONG INDEX_INCR DIRECT NO_AXIS_PTS_X 1 UWORD /end RECORD_LAYOUT
/begin RECORD_LAYOUT STANDARD_DIST_S8 AXIS_PTS_X 2 SBYTE INDEX_INCR DIRECT NO_AXIS_PTS_X 1 UBYTE /end RECORD_LAYOUT
/begin RECORD_LAYOUT STANDARD_DIST_U16 AXIS_PTS_X 2 UWORD INDEX_INCR DIRECT NO_AXIS_PTS_X 1 UWORD /end RECORD_LAYOUT
/begin RECORD_LAYOUT STANDARD_DIST_U32 AXIS_PTS_X 2 ULONG INDEX_INCR DIRECT NO_AXIS_PTS_X 1 UWORD /end RECORD_LAYOUT
/begin RECORD_LAYOUT STANDARD_DIST_U8 AXIS_PTS_X 2 UBYTE INDEX_INCR DIRECT NO_AXIS_PTS_X 1 UBYTE /end RECORD_LAYOUT
/begin RECORD_LAYOUT STANDARD_GROUP_R32 FNC_VALUES 1 FLOAT32_IEEE COLUMN_DIR DIRECT /end RECORD_LAYOUT
/begin RECORD_LAYOUT STANDARD_GROUP_S16 FNC_VALUES 1 SWORD COLUMN_DIR DIRECT /end RECORD_LAYOUT
/begin RECORD_LAYOUT STANDARD_GROUP_S32 FNC_VALUES 1 SLONG COLUMN_DIR DIRECT /end RECORD_LAYOUT
/begin RECORD_LAYOUT STANDARD_GROUP_S8 FNC_VALUES 1 SBYTE COLUMN_DIR DIRECT /end RECORD_LAYOUT
/begin RECORD_LAYOUT STANDARD_GROUP_U16 FNC_VALUES 1 UWORD COLUMN_DIR DIRECT /end RECORD_LAYOUT
/begin RECORD_LAYOUT STANDARD_GROUP_U32 FNC_VALUES 1 ULONG COLUMN_DIR DIRECT /end RECORD_LAYOUT
/begin RECORD_LAYOUT STANDARD_GROUP_U8 FNC_VALUES 1 UBYTE COLUMN_DIR DIRECT /end RECORD_LAYOUT
/begin RECORD_LAYOUT STANDARD_MAP_R32R32R32 FNC_VALUES 5 FLOAT32_IEEE COLUMN_DIR DIRECT AXIS_PTS_X 3 FLOAT32_IEEE INDEX_INCR DIRECT AXIS_PTS_Y 4 FLOAT32_IEEE INDEX_INCR DIRECT NO_AXIS_PTS_X 1 UWORD NO_AXIS_PTS_Y 2 UWORD /end RECORD_LAYOUT
/begin RECORD_LAYOUT STANDARD_MAP_S16S16S16 FNC_VALUES 5 SWORD COLUMN_DIR DIRECT AXIS_PTS_X 3 SWORD INDEX_INCR DIRECT AXIS_PTS_Y 4 SWORD INDEX_INCR DIRECT NO_AXIS_PTS_X 1 UWORD NO_AXIS_PTS_Y 2 UWORD /end RECORD_LAYOUT
/begin RECORD_LAYOUT STANDARD_MAP_S32S32S32 FNC_VALUES 5 SLONG COLUMN_DIR DIRECT AXIS_PTS_X 3 SLONG INDEX_INCR DIRECT AXIS_PTS_Y 4 SLONG INDEX_INCR DIRECT NO_AXIS_PTS_X 1 UWORD NO_AXIS_PTS_Y 2 UWORD /end RECORD_LAYOUT
/begin RECORD_LAYOUT STANDARD_MAP_S8S8S8 FNC_VALUES 5 SBYTE COLUMN_DIR DIRECT AXIS_PTS_X 3 SBYTE INDEX_INCR DIRECT AXIS_PTS_Y 4 SBYTE INDEX_INCR DIRECT NO_AXIS_PTS_X 1 UBYTE NO_AXIS_PTS_Y 2 UBYTE /end RECORD_LAYOUT
/begin RECORD_LAYOUT STANDARD_MAP_U16U16U16 FNC_VALUES 5 UWORD COLUMN_DIR DIRECT AXIS_PTS_X 3 UWORD INDEX_INCR DIRECT AXIS_PTS_Y 4 UWORD INDEX_INCR DIRECT NO_AXIS_PTS_X 1 UWORD NO_AXIS_PTS_Y 2 UWORD /end RECORD_LAYOUT
/begin RECORD_LAYOUT STANDARD_MAP_U32U32U32 FNC_VALUES 5 ULONG COLUMN_DIR DIRECT AXIS_PTS_X 3 ULONG INDEX_INCR DIRECT AXIS_PTS_Y 4 ULONG INDEX_INCR DIRECT NO_AXIS_PTS_X 1 UWORD NO_AXIS_PTS_Y 2 UWORD /end RECORD_LAYOUT
/begin RECORD_LAYOUT STANDARD_MAP_U8U8U8 FNC_VALUES 5 UBYTE COLUMN_DIR DIRECT AXIS_PTS_X 3 UBYTE INDEX_INCR DIRECT AXIS_PTS_Y 4 UBYTE INDEX_INCR DIRECT NO_AXIS_PTS_X 1 UBYTE NO_AXIS_PTS_Y 2 UBYTE /end RECORD_LAYOUT
/begin RECORD_LAYOUT STANDARD_VALUE_R32 FNC_VALUES 1 FLOAT32_IEEE COLUMN_DIR DIRECT /end RECORD_LAYOUT
/begin RECORD_LAYOUT STANDARD_VALUE_S16 FNC_VALUES 1 SWORD COLUMN_DIR DIRECT /end RECORD_LAYOUT
/begin RECORD_LAYOUT STANDARD_VALUE_S32 FNC_VALUES 1 SLONG COLUMN_DIR DIRECT /end RECORD_LAYOUT
/begin RECORD_LAYOUT STANDARD_VALUE_S8 FNC_VALUES 1 SBYTE COLUMN_DIR DIRECT /end RECORD_LAYOUT
/begin RECORD_LAYOUT STANDARD_VALUE_U16 FNC_VALUES 1 UWORD COLUMN_DIR DIRECT /end RECORD_LAYOUT
/begin RECORD_LAYOUT STANDARD_VALUE_U32 FNC_VALUES 1 ULONG COLUMN_DIR DIRECT /end RECORD_LAYOUT
/begin RECORD_LAYOUT STANDARD_VALUE_U8 FNC_VALUES 1 UBYTE COLUMN_DIR DIRECT /end RECORD_LAYOUT
/end MODULE
/end PROJECT
