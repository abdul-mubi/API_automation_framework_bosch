ASAP2_VERSION 1 61
/begin PROJECT HWA_UDSonCAN_ReferenceSystem "Modified for UDSonCAN Tests with new CalMeasure Mapping"
/begin HEADER "" VERSION "000" PROJECT_NO ASD /end HEADER
/begin MODULE HWA_UDSonCAN_ReferenceSystem "Modified for UDSonCAN Tests with new CalMeasure Mapping"
/begin MOD_COMMON "2013-05-06 09:52:20	create by ETASHexVirtualAddressTableHeaderV2" BYTE_ORDER MSB_FIRST ALIGNMENT_BYTE 1 ALIGNMENT_WORD 2 ALIGNMENT_LONG 4 ALIGNMENT_FLOAT32_IEEE 4 ALIGNMENT_FLOAT64_IEEE 8 /end MOD_COMMON
/begin CHARACTERISTIC Alarm_ID.R01.Restart_Raster_16T "" VALUE 0x1DA688 STANDARD_VALUE_U8 0.0 ident 0 255 /end CHARACTERISTIC
/begin CHARACTERISTIC Alarm_ID.R02.Restart_Raster_16T "" VALUE 0x1DA69C STANDARD_VALUE_U8 0.0 ident 0 255 /end CHARACTERISTIC
/begin CHARACTERISTIC Alarm_ID.R03.Restart_Raster_16T "" VALUE 0x1DA6B0 STANDARD_VALUE_U8 0.0 ident 0 255 /end CHARACTERISTIC
/begin CHARACTERISTIC Alarm_ID.R04_Sync.Restart_Raster_16T "" VALUE 0x1DA744 STANDARD_VALUE_U8 0.0 ident 0 255 /end CHARACTERISTIC
/begin CHARACTERISTIC Alarm_ID.R05.Restart_Raster_16T "" VALUE 0x1DA758 STANDARD_VALUE_U8 0.0 ident 0 255 /end CHARACTERISTIC
/begin CHARACTERISTIC Alarm_ID.R06.Restart_Raster_16T "" VALUE 0x1DA768 STANDARD_VALUE_U8 0.0 ident 0 255 /end CHARACTERISTIC
/begin CHARACTERISTIC Alarm_ID.R07.Restart_Raster_16T "" VALUE 0x1DA778 STANDARD_VALUE_U8 0.0 ident 0 255 /end CHARACTERISTIC
/begin CHARACTERISTIC Alarm_ID.R08.Restart_Raster_16T "" VALUE 0x1DA788 STANDARD_VALUE_U8 0.0 ident 0 255 /end CHARACTERISTIC
/begin CHARACTERISTIC Alarm_ID.R09.Restart_Raster_16T "" VALUE 0x1DA798 STANDARD_VALUE_U8 0.0 ident 0 255 /end CHARACTERISTIC
/begin CHARACTERISTIC Alarm_ID.R10.Restart_Raster_16T "" VALUE 0x1DA7A8 STANDARD_VALUE_U8 0.0 ident 0 255 /end CHARACTERISTIC
/begin CHARACTERISTIC Alarm_ID.R11.Restart_Raster_16T "" VALUE 0x1DA7B8 STANDARD_VALUE_U8 0.0 ident 0 255 /end CHARACTERISTIC
/begin CHARACTERISTIC Alarm_ID.R12.Restart_Raster_16T "" VALUE 0x1DA7C8 STANDARD_VALUE_U8 0.0 ident 0 255 /end CHARACTERISTIC
/begin CHARACTERISTIC Alarm_ID.R13.Restart_Raster_16T "" VALUE 0x1DA7D8 STANDARD_VALUE_U8 0.0 ident 0 255 /end CHARACTERISTIC
/begin CHARACTERISTIC Alarm_ID.R14.Restart_Raster_16T "" VALUE 0x1DA7E8 STANDARD_VALUE_U8 0.0 ident 0 255 /end CHARACTERISTIC
/begin CHARACTERISTIC Alarm_ID.R15.Restart_Raster_16T "" VALUE 0x1DA7F8 STANDARD_VALUE_U8 0.0 ident 0 255 /end CHARACTERISTIC
/begin CHARACTERISTIC Alarm_ID.R16.Restart_Raster_16T "" VALUE 0x1DA808 STANDARD_VALUE_U8 0.0 ident 0 255 /end CHARACTERISTIC
/begin CHARACTERISTIC asynchron_alarm_cycle_times_array.R01.Restart_Raster_16T "" VAL_BLK 0x1DA608 STANDARD_VALUE_U32 0.0 TickType2ms 0.0 1227133.512857143 MATRIX_DIM 32 1 1 /end CHARACTERISTIC
/begin CHARACTERISTIC asynchron_alarm_cycle_times_array.R04_Sync.Restart_Raster_16T "" VAL_BLK 0x1DA6C4 STANDARD_VALUE_U32 0.0 TickType2ms 0.0 1227133.512857143 MATRIX_DIM 32 1 1 /end CHARACTERISTIC
/begin CHARACTERISTIC HWE_Enter_NL_Debug.SIKO_Module "" VALUE 0x1DA8E4 STANDARD_VALUE_S8 0.0 ident 0 1 BIT_MASK 0x1 /end CHARACTERISTIC
/begin CHARACTERISTIC p_AcceptAllKeys_u8.XCP_SHELL_VAR.XCP_SHELL "" VALUE 0x1DABEA STANDARD_VALUE_U8 0.0 ident 0 255 /end CHARACTERISTIC
/begin CHARACTERISTIC P_alarm_cycle.R01.Restart_Raster_16T "" VALUE 0x1DA600 STANDARD_VALUE_U32 0.0 TickType2ms 0.0 1227133.512857143 /end CHARACTERISTIC
/begin CHARACTERISTIC P_alarm_cycle.R02.Restart_Raster_16T "" VALUE 0x1DA694 STANDARD_VALUE_U32 0.0 TickType2ms 0.0 1227133.512857143 /end CHARACTERISTIC
/begin CHARACTERISTIC P_alarm_cycle.R03.Restart_Raster_16T "" VALUE 0x1DA6A8 STANDARD_VALUE_U32 0.0 TickType2ms 0.0 1227133.512857143 /end CHARACTERISTIC
/begin CHARACTERISTIC P_alarm_cycle.R04_Sync.Restart_Raster_16T "" VALUE 0x1DA6BC STANDARD_VALUE_U32 0.0 TickType2ms 0.0 1227133.512857143 /end CHARACTERISTIC
/begin CHARACTERISTIC P_alarm_cycle.R05.Restart_Raster_16T "" VALUE 0x1DA750 STANDARD_VALUE_U32 0.0 TickType2ms 0.0 1227133.512857143 /end CHARACTERISTIC
/begin CHARACTERISTIC P_alarm_cycle.R06.Restart_Raster_16T "" VALUE 0x1DA760 STANDARD_VALUE_U32 0.0 TickType2ms 0.0 1227133.512857143 /end CHARACTERISTIC
/begin CHARACTERISTIC P_alarm_cycle.R07.Restart_Raster_16T "" VALUE 0x1DA770 STANDARD_VALUE_U32 0.0 TickType2ms 0.0 1227133.512857143 /end CHARACTERISTIC
/begin CHARACTERISTIC P_alarm_cycle.R08.Restart_Raster_16T "" VALUE 0x1DA780 STANDARD_VALUE_U32 0.0 TickType2ms 0.0 1227133.512857143 /end CHARACTERISTIC
/begin CHARACTERISTIC P_alarm_cycle.R09.Restart_Raster_16T "" VALUE 0x1DA790 STANDARD_VALUE_U32 0.0 TickType2ms 0.0 1227133.512857143 /end CHARACTERISTIC
/begin CHARACTERISTIC P_alarm_cycle.R10.Restart_Raster_16T "" VALUE 0x1DA7A0 STANDARD_VALUE_U32 0.0 TickType2ms 0.0 1227133.512857143 /end CHARACTERISTIC
/begin CHARACTERISTIC P_alarm_cycle.R11.Restart_Raster_16T "" VALUE 0x1DA7B0 STANDARD_VALUE_U32 0.0 TickType2ms 0.0 1227133.512857143 /end CHARACTERISTIC
/begin CHARACTERISTIC P_alarm_cycle.R12.Restart_Raster_16T "" VALUE 0x1DA7C0 STANDARD_VALUE_U32 0.0 TickType2ms 0.0 1227133.512857143 /end CHARACTERISTIC
/begin CHARACTERISTIC P_alarm_cycle.R13.Restart_Raster_16T "" VALUE 0x1DA7D0 STANDARD_VALUE_U32 0.0 TickType2ms 0.0 1227133.512857143 /end CHARACTERISTIC
/begin CHARACTERISTIC P_alarm_cycle.R14.Restart_Raster_16T "" VALUE 0x1DA7E0 STANDARD_VALUE_U32 0.0 TickType2ms 0.0 1227133.512857143 /end CHARACTERISTIC
/begin CHARACTERISTIC P_alarm_cycle.R15.Restart_Raster_16T "" VALUE 0x1DA7F0 STANDARD_VALUE_U32 0.0 TickType2ms 0.0 1227133.512857143 /end CHARACTERISTIC
/begin CHARACTERISTIC P_alarm_cycle.R16.Restart_Raster_16T "" VALUE 0x1DA800 STANDARD_VALUE_U32 0.0 TickType2ms 0.0 1227133.512857143 /end CHARACTERISTIC
/begin CHARACTERISTIC P_alarm_cycle_delay.R01.Restart_Raster_16T "" VALUE 0x1DA604 STANDARD_VALUE_U32 0.0 TickType2ms 0.0 1227133.512857143 /end CHARACTERISTIC
/begin CHARACTERISTIC P_alarm_cycle_delay.R02.Restart_Raster_16T "" VALUE 0x1DA698 STANDARD_VALUE_U32 0.0 TickType2ms 0.0 1227133.512857143 /end CHARACTERISTIC
/begin CHARACTERISTIC P_alarm_cycle_delay.R03.Restart_Raster_16T "" VALUE 0x1DA6AC STANDARD_VALUE_U32 0.0 TickType2ms 0.0 1227133.512857143 /end CHARACTERISTIC
/begin CHARACTERISTIC P_alarm_cycle_delay.R04_Sync.Restart_Raster_16T "" VALUE 0x1DA6C0 STANDARD_VALUE_U32 0.0 TickType2ms 0.0 1227133.512857143 /end CHARACTERISTIC
/begin CHARACTERISTIC P_alarm_cycle_delay.R05.Restart_Raster_16T "" VALUE 0x1DA754 STANDARD_VALUE_U32 0.0 TickType2ms 0.0 1227133.512857143 /end CHARACTERISTIC
/begin CHARACTERISTIC P_alarm_cycle_delay.R06.Restart_Raster_16T "" VALUE 0x1DA764 STANDARD_VALUE_U32 0.0 TickType2ms 0.0 1227133.512857143 /end CHARACTERISTIC
/begin CHARACTERISTIC P_alarm_cycle_delay.R07.Restart_Raster_16T "" VALUE 0x1DA774 STANDARD_VALUE_U32 0.0 TickType2ms 0.0 1227133.512857143 /end CHARACTERISTIC
/begin CHARACTERISTIC P_alarm_cycle_delay.R08.Restart_Raster_16T "" VALUE 0x1DA784 STANDARD_VALUE_U32 0.0 TickType2ms 0.0 1227133.512857143 /end CHARACTERISTIC
/begin CHARACTERISTIC P_alarm_cycle_delay.R09.Restart_Raster_16T "" VALUE 0x1DA794 STANDARD_VALUE_U32 0.0 TickType2ms 0.0 1227133.512857143 /end CHARACTERISTIC
/begin CHARACTERISTIC P_alarm_cycle_delay.R10.Restart_Raster_16T "" VALUE 0x1DA7A4 STANDARD_VALUE_U32 0.0 TickType2ms 0.0 1227133.512857143 /end CHARACTERISTIC
/begin CHARACTERISTIC P_alarm_cycle_delay.R11.Restart_Raster_16T "" VALUE 0x1DA7B4 STANDARD_VALUE_U32 0.0 TickType2ms 0.0 1227133.512857143 /end CHARACTERISTIC
/begin CHARACTERISTIC P_alarm_cycle_delay.R12.Restart_Raster_16T "" VALUE 0x1DA7C4 STANDARD_VALUE_U32 0.0 TickType2ms 0.0 1227133.512857143 /end CHARACTERISTIC
/begin CHARACTERISTIC P_alarm_cycle_delay.R13.Restart_Raster_16T "" VALUE 0x1DA7D4 STANDARD_VALUE_U32 0.0 TickType2ms 0.0 1227133.512857143 /end CHARACTERISTIC
/begin CHARACTERISTIC P_alarm_cycle_delay.R14.Restart_Raster_16T "" VALUE 0x1DA7E4 STANDARD_VALUE_U32 0.0 TickType2ms 0.0 1227133.512857143 /end CHARACTERISTIC
/begin CHARACTERISTIC P_alarm_cycle_delay.R15.Restart_Raster_16T "" VALUE 0x1DA7F4 STANDARD_VALUE_U32 0.0 TickType2ms 0.0 1227133.512857143 /end CHARACTERISTIC
/begin CHARACTERISTIC P_alarm_cycle_delay.R16.Restart_Raster_16T "" VALUE 0x1DA804 STANDARD_VALUE_U32 0.0 TickType2ms 0.0 1227133.512857143 /end CHARACTERISTIC
/begin CHARACTERISTIC P_asynchron_alarm_cycle.R01.Restart_Raster_16T "" VALUE 0x1DA689 STANDARD_VALUE_U8 0.0 ident 0 1 BIT_MASK 0x1 /end CHARACTERISTIC
/begin CHARACTERISTIC P_asynchron_alarm_cycle.R04_Sync.Restart_Raster_16T "" VALUE 0x1DA745 STANDARD_VALUE_U8 0.0 ident 0 1 BIT_MASK 0x1 /end CHARACTERISTIC
/begin CHARACTERISTIC p_cont_sint16_1_100_Xcp_B04.Model_XcpByp_B04 "" VALUE 0x1D7FFA STANDARD_VALUE_S16 0.0 formula_1_100 -327.68 327.67 /end CHARACTERISTIC
/begin CHARACTERISTIC p_cont_sint16_Xcp_B04.Model_XcpByp_B04 "" VALUE 0x1D7FFC STANDARD_VALUE_S16 0.0 ident -32768.0 32767.0 /end CHARACTERISTIC
/begin CHARACTERISTIC p_cont_sint8_1_10_Xcp_B04.Model_XcpByp_B04 "" VALUE 0x1D8004 STANDARD_VALUE_S8 0.0 formula_1_10 -12.8 12.7 /end CHARACTERISTIC
/begin CHARACTERISTIC p_cont_sint8_Xcp_B04.Model_XcpByp_B04 "" VALUE 0x1D8005 STANDARD_VALUE_S8 0.0 ident -128.0 127.0 /end CHARACTERISTIC
/begin CHARACTERISTIC p_cont_uint16_1_2_Xcp_B04.Model_XcpByp_B04 "" VALUE 0x1D7FFE STANDARD_VALUE_U16 0.0 formula_1_2 0.0 32767.5 /end CHARACTERISTIC
/begin CHARACTERISTIC p_cont_uint8_10_1_Xcp_B04.Model_XcpByp_B04 "" VALUE 0x1D8006 STANDARD_VALUE_U8 0.0 formula_10_1 0.0 2550.0 /end CHARACTERISTIC
/begin CHARACTERISTIC P_Count_Single_Step.Replay_Data "" VALUE 0x1D9E04 STANDARD_VALUE_U8 0.0 ident 0 1 BIT_MASK 0x1 /end CHARACTERISTIC
/begin CHARACTERISTIC P_Counter_Max.Replay_Data "" VALUE 0x1D9E05 STANDARD_VALUE_U8 0.0 ident 0 250 /end CHARACTERISTIC
/begin CHARACTERISTIC P_Delta_Counter_2ms_Task.OS_Counter "" VALUE 0x1D8012 STANDARD_VALUE_U8 0.0 ident 0 255 /end CHARACTERISTIC
/begin CHARACTERISTIC P_Delta_Counter_BG_Task.OS_Counter "" VALUE 0x1D8011 STANDARD_VALUE_U8 0.0 ident 0 255 /end CHARACTERISTIC
/begin CHARACTERISTIC P_Delta_Counter_CANA_IRQ.OS_Counter "" VALUE 0x1D800D STANDARD_VALUE_U8 0.0 ident 0 255 /end CHARACTERISTIC
/begin CHARACTERISTIC P_Delta_Counter_CANB_IRQ.OS_Counter "" VALUE 0x1D8014 STANDARD_VALUE_U8 0.0 ident 0 255 /end CHARACTERISTIC
/begin CHARACTERISTIC P_Delta_Counter_CANC_IRQ.OS_Counter "" VALUE 0x1D8013 STANDARD_VALUE_U8 0.0 ident 0 255 /end CHARACTERISTIC
/begin CHARACTERISTIC P_Delta_Counter_R01.OS_Counter "" VALUE 0x1D800C STANDARD_VALUE_U8 0.0 ident 0 255 /end CHARACTERISTIC
/begin CHARACTERISTIC P_Delta_Counter_R02.OS_Counter "" VALUE 0x1D800F STANDARD_VALUE_U8 0.0 ident 0 255 /end CHARACTERISTIC
/begin CHARACTERISTIC P_Delta_Counter_R03.OS_Counter "" VALUE 0x1D8015 STANDARD_VALUE_U8 0.0 ident 0 255 /end CHARACTERISTIC
/begin CHARACTERISTIC P_Do_Single_Step.Replay_Data "" VALUE 0x1D9E06 STANDARD_VALUE_U8 0.0 ident 0 1 BIT_MASK 0x1 /end CHARACTERISTIC
/begin CHARACTERISTIC p_enableSyncR04burst_u8.Restart_Raster_16T "" VALUE 0x1DA80C STANDARD_VALUE_U8 0.0 ident 0 1 BIT_MASK 0x1 /end CHARACTERISTIC
/begin CHARACTERISTIC p_log_uint8_0_Xcp_B04.Model_XcpByp_B04 "" VALUE 0x1D8007 STANDARD_VALUE_U8 0.0 ident 0 1 BIT_MASK 0x1 /end CHARACTERISTIC
/begin CHARACTERISTIC p_log_uint8_1_Xcp_B04.Model_XcpByp_B04 "" VALUE 0x1D8008 STANDARD_VALUE_U8 0.0 ident 0 1 BIT_MASK 0x1 /end CHARACTERISTIC
/begin CHARACTERISTIC p_power_u8.XCP_SHELL_VAR.XCP_SHELL "" VALUE 0x1DABEC STANDARD_VALUE_U8 0.0 ident 0 255 /end CHARACTERISTIC
/begin CHARACTERISTIC p_R01Count16Bit_b.R01_16bit "" VALUE 0x1D807C STANDARD_VALUE_U8 0.0 ident 0 1 BIT_MASK 0x1 /end CHARACTERISTIC
/begin CHARACTERISTIC p_R01Count8Bit_b.R01_8bit "" VALUE 0x1D8104 STANDARD_VALUE_U8 0.0 ident 0 1 BIT_MASK 0x1 /end CHARACTERISTIC
/begin CHARACTERISTIC P_Reset.Reset_Schalter "" VALUE 0x1DA5D8 STANDARD_VALUE_U8 0.0 ident 0 1 BIT_MASK 0x1 DISPLAY_IDENTIFIER P_Reset.Reset_Schalter_DISP_ID /end CHARACTERISTIC
/begin CHARACTERISTIC P_Reset_Err_Counter.OS_Counter "" VALUE 0x1D8010 STANDARD_VALUE_U8 0.0 ident 0 1 BIT_MASK 0x1 /end CHARACTERISTIC
/begin CHARACTERISTIC P_Reset_Task_Counter.OS_Counter "" VALUE 0x1D800E STANDARD_VALUE_U8 0.0 ident 0 1 BIT_MASK 0x1 /end CHARACTERISTIC
/begin CHARACTERISTIC P_reset_task_not_running_counter.raster_running "" VALUE 0x1D82A4 STANDARD_VALUE_S8 0.0 ident 0 1 BIT_MASK 0x1 /end CHARACTERISTIC
/begin CHARACTERISTIC P_S16_1_Array.Replay_Data "" VAL_BLK 0x1D924C STANDARD_VALUE_S16 0.0 ident -32768 32767 MATRIX_DIM 250 1 1 /end CHARACTERISTIC
/begin CHARACTERISTIC P_S16_2_Array.Replay_Data "" VAL_BLK 0x1D9440 STANDARD_VALUE_S16 0.0 ident -32768 32767 MATRIX_DIM 250 1 1 /end CHARACTERISTIC
/begin CHARACTERISTIC P_S16_3_Array.Replay_Data "" VAL_BLK 0x1D9634 STANDARD_VALUE_S16 0.0 ident -32768 32767 MATRIX_DIM 250 1 1 /end CHARACTERISTIC
/begin CHARACTERISTIC P_S32_1_Array.Replay_Data "" VAL_BLK 0x1D82AC STANDARD_VALUE_S32 0.0 ident -2147483648 2147483647 MATRIX_DIM 250 1 1 /end CHARACTERISTIC
/begin CHARACTERISTIC P_S32_2_Array.Replay_Data "" VAL_BLK 0x1D8694 STANDARD_VALUE_S32 0.0 ident -2147483648 2147483647 MATRIX_DIM 250 1 1 /end CHARACTERISTIC
/begin CHARACTERISTIC P_S8_1_Array.Replay_Data "" VAL_BLK 0x1D9E07 STANDARD_VALUE_S8 0.0 ident -128 127 MATRIX_DIM 250 1 1 /end CHARACTERISTIC
/begin CHARACTERISTIC P_S8_2_Array.Replay_Data "" VAL_BLK 0x1D9F01 STANDARD_VALUE_S8 0.0 ident -128 127 MATRIX_DIM 250 1 1 /end CHARACTERISTIC
/begin CHARACTERISTIC P_S8_3_Array.Replay_Data "" VAL_BLK 0x1D9FFB STANDARD_VALUE_S8 0.0 ident -128 127 MATRIX_DIM 250 1 1 /end CHARACTERISTIC
/begin CHARACTERISTIC P_S8_4_Array.Replay_Data "" VAL_BLK 0x1DA0F5 STANDARD_VALUE_S8 0.0 ident -128 127 MATRIX_DIM 250 1 1 /end CHARACTERISTIC
/begin CHARACTERISTIC p_sdisc_sint16_Xcp_B04.Model_XcpByp_B04 "" VALUE 0x1D8000 STANDARD_VALUE_S16 0.0 ident -32768 32767 /end CHARACTERISTIC
/begin CHARACTERISTIC p_sdisc_sint8_Xcp_B04.Model_XcpByp_B04 "" VALUE 0x1D8009 STANDARD_VALUE_S8 0.0 ident -128 127 /end CHARACTERISTIC
/begin CHARACTERISTIC p_SoftResetECU_u8.Reset_Schalter "" VALUE 0x1DA5D9 STANDARD_VALUE_U8 0.0 ident 0 1 DISPLAY_IDENTIFIER p_SoftResetECU_u8.Reset_Schalter_DISP_ID /end CHARACTERISTIC
/begin CHARACTERISTIC p_SwitchConfig_ECU_u8.XCP_SHELL_VAR.XCP_SHELL "" VALUE 0x1DABEB STANDARD_VALUE_U8 0.0 enum_ConfigECU_e 0 1 /end CHARACTERISTIC
/begin CHARACTERISTIC p_t01_bool.Type_Tests_EXTERN "" VALUE 0x1DAA52 STANDARD_VALUE_BIT 0.0 ident 0 1 BIT_MASK 0x80 /end CHARACTERISTIC
/begin CHARACTERISTIC p_t01_f32.Type_Tests_EXTERN "" VALUE 0x1DAA40 STANDARD_VALUE_R32 0.0 ident -1.e+037 1.e+037 /end CHARACTERISTIC
/begin CHARACTERISTIC p_t01_f32.XCP_PredefinedTypes "" VALUE 0x1DAB34 STANDARD_VALUE_R32 0.0 ident -1.e+037 1.e+037 /end CHARACTERISTIC
/begin CHARACTERISTIC p_t01_f32.XCP_Type_Tests "" VALUE 0x1DAC08 STANDARD_VALUE_R32 0.0 ident -1.e+037 1.e+037 /end CHARACTERISTIC
/begin CHARACTERISTIC p_t01_f64.Type_Tests_EXTERN "" VALUE 0x1DAA38 STANDARD_VALUE_R64 0.0 ident -1.e+037 1.e+037 /end CHARACTERISTIC
/begin CHARACTERISTIC p_t01_f64.XCP_Type_Tests "" VALUE 0x1DAC00 STANDARD_VALUE_R64 0.0 ident -1.e+037 1.e+037 /end CHARACTERISTIC
/begin CHARACTERISTIC p_t01_s16.Type_Tests_EXTERN "" VALUE 0x1DAA4C STANDARD_VALUE_S16 0.0 ident -32768.0 32767.0 /end CHARACTERISTIC
/begin CHARACTERISTIC p_t01_s16.XCP_PredefinedTypes "" VALUE 0x1DAB40 STANDARD_VALUE_S16 0.0 ident -32768.0 32767.0 /end CHARACTERISTIC
/begin CHARACTERISTIC p_t01_s16.XCP_Type_Tests "" VALUE 0x1DAC18 STANDARD_VALUE_S16 0.0 ident -32768.0 32767.0 /end CHARACTERISTIC
/begin CHARACTERISTIC p_t01_s32.Type_Tests_EXTERN "" VALUE 0x1DAA44 STANDARD_VALUE_S32 0.0 ident -2147483648.0 2147483647.0 /end CHARACTERISTIC
/begin CHARACTERISTIC p_t01_s32.XCP_PredefinedTypes "" VALUE 0x1DAB38 STANDARD_VALUE_S32 0.0 ident -2147483648.0 2147483647.0 /end CHARACTERISTIC
/begin CHARACTERISTIC p_t01_s32.XCP_Type_Tests "" VALUE 0x1DAC0C STANDARD_VALUE_S32 0.0 ident -2147483648.0 2147483647.0 /end CHARACTERISTIC
/begin CHARACTERISTIC p_t01_s8.Type_Tests_EXTERN "" VALUE 0x1DAA50 STANDARD_VALUE_S8 0.0 ident -128.0 127.0 /end CHARACTERISTIC
/begin CHARACTERISTIC p_t01_s8.XCP_PredefinedTypes "" VALUE 0x1DAB44 STANDARD_VALUE_S8 0.0 ident -128.0 127.0 /end CHARACTERISTIC
/begin CHARACTERISTIC p_t01_s8.XCP_Type_Tests "" VALUE 0x1DAC1C STANDARD_VALUE_S8 0.0 ident -128.0 127.0 /end CHARACTERISTIC
/begin CHARACTERISTIC p_t01_u16.Type_Tests_EXTERN "" VALUE 0x1DAA4E STANDARD_VALUE_U16 0.0 ident 0.0 65535.0 /end CHARACTERISTIC
/begin CHARACTERISTIC p_t01_u16.XCP_PredefinedTypes "" VALUE 0x1DAB42 STANDARD_VALUE_U16 0.0 ident 0.0 65535.0 /end CHARACTERISTIC
/begin CHARACTERISTIC p_t01_u16.XCP_Type_Tests "" VALUE 0x1DAC1A STANDARD_VALUE_U16 0.0 ident 0.0 65535.0 /end CHARACTERISTIC
/begin CHARACTERISTIC p_t01_u32.Type_Tests_EXTERN "" VALUE 0x1DAA48 STANDARD_VALUE_U32 0.0 ident 0.0 4294967295.0 /end CHARACTERISTIC
/begin CHARACTERISTIC p_t01_u32.XCP_PredefinedTypes "" VALUE 0x1DAB3C STANDARD_VALUE_U32 0.0 ident 0.0 4294967295.0 /end CHARACTERISTIC
/begin CHARACTERISTIC p_t01_u32.XCP_Type_Tests "" VALUE 0x1DAC10 STANDARD_VALUE_U32 0.0 ident 0.0 4294967295.0 /end CHARACTERISTIC
/begin CHARACTERISTIC p_t01_u8.Type_Tests_EXTERN "" VALUE 0x1DAA51 STANDARD_VALUE_U8 0.0 ident 0.0 255.0 /end CHARACTERISTIC
/begin CHARACTERISTIC p_t01_u8.XCP_PredefinedTypes "" VALUE 0x1DAB45 STANDARD_VALUE_U8 0.0 ident 0.0 255.0 /end CHARACTERISTIC
/begin CHARACTERISTIC p_t01_u8.XCP_Type_Tests "" VALUE 0x1DAC1D STANDARD_VALUE_U8 0.0 ident 0.0 255.0 /end CHARACTERISTIC
/begin CHARACTERISTIC p_t01_u8_bool.XCP_Type_Tests "" VALUE 0x1DAC1E STANDARD_VALUE_U8 0.0 ident 0.0 1.0 /end CHARACTERISTIC
/begin CHARACTERISTIC p_t02_bool.Type_Tests_EXTERN "" VALUE 0x1DAA52 STANDARD_VALUE_BIT 0.0 ident 0 1 BIT_MASK 0x40 /end CHARACTERISTIC
/begin CHARACTERISTIC p_t02_u32_bool.XCP_Type_Tests "" VALUE 0x1DAC14 STANDARD_VALUE_U32 0.0 ident 0.0 1.0 /end CHARACTERISTIC
/begin CHARACTERISTIC p_TriggerOverload_u8.XCP_SHELL_VAR.XCP_SHELL "" VALUE 0x1DABD1 STANDARD_VALUE_U8 0.0 ident 0 255 /end CHARACTERISTIC
/begin CHARACTERISTIC P_U16_1_Array.Replay_Data "" VAL_BLK 0x1D9828 STANDARD_VALUE_U16 0.0 ident 0 65535 MATRIX_DIM 250 1 1 /end CHARACTERISTIC
/begin CHARACTERISTIC P_U16_2_Array.Replay_Data "" VAL_BLK 0x1D9A1C STANDARD_VALUE_U16 0.0 ident 0 65535 MATRIX_DIM 250 1 1 /end CHARACTERISTIC
/begin CHARACTERISTIC P_U16_3_Array.Replay_Data "" VAL_BLK 0x1D9C10 STANDARD_VALUE_U16 0.0 ident 0 65535 MATRIX_DIM 250 1 1 /end CHARACTERISTIC
/begin CHARACTERISTIC P_U32_1_Array.Replay_Data "" VAL_BLK 0x1D8A7C STANDARD_VALUE_U32 0.0 ident 0 4294967295 MATRIX_DIM 250 1 1 /end CHARACTERISTIC
/begin CHARACTERISTIC P_U32_2_Array.Replay_Data "" VAL_BLK 0x1D8E64 STANDARD_VALUE_U32 0.0 ident 0 4294967295 MATRIX_DIM 250 1 1 /end CHARACTERISTIC
/begin CHARACTERISTIC P_U8_1_Array.Replay_Data "" VAL_BLK 0x1DA1EF STANDARD_VALUE_U8 0.0 ident 0 255 MATRIX_DIM 250 1 1 /end CHARACTERISTIC
/begin CHARACTERISTIC P_U8_2_Array.Replay_Data "" VAL_BLK 0x1DA2E9 STANDARD_VALUE_U8 0.0 ident 0 255 MATRIX_DIM 250 1 1 /end CHARACTERISTIC
/begin CHARACTERISTIC P_U8_3_Array.Replay_Data "" VAL_BLK 0x1DA3E3 STANDARD_VALUE_U8 0.0 ident 0 255 MATRIX_DIM 250 1 1 /end CHARACTERISTIC
/begin CHARACTERISTIC P_U8_4_Array.Replay_Data "" VAL_BLK 0x1DA4DD STANDARD_VALUE_U8 0.0 ident 0 255 MATRIX_DIM 250 1 1 /end CHARACTERISTIC
/begin CHARACTERISTIC p_udisc_uint16_Xcp_B04.Model_XcpByp_B04 "" VALUE 0x1D8002 STANDARD_VALUE_U16 0.0 ident 0 65535 /end CHARACTERISTIC
/begin CHARACTERISTIC p_udisc_uint8_Xcp_B04.Model_XcpByp_B04 "" VALUE 0x1D800A STANDARD_VALUE_U8 0.0 ident 0 255 /end CHARACTERISTIC
/begin CHARACTERISTIC p_UdsCanIDEcu_u32.UdsSendList_save.UdsSendList "" VALUE 0x1DAB00 STANDARD_VALUE_U32 0.0 ident 0 4294967295 /end CHARACTERISTIC
/begin CHARACTERISTIC p_UdsCanIDInca_u32.UdsSendList_save.UdsSendList "" VALUE 0x1DAB04 STANDARD_VALUE_U32 0.0 ident 0 4294967295 /end CHARACTERISTIC
/begin CHARACTERISTIC p_UdsCanIDMode_u8.UdsSendList "" VALUE 0x1DAAF0 STANDARD_VALUE_U8 0.0 enum_UDS_CAN_ID_MODE_FREERUN_E 0 3 /end CHARACTERISTIC
/begin CHARACTERISTIC p_UdsID_TGT_ECU_u8.UdsSendList_save.UdsSendList "" VALUE 0x1DAB09 STANDARD_VALUE_U8 0.0 ident 0 255 /end CHARACTERISTIC
/begin CHARACTERISTIC p_UdsID_TGT_INCA_u8.UdsSendList_save.UdsSendList "" VALUE 0x1DAB08 STANDARD_VALUE_U8 0.0 ident 0 255 /end CHARACTERISTIC
/begin CHARACTERISTIC p_UDSmaxLocIds_u8.UdsLocIDs "" VALUE 0x1DAA60 STANDARD_VALUE_U8 0.0 ident 0 255 /end CHARACTERISTIC
/begin CHARACTERISTIC p_UdsSendList1Elem_u32.UdsSendList_save.UdsSendList "" VALUE 0x1DAAF8 STANDARD_VALUE_U32 0.0 ident 0 4294967295 /end CHARACTERISTIC
/begin CHARACTERISTIC p_UdsSendList1Val_u32.UdsSendList_save.UdsSendList "" VALUE 0x1DAAFC STANDARD_VALUE_U32 0.0 ident 0 4294967295 /end CHARACTERISTIC
/begin CHARACTERISTIC p_XcpAutoResetAfterStoreDaq_u8.XCP_SHELL_VAR.XCP_SHELL "" VALUE 0x1DABE9 STANDARD_VALUE_U8 0.0 ident 0 255 /end CHARACTERISTIC
/begin CHARACTERISTIC p_XcpBitStimVersion_u8.XCP_SHELL_VAR.XCP_SHELL "" VALUE 0x1DABD0 STANDARD_VALUE_U8 0.0 enum_XCP_BitSTIMVERSION_e 0 1 /end CHARACTERISTIC
/begin CHARACTERISTIC p_XcpBlockDownloadMaxBS_u8.XCP_SHELL_VAR.XCP_SHELL "" VALUE 0x1DABD5 STANDARD_VALUE_U8 0.0 ident 0 255 /end CHARACTERISTIC
/begin CHARACTERISTIC p_XcpBlockDownloadMinST_u8.XCP_SHELL_VAR.XCP_SHELL "" VALUE 0x1DABC8 STANDARD_VALUE_U8 0.0 ident 0 255 /end CHARACTERISTIC
/begin CHARACTERISTIC p_XcpBlockFlashMaxBS_u8.XCP_SHELL_VAR.XCP_SHELL "" VALUE 0x1DABCF STANDARD_VALUE_U8 0.0 ident 0 255 /end CHARACTERISTIC
/begin CHARACTERISTIC p_XcpBlockFlashMinST_u8.XCP_SHELL_VAR.XCP_SHELL "" VALUE 0x1DABED STANDARD_VALUE_U8 0.0 ident 0 255 /end CHARACTERISTIC
/begin CHARACTERISTIC p_XcpChecksumByteOrder_u8.XCP_SHELL_VAR.XCP_SHELL "" VALUE 0x1DABCE STANDARD_VALUE_U8 0.0 enum_XCP_ByteOrder_e 0 1 /end CHARACTERISTIC
/begin CHARACTERISTIC p_XcpChecksumType_u8.XCP_SHELL_VAR.XCP_SHELL "" VALUE 0x1DABE6 STANDARD_VALUE_U8 0.0 enum_XCP_ChecksumType_e 0 9 /end CHARACTERISTIC
/begin CHARACTERISTIC p_XcpCommModeBasic_u8.XCP_SHELL_VAR.XCP_SHELL "" VALUE 0x1DABC9 STANDARD_VALUE_U8 0.0 ident 0 255 /end CHARACTERISTIC
/begin CHARACTERISTIC p_XcpCommModeOptional_u8.XCP_SHELL_VAR.XCP_SHELL "" VALUE 0x1DABD6 STANDARD_VALUE_U8 0.0 ident 0 255 /end CHARACTERISTIC
/begin CHARACTERISTIC p_XcpCommModePgm_u8.XCP_SHELL_VAR.XCP_SHELL "" VALUE 0x1DABD2 STANDARD_VALUE_U8 0.0 ident 0 255 /end CHARACTERISTIC
/begin CHARACTERISTIC p_XcpConnectResetECU_u8.XCP_SHELL_VAR.XCP_SHELL "" VALUE 0x1DABD8 STANDARD_VALUE_U8 0.0 ident 0 255 /end CHARACTERISTIC
/begin CHARACTERISTIC p_XcpCtoMax_u8.XCP_SHELL_VAR.XCP_SHELL "" VALUE 0x1DABE7 STANDARD_VALUE_U8 0.0 ident 0 255 /end CHARACTERISTIC
/begin CHARACTERISTIC p_XcpCtoMaxPgm_u8.XCP_SHELL_VAR.XCP_SHELL "" VALUE 0x1DABF4 STANDARD_VALUE_U8 0.0 ident 0 255 /end CHARACTERISTIC
/begin CHARACTERISTIC p_XcpDaqKeyByte_u8.XCP_SHELL_VAR.XCP_SHELL "" VALUE 0x1DABE8 STANDARD_VALUE_U8 0.0 ident 0 255 /end CHARACTERISTIC
/begin CHARACTERISTIC p_XcpDaqListProperties_u8.XCP_SHELL_VAR.XCP_SHELL "" VALUE 0x1DABD4 STANDARD_VALUE_U8 0.0 ident 0 255 /end CHARACTERISTIC
/begin CHARACTERISTIC p_XcpDaqProperties_u8.XCP_SHELL_VAR.XCP_SHELL "" VALUE 0x1DABDD STANDARD_VALUE_U8 0.0 ident 0 255 /end CHARACTERISTIC
/begin CHARACTERISTIC p_XcpDisableDaqTransmition_b.XCP_Failure.XCP_SHELL "" VALUE 0x1DAB2F STANDARD_VALUE_U8 0.0 ident 0 1 BIT_MASK 0x1 /end CHARACTERISTIC
/begin CHARACTERISTIC p_XcpDtoMax_u16.XCP_SHELL_VAR.XCP_SHELL "" VALUE 0x1DABF2 STANDARD_VALUE_U16 0.0 ident 0 65535 /end CHARACTERISTIC
/begin CHARACTERISTIC p_XcpErrBasePat_au8.XCP_ErrorHook.XCP_SHELL "" VAL_BLK 0x1DAB24 STANDARD_VALUE_U8 0.0 ident 0 255 MATRIX_DIM 8 1 1 /end CHARACTERISTIC
/begin CHARACTERISTIC p_XcpErrFilter_au8.XCP_ErrorHook.XCP_SHELL "" VAL_BLK 0x1DAB18 STANDARD_VALUE_U8 0.0 ident 0 255 MATRIX_DIM 8 1 1 /end CHARACTERISTIC
/begin CHARACTERISTIC p_XcpErrorClear_u8.XCP_Failure.XCP_SHELL "" VALUE 0x1DAB2E STANDARD_VALUE_U8 0.0 ident 0 255 /end CHARACTERISTIC
/begin CHARACTERISTIC p_XcpErrorPrescaler_u8.XCP_ErrorHook.XCP_SHELL "" VALUE 0x1DAB14 STANDARD_VALUE_U8 0.0 ident 0 255 /end CHARACTERISTIC
/begin CHARACTERISTIC p_XcpEtasTool_u8.XCP_SHELL_VAR.XCP_SHELL "" VALUE 0x1DABF5 STANDARD_VALUE_U8 0.0 enum_XCP_ETASTool_e 0 1 /end CHARACTERISTIC
/begin CHARACTERISTIC p_XcpGranularityOdtEntrySizeDaq_u8.XCP_SHELL_VAR.XCP_SHELL "" VALUE 0x1DABF0 STANDARD_VALUE_U8 0.0 ident 0 255 /end CHARACTERISTIC
/begin CHARACTERISTIC p_XcpGranularityOdtEntrySizeStim_u8.XCP_SHELL_VAR.XCP_SHELL "" VALUE 0x1DABCA STANDARD_VALUE_U8 0.0 ident 0 255 /end CHARACTERISTIC
/begin CHARACTERISTIC p_XcpMaxDaq_u16.XCP_SHELL_VAR.XCP_SHELL "" VALUE 0x1DABEE STANDARD_VALUE_U16 0.0 ident 0 65535 /end CHARACTERISTIC
/begin CHARACTERISTIC p_XcpMaxEventNo_u16.XCP_SHELL_VAR.XCP_SHELL "" VALUE 0x1DABDA STANDARD_VALUE_U16 0.0 ident 0 65535 /end CHARACTERISTIC
/begin CHARACTERISTIC p_XcpMaxOdtEntrySizeDaq_u8.XCP_SHELL_VAR.XCP_SHELL "" VALUE 0x1DABE5 STANDARD_VALUE_U8 0.0 ident 0 255 /end CHARACTERISTIC
/begin CHARACTERISTIC p_XcpMaxOdtEntrySizeStim_u8.XCP_SHELL_VAR.XCP_SHELL "" VALUE 0x1DABC7 STANDARD_VALUE_U8 0.0 ident 0 255 /end CHARACTERISTIC
/begin CHARACTERISTIC p_XcpMinDaq_u8.XCP_SHELL_VAR.XCP_SHELL "" VALUE 0x1DABC4 STANDARD_VALUE_U8 0.0 ident 0 255 /end CHARACTERISTIC
/begin CHARACTERISTIC p_XcpNumError_u8.XCP_ErrorHook.XCP_SHELL "" VALUE 0x1DAB20 STANDARD_VALUE_U8 0.0 ident 0 255 /end CHARACTERISTIC
/begin CHARACTERISTIC p_XcpPagProperties_u8.XCP_SHELL_VAR.XCP_SHELL "" VALUE 0x1DABDE STANDARD_VALUE_U8 0.0 ident 0 255 /end CHARACTERISTIC
/begin CHARACTERISTIC p_XcpResource_u8.XCP_SHELL_VAR.XCP_SHELL "" VALUE 0x1DABC6 STANDARD_VALUE_U8 0.0 ident 0 255 /end CHARACTERISTIC
/begin CHARACTERISTIC p_XcpResourceProtect_u8.XCP_SHELL_VAR.XCP_SHELL "" VALUE 0x1DABDC STANDARD_VALUE_U8 0.0 ident 0 255 /end CHARACTERISTIC
/begin CHARACTERISTIC p_XcpResponce_u8.XCP_ErrorHook.XCP_SHELL "" VAL_BLK 0x1DAB0C STANDARD_VALUE_U8 0.0 ident 0 255 MATRIX_DIM 8 1 1 /end CHARACTERISTIC
/begin CHARACTERISTIC p_XcpSwitchBackground_u8.XCP_SHELL_VAR.XCP_SHELL "" VALUE 0x1DABC5 STANDARD_VALUE_U8 0.0 ident 0 255 /end CHARACTERISTIC
/begin CHARACTERISTIC p_XcpTestOdtOpt_u8.XCP_Failure.XCP_SHELL "" VALUE 0x1DAB2D STANDARD_VALUE_U8 0.0 ident 0 255 /end CHARACTERISTIC
/begin CHARACTERISTIC p_XcpTestOdtOptSendResult_u8.XCP_Failure.XCP_SHELL "" VALUE 0x1DAB32 STANDARD_VALUE_U8 0.0 ident 0 255 /end CHARACTERISTIC
/begin CHARACTERISTIC p_XcpTickDurationEcu_f32.XCP_SHELL_VAR.XCP_SHELL "" VALUE 0x1DABE0 STANDARD_VALUE_R32 0.0 ident 1.e-009 1.e+037 /end CHARACTERISTIC
/begin CHARACTERISTIC p_XcpTimestampMode_u8.XCP_SHELL_VAR.XCP_SHELL "" VALUE 0x1DABD7 STANDARD_VALUE_U8 0.0 ident 0 255 /end CHARACTERISTIC
/begin CHARACTERISTIC p_XcpTimestampProp_u8.XCP_SHELL_VAR.XCP_SHELL "" VALUE 0x1DABD3 STANDARD_VALUE_U8 0.0 enum_XCP_TimestampProp_e 0 3 /end CHARACTERISTIC
/begin CHARACTERISTIC p_XcpTimestampTicks_u16.XCP_SHELL_VAR.XCP_SHELL "" VALUE 0x1DABCC STANDARD_VALUE_U16 0.0 ident 0 65535 /end CHARACTERISTIC
/begin CHARACTERISTIC p_XcpTrigDaqFailure_u8.XCP_Failure.XCP_SHELL "" VALUE 0x1DAB2C STANDARD_VALUE_U8 0.0 ident 0 255 /end CHARACTERISTIC
/begin CHARACTERISTIC p_XcpTriggerError_u8.XCP_ErrorHook.XCP_SHELL "" VALUE 0x1DAB21 STANDARD_VALUE_U8 0.0 enum_XCP_ERROR_TRIGGER_E 0 2 /end CHARACTERISTIC
/begin CHARACTERISTIC p_XcpTrigOdtFailure_u8.XCP_Failure.XCP_SHELL "" VALUE 0x1DAB31 STANDARD_VALUE_U8 0.0 ident 0 255 /end CHARACTERISTIC
/begin CHARACTERISTIC p_XcpTrigOverload_u8.XCP_Failure.XCP_SHELL "" VALUE 0x1DAB30 STANDARD_VALUE_U8 0.0 ident 0 255 /end CHARACTERISTIC
/begin CHARACTERISTIC p_XcpTrigResume_u8.XCP_SHELL_VAR.XCP_SHELL "" VALUE 0x1DABE4 STANDARD_VALUE_U8 0.0 ident 0 255 /end CHARACTERISTIC
/begin CHARACTERISTIC pi_FirstCanID_u32.UDS_100ms_R03_SLOW1.UdsSendList "" VALUE 0x1DAAD0 STANDARD_VALUE_U32 0.0 ident 0 4294967295 /end CHARACTERISTIC
/begin CHARACTERISTIC pi_FirstCanID_u32.UDS_10ms_R01_FAST3.UdsSendList "" VALUE 0x1DAADC STANDARD_VALUE_U32 0.0 ident 0 4294967295 /end CHARACTERISTIC
/begin CHARACTERISTIC pi_FirstCanID_u32.UDS_50ms_R02_MEDIUM2.UdsSendList "" VALUE 0x1DAAE8 STANDARD_VALUE_U32 0.0 ident 0 4294967295 /end CHARACTERISTIC
/begin CHARACTERISTIC pi_LastCanID_u32.UDS_100ms_R03_SLOW1.UdsSendList "" VALUE 0x1DAAD4 STANDARD_VALUE_U32 0.0 ident 0 4294967295 /end CHARACTERISTIC
/begin CHARACTERISTIC pi_LastCanID_u32.UDS_10ms_R01_FAST3.UdsSendList "" VALUE 0x1DAAE0 STANDARD_VALUE_U32 0.0 ident 0 4294967295 /end CHARACTERISTIC
/begin CHARACTERISTIC pi_LastCanID_u32.UDS_50ms_R02_MEDIUM2.UdsSendList "" VALUE 0x1DAAEC STANDARD_VALUE_U32 0.0 ident 0 4294967295 /end CHARACTERISTIC
/begin CHARACTERISTIC SIKO_AR_CounterReloads.SIKO_Module "The reload values for the SIKO_Counters array in afterrun" VAL_BLK 0x1DA9AC STANDARD_VALUE_U16 0.0 FastestTaskTicks_to_ms 0.0 131070.0 MATRIX_DIM 64 1 1 /end CHARACTERISTIC
/begin CHARACTERISTIC SIKO_CounterReloadDisable.SIKO_Module "Calibration data for SIKO test purposes" VAL_BLK 0x1DA96C STANDARD_VALUE_S8 0.0 ident 0 1 MATRIX_DIM 64 1 1 /end CHARACTERISTIC
/begin CHARACTERISTIC SIKO_CounterReloads.SIKO_Module "The reload values for the SIKO_Counters array" VAL_BLK 0x1DA8EC STANDARD_VALUE_U16 0.0 FastestTaskTicks_to_ms 0.0 131070.0 MATRIX_DIM 64 1 1 /end CHARACTERISTIC
/begin CHARACTERISTIC SIKO_DisableCounterCheck.SIKO_Module "Disables the SIKO counter checking" VALUE 0x1DA8E5 STANDARD_VALUE_S8 0.0 ident 0 1 BIT_MASK 0x1 /end CHARACTERISTIC
/begin CHARACTERISTIC SIKO_DisableOutputCheck.SIKO_Module "Enables the check of the APPL_RequestOutputDisable[] array" VALUE 0x1DA8E6 STANDARD_VALUE_S8 0.0 ident 0 1 BIT_MASK 0x1 /end CHARACTERISTIC
/begin CHARACTERISTIC SIKO_OutputDisableDelay_Cal.SIKO_Module "Delay in 10ms increments to delay SIKO_RequestOutputDisable for WDA plausi checking" VALUE 0x1DA8E7 STANDARD_VALUE_U8 0.0 ident 0 255 /end CHARACTERISTIC
/begin CHARACTERISTIC SIKO_StackCheckDisable.SIKO_Module "Enables the stackcheck call" VALUE 0x1DA8E8 STANDARD_VALUE_S8 0.0 ident 0 1 BIT_MASK 0x1 /end CHARACTERISTIC
/begin CHARACTERISTIC SIKO_StackCrashEnable.SIKO_Module "Controls stack crashing (by SIKO_Process_10ms) if > 0" VALUE 0x1DA8E9 STANDARD_VALUE_U8 0.0 ident__ 0 255 /end CHARACTERISTIC
/begin CHARACTERISTIC SIKO_WDA_FailureDelay_Cal.SIKO_Module "Delay in 10ms increments til WDA failure is recognized" VALUE 0x1DA8EA STANDARD_VALUE_U8 0.0 ident 2 255 /end CHARACTERISTIC
/begin CHARACTERISTIC Ticks_per_activation_100ms.RuntimeTaskFrame "" VALUE 0x1DA814 STANDARD_VALUE_U16 0.0 ident_s 0.0 655.35 /end CHARACTERISTIC
/begin CHARACTERISTIC Ticks_per_activation_10ms.RuntimeTaskFrame "" VALUE 0x1DA818 STANDARD_VALUE_U16 0.0 ident_s 0.0 655.35 /end CHARACTERISTIC
/begin CHARACTERISTIC Ticks_per_activation_50ms.RuntimeTaskFrame "" VALUE 0x1DA81A STANDARD_VALUE_U16 0.0 ident_s 0.0 655.35 /end CHARACTERISTIC
/begin CHARACTERISTIC Ticks_per_activation_Bkgnd.RuntimeTaskFrame "" VALUE 0x1DA81C STANDARD_VALUE_U16 0.0 ident_s 0.0 655.35 /end CHARACTERISTIC
/begin CHARACTERISTIC Ticks_per_activation_initvalue.RuntimeTaskFrame "To initalize" VALUE 0x1DA816 STANDARD_VALUE_U16 0.0 ident_s 0.0 655.35 /end CHARACTERISTIC
/begin CHARACTERISTIC Two_D "" MAP 0x1D2730 STANDARD_MAP_R64R64R64 0.0 ident -1.e+037 1.e+037 /begin AXIS_DESCR STD_AXIS NO_INPUT_QUANTITY ident 1 -1.e+037 1.e+037 /end AXIS_DESCR /begin AXIS_DESCR STD_AXIS NO_INPUT_QUANTITY ident 1 -1.e+037 1.e+037 /end AXIS_DESCR /end CHARACTERISTIC
/begin CHARACTERISTIC WDMod_InvertAnswer_Cal.Watchdog_Module "Inverts the answer byte(s) if the correspondig bit is set" VALUE 0x1DAB0A STANDARD_VALUE_U8 0.0 ident 0 15 /end CHARACTERISTIC
/begin CHARACTERISTIC WDMod_WatchdogPeriod_Cal.Watchdog_Module "multiples of 1.6 ms" VALUE 0x1DAB0B STANDARD_VALUE_U8 0.0 ident 0 63 /end CHARACTERISTIC
/begin CHARACTERISTIC XCP_Variants.XCP_SHELL "" VAL_BLK 0x1DAB90 STANDARD_VALUE_U8 0.0 ident 0 255 MATRIX_DIM 10 5 1 /end CHARACTERISTIC
/begin MEASUREMENT _g_UdsSendList_pu32.UdsSendList_save.UdsSendList "" ULONG ident 1 100 0 4294967295 ECU_ADDRESS 0x823724 /end MEASUREMENT
/begin MEASUREMENT APPL_RequestOutputDisable.SIKO_Module "Switches to suppress the reload of SIKO_Counters. Purpose: Test" SBYTE ident 1 100 0 1 ECU_ADDRESS 0x7FB9B4 MATRIX_DIM 8 1 1 /end MEASUREMENT
/begin MEASUREMENT asynchron_alarm_delta_t.R01.Restart_Raster_16T "" ULONG TickType2ms 1 100 0.0 1227133.512857143 ECU_ADDRESS 0x7FB7CC /end MEASUREMENT
/begin MEASUREMENT asynchron_alarm_delta_t.R04_Sync.Restart_Raster_16T "" ULONG TickType2ms 1 100 0.0 1227133.512857143 ECU_ADDRESS 0x7FB81C /end MEASUREMENT
/begin MEASUREMENT asynchron_alarm_table_index.R01.Restart_Raster_16T "" UWORD ident 1 100 0 65535 ECU_ADDRESS 0x7FB7D8 /end MEASUREMENT
/begin MEASUREMENT asynchron_alarm_table_index.R04_Sync.Restart_Raster_16T "" UWORD ident 1 100 0 65535 ECU_ADDRESS 0x7FB828 /end MEASUREMENT
/begin MEASUREMENT c_NumLists_u8.UdsSendList "" UBYTE ident 1 100 0 255 ECU_ADDRESS 0x7F9134 /end MEASUREMENT
/begin MEASUREMENT c_power_u8.XCP_SHELL_VAR.XCP_SHELL "" UBYTE ident 1 100 0 255 ECU_ADDRESS 0x7FBADD /end MEASUREMENT
/begin MEASUREMENT cont_sint16_1_100_Xcp_B04.Model_XcpByp_B04 "" SWORD formula_1_100 1 100 -327.68 327.67 ECU_ADDRESS 0x7FB5A0 /end MEASUREMENT
/begin MEASUREMENT cont_sint16_Xcp_B04.Model_XcpByp_B04 "" SWORD ident 1 100 -32768 32767.0 ECU_ADDRESS 0x7FB5A2 /end MEASUREMENT
/begin MEASUREMENT cont_sint8_1_10_Xcp_B04.Model_XcpByp_B04 "" SBYTE formula_1_10 1 100 -12.8 12.7 ECU_ADDRESS 0x7FB5AA /end MEASUREMENT
/begin MEASUREMENT cont_sint8_Xcp_B04.Model_XcpByp_B04 "" SBYTE ident 1 100 -128.0 127.0 ECU_ADDRESS 0x7FB5AB /end MEASUREMENT
/begin MEASUREMENT cont_uint16_1_2_Xcp_B04.Model_XcpByp_B04 "" UWORD formula_1_2 1 100 0.0 32767.5 ECU_ADDRESS 0x7FB5A4 /end MEASUREMENT
/begin MEASUREMENT cont_uint8_10_1_Xcp_B04.Model_XcpByp_B04 "" UBYTE formula_10_1 1 100 0.0 2550.0 ECU_ADDRESS 0x7FB5AC /end MEASUREMENT
/begin MEASUREMENT Counter.Replay_Data "" UBYTE ident 1 100 0 250 ECU_ADDRESS 0x7F8FD8 /end MEASUREMENT
/begin MEASUREMENT Counter_2ms_Task.OS_Counter "" ULONG ident 1 100 0 4294967295 ECU_ADDRESS 0x7FB5EC /end MEASUREMENT
/begin MEASUREMENT Counter_BG_Task.OS_Counter "" UWORD ident 1 100 0 65535 ECU_ADDRESS 0x7FB650 /end MEASUREMENT
/begin MEASUREMENT Counter_CANA_IRQ.OS_Counter "" ULONG ident 1 100 0 4294967295 ECU_ADDRESS 0x7FB5F0 /end MEASUREMENT
/begin MEASUREMENT Counter_CANB_IRQ.OS_Counter "" ULONG ident 1 100 0 4294967295 ECU_ADDRESS 0x7FB5F4 /end MEASUREMENT
/begin MEASUREMENT Counter_CANC_IRQ.OS_Counter "" ULONG ident 1 100 0 4294967295 ECU_ADDRESS 0x7FB5F8 /end MEASUREMENT
/begin MEASUREMENT Counter_default.OS_Counter "" ULONG ident 1 100 0 4294967295 ECU_ADDRESS 0x7FB64C /end MEASUREMENT
/begin MEASUREMENT Counter_E_OS_FUNC_default.OS_Counter "" ULONG ident 1 100 0 4294967295 ECU_ADDRESS 0x7FB600 /end MEASUREMENT
/begin MEASUREMENT Counter_E_OS_ID.OS_Counter "" ULONG ident 1 100 0 4294967295 ECU_ADDRESS 0x7FB604 /end MEASUREMENT
/begin MEASUREMENT Counter_E_OS_LIMIT.OS_Counter "" ULONG ident 1 100 0 4294967295 ECU_ADDRESS 0x7FB608 /end MEASUREMENT
/begin MEASUREMENT Counter_E_OS_LIMIT_2ms.OS_Counter "" ULONG ident 1 100 0 4294967295 ECU_ADDRESS 0x7FB60C /end MEASUREMENT
/begin MEASUREMENT Counter_E_OS_LIMIT_old.OS_Counter "" ULONG ident 1 100 0 4294967295 ECU_ADDRESS 0x7FB5B4 MATRIX_DIM 14 1 1 /end MEASUREMENT
/begin MEASUREMENT Counter_E_OS_LIMIT_R01.OS_Counter "" ULONG ident 1 100 0 4294967295 ECU_ADDRESS 0x7FB610 /end MEASUREMENT
/begin MEASUREMENT Counter_E_OS_LIMIT_R02.OS_Counter "" ULONG ident 1 100 0 4294967295 ECU_ADDRESS 0x7FB614 /end MEASUREMENT
/begin MEASUREMENT Counter_E_OS_LIMIT_R03.OS_Counter "" ULONG ident 1 100 0 4294967295 ECU_ADDRESS 0x7FB618 /end MEASUREMENT
/begin MEASUREMENT Counter_E_OS_MISSING_TIMETABLE.OS_Counter "" ULONG ident 1 100 0 4294967295 ECU_ADDRESS 0x7FB61C /end MEASUREMENT
/begin MEASUREMENT Counter_E_OS_NOFUNC.OS_Counter "" ULONG ident 1 100 0 4294967295 ECU_ADDRESS 0x7FB620 /end MEASUREMENT
/begin MEASUREMENT Counter_E_OS_SERVICE_NOT_SUPPORTED.OS_Counter "" ULONG ident 1 100 0 4294967295 ECU_ADDRESS 0x7FB624 /end MEASUREMENT
/begin MEASUREMENT Counter_E_OS_SYS_STACK_default.OS_Counter "" ULONG ident 1 100 0 4294967295 ECU_ADDRESS 0x7FB628 /end MEASUREMENT
/begin MEASUREMENT Counter_E_OS_TIMETABLE_ALREADY_ACTIVE.OS_Counter "" ULONG ident 1 100 0 4294967295 ECU_ADDRESS 0x7FB62C /end MEASUREMENT
/begin MEASUREMENT Counter_E_OS_VALUE.OS_Counter "" ULONG ident 1 100 0 4294967295 ECU_ADDRESS 0x7FB630 /end MEASUREMENT
/begin MEASUREMENT Counter_ESTACK_OVFL.OS_Counter "" ULONG ident 1 100 0 4294967295 ECU_ADDRESS 0x7FB5FC /end MEASUREMENT
/begin MEASUREMENT Counter_OSTACK_OVFL.OS_Counter "" ULONG ident 1 100 0 4294967295 ECU_ADDRESS 0x7FB634 /end MEASUREMENT
/begin MEASUREMENT Counter_R01.OS_Counter "" ULONG ident 1 100 0 4294967295 ECU_ADDRESS 0x7FB638 /end MEASUREMENT
/begin MEASUREMENT Counter_R02.OS_Counter "" ULONG ident 1 100 0 4294967295 ECU_ADDRESS 0x7FB63C /end MEASUREMENT
/begin MEASUREMENT Counter_R03.OS_Counter "" ULONG ident 1 100 0 4294967295 ECU_ADDRESS 0x7FB640 /end MEASUREMENT
/begin MEASUREMENT counter_sint16_R01.R01 "" SWORD ident 1 100 -32768.0 32767.0 ECU_ADDRESS 0x7FB682 DISPLAY_IDENTIFIER counter_sint16_R01.R01_DISP_ID_R01 /end MEASUREMENT
/begin MEASUREMENT counter_sint16_R02.R02 "" SWORD ident 1 100 -32768.0 32767.0 ECU_ADDRESS 0x7FB6BA DISPLAY_IDENTIFIER counter_sint16_R02.R02_DISP_ID_R02 /end MEASUREMENT
/begin MEASUREMENT counter_sint16_R03.R03 "" SWORD ident 1 100 -32768.0 32767.0 ECU_ADDRESS 0x7FB6F2 DISPLAY_IDENTIFIER counter_sint16_R03.R03_DISP_ID_R03 /end MEASUREMENT
/begin MEASUREMENT counter_sint16_R04.R04 "" SWORD ident 1 100 -32768.0 32767.0 ECU_ADDRESS 0x7FB728 /end MEASUREMENT
/begin MEASUREMENT counter_sint16_R05.R05 "" SWORD ident 1 100 -32768.0 32767.0 ECU_ADDRESS 0x7FB72E /end MEASUREMENT
/begin MEASUREMENT counter_sint16_R06.R06 "" SWORD ident 1 100 -32768.0 32767.0 ECU_ADDRESS 0x7FB734 /end MEASUREMENT
/begin MEASUREMENT counter_sint16_R07.R07 "" SWORD ident 1 100 -32768.0 32767.0 ECU_ADDRESS 0x7FB73A /end MEASUREMENT
/begin MEASUREMENT counter_sint16_R08.R08 "" SWORD ident 1 100 -32768.0 32767.0 ECU_ADDRESS 0x7FB740 /end MEASUREMENT
/begin MEASUREMENT counter_sint16_R09.R09 "" SWORD ident 1 100 -32768.0 32767.0 ECU_ADDRESS 0x7FB746 /end MEASUREMENT
/begin MEASUREMENT counter_sint16_R10.R10 "" SWORD ident 1 100 -32768.0 32767.0 ECU_ADDRESS 0x7FB74C /end MEASUREMENT
/begin MEASUREMENT counter_sint16_R11.R11 "" SWORD ident 1 100 -32768.0 32767.0 ECU_ADDRESS 0x7FB752 /end MEASUREMENT
/begin MEASUREMENT counter_sint16_R12.R12 "" SWORD ident 1 100 -32768.0 32767.0 ECU_ADDRESS 0x7FB758 /end MEASUREMENT
/begin MEASUREMENT counter_sint16_R13.R13 "" SWORD ident 1 100 -32768.0 32767.0 ECU_ADDRESS 0x7FB75E /end MEASUREMENT
/begin MEASUREMENT counter_sint16_R14.R14 "" SWORD ident 1 100 -32768.0 32767.0 ECU_ADDRESS 0x7FB764 /end MEASUREMENT
/begin MEASUREMENT counter_sint16_R15.R15 "" SWORD ident 1 100 -32768.0 32767.0 ECU_ADDRESS 0x7FB76A /end MEASUREMENT
/begin MEASUREMENT counter_sint8_R01.R01 "" SBYTE ident 1 100 -128.0 127.0 ECU_ADDRESS 0x7FB686 DISPLAY_IDENTIFIER counter_sint8_R01.R01_DISP_ID_R01 /end MEASUREMENT
/begin MEASUREMENT counter_sint8_R02.R02 "" SBYTE ident 1 100 -128.0 127.0 ECU_ADDRESS 0x7FB6BE DISPLAY_IDENTIFIER counter_sint8_R02.R02_DISP_ID_R02 /end MEASUREMENT
/begin MEASUREMENT counter_sint8_R03.R03 "" SBYTE ident 1 100 -128.0 127.0 ECU_ADDRESS 0x7FB6F6 DISPLAY_IDENTIFIER counter_sint8_R03.R03_DISP_ID_R03 /end MEASUREMENT
/begin MEASUREMENT counter_sint8_R04.R04 "" SBYTE ident 1 100 -128.0 127.0 ECU_ADDRESS 0x7FB72C /end MEASUREMENT
/begin MEASUREMENT counter_sint8_R05.R05 "" SBYTE ident 1 100 -128.0 127.0 ECU_ADDRESS 0x7FB732 /end MEASUREMENT
/begin MEASUREMENT counter_sint8_R06.R06 "" SBYTE ident 1 100 -128.0 127.0 ECU_ADDRESS 0x7FB738 /end MEASUREMENT
/begin MEASUREMENT counter_sint8_R07.R07 "" SBYTE ident 1 100 -128.0 127.0 ECU_ADDRESS 0x7FB73E /end MEASUREMENT
/begin MEASUREMENT counter_sint8_R08.R08 "" SBYTE ident 1 100 -128.0 127.0 ECU_ADDRESS 0x7FB744 /end MEASUREMENT
/begin MEASUREMENT counter_sint8_R09.R09 "" SBYTE ident 1 100 -128.0 127.0 ECU_ADDRESS 0x7FB74A /end MEASUREMENT
/begin MEASUREMENT counter_sint8_R10.R10 "" SBYTE ident 1 100 -128.0 127.0 ECU_ADDRESS 0x7FB750 /end MEASUREMENT
/begin MEASUREMENT counter_sint8_R11.R11 "" SBYTE ident 1 100 -128.0 127.0 ECU_ADDRESS 0x7FB756 /end MEASUREMENT
/begin MEASUREMENT counter_sint8_R12.R12 "" SBYTE ident 1 100 -128.0 127.0 ECU_ADDRESS 0x7FB75C /end MEASUREMENT
/begin MEASUREMENT counter_sint8_R13.R13 "" SBYTE ident 1 100 -128.0 127.0 ECU_ADDRESS 0x7FB762 /end MEASUREMENT
/begin MEASUREMENT counter_sint8_R14.R14 "" SBYTE ident 1 100 -128.0 127.0 ECU_ADDRESS 0x7FB768 /end MEASUREMENT
/begin MEASUREMENT counter_sint8_R15.R15 "" SBYTE ident 1 100 -128.0 127.0 ECU_ADDRESS 0x7FB76E /end MEASUREMENT
/begin MEASUREMENT counter_sint8_R16.R16 "" SBYTE ident 1 100 -128.0 127.0 ECU_ADDRESS 0x7FB770 /end MEASUREMENT
/begin MEASUREMENT counter_uint16_R01.R01 "" UWORD ident 1 100 0.0 65535.0 ECU_ADDRESS 0x7FB684 DISPLAY_IDENTIFIER counter_uint16_R01.R01_DISP_ID_R01 /end MEASUREMENT
/begin MEASUREMENT counter_uint16_R02.R02 "" UWORD ident 1 100 0.0 65535.0 ECU_ADDRESS 0x7FB6BC DISPLAY_IDENTIFIER counter_uint16_R02.R02_DISP_ID_R02 /end MEASUREMENT
/begin MEASUREMENT counter_uint16_R03.R03 "" UWORD ident 1 100 0.0 65535.0 ECU_ADDRESS 0x7FB6F4 DISPLAY_IDENTIFIER counter_uint16_R03.R03_DISP_ID_R03 /end MEASUREMENT
/begin MEASUREMENT counter_uint16_R04.R04 "" UWORD ident 1 100 0.0 65535.0 ECU_ADDRESS 0x7FB72A /end MEASUREMENT
/begin MEASUREMENT counter_uint16_R05.R05 "" UWORD ident 1 100 0.0 65535.0 ECU_ADDRESS 0x7FB730 /end MEASUREMENT
/begin MEASUREMENT counter_uint16_R06.R06 "" UWORD ident 1 100 0.0 65535.0 ECU_ADDRESS 0x7FB736 /end MEASUREMENT
/begin MEASUREMENT counter_uint16_R07.R07 "" UWORD ident 1 100 0.0 65535.0 ECU_ADDRESS 0x7FB73C /end MEASUREMENT
/begin MEASUREMENT counter_uint16_R08.R08 "" UWORD ident 1 100 0.0 65535.0 ECU_ADDRESS 0x7FB742 /end MEASUREMENT
/begin MEASUREMENT counter_uint16_R09.R09 "" UWORD ident 1 100 0.0 65535.0 ECU_ADDRESS 0x7FB748 /end MEASUREMENT
/begin MEASUREMENT counter_uint16_R10.R10 "" UWORD ident 1 100 0.0 65535.0 ECU_ADDRESS 0x7FB74E /end MEASUREMENT
/begin MEASUREMENT counter_uint16_R11.R11 "" UWORD ident 1 100 0.0 65535.0 ECU_ADDRESS 0x7FB754 /end MEASUREMENT
/begin MEASUREMENT counter_uint16_R12.R12 "" UWORD ident 1 100 0.0 65535.0 ECU_ADDRESS 0x7FB75A /end MEASUREMENT
/begin MEASUREMENT counter_uint16_R13.R13 "" UWORD ident 1 100 0.0 65535.0 ECU_ADDRESS 0x7FB760 /end MEASUREMENT
/begin MEASUREMENT counter_uint16_R14.R14 "" UWORD ident 1 100 0.0 65535.0 ECU_ADDRESS 0x7FB766 /end MEASUREMENT
/begin MEASUREMENT counter_uint16_R15.R15 "" UWORD ident 1 100 0.0 65535.0 ECU_ADDRESS 0x7FB76C /end MEASUREMENT
/begin MEASUREMENT counter_uint8_B01.R01 "" UBYTE ident 1 100 0.0 255.0 ECU_ADDRESS 0x7FB687 DISPLAY_IDENTIFIER counter_uint8_B01.R01_DISP_ID_R01 /end MEASUREMENT
/begin MEASUREMENT counter_uint8_B02.R02 "" UBYTE ident 1 100 0.0 255.0 ECU_ADDRESS 0x7FB6BF DISPLAY_IDENTIFIER counter_uint8_B02.R02_DISP_ID_R02 /end MEASUREMENT
/begin MEASUREMENT counter_uint8_R01.R01 "" UBYTE ident 1 100 0.0 255.0 ECU_ADDRESS 0x7FB688 DISPLAY_IDENTIFIER counter_uint8_R01.R01_DISP_ID_R01 /end MEASUREMENT
/begin MEASUREMENT counter_uint8_R01_old.raster_running "" UBYTE ident 1 100 0.0 255.0 ECU_ADDRESS 0x7FB772 /end MEASUREMENT
/begin MEASUREMENT counter_uint8_R02.R02 "" UBYTE ident 1 100 0.0 255.0 ECU_ADDRESS 0x7FB6C0 DISPLAY_IDENTIFIER counter_uint8_R02.R02_DISP_ID_R02 /end MEASUREMENT
/begin MEASUREMENT counter_uint8_R02_old.raster_running "" UBYTE ident 1 100 0.0 255.0 ECU_ADDRESS 0x7FB773 /end MEASUREMENT
/begin MEASUREMENT counter_uint8_R03.R03 "" UBYTE ident 1 100 0.0 255.0 ECU_ADDRESS 0x7FB6F7 DISPLAY_IDENTIFIER counter_uint8_R03.R03_DISP_ID_R03 /end MEASUREMENT
/begin MEASUREMENT counter_uint8_R03_old.raster_running "" UBYTE ident 1 100 0.0 255.0 ECU_ADDRESS 0x7FB774 /end MEASUREMENT
/begin MEASUREMENT counter_uint8_R04.R04 "" UBYTE ident 1 100 0.0 255.0 ECU_ADDRESS 0x7FB72D /end MEASUREMENT
/begin MEASUREMENT counter_uint8_R04_old.raster_running "" UBYTE ident 1 100 0.0 255.0 ECU_ADDRESS 0x7FB775 /end MEASUREMENT
/begin MEASUREMENT counter_uint8_R05.R05 "" UBYTE ident 1 100 0.0 255.0 ECU_ADDRESS 0x7FB733 /end MEASUREMENT
/begin MEASUREMENT counter_uint8_R05_old.raster_running "" UBYTE ident 1 100 0.0 255.0 ECU_ADDRESS 0x7FB776 /end MEASUREMENT
/begin MEASUREMENT counter_uint8_R06.R06 "" UBYTE ident 1 100 0.0 255.0 ECU_ADDRESS 0x7FB739 /end MEASUREMENT
/begin MEASUREMENT counter_uint8_R06_old.raster_running "" UBYTE ident 1 100 0.0 255.0 ECU_ADDRESS 0x7FB777 /end MEASUREMENT
/begin MEASUREMENT counter_uint8_R07.R07 "" UBYTE ident 1 100 0.0 255.0 ECU_ADDRESS 0x7FB73F /end MEASUREMENT
/begin MEASUREMENT counter_uint8_R07_old.raster_running "" UBYTE ident 1 100 0.0 255.0 ECU_ADDRESS 0x7FB778 /end MEASUREMENT
/begin MEASUREMENT counter_uint8_R08.R08 "" UBYTE ident 1 100 0.0 255.0 ECU_ADDRESS 0x7FB745 /end MEASUREMENT
/begin MEASUREMENT counter_uint8_R08_old.raster_running "" UBYTE ident 1 100 0.0 255.0 ECU_ADDRESS 0x7FB779 /end MEASUREMENT
/begin MEASUREMENT counter_uint8_R09.R09 "" UBYTE ident 1 100 0.0 255.0 ECU_ADDRESS 0x7FB74B /end MEASUREMENT
/begin MEASUREMENT counter_uint8_R09_old.raster_running "" UBYTE ident 1 100 0.0 255.0 ECU_ADDRESS 0x7FB77A /end MEASUREMENT
/begin MEASUREMENT counter_uint8_R10.R10 "" UBYTE ident 1 100 0.0 255.0 ECU_ADDRESS 0x7FB751 /end MEASUREMENT
/begin MEASUREMENT counter_uint8_R10_old.raster_running "" UBYTE ident 1 100 0.0 255.0 ECU_ADDRESS 0x7FB77B /end MEASUREMENT
/begin MEASUREMENT counter_uint8_R11.R11 "" UBYTE ident 1 100 0.0 255.0 ECU_ADDRESS 0x7FB757 /end MEASUREMENT
/begin MEASUREMENT counter_uint8_R11_old.raster_running "" UBYTE ident 1 100 0.0 255.0 ECU_ADDRESS 0x7FB77C /end MEASUREMENT
/begin MEASUREMENT counter_uint8_R12.R12 "" UBYTE ident 1 100 0.0 255.0 ECU_ADDRESS 0x7FB75D /end MEASUREMENT
/begin MEASUREMENT counter_uint8_R12_old.raster_running "" UBYTE ident 1 100 0.0 255.0 ECU_ADDRESS 0x7FB77D /end MEASUREMENT
/begin MEASUREMENT counter_uint8_R13.R13 "" UBYTE ident 1 100 0.0 255.0 ECU_ADDRESS 0x7FB763 /end MEASUREMENT
/begin MEASUREMENT counter_uint8_R13_old.raster_running "" UBYTE ident 1 100 0.0 255.0 ECU_ADDRESS 0x7FB77E /end MEASUREMENT
/begin MEASUREMENT counter_uint8_R14.R14 "" UBYTE ident 1 100 0.0 255.0 ECU_ADDRESS 0x7FB769 /end MEASUREMENT
/begin MEASUREMENT counter_uint8_R14_old.raster_running "" UBYTE ident 1 100 0.0 255.0 ECU_ADDRESS 0x7FB77F /end MEASUREMENT
/begin MEASUREMENT counter_uint8_R15.R15 "" UBYTE ident 1 100 0.0 255.0 ECU_ADDRESS 0x7FB76F /end MEASUREMENT
/begin MEASUREMENT counter_uint8_R15_old.raster_running "" UBYTE ident 1 100 0.0 255.0 ECU_ADDRESS 0x7FB780 /end MEASUREMENT
/begin MEASUREMENT counter_uint8_R16.R16 "" UBYTE ident 1 100 0.0 255.0 ECU_ADDRESS 0x7FB771 /end MEASUREMENT
/begin MEASUREMENT counter_uint8_R16_old.raster_running "" UBYTE ident 1 100 0.0 255.0 ECU_ADDRESS 0x7FB781 /end MEASUREMENT
/begin MEASUREMENT counter_uint8_send_fast.counter_send_fast "" UBYTE ident 1 100 0.0 255.0 ECU_ADDRESS 0x7FB420 /end MEASUREMENT
/begin MEASUREMENT Counter_USTACK_NFULL.OS_Counter "" ULONG ident 1 100 0 4294967295 ECU_ADDRESS 0x7FB644 /end MEASUREMENT
/begin MEASUREMENT Counter_USTACK_OVFL.OS_Counter "" ULONG ident 1 100 0 4294967295 ECU_ADDRESS 0x7FB648 /end MEASUREMENT
/begin MEASUREMENT cycle_raster.raster_running "" UBYTE ident 1 100 0.0 255.0 ECU_ADDRESS 0x7FB782 /end MEASUREMENT
/begin MEASUREMENT Cyclic_RAMCheck_ActError.SIKO_Module "" UWORD ident 1 100 0 65535 ECU_ADDRESS 0x7FB9BC /end MEASUREMENT
/begin MEASUREMENT Cyclic_RAMCheck_ActStatus.SIKO_Module "" UWORD ident 1 100 0 65535 ECU_ADDRESS 0x7FB9BE /end MEASUREMENT
/begin MEASUREMENT Cyclic_ROMCheck_ActError.SIKO_Module "" UWORD ident 1 100 0 65535 ECU_ADDRESS 0x7FB9C0 /end MEASUREMENT
/begin MEASUREMENT Cyclic_ROMCheck_ActStatus.SIKO_Module "" UWORD ident 1 100 0 65535 ECU_ADDRESS 0x7FB9C2 /end MEASUREMENT
/begin MEASUREMENT debugflag.XCP_SHELL "" UBYTE ident 1 100 0 255 ECU_ADDRESS 0x7F9385 /end MEASUREMENT
/begin MEASUREMENT Do_Single_Step_alt.Replay_Data "" UBYTE ident 1 100 0 1 BIT_MASK 0x1 ECU_ADDRESS 0x7F8FD9 /end MEASUREMENT
/begin MEASUREMENT dT "" UWORD TickType2ms 1 100 0.0 18.72428571428571 ECU_ADDRESS 0x7FB524 /end MEASUREMENT
/begin MEASUREMENT dT_Raster.R01.Restart_Raster_16T "" ULONG TickType2ms 1 100 0.0 1227133.512857143 ECU_ADDRESS 0x7FB7D0 /end MEASUREMENT
/begin MEASUREMENT dT_Raster.R02.Restart_Raster_16T "" ULONG TickType2ms 1 100 0.0 1227133.51285714 ECU_ADDRESS 0x7FB7EC /end MEASUREMENT
/begin MEASUREMENT dT_Raster.R03.Restart_Raster_16T "" ULONG TickType2ms 1 100 0.0 1227133.51285714 ECU_ADDRESS 0x7FB804 /end MEASUREMENT
/begin MEASUREMENT dT_Raster.R04_Sync.Restart_Raster_16T "" ULONG TickType2ms 1 100 0.0 1227133.512857143 ECU_ADDRESS 0x7FB820 /end MEASUREMENT
/begin MEASUREMENT dT_Raster.R05.Restart_Raster_16T "" ULONG TickType2ms 1 100 0.0 1227133.51285714 ECU_ADDRESS 0x7FB83C /end MEASUREMENT
/begin MEASUREMENT dT_Raster.R06.Restart_Raster_16T "" ULONG TickType2ms 1 100 0.0 1227133.51285714 ECU_ADDRESS 0x7FB844 /end MEASUREMENT
/begin MEASUREMENT dT_Raster.R07.Restart_Raster_16T "" ULONG TickType2ms 1 100 0.0 1227133.51285714 ECU_ADDRESS 0x7FB84C /end MEASUREMENT
/begin MEASUREMENT dT_Raster.R08.Restart_Raster_16T "" ULONG TickType2ms 1 100 0.0 1227133.51285714 ECU_ADDRESS 0x7FB854 /end MEASUREMENT
/begin MEASUREMENT dT_Raster.R09.Restart_Raster_16T "" ULONG TickType2ms 1 100 0.0 1227133.51285714 ECU_ADDRESS 0x7FB85C /end MEASUREMENT
/begin MEASUREMENT dT_Raster.R10.Restart_Raster_16T "" ULONG TickType2ms 1 100 0.0 1227133.51285714 ECU_ADDRESS 0x7FB864 /end MEASUREMENT
/begin MEASUREMENT dT_Raster.R11.Restart_Raster_16T "" ULONG TickType2ms 1 100 0.0 1227133.51285714 ECU_ADDRESS 0x7FB86C /end MEASUREMENT
/begin MEASUREMENT dT_Raster.R12.Restart_Raster_16T "" ULONG TickType2ms 1 100 0.0 1227133.51285714 ECU_ADDRESS 0x7FB874 /end MEASUREMENT
/begin MEASUREMENT dT_Raster.R13.Restart_Raster_16T "" ULONG TickType2ms 1 100 0.0 1227133.51285714 ECU_ADDRESS 0x7FB87C /end MEASUREMENT
/begin MEASUREMENT dT_Raster.R14.Restart_Raster_16T "" ULONG TickType2ms 1 100 0.0 1227133.51285714 ECU_ADDRESS 0x7FB884 /end MEASUREMENT
/begin MEASUREMENT dT_Raster.R15.Restart_Raster_16T "" ULONG TickType2ms 1 100 0.0 1227133.51285714 ECU_ADDRESS 0x7FB88C /end MEASUREMENT
/begin MEASUREMENT dT_Raster.R16.Restart_Raster_16T "" ULONG TickType2ms 1 100 0.0 1227133.51285714 ECU_ADDRESS 0x7FB894 /end MEASUREMENT
/begin MEASUREMENT EARDelayTime.SIKO_Module "" UBYTE FastestTaskTicks_to_ms 1 100 0.0 510.0 ECU_ADDRESS 0x7F900C /end MEASUREMENT
/begin MEASUREMENT EHookOn75.SIKO_Module "" SLONG ident 1 100 -2147483648 2147483647 ECU_ADDRESS 0x7FB9B0 /end MEASUREMENT
/begin MEASUREMENT ERCOS_EStackSize.SIKO_Module "Displays __OSSTACKSIZE (cf. mpc555.lay)" UWORD ident_DWords 1 100 0 65535 ECU_ADDRESS 0x7FB9C4 /end MEASUREMENT
/begin MEASUREMENT ERCOS_EStackUsed.SIKO_Module "See ERCOS manual (cf. E_STACK.H)" UWORD ident_DWords 1 100 0 65535 ECU_ADDRESS 0x7FB9C6 /end MEASUREMENT
/begin MEASUREMENT ERCOS_StackStatus.SIKO_Module "See ERCOS manual (cf. E_STACK.H)" UWORD ident 1 100 0 65535 ECU_ADDRESS 0x7FB9C8 /end MEASUREMENT
/begin MEASUREMENT ERCOS_UStackSize.SIKO_Module "Displays __USERSTACKSIZE (cf. mpc555.lay)" UWORD ident_DWords 1 100 0 65535 ECU_ADDRESS 0x7FB9CA /end MEASUREMENT
/begin MEASUREMENT ERCOS_UStackUsed.SIKO_Module "See ERCOS manual (cf. E_STACK.H)" UWORD ident_DWords 1 100 0 65535 ECU_ADDRESS 0x7FB9CC /end MEASUREMENT
/begin MEASUREMENT g_AcceptAllKeys_u8.XCP_SHELL_VAR.XCP_SHELL "" UBYTE ident 1 100 0 255 ECU_ADDRESS 0x7FBB1C /end MEASUREMENT
/begin MEASUREMENT g_enableSyncR04burst_u8.Restart_Raster_16T "" UBYTE ident 1 100 0 1 BIT_MASK 0x1 ECU_ADDRESS 0x7F8FDA /end MEASUREMENT
/begin MEASUREMENT g_power_u8.XCP_SHELL_VAR.XCP_SHELL "" UBYTE ident 1 100 0 255 ECU_ADDRESS 0x7FBB1D /end MEASUREMENT
/begin MEASUREMENT g_Pre01_f32_0.XCP_PredefinedTypes "" FLOAT32_IEEE ident 1 100 -1.e+037 1.e+037 ECU_ADDRESS 0x7FBAC4 /end MEASUREMENT
/begin MEASUREMENT g_Pre01_s16_0.XCP_PredefinedTypes "" SWORD ident 1 100 -32768 32767 ECU_ADDRESS 0x7FBACC /end MEASUREMENT
/begin MEASUREMENT g_Pre01_s32_0.XCP_PredefinedTypes "" SLONG ident 1 100 -2147483648 2147483647 ECU_ADDRESS 0x7FBABC /end MEASUREMENT
/begin MEASUREMENT g_Pre01_s8_0.XCP_PredefinedTypes "" SBYTE ident 1 100 -128 127 ECU_ADDRESS 0x7FBACA /end MEASUREMENT
/begin MEASUREMENT g_Pre01_s8_1.XCP_PredefinedTypes "" SBYTE ident 1 100 -128 127 ECU_ADDRESS 0x7FBAC0 /end MEASUREMENT
/begin MEASUREMENT g_Pre01_u16_0.XCP_PredefinedTypes "" UWORD ident 1 100 0 65535 ECU_ADDRESS 0x7FBAC8 /end MEASUREMENT
/begin MEASUREMENT g_Pre01_u32_0.XCP_PredefinedTypes "" ULONG ident 1 100 0 4294967295 ECU_ADDRESS 0x7FBAD0 /end MEASUREMENT
/begin MEASUREMENT g_Pre01_u8_0.XCP_PredefinedTypes "" UBYTE ident 1 100 0 255 ECU_ADDRESS 0x7FBAB8 /end MEASUREMENT
/begin MEASUREMENT g_Pre01_u8_1.XCP_PredefinedTypes "" UBYTE ident 1 100 0 255 ECU_ADDRESS 0x7FBACE /end MEASUREMENT
/begin MEASUREMENT g_SoftResetECU_u8.Reset_Schalter "" UBYTE ident 1 100 0 1 ECU_ADDRESS 0x7FB7B9 DISPLAY_IDENTIFIER g_SoftResetECU_u8.Reset_Schalter_DISP_ID /end MEASUREMENT
/begin MEASUREMENT g_TriggerOverload_u8.XCP_SHELL_VAR.XCP_SHELL "" UBYTE ident 1 100 0 255 ECU_ADDRESS 0x7FBB0B /end MEASUREMENT
/begin MEASUREMENT g_UdsAddressing_u8.UdsSendList_save.UdsSendList "" UBYTE enum_UDS_ADDRESS_MODE_E 1 100 0 1 ECU_ADDRESS 0x8200F4 /end MEASUREMENT
/begin MEASUREMENT g_UdsBufLocId_au32.UdsLocIDs "" ULONG ident 1 100 0 4294967295 ECU_ADDRESS 0x8230F8 MATRIX_DIM 10 1 1 /end MEASUREMENT
/begin MEASUREMENT g_UdsCanIDEcu_u32.UdsSendList_save.UdsSendList "" ULONG ident 1 100 0 4294967295 ECU_ADDRESS 0x8200F8 /end MEASUREMENT
/begin MEASUREMENT g_UdsCanIDInca_u32.UdsSendList_save.UdsSendList "" ULONG ident 1 100 0 4294967295 ECU_ADDRESS 0x8200F0 /end MEASUREMENT
/begin MEASUREMENT g_UdsID_TGT_ECU_u8.UdsSendList_save.UdsSendList "" UBYTE ident 1 100 0 255 ECU_ADDRESS 0x8200FD /end MEASUREMENT
/begin MEASUREMENT g_UdsID_TGT_INCA_u8.UdsSendList_save.UdsSendList "" UBYTE ident 1 100 0 255 ECU_ADDRESS 0x8200FC /end MEASUREMENT
/begin MEASUREMENT g_UdsLocId_pu32.UdsLocIDs "" ULONG ident 1 100 0 4294967295 ECU_ADDRESS 0x7FB9FC /end MEASUREMENT
/begin MEASUREMENT g_UdsLocIds_apu32.UdsLocIDs "" ULONG ident 1 100 0 4294967295 ECU_ADDRESS 0x7FB9E4 MATRIX_DIM 6 1 1 /end MEASUREMENT
/begin MEASUREMENT g_UdsRasterList_apu32.UdsSendList "" ULONG ident 1 100 0 4294967295 ECU_ADDRESS 0x7F90C8 MATRIX_DIM 3 1 1 /end MEASUREMENT
/begin MEASUREMENT g_UdsSendList_au32.UdsSendList "" ULONG ident 1 100 0 4294967295 ECU_ADDRESS 0x823120 MATRIX_DIM 385 1 1 /end MEASUREMENT
/begin MEASUREMENT g_UdsSendList_pu32.UdsSendList_save.UdsSendList "" ULONG ident 1 100 0 4294967295 ECU_ADDRESS 0x823730 /end MEASUREMENT
/begin MEASUREMENT g_UdsSendList1Elem_u32.UdsSendList_save.UdsSendList "" ULONG ident 1 100 0 4294967295 ECU_ADDRESS 0x823728 /end MEASUREMENT
/begin MEASUREMENT g_UdsSendList1Val_u32.UdsSendList_save.UdsSendList "" ULONG ident 1 100 0 4294967295 ECU_ADDRESS 0x82372C /end MEASUREMENT
/begin MEASUREMENT g_UdsSendLists_apu32.UdsSendList "" ULONG ident 1 100 0 4294967295 ECU_ADDRESS 0x7F90D4 MATRIX_DIM 24 1 1 /end MEASUREMENT
/begin MEASUREMENT g_XcpAutoResetAfterStoreDaq_u8.XCP_SHELL_VAR.XCP_SHELL "" UBYTE ident 1 100 0 255 ECU_ADDRESS 0x7F9436 /end MEASUREMENT
/begin MEASUREMENT g_XcpBitStimSupport_u8.XCP_SHELL_VAR.XCP_SHELL "" UBYTE enum_XCP_BitSTIM_e 1 100 0 1 ECU_ADDRESS 0x7FBAF4 /end MEASUREMENT
/begin MEASUREMENT g_XcpBitStimVersion_u8.XCP_SHELL_VAR.XCP_SHELL "" UBYTE enum_XCP_BitSTIMVERSION_e 1 100 0 1 ECU_ADDRESS 0x7FBB06 /end MEASUREMENT
/begin MEASUREMENT g_XcpBlockDownloadMaxBS_u8.XCP_SHELL_VAR.XCP_SHELL "" UBYTE ident 1 100 0 255 ECU_ADDRESS 0x7F9435 /end MEASUREMENT
/begin MEASUREMENT g_XcpBlockDownloadMinST_u8.XCP_SHELL_VAR.XCP_SHELL "" UBYTE ident 1 100 0 255 ECU_ADDRESS 0x7FBB27 /end MEASUREMENT
/begin MEASUREMENT g_XcpBlockFlashMaxBS_u8.XCP_SHELL_VAR.XCP_SHELL "" UBYTE ident 1 100 0 255 ECU_ADDRESS 0x7F942B /end MEASUREMENT
/begin MEASUREMENT g_XcpBlockFlashMinST_u8.XCP_SHELL_VAR.XCP_SHELL "" UBYTE ident 1 100 0 255 ECU_ADDRESS 0x7FBB1F /end MEASUREMENT
/begin MEASUREMENT g_XcpByteOrder_u8.XCP_SHELL_VAR.XCP_SHELL "" UBYTE enum_XCP_ByteOrder_e 1 100 0 1 ECU_ADDRESS 0x7FBAED /end MEASUREMENT
/begin MEASUREMENT g_XcpCommModeBasic_u8.XCP_SHELL_VAR.XCP_SHELL "" UBYTE ident 1 100 0 255 ECU_ADDRESS 0x7FBAF3 /end MEASUREMENT
/begin MEASUREMENT g_XcpCommModeOptional_u8.XCP_SHELL_VAR.XCP_SHELL "" UBYTE ident 1 100 0 255 ECU_ADDRESS 0x7FBB08 /end MEASUREMENT
/begin MEASUREMENT g_XcpCommModePgm_u8.XCP_SHELL_VAR.XCP_SHELL "" UBYTE ident 1 100 0 255 ECU_ADDRESS 0x7F9428 /end MEASUREMENT
/begin MEASUREMENT g_XcpConnectResetECU_u8.XCP_SHELL_VAR.XCP_SHELL "" UBYTE ident 1 100 0 255 ECU_ADDRESS 0x7FBB03 /end MEASUREMENT
/begin MEASUREMENT g_XcpCtoMax_u8.XCP_SHELL_VAR.XCP_SHELL "" UBYTE ident 1 100 0 255 ECU_ADDRESS 0x7F9437 /end MEASUREMENT
/begin MEASUREMENT g_XcpCtoMaxPgm_u8.XCP_SHELL_VAR.XCP_SHELL "" UBYTE ident 1 100 0 255 ECU_ADDRESS 0x7F9429 /end MEASUREMENT
/begin MEASUREMENT g_XcpDaqConfigType_u8.XCP_SHELL_VAR.XCP_SHELL "" UBYTE enum_XCP_DaqConfigType_e 1 100 0 1 ECU_ADDRESS 0x7FBB15 /end MEASUREMENT
/begin MEASUREMENT g_XcpDaqKeyByte_u8.XCP_SHELL_VAR.XCP_SHELL "" UBYTE ident 1 100 0 255 ECU_ADDRESS 0x7FBB24 /end MEASUREMENT
/begin MEASUREMENT g_XcpDaqListProperties_u8.XCP_SHELL_VAR.XCP_SHELL "" UBYTE ident 1 100 0 255 ECU_ADDRESS 0x7FBB09 /end MEASUREMENT
/begin MEASUREMENT g_XcpDaqProperties_u8.XCP_SHELL_VAR.XCP_SHELL "" UBYTE ident 1 100 0 255 ECU_ADDRESS 0x7F9434 /end MEASUREMENT
/begin MEASUREMENT g_XcpDisableDaqTransmition_b.XCP_Failure.XCP_SHELL "" UBYTE ident 1 100 0 1 BIT_MASK 0x1 ECU_ADDRESS 0x7F937C /end MEASUREMENT
/begin MEASUREMENT g_XcpDtoMax_u16.XCP_SHELL_VAR.XCP_SHELL "" UWORD ident 1 100 0 65535 ECU_ADDRESS 0x7F943A /end MEASUREMENT
/begin MEASUREMENT g_XcpError_u8.XCP_Failure.XCP_SHELL "" UBYTE ident 1 100 0 255 ECU_ADDRESS 0x7FBAB2 /end MEASUREMENT
/begin MEASUREMENT g_XcpErrorClear_u8.XCP_Failure.XCP_SHELL "" UBYTE ident 1 100 0 255 ECU_ADDRESS 0x7FBAB1 /end MEASUREMENT
/begin MEASUREMENT g_XcpEtasTool_u8.XCP_SHELL_VAR.XCP_SHELL "" UBYTE enum_XCP_ETASTool_e 1 100 0 1 ECU_ADDRESS 0x7FBADE /end MEASUREMENT
/begin MEASUREMENT g_XcpGranularityOdtEntrySizeDaq_u8.XCP_SHELL_VAR.XCP_SHELL "" UBYTE ident 1 100 0 255 ECU_ADDRESS 0x7FBADF /end MEASUREMENT
/begin MEASUREMENT g_XcpGranularityOdtEntrySizeStim_u8.XCP_SHELL_VAR.XCP_SHELL "" UBYTE ident 1 100 0 255 ECU_ADDRESS 0x7FBADA /end MEASUREMENT
/begin MEASUREMENT g_XcpIdentFieldType_u8.XCP_SHELL_VAR.XCP_SHELL "" UBYTE enum_XCP_IdentType_e 1 100 0 3 ECU_ADDRESS 0x7FBAEC /end MEASUREMENT
/begin MEASUREMENT g_XcpMasterBlockmodeOn_u8.XCP_SHELL_VAR.XCP_SHELL "" UBYTE ident 1 100 0 255 ECU_ADDRESS 0x7FBB00 /end MEASUREMENT
/begin MEASUREMENT g_XcpMasterBlockmodePgmOn_u8.XCP_SHELL_VAR.XCP_SHELL "" UBYTE ident 1 100 0 255 ECU_ADDRESS 0x7F9420 /end MEASUREMENT
/begin MEASUREMENT g_XcpMasterPowerOn_u8_unused.XCP_SHELL_VAR.XCP_SHELL "" UBYTE ident 1 100 0 255 ECU_ADDRESS 0x7FBAFD /end MEASUREMENT
/begin MEASUREMENT g_XcpMaxDaq_u16.XCP_SHELL_VAR.XCP_SHELL "" UWORD ident 1 100 0 65535 ECU_ADDRESS 0x7FBB28 /end MEASUREMENT
/begin MEASUREMENT g_XcpMaxEventNo_u16.XCP_SHELL_VAR.XCP_SHELL "" UWORD ident 1 100 0 65535 ECU_ADDRESS 0x7FBB16 /end MEASUREMENT
/begin MEASUREMENT g_XcpMaxOdtEntrySizeDaq_u8.XCP_SHELL_VAR.XCP_SHELL "" UBYTE ident 1 100 0 255 ECU_ADDRESS 0x7FBB18 /end MEASUREMENT
/begin MEASUREMENT g_XcpMaxOdtEntrySizeStim_u8.XCP_SHELL_VAR.XCP_SHELL "" UBYTE ident 1 100 0 255 ECU_ADDRESS 0x7FBAFC /end MEASUREMENT
/begin MEASUREMENT g_XcpMaxPredefDaq_u8.XCP_SHELL_VAR.XCP_SHELL "" UBYTE ident 1 100 0 255 ECU_ADDRESS 0x7FBB0A /end MEASUREMENT
/begin MEASUREMENT g_XcpMinDaq_u8.XCP_SHELL_VAR.XCP_SHELL "" UBYTE ident 1 100 0 255 ECU_ADDRESS 0x7FBB1E /end MEASUREMENT
/begin MEASUREMENT g_XcpNumError_u8.XCP_ErrorHook.XCP_SHELL "" UBYTE ident 1 100 0 255 ECU_ADDRESS 0x7FBAAE /end MEASUREMENT
/begin MEASUREMENT g_XcpOverloadType_u8.XCP_SHELL_VAR.XCP_SHELL "" UBYTE enum_XCP_Overload_e 1 100 0 3 ECU_ADDRESS 0x7FBB1A /end MEASUREMENT
/begin MEASUREMENT g_XcpPagProperties_u8.XCP_SHELL_VAR.XCP_SHELL "" UBYTE enum_XCP_PagProperties_e 1 100 0 1 ECU_ADDRESS 0x7FBB04 /end MEASUREMENT
/begin MEASUREMENT g_XcpPIDoffSupport_u8.XCP_SHELL_VAR.XCP_SHELL "" UBYTE enum_XCP_PIDoff_e 1 100 0 1 ECU_ADDRESS 0x7FBAE4 /end MEASUREMENT
/begin MEASUREMENT g_XcpPowerOn_u8.XCP_SHELL_VAR.XCP_SHELL "" UBYTE ident 1 100 0 255 ECU_ADDRESS 0x7FBAFE /end MEASUREMENT
/begin MEASUREMENT g_XcpPrescalerSupport_u8.XCP_SHELL_VAR.XCP_SHELL "" UBYTE enum_XCP_Prescaler_e 1 100 0 1 ECU_ADDRESS 0x7FBB01 /end MEASUREMENT
/begin MEASUREMENT g_XcpResetConfig_u8.XCP_SHELL_VAR.XCP_SHELL "" UBYTE ident 1 100 0 255 ECU_ADDRESS 0x7FBB19 /end MEASUREMENT
/begin MEASUREMENT g_XcpResource_u8.XCP_SHELL_VAR.XCP_SHELL "" UBYTE ident 1 100 0 255 ECU_ADDRESS 0x7FBAD8 /end MEASUREMENT
/begin MEASUREMENT g_XcpResourceProtect_u8.XCP_SHELL_VAR.XCP_SHELL "" UBYTE ident 1 100 0 255 ECU_ADDRESS 0x7FBB05 /end MEASUREMENT
/begin MEASUREMENT g_XcpResumeMasterConnectTimeout_u32.XCP_SHELL_VAR.XCP_SHELL "" ULONG ident 1 100 0 4294967295 ECU_ADDRESS 0x7F942C /end MEASUREMENT
/begin MEASUREMENT g_XcpResumeMasterConnectTimeoutCheck_u8.XCP_SHELL_VAR.XCP_SHELL "" UBYTE ident 1 100 0 255 ECU_ADDRESS 0x7FBB07 /end MEASUREMENT
/begin MEASUREMENT g_XcpResumeMasterConnectTimeoutStart_u32.XCP_SHELL_VAR.XCP_SHELL "" ULONG ident 1 100 0 4294967295 ECU_ADDRESS 0x7FBB20 /end MEASUREMENT
/begin MEASUREMENT g_XcpResumeSupport_u8.XCP_SHELL_VAR.XCP_SHELL "" UBYTE enum_XCP_Resume_e 1 100 0 1 ECU_ADDRESS 0x7FBAF2 /end MEASUREMENT
/begin MEASUREMENT g_XcpSessStatus_u8.XCP_SHELL_VAR.XCP_SHELL "" UBYTE ident 1 100 0 255 ECU_ADDRESS 0x7FBADC /end MEASUREMENT
/begin MEASUREMENT g_XcpSessStatus_u8_nv.XCP_SHELL_VAR.XCP_SHELL "" UBYTE ident 1 100 0 255 ECU_ADDRESS 0x7F811D /end MEASUREMENT
/begin MEASUREMENT g_XcpSlaveBlockmodeOn_u8.XCP_SHELL_VAR.XCP_SHELL "" UBYTE ident 1 100 0 255 ECU_ADDRESS 0x7FBB26 /end MEASUREMENT
/begin MEASUREMENT g_XcpStateBypEv0_u8.XCP_SHELL "" UBYTE enum_XCP_STATE_BYP 1 100 0 3 ECU_ADDRESS 0x7FBAD4 /end MEASUREMENT
/begin MEASUREMENT g_XcpSwitchBackground_u8.XCP_SHELL_VAR.XCP_SHELL "" UBYTE ident 1 100 0 255 ECU_ADDRESS 0x7F9438 /end MEASUREMENT
/begin MEASUREMENT g_XcpTestOdtOpt_u8.XCP_SHELL_VAR.XCP_SHELL "" UBYTE ident 1 100 0 255 ECU_ADDRESS 0x7FBADB /end MEASUREMENT
/begin MEASUREMENT g_XcpTestOdtOptResult_u8.XCP_Failure.XCP_SHELL "" UBYTE ident 1 100 0 255 ECU_ADDRESS 0x7F937D /end MEASUREMENT
/begin MEASUREMENT g_XcpTestOdtOptSendResult_u8.XCP_SHELL_VAR.XCP_SHELL "" UBYTE ident 1 100 0 255 ECU_ADDRESS 0x7FBB14 /end MEASUREMENT
/begin MEASUREMENT g_XcpTickDuration_f32.XCP_SHELL_VAR.XCP_SHELL "" FLOAT32_IEEE ident 1 100 1.e-009 1.e+037 ECU_ADDRESS 0x7F9424 /end MEASUREMENT
/begin MEASUREMENT g_XcpTickDurationEcu_f32.XCP_SHELL_VAR.XCP_SHELL "" FLOAT32_IEEE ident 1 100 1.e-009 1.e+037 ECU_ADDRESS 0x7F9430 /end MEASUREMENT
/begin MEASUREMENT g_XcpTickDurationPrescaler_f32.XCP_SHELL_VAR.XCP_SHELL "" FLOAT32_IEEE ident 1 100 1.e-009 1.e+037 ECU_ADDRESS 0x7F943C /end MEASUREMENT
/begin MEASUREMENT g_XcpTimestampFix_u8.XCP_SHELL_VAR.XCP_SHELL "" UBYTE enum_XCP_TimstampFix_e 1 100 0 1 ECU_ADDRESS 0x7FBB25 /end MEASUREMENT
/begin MEASUREMENT g_XcpTimestampMode_u8.XCP_SHELL_VAR.XCP_SHELL "" UBYTE ident 1 100 0 255 ECU_ADDRESS 0x7FBB02 /end MEASUREMENT
/begin MEASUREMENT g_XcpTimestampProp_u8.XCP_SHELL_VAR.XCP_SHELL "" UBYTE enum_XCP_TimestampProp_e 1 100 0 3 ECU_ADDRESS 0x7F942A /end MEASUREMENT
/begin MEASUREMENT g_XcpTimestampSupport_u8.XCP_SHELL_VAR.XCP_SHELL "" UBYTE enum_XCP_TimestampSupport_e 1 100 0 1 ECU_ADDRESS 0x7FBAFF /end MEASUREMENT
/begin MEASUREMENT g_XcpTimestampTicks_u16.XCP_SHELL_VAR.XCP_SHELL "" UWORD ident 1 100 0 65535 ECU_ADDRESS 0x7FBAF0 /end MEASUREMENT
/begin MEASUREMENT g_XcpTimestampUnit_u8.XCP_SHELL_VAR.XCP_SHELL "" UBYTE enum_XCP_TimestampUnit_e 1 100 0 9 ECU_ADDRESS 0x7FBAEE /end MEASUREMENT
/begin MEASUREMENT g_XcpTimstampSize_u8.XCP_SHELL_VAR.XCP_SHELL "" UBYTE enum_XCP_TimestampSize_e 1 100 0 4 ECU_ADDRESS 0x7FBAD9 /end MEASUREMENT
/begin MEASUREMENT g_XcpTrigDaqFailure_u8.XCP_Failure.XCP_SHELL "" UBYTE ident 1 100 0 255 ECU_ADDRESS 0x7FBAB0 /end MEASUREMENT
/begin MEASUREMENT g_XcpTriggerError_u8.XCP_ErrorHook.XCP_SHELL "" UBYTE enum_XCP_ERROR_TRIGGER_E 1 100 0 2 ECU_ADDRESS 0x7FBAAF /end MEASUREMENT
/begin MEASUREMENT g_XcpTrigOdtFailure_u8.XCP_Failure.XCP_SHELL "" UBYTE ident 1 100 0 255 ECU_ADDRESS 0x7FBAB4 /end MEASUREMENT
/begin MEASUREMENT g_XcpTrigOverload_u8.XCP_Failure.XCP_SHELL "" UBYTE ident 1 100 0 255 ECU_ADDRESS 0x7FBAB3 /end MEASUREMENT
/begin MEASUREMENT g_XcpTrigResume_u8.XCP_SHELL_VAR.XCP_SHELL "" UBYTE ident 1 100 0 255 ECU_ADDRESS 0x7FBB1B /end MEASUREMENT
/begin MEASUREMENT gm_XcpAddrOptimization_u8.XCP_SHELL_VAR.XCP_SHELL "" UBYTE ident 1 100 0 255 ECU_ADDRESS 0x7FBB34 /end MEASUREMENT
/begin MEASUREMENT gm_XcpResumemodeCompare_u32.XCP_SHELL_VAR.XCP_SHELL "" ULONG ident 1 100 0 4294967295 ECU_ADDRESS 0x7FBAF8 /end MEASUREMENT
/begin MEASUREMENT gm_XcpResumemodeCounter_u32.XCP_SHELL_VAR.XCP_SHELL "" ULONG ident 1 100 0 4294967295 ECU_ADDRESS 0x7FBAE8 /end MEASUREMENT
/begin MEASUREMENT gm_XcpResumemodeCounterEv0_u32.XCP_SHELL_VAR.XCP_SHELL "" ULONG ident 1 100 0 4294967295 ECU_ADDRESS 0x7FBAE0 /end MEASUREMENT
/begin MEASUREMENT gm_XcpResumemodeCounterEv1_u32.XCP_SHELL_VAR.XCP_SHELL "" ULONG ident 1 100 0 4294967295 ECU_ADDRESS 0x7FBB0C /end MEASUREMENT
/begin MEASUREMENT gm_XcpResumemodeCounterEv2_u32.XCP_SHELL_VAR.XCP_SHELL "" ULONG ident 1 100 0 4294967295 ECU_ADDRESS 0x7FBB10 /end MEASUREMENT
/begin MEASUREMENT gm_XcpSizeOptimization_u8.XCP_SHELL_VAR.XCP_SHELL "" UBYTE ident 1 100 0 255 ECU_ADDRESS 0x7FBB35 /end MEASUREMENT
/begin MEASUREMENT grossRunTime.R01_Mon.Restart_Raster_16T "" ULONG TickType2ms 1 100 0.0 1227133.512857143 ECU_ADDRESS 0x7FB7DC /end MEASUREMENT
/begin MEASUREMENT grossRunTime.R02_Mon.Restart_Raster_16T "" ULONG TickType2ms 1 100 0.0 1227133.512857143 ECU_ADDRESS 0x7FB7F4 /end MEASUREMENT
/begin MEASUREMENT grossRunTime.R03_Mon.Restart_Raster_16T "" ULONG TickType2ms 1 100 0.0 1227133.512857143 ECU_ADDRESS 0x7FB80C /end MEASUREMENT
/begin MEASUREMENT grossRunTime.R04_Sync_Mon.Restart_Raster_16T "" ULONG TickType2ms 1 100 0.0 1227133.512857143 ECU_ADDRESS 0x7FB82C /end MEASUREMENT
/begin MEASUREMENT HWE_RAMCheck_Err.SIKO_Module "" UWORD ident 1 100 0 65535 ECU_ADDRESS 0x7FB9CE /end MEASUREMENT
/begin MEASUREMENT HWE_RAMCheck_Stat.SIKO_Module "" UWORD ident 1 100 0 65535 ECU_ADDRESS 0x7FB9D0 /end MEASUREMENT
/begin MEASUREMENT HWE_ROMCheck_Err.SIKO_Module "" UWORD ident 1 100 0 65535 ECU_ADDRESS 0x7FB9D2 /end MEASUREMENT
/begin MEASUREMENT HWE_ROMCheck_Stat.SIKO_Module "" UWORD ident 1 100 0 65535 ECU_ADDRESS 0x7FB9D4 /end MEASUREMENT
/begin MEASUREMENT i_Raster_u8.UDS_100ms_R03_SLOW1.UdsSendList "" UBYTE ident 1 100 0 255 ECU_ADDRESS 0x7F9378 /end MEASUREMENT
/begin MEASUREMENT i_Raster_u8.UDS_10ms_R01_FAST3.UdsSendList "" UBYTE ident 1 100 0 255 ECU_ADDRESS 0x7F9379 /end MEASUREMENT
/begin MEASUREMENT i_Raster_u8.UDS_50ms_R02_MEDIUM2.UdsSendList "" UBYTE ident 1 100 0 255 ECU_ADDRESS 0x7F937A /end MEASUREMENT
/begin MEASUREMENT l_R01Count16Bit_Temp_b.R01_16bit "" UBYTE ident 1 100 0 1 BIT_MASK 0x1 ECU_ADDRESS 0x7F8C54 /end MEASUREMENT
/begin MEASUREMENT l_R01Count8Bit_Temp_b.R01_8bit "" UBYTE ident 1 100 0 1 BIT_MASK 0x1 ECU_ADDRESS 0x7F8CD6 /end MEASUREMENT
/begin MEASUREMENT l_t01_bool_0.Type_Tests_EXTERN "" UBYTE ident 1 100 0 1 BIT_MASK 0x80 ECU_ADDRESS 0x8200E8 /end MEASUREMENT
/begin MEASUREMENT l_t01_bool_1.Type_Tests_EXTERN "" UBYTE ident 1 100 0 1 BIT_MASK 0x40 ECU_ADDRESS 0x8200E8 /end MEASUREMENT
/begin MEASUREMENT l_t01_bool_2.Type_Tests_EXTERN "" UBYTE ident 1 100 0 1 BIT_MASK 0x20 ECU_ADDRESS 0x8200E8 /end MEASUREMENT
/begin MEASUREMENT l_t01_bool_3.Type_Tests_EXTERN "" UBYTE ident 1 100 0 1 BIT_MASK 0x10 ECU_ADDRESS 0x8200E8 /end MEASUREMENT
/begin MEASUREMENT l_t01_bool_4.Type_Tests_EXTERN "" UBYTE ident 1 100 0 1 BIT_MASK 0x8 ECU_ADDRESS 0x8200E8 /end MEASUREMENT
/begin MEASUREMENT l_t01_bool_5.Type_Tests_EXTERN "" UBYTE ident 1 100 0 1 BIT_MASK 0x4 ECU_ADDRESS 0x8200E8 /end MEASUREMENT
/begin MEASUREMENT l_t01_bool_6.Type_Tests_EXTERN "" UBYTE ident 1 100 0 1 BIT_MASK 0x2 ECU_ADDRESS 0x8200E8 /end MEASUREMENT
/begin MEASUREMENT l_t01_bool_7.Type_Tests_EXTERN "" UBYTE ident 1 100 0 1 BIT_MASK 0x1 ECU_ADDRESS 0x8200E8 /end MEASUREMENT
/begin MEASUREMENT l_t01_f32_0.Type_Tests_EXTERN "" FLOAT32_IEEE ident 1 100 -1.e+037 1.e+037 ECU_ADDRESS 0x820058 /end MEASUREMENT
/begin MEASUREMENT l_t01_f32_0.XCP_Type_Tests "" FLOAT32_IEEE ident 1 100 -1.e+037 1.e+037 ECU_ADDRESS 0x7FBBA0 /end MEASUREMENT
/begin MEASUREMENT l_t01_f32_1.Type_Tests_EXTERN "" FLOAT32_IEEE ident 1 100 -1.e+037 1.e+037 ECU_ADDRESS 0x82005C /end MEASUREMENT
/begin MEASUREMENT l_t01_f32_1.XCP_Type_Tests "" FLOAT32_IEEE ident 1 100 -1.e+037 1.e+037 ECU_ADDRESS 0x7FBBA4 /end MEASUREMENT
/begin MEASUREMENT l_t01_f32_2.Type_Tests_EXTERN "" FLOAT32_IEEE ident 1 100 -1.e+037 1.e+037 ECU_ADDRESS 0x820060 /end MEASUREMENT
/begin MEASUREMENT l_t01_f32_2.XCP_Type_Tests "" FLOAT32_IEEE ident 1 100 -1.e+037 1.e+037 ECU_ADDRESS 0x7FBBA8 /end MEASUREMENT
/begin MEASUREMENT l_t01_f32_3.Type_Tests_EXTERN "" FLOAT32_IEEE ident 1 100 -1.e+037 1.e+037 ECU_ADDRESS 0x820064 /end MEASUREMENT
/begin MEASUREMENT l_t01_f32_3.XCP_Type_Tests "" FLOAT32_IEEE ident 1 100 -1.e+037 1.e+037 ECU_ADDRESS 0x7FBBAC /end MEASUREMENT
/begin MEASUREMENT l_t01_f32_4.Type_Tests_EXTERN "" FLOAT32_IEEE ident 1 100 -1.e+037 1.e+037 ECU_ADDRESS 0x820068 /end MEASUREMENT
/begin MEASUREMENT l_t01_f32_4.XCP_Type_Tests "" FLOAT32_IEEE ident 1 100 -1.e+037 1.e+037 ECU_ADDRESS 0x7FBBB0 /end MEASUREMENT
/begin MEASUREMENT l_t01_f32_5.Type_Tests_EXTERN "" FLOAT32_IEEE ident 1 100 -1.e+037 1.e+037 ECU_ADDRESS 0x82006C /end MEASUREMENT
/begin MEASUREMENT l_t01_f32_5.XCP_Type_Tests "" FLOAT32_IEEE ident 1 100 -1.e+037 1.e+037 ECU_ADDRESS 0x7FBBB4 /end MEASUREMENT
/begin MEASUREMENT l_t01_f32_6.Type_Tests_EXTERN "" FLOAT32_IEEE ident 1 100 -1.e+037 1.e+037 ECU_ADDRESS 0x820070 /end MEASUREMENT
/begin MEASUREMENT l_t01_f32_6.XCP_Type_Tests "" FLOAT32_IEEE ident 1 100 -1.e+037 1.e+037 ECU_ADDRESS 0x7FBBB8 /end MEASUREMENT
/begin MEASUREMENT l_t01_f32_7.Type_Tests_EXTERN "" FLOAT32_IEEE ident 1 100 -1.e+037 1.e+037 ECU_ADDRESS 0x820074 /end MEASUREMENT
/begin MEASUREMENT l_t01_f32_7.XCP_Type_Tests "" FLOAT32_IEEE ident 1 100 -1.e+037 1.e+037 ECU_ADDRESS 0x7FBBBC /end MEASUREMENT
/begin MEASUREMENT l_t01_f64_0.Type_Tests_EXTERN "" FLOAT64_IEEE ident 1 100 -1.e+037 1.e+037 ECU_ADDRESS 0x820018 /end MEASUREMENT
/begin MEASUREMENT l_t01_f64_0.XCP_Type_Tests "" FLOAT64_IEEE ident 1 100 -1.e+037 1.e+037 ECU_ADDRESS 0x7FBB60 /end MEASUREMENT
/begin MEASUREMENT l_t01_f64_1.Type_Tests_EXTERN "" FLOAT64_IEEE ident 1 100 -1.e+037 1.e+037 ECU_ADDRESS 0x820020 /end MEASUREMENT
/begin MEASUREMENT l_t01_f64_1.XCP_Type_Tests "" FLOAT64_IEEE ident 1 100 -1.e+037 1.e+037 ECU_ADDRESS 0x7FBB68 /end MEASUREMENT
/begin MEASUREMENT l_t01_f64_2.Type_Tests_EXTERN "" FLOAT64_IEEE ident 1 100 -1.e+037 1.e+037 ECU_ADDRESS 0x820028 /end MEASUREMENT
/begin MEASUREMENT l_t01_f64_2.XCP_Type_Tests "" FLOAT64_IEEE ident 1 100 -1.e+037 1.e+037 ECU_ADDRESS 0x7FBB70 /end MEASUREMENT
/begin MEASUREMENT l_t01_f64_3.Type_Tests_EXTERN "" FLOAT64_IEEE ident 1 100 -1.e+037 1.e+037 ECU_ADDRESS 0x820030 /end MEASUREMENT
/begin MEASUREMENT l_t01_f64_3.XCP_Type_Tests "" FLOAT64_IEEE ident 1 100 -1.e+037 1.e+037 ECU_ADDRESS 0x7FBB78 /end MEASUREMENT
/begin MEASUREMENT l_t01_f64_4.Type_Tests_EXTERN "" FLOAT64_IEEE ident 1 100 -1.e+037 1.e+037 ECU_ADDRESS 0x820038 /end MEASUREMENT
/begin MEASUREMENT l_t01_f64_4.XCP_Type_Tests "" FLOAT64_IEEE ident 1 100 -1.e+037 1.e+037 ECU_ADDRESS 0x7FBB80 /end MEASUREMENT
/begin MEASUREMENT l_t01_f64_5.Type_Tests_EXTERN "" FLOAT64_IEEE ident 1 100 -1.e+037 1.e+037 ECU_ADDRESS 0x820040 /end MEASUREMENT
/begin MEASUREMENT l_t01_f64_5.XCP_Type_Tests "" FLOAT64_IEEE ident 1 100 -1.e+037 1.e+037 ECU_ADDRESS 0x7FBB88 /end MEASUREMENT
/begin MEASUREMENT l_t01_f64_6.Type_Tests_EXTERN "" FLOAT64_IEEE ident 1 100 -1.e+037 1.e+037 ECU_ADDRESS 0x820048 /end MEASUREMENT
/begin MEASUREMENT l_t01_f64_6.XCP_Type_Tests "" FLOAT64_IEEE ident 1 100 -1.e+037 1.e+037 ECU_ADDRESS 0x7FBB90 /end MEASUREMENT
/begin MEASUREMENT l_t01_f64_7.Type_Tests_EXTERN "" FLOAT64_IEEE ident 1 100 -1.e+037 1.e+037 ECU_ADDRESS 0x820050 /end MEASUREMENT
/begin MEASUREMENT l_t01_f64_7.XCP_Type_Tests "" FLOAT64_IEEE ident 1 100 -1.e+037 1.e+037 ECU_ADDRESS 0x7FBB98 /end MEASUREMENT
/begin MEASUREMENT l_t01_s16_0.Type_Tests_EXTERN "" SWORD ident 1 100 -32768 32767 ECU_ADDRESS 0x8200B8 /end MEASUREMENT
/begin MEASUREMENT l_t01_s16_0.XCP_Type_Tests "" SWORD ident 1 100 -32768 32767 ECU_ADDRESS 0x7FBC20 /end MEASUREMENT
/begin MEASUREMENT l_t01_s16_1.Type_Tests_EXTERN "" SWORD ident 1 100 -32768 32767 ECU_ADDRESS 0x8200BA /end MEASUREMENT
/begin MEASUREMENT l_t01_s16_1.XCP_Type_Tests "" SWORD ident 1 100 -32768 32767 ECU_ADDRESS 0x7FBC22 /end MEASUREMENT
/begin MEASUREMENT l_t01_s16_2.Type_Tests_EXTERN "" SWORD ident 1 100 -32768 32767 ECU_ADDRESS 0x8200BC /end MEASUREMENT
/begin MEASUREMENT l_t01_s16_2.XCP_Type_Tests "" SWORD ident 1 100 -32768 32767 ECU_ADDRESS 0x7FBC24 /end MEASUREMENT
/begin MEASUREMENT l_t01_s16_3.Type_Tests_EXTERN "" SWORD ident 1 100 -32768 32767 ECU_ADDRESS 0x8200BE /end MEASUREMENT
/begin MEASUREMENT l_t01_s16_3.XCP_Type_Tests "" SWORD ident 1 100 -32768 32767 ECU_ADDRESS 0x7FBC26 /end MEASUREMENT
/begin MEASUREMENT l_t01_s16_4.Type_Tests_EXTERN "" SWORD ident 1 100 -32768 32767 ECU_ADDRESS 0x8200C0 /end MEASUREMENT
/begin MEASUREMENT l_t01_s16_4.XCP_Type_Tests "" SWORD ident 1 100 -32768 32767 ECU_ADDRESS 0x7FBC28 /end MEASUREMENT
/begin MEASUREMENT l_t01_s16_5.Type_Tests_EXTERN "" SWORD ident 1 100 -32768 32767 ECU_ADDRESS 0x8200C2 /end MEASUREMENT
/begin MEASUREMENT l_t01_s16_5.XCP_Type_Tests "" SWORD ident 1 100 -32768 32767 ECU_ADDRESS 0x7FBC2A /end MEASUREMENT
/begin MEASUREMENT l_t01_s16_6.Type_Tests_EXTERN "" SWORD ident 1 100 -32768 32767 ECU_ADDRESS 0x8200C4 /end MEASUREMENT
/begin MEASUREMENT l_t01_s16_6.XCP_Type_Tests "" SWORD ident 1 100 -32768 32767 ECU_ADDRESS 0x7FBC2C /end MEASUREMENT
/begin MEASUREMENT l_t01_s16_7.Type_Tests_EXTERN "" SWORD ident 1 100 -32768 32767 ECU_ADDRESS 0x8200C6 /end MEASUREMENT
/begin MEASUREMENT l_t01_s16_7.XCP_Type_Tests "" SWORD ident 1 100 -32768 32767 ECU_ADDRESS 0x7FBC2E /end MEASUREMENT
/begin MEASUREMENT l_t01_s32_0.Type_Tests_EXTERN "" SLONG ident 1 100 -2147483648 2147483647 ECU_ADDRESS 0x820078 /end MEASUREMENT
/begin MEASUREMENT l_t01_s32_0.XCP_Type_Tests "" SLONG ident 1 100 -2147483648 2147483647 ECU_ADDRESS 0x7FBBC0 /end MEASUREMENT
/begin MEASUREMENT l_t01_s32_1.Type_Tests_EXTERN "" SLONG ident 1 100 -2147483648 2147483647 ECU_ADDRESS 0x82007C /end MEASUREMENT
/begin MEASUREMENT l_t01_s32_1.XCP_Type_Tests "" SLONG ident 1 100 -2147483648 2147483647 ECU_ADDRESS 0x7FBBC4 /end MEASUREMENT
/begin MEASUREMENT l_t01_s32_2.Type_Tests_EXTERN "" SLONG ident 1 100 -2147483648 2147483647 ECU_ADDRESS 0x820080 /end MEASUREMENT
/begin MEASUREMENT l_t01_s32_2.XCP_Type_Tests "" SLONG ident 1 100 -2147483648 2147483647 ECU_ADDRESS 0x7FBBC8 /end MEASUREMENT
/begin MEASUREMENT l_t01_s32_3.Type_Tests_EXTERN "" SLONG ident 1 100 -2147483648 2147483647 ECU_ADDRESS 0x820084 /end MEASUREMENT
/begin MEASUREMENT l_t01_s32_3.XCP_Type_Tests "" SLONG ident 1 100 -2147483648 2147483647 ECU_ADDRESS 0x7FBBCC /end MEASUREMENT
/begin MEASUREMENT l_t01_s32_4.Type_Tests_EXTERN "" SLONG ident 1 100 -2147483648 2147483647 ECU_ADDRESS 0x820088 /end MEASUREMENT
/begin MEASUREMENT l_t01_s32_4.XCP_Type_Tests "" SLONG ident 1 100 -2147483648 2147483647 ECU_ADDRESS 0x7FBBD0 /end MEASUREMENT
/begin MEASUREMENT l_t01_s32_5.Type_Tests_EXTERN "" SLONG ident 1 100 -2147483648 2147483647 ECU_ADDRESS 0x82008C /end MEASUREMENT
/begin MEASUREMENT l_t01_s32_5.XCP_Type_Tests "" SLONG ident 1 100 -2147483648 2147483647 ECU_ADDRESS 0x7FBBD4 /end MEASUREMENT
/begin MEASUREMENT l_t01_s32_6.Type_Tests_EXTERN "" SLONG ident 1 100 -2147483648 2147483647 ECU_ADDRESS 0x820090 /end MEASUREMENT
/begin MEASUREMENT l_t01_s32_6.XCP_Type_Tests "" SLONG ident 1 100 -2147483648 2147483647 ECU_ADDRESS 0x7FBBD8 /end MEASUREMENT
/begin MEASUREMENT l_t01_s32_7.Type_Tests_EXTERN "" SLONG ident 1 100 -2147483648 2147483647 ECU_ADDRESS 0x820094 /end MEASUREMENT
/begin MEASUREMENT l_t01_s32_7.XCP_Type_Tests "" SLONG ident 1 100 -2147483648 2147483647 ECU_ADDRESS 0x7FBBDC /end MEASUREMENT
/begin MEASUREMENT l_t01_s8_0.Type_Tests_EXTERN "" SBYTE ident 1 100 -128 127 ECU_ADDRESS 0x8200D8 /end MEASUREMENT
/begin MEASUREMENT l_t01_s8_0.XCP_Type_Tests "" SBYTE ident 1 100 -128 127 ECU_ADDRESS 0x7FBC40 /end MEASUREMENT
/begin MEASUREMENT l_t01_s8_1.Type_Tests_EXTERN "" SBYTE ident 1 100 -128 127 ECU_ADDRESS 0x8200D9 /end MEASUREMENT
/begin MEASUREMENT l_t01_s8_1.XCP_Type_Tests "" SBYTE ident 1 100 -128 127 ECU_ADDRESS 0x7FBC41 /end MEASUREMENT
/begin MEASUREMENT l_t01_s8_2.Type_Tests_EXTERN "" SBYTE ident 1 100 -128 127 ECU_ADDRESS 0x8200DA /end MEASUREMENT
/begin MEASUREMENT l_t01_s8_2.XCP_Type_Tests "" SBYTE ident 1 100 -128 127 ECU_ADDRESS 0x7FBC42 /end MEASUREMENT
/begin MEASUREMENT l_t01_s8_3.Type_Tests_EXTERN "" SBYTE ident 1 100 -128 127 ECU_ADDRESS 0x8200DB /end MEASUREMENT
/begin MEASUREMENT l_t01_s8_3.XCP_Type_Tests "" SBYTE ident 1 100 -128 127 ECU_ADDRESS 0x7FBC43 /end MEASUREMENT
/begin MEASUREMENT l_t01_s8_4.Type_Tests_EXTERN "" SBYTE ident 1 100 -128 127 ECU_ADDRESS 0x8200DC /end MEASUREMENT
/begin MEASUREMENT l_t01_s8_4.XCP_Type_Tests "" SBYTE ident 1 100 -128 127 ECU_ADDRESS 0x7FBC44 /end MEASUREMENT
/begin MEASUREMENT l_t01_s8_5.Type_Tests_EXTERN "" SBYTE ident 1 100 -128 127 ECU_ADDRESS 0x8200DD /end MEASUREMENT
/begin MEASUREMENT l_t01_s8_5.XCP_Type_Tests "" SBYTE ident 1 100 -128 127 ECU_ADDRESS 0x7FBC45 /end MEASUREMENT
/begin MEASUREMENT l_t01_s8_6.Type_Tests_EXTERN "" SBYTE ident 1 100 -128 127 ECU_ADDRESS 0x8200DE /end MEASUREMENT
/begin MEASUREMENT l_t01_s8_6.XCP_Type_Tests "" SBYTE ident 1 100 -128 127 ECU_ADDRESS 0x7FBC46 /end MEASUREMENT
/begin MEASUREMENT l_t01_s8_7.Type_Tests_EXTERN "" SBYTE ident 1 100 -128 127 ECU_ADDRESS 0x8200DF /end MEASUREMENT
/begin MEASUREMENT l_t01_s8_7.XCP_Type_Tests "" SBYTE ident 1 100 -128 127 ECU_ADDRESS 0x7FBC47 /end MEASUREMENT
/begin MEASUREMENT l_t01_u16_0.Type_Tests_EXTERN "" UWORD ident 1 100 0 65535 ECU_ADDRESS 0x8200C8 /end MEASUREMENT
/begin MEASUREMENT l_t01_u16_0.XCP_Type_Tests "" UWORD ident 1 100 0 65535 ECU_ADDRESS 0x7FBC30 /end MEASUREMENT
/begin MEASUREMENT l_t01_u16_1.Type_Tests_EXTERN "" UWORD ident 1 100 0 65535 ECU_ADDRESS 0x8200CA /end MEASUREMENT
/begin MEASUREMENT l_t01_u16_1.XCP_Type_Tests "" UWORD ident 1 100 0 65535 ECU_ADDRESS 0x7FBC32 /end MEASUREMENT
/begin MEASUREMENT l_t01_u16_2.Type_Tests_EXTERN "" UWORD ident 1 100 0 65535 ECU_ADDRESS 0x8200CC /end MEASUREMENT
/begin MEASUREMENT l_t01_u16_2.XCP_Type_Tests "" UWORD ident 1 100 0 65535 ECU_ADDRESS 0x7FBC34 /end MEASUREMENT
/begin MEASUREMENT l_t01_u16_3.Type_Tests_EXTERN "" UWORD ident 1 100 0 65535 ECU_ADDRESS 0x8200CE /end MEASUREMENT
/begin MEASUREMENT l_t01_u16_3.XCP_Type_Tests "" UWORD ident 1 100 0 65535 ECU_ADDRESS 0x7FBC36 /end MEASUREMENT
/begin MEASUREMENT l_t01_u16_4.Type_Tests_EXTERN "" UWORD ident 1 100 0 65535 ECU_ADDRESS 0x8200D0 /end MEASUREMENT
/begin MEASUREMENT l_t01_u16_4.XCP_Type_Tests "" UWORD ident 1 100 0 65535 ECU_ADDRESS 0x7FBC38 /end MEASUREMENT
/begin MEASUREMENT l_t01_u16_5.Type_Tests_EXTERN "" UWORD ident 1 100 0 65535 ECU_ADDRESS 0x8200D2 /end MEASUREMENT
/begin MEASUREMENT l_t01_u16_5.XCP_Type_Tests "" UWORD ident 1 100 0 65535 ECU_ADDRESS 0x7FBC3A /end MEASUREMENT
/begin MEASUREMENT l_t01_u16_6.Type_Tests_EXTERN "" UWORD ident 1 100 0 65535 ECU_ADDRESS 0x8200D4 /end MEASUREMENT
/begin MEASUREMENT l_t01_u16_6.XCP_Type_Tests "" UWORD ident 1 100 0 65535 ECU_ADDRESS 0x7FBC3C /end MEASUREMENT
/begin MEASUREMENT l_t01_u16_7.Type_Tests_EXTERN "" UWORD ident 1 100 0 65535 ECU_ADDRESS 0x8200D6 /end MEASUREMENT
/begin MEASUREMENT l_t01_u16_7.XCP_Type_Tests "" UWORD ident 1 100 0 65535 ECU_ADDRESS 0x7FBC3E /end MEASUREMENT
/begin MEASUREMENT l_t01_u32_0.Type_Tests_EXTERN "" ULONG ident 1 100 0 4294967295 ECU_ADDRESS 0x820098 /end MEASUREMENT
/begin MEASUREMENT l_t01_u32_0.XCP_Type_Tests "" ULONG ident 1 100 0 4294967295 ECU_ADDRESS 0x7FBBE0 /end MEASUREMENT
/begin MEASUREMENT l_t01_u32_1.Type_Tests_EXTERN "" ULONG ident 1 100 0 4294967295 ECU_ADDRESS 0x82009C /end MEASUREMENT
/begin MEASUREMENT l_t01_u32_1.XCP_Type_Tests "" ULONG ident 1 100 0 4294967295 ECU_ADDRESS 0x7FBBE4 /end MEASUREMENT
/begin MEASUREMENT l_t01_u32_2.Type_Tests_EXTERN "" ULONG ident 1 100 0 4294967295 ECU_ADDRESS 0x8200A0 /end MEASUREMENT
/begin MEASUREMENT l_t01_u32_2.XCP_Type_Tests "" ULONG ident 1 100 0 4294967295 ECU_ADDRESS 0x7FBBE8 /end MEASUREMENT
/begin MEASUREMENT l_t01_u32_3.Type_Tests_EXTERN "" ULONG ident 1 100 0 4294967295 ECU_ADDRESS 0x8200A4 /end MEASUREMENT
/begin MEASUREMENT l_t01_u32_3.XCP_Type_Tests "" ULONG ident 1 100 0 4294967295 ECU_ADDRESS 0x7FBBEC /end MEASUREMENT
/begin MEASUREMENT l_t01_u32_4.Type_Tests_EXTERN "" ULONG ident 1 100 0 4294967295 ECU_ADDRESS 0x8200A8 /end MEASUREMENT
/begin MEASUREMENT l_t01_u32_4.XCP_Type_Tests "" ULONG ident 1 100 0 4294967295 ECU_ADDRESS 0x7FBBF0 /end MEASUREMENT
/begin MEASUREMENT l_t01_u32_5.Type_Tests_EXTERN "" ULONG ident 1 100 0 4294967295 ECU_ADDRESS 0x8200AC /end MEASUREMENT
/begin MEASUREMENT l_t01_u32_5.XCP_Type_Tests "" ULONG ident 1 100 0 4294967295 ECU_ADDRESS 0x7FBBF4 /end MEASUREMENT
/begin MEASUREMENT l_t01_u32_6.Type_Tests_EXTERN "" ULONG ident 1 100 0 4294967295 ECU_ADDRESS 0x8200B0 /end MEASUREMENT
/begin MEASUREMENT l_t01_u32_6.XCP_Type_Tests "" ULONG ident 1 100 0 4294967295 ECU_ADDRESS 0x7FBBF8 /end MEASUREMENT
/begin MEASUREMENT l_t01_u32_7.Type_Tests_EXTERN "" ULONG ident 1 100 0 4294967295 ECU_ADDRESS 0x8200B4 /end MEASUREMENT
/begin MEASUREMENT l_t01_u32_7.XCP_Type_Tests "" ULONG ident 1 100 0 4294967295 ECU_ADDRESS 0x7FBBFC /end MEASUREMENT
/begin MEASUREMENT l_t01_u8_0.Type_Tests_EXTERN "" UBYTE ident 1 100 0 255 ECU_ADDRESS 0x8200E0 /end MEASUREMENT
/begin MEASUREMENT l_t01_u8_0.XCP_Type_Tests "" UBYTE ident 1 100 0 255 ECU_ADDRESS 0x7FBC48 /end MEASUREMENT
/begin MEASUREMENT l_t01_u8_1.Type_Tests_EXTERN "" UBYTE ident 1 100 0 255 ECU_ADDRESS 0x8200E1 /end MEASUREMENT
/begin MEASUREMENT l_t01_u8_1.XCP_Type_Tests "" UBYTE ident 1 100 0 255 ECU_ADDRESS 0x7FBC49 /end MEASUREMENT
/begin MEASUREMENT l_t01_u8_2.Type_Tests_EXTERN "" UBYTE ident 1 100 0 255 ECU_ADDRESS 0x8200E2 /end MEASUREMENT
/begin MEASUREMENT l_t01_u8_2.XCP_Type_Tests "" UBYTE ident 1 100 0 255 ECU_ADDRESS 0x7FBC4A /end MEASUREMENT
/begin MEASUREMENT l_t01_u8_3.Type_Tests_EXTERN "" UBYTE ident 1 100 0 255 ECU_ADDRESS 0x8200E3 /end MEASUREMENT
/begin MEASUREMENT l_t01_u8_3.XCP_Type_Tests "" UBYTE ident 1 100 0 255 ECU_ADDRESS 0x7FBC4B /end MEASUREMENT
/begin MEASUREMENT l_t01_u8_4.Type_Tests_EXTERN "" UBYTE ident 1 100 0 255 ECU_ADDRESS 0x8200E4 /end MEASUREMENT
/begin MEASUREMENT l_t01_u8_4.XCP_Type_Tests "" UBYTE ident 1 100 0 255 ECU_ADDRESS 0x7FBC4C /end MEASUREMENT
/begin MEASUREMENT l_t01_u8_5.Type_Tests_EXTERN "" UBYTE ident 1 100 0 255 ECU_ADDRESS 0x8200E5 /end MEASUREMENT
/begin MEASUREMENT l_t01_u8_5.XCP_Type_Tests "" UBYTE ident 1 100 0 255 ECU_ADDRESS 0x7FBC4D /end MEASUREMENT
/begin MEASUREMENT l_t01_u8_6.Type_Tests_EXTERN "" UBYTE ident 1 100 0 255 ECU_ADDRESS 0x8200E6 /end MEASUREMENT
/begin MEASUREMENT l_t01_u8_6.XCP_Type_Tests "" UBYTE ident 1 100 0 255 ECU_ADDRESS 0x7FBC4E /end MEASUREMENT
/begin MEASUREMENT l_t01_u8_7.Type_Tests_EXTERN "" UBYTE ident 1 100 0 255 ECU_ADDRESS 0x8200E7 /end MEASUREMENT
/begin MEASUREMENT l_t01_u8_7.XCP_Type_Tests "" UBYTE ident 1 100 0 255 ECU_ADDRESS 0x7FBC4F /end MEASUREMENT
/begin MEASUREMENT l_t01_u8_bool_0.XCP_Type_Tests "" UBYTE ident 1 100 0 1 ECU_ADDRESS 0x7FBC50 /end MEASUREMENT
/begin MEASUREMENT l_t01_u8_bool_1.XCP_Type_Tests "" UBYTE ident 1 100 0 1 ECU_ADDRESS 0x7FBC51 /end MEASUREMENT
/begin MEASUREMENT l_t01_u8_bool_2.XCP_Type_Tests "" UBYTE ident 1 100 0 1 ECU_ADDRESS 0x7FBC52 /end MEASUREMENT
/begin MEASUREMENT l_t01_u8_bool_3.XCP_Type_Tests "" UBYTE ident 1 100 0 1 ECU_ADDRESS 0x7FBC53 /end MEASUREMENT
/begin MEASUREMENT l_t01_u8_bool_4.XCP_Type_Tests "" UBYTE ident 1 100 0 1 ECU_ADDRESS 0x7FBC54 /end MEASUREMENT
/begin MEASUREMENT l_t01_u8_bool_5.XCP_Type_Tests "" UBYTE ident 1 100 0 1 ECU_ADDRESS 0x7FBC55 /end MEASUREMENT
/begin MEASUREMENT l_t01_u8_bool_6.XCP_Type_Tests "" UBYTE ident 1 100 0 1 ECU_ADDRESS 0x7FBC56 /end MEASUREMENT
/begin MEASUREMENT l_t01_u8_bool_7.XCP_Type_Tests "" UBYTE ident 1 100 0 1 ECU_ADDRESS 0x7FBC57 /end MEASUREMENT
/begin MEASUREMENT l_t02_bool_0.Type_Tests_EXTERN "" UBYTE ident 1 100 0 1 BIT_MASK 0x80 ECU_ADDRESS 0x8200E9 /end MEASUREMENT
/begin MEASUREMENT l_t02_bool_1.Type_Tests_EXTERN "" UBYTE ident 1 100 0 1 BIT_MASK 0x40 ECU_ADDRESS 0x8200E9 /end MEASUREMENT
/begin MEASUREMENT l_t02_bool_2.Type_Tests_EXTERN "" UBYTE ident 1 100 0 1 BIT_MASK 0x20 ECU_ADDRESS 0x8200E9 /end MEASUREMENT
/begin MEASUREMENT l_t02_bool_3.Type_Tests_EXTERN "" UBYTE ident 1 100 0 1 BIT_MASK 0x10 ECU_ADDRESS 0x8200E9 /end MEASUREMENT
/begin MEASUREMENT l_t02_bool_4.Type_Tests_EXTERN "" UBYTE ident 1 100 0 1 BIT_MASK 0x8 ECU_ADDRESS 0x8200E9 /end MEASUREMENT
/begin MEASUREMENT l_t02_bool_5.Type_Tests_EXTERN "" UBYTE ident 1 100 0 1 BIT_MASK 0x4 ECU_ADDRESS 0x8200E9 /end MEASUREMENT
/begin MEASUREMENT l_t02_bool_6.Type_Tests_EXTERN "" UBYTE ident 1 100 0 1 BIT_MASK 0x2 ECU_ADDRESS 0x8200E9 /end MEASUREMENT
/begin MEASUREMENT l_t02_bool_7.Type_Tests_EXTERN "" UBYTE ident 1 100 0 1 BIT_MASK 0x1 ECU_ADDRESS 0x8200E9 /end MEASUREMENT
/begin MEASUREMENT l_t02_u32_bool_0.XCP_Type_Tests "" ULONG ident 1 100 0 1 ECU_ADDRESS 0x7FBC00 /end MEASUREMENT
/begin MEASUREMENT l_t02_u32_bool_1.XCP_Type_Tests "" ULONG ident 1 100 0 1 ECU_ADDRESS 0x7FBC04 /end MEASUREMENT
/begin MEASUREMENT l_t02_u32_bool_2.XCP_Type_Tests "" ULONG ident 1 100 0 1 ECU_ADDRESS 0x7FBC08 /end MEASUREMENT
/begin MEASUREMENT l_t02_u32_bool_3.XCP_Type_Tests "" ULONG ident 1 100 0 1 ECU_ADDRESS 0x7FBC0C /end MEASUREMENT
/begin MEASUREMENT l_t02_u32_bool_4.XCP_Type_Tests "" ULONG ident 1 100 0 1 ECU_ADDRESS 0x7FBC10 /end MEASUREMENT
/begin MEASUREMENT l_t02_u32_bool_5.XCP_Type_Tests "" ULONG ident 1 100 0 1 ECU_ADDRESS 0x7FBC14 /end MEASUREMENT
/begin MEASUREMENT l_t02_u32_bool_6.XCP_Type_Tests "" ULONG ident 1 100 0 1 ECU_ADDRESS 0x7FBC18 /end MEASUREMENT
/begin MEASUREMENT l_t02_u32_bool_7.XCP_Type_Tests "" ULONG ident 1 100 0 1 ECU_ADDRESS 0x7FBC1C /end MEASUREMENT
/begin MEASUREMENT LocalTickBuffer_100ms.RuntimeTaskFrame "" UWORD ident 1 100 0.0 655.35 ECU_ADDRESS 0x7FB89C /end MEASUREMENT
/begin MEASUREMENT LocalTickBuffer_10ms.RuntimeTaskFrame "" UWORD ident 1 100 0.0 655.35 ECU_ADDRESS 0x7FB89E /end MEASUREMENT
/begin MEASUREMENT LocalTickBuffer_50ms.RuntimeTaskFrame "" UWORD ident 1 100 0.0 655.35 ECU_ADDRESS 0x7FB8A0 /end MEASUREMENT
/begin MEASUREMENT LocalTickBuffer_Bkgnd.RuntimeTaskFrame "" UWORD ident 1 100 0.0 655.35 ECU_ADDRESS 0x7FB8A2 /end MEASUREMENT
/begin MEASUREMENT log_uint8_0_Xcp_B04.Model_XcpByp_B04 "" UBYTE ident 1 100 0 1 BIT_MASK 0x1 ECU_ADDRESS 0x7FB5AD /end MEASUREMENT
/begin MEASUREMENT log_uint8_1_Xcp_B04.Model_XcpByp_B04 "" UBYTE ident 1 100 0 1 BIT_MASK 0x1 ECU_ADDRESS 0x7FB5AE /end MEASUREMENT
/begin MEASUREMENT maxRunTime.R01_Mon.Restart_Raster_16T "" ULONG TickType2ms 1 100 0.0 1227133.512857143 ECU_ADDRESS 0x7FB7E0 /end MEASUREMENT
/begin MEASUREMENT maxRunTime.R02_Mon.Restart_Raster_16T "" ULONG TickType2ms 1 100 0.0 1227133.512857143 ECU_ADDRESS 0x7FB7F8 /end MEASUREMENT
/begin MEASUREMENT maxRunTime.R03_Mon.Restart_Raster_16T "" ULONG TickType2ms 1 100 0.0 1227133.512857143 ECU_ADDRESS 0x7FB810 /end MEASUREMENT
/begin MEASUREMENT maxRunTime.R04_Sync_Mon.Restart_Raster_16T "" ULONG TickType2ms 1 100 0.0 1227133.512857143 ECU_ADDRESS 0x7FB830 /end MEASUREMENT
/begin MEASUREMENT mem_alarm_cycle.R01.Restart_Raster_16T "" ULONG TickType2ms 1 100 0.0 46875.0 ECU_ADDRESS 0x7FB7D4 /end MEASUREMENT
/begin MEASUREMENT mem_alarm_cycle.R02.Restart_Raster_16T "" ULONG TickType2ms 1 100 0.0 46875.0 ECU_ADDRESS 0x7FB7F0 /end MEASUREMENT
/begin MEASUREMENT mem_alarm_cycle.R03.Restart_Raster_16T "" ULONG TickType2ms 1 100 0.0 46875.0 ECU_ADDRESS 0x7FB808 /end MEASUREMENT
/begin MEASUREMENT mem_alarm_cycle.R04_Sync.Restart_Raster_16T "" ULONG TickType2ms 1 100 0.0 46875.0 ECU_ADDRESS 0x7FB824 /end MEASUREMENT
/begin MEASUREMENT mem_alarm_cycle.R05.Restart_Raster_16T "" ULONG TickType2ms 1 100 0.0 46875.0 ECU_ADDRESS 0x7FB840 /end MEASUREMENT
/begin MEASUREMENT mem_alarm_cycle.R06.Restart_Raster_16T "" ULONG TickType2ms 1 100 0.0 46875.0 ECU_ADDRESS 0x7FB848 /end MEASUREMENT
/begin MEASUREMENT mem_alarm_cycle.R07.Restart_Raster_16T "" ULONG TickType2ms 1 100 0.0 46875.0 ECU_ADDRESS 0x7FB850 /end MEASUREMENT
/begin MEASUREMENT mem_alarm_cycle.R08.Restart_Raster_16T "" ULONG TickType2ms 1 100 0.0 46875.0 ECU_ADDRESS 0x7FB858 /end MEASUREMENT
/begin MEASUREMENT mem_alarm_cycle.R09.Restart_Raster_16T "" ULONG TickType2ms 1 100 0.0 46875.0 ECU_ADDRESS 0x7FB860 /end MEASUREMENT
/begin MEASUREMENT mem_alarm_cycle.R10.Restart_Raster_16T "" ULONG TickType2ms 1 100 0.0 46875.0 ECU_ADDRESS 0x7FB868 /end MEASUREMENT
/begin MEASUREMENT mem_alarm_cycle.R11.Restart_Raster_16T "" ULONG TickType2ms 1 100 0.0 46875.0 ECU_ADDRESS 0x7FB870 /end MEASUREMENT
/begin MEASUREMENT mem_alarm_cycle.R12.Restart_Raster_16T "" ULONG TickType2ms 1 100 0.0 46875.0 ECU_ADDRESS 0x7FB878 /end MEASUREMENT
/begin MEASUREMENT mem_alarm_cycle.R13.Restart_Raster_16T "" ULONG TickType2ms 1 100 0.0 46875.0 ECU_ADDRESS 0x7FB880 /end MEASUREMENT
/begin MEASUREMENT mem_alarm_cycle.R14.Restart_Raster_16T "" ULONG TickType2ms 1 100 0.0 46875.0 ECU_ADDRESS 0x7FB888 /end MEASUREMENT
/begin MEASUREMENT mem_alarm_cycle.R15.Restart_Raster_16T "" ULONG TickType2ms 1 100 0.0 46875.0 ECU_ADDRESS 0x7FB890 /end MEASUREMENT
/begin MEASUREMENT mem_alarm_cycle.R16.Restart_Raster_16T "" ULONG TickType2ms 1 100 0.0 46875.0 ECU_ADDRESS 0x7FB898 /end MEASUREMENT
/begin MEASUREMENT mg_AcceptAllKeys_u8.XCP_SHELL_VAR.XCP_SHELL "" UBYTE ident 1 100 0 255 ECU_ADDRESS 0x7FBB36 /end MEASUREMENT
/begin MEASUREMENT mg_power_u8.XCP_SHELL_VAR.XCP_SHELL "" UBYTE ident 1 100 0 255 ECU_ADDRESS 0x7FBB5F /end MEASUREMENT
/begin MEASUREMENT mg_SwitchConfig_ECU_u8.XCP_SHELL_VAR.XCP_SHELL "" UBYTE enum_ConfigECU_e 1 100 0 1 ECU_ADDRESS 0x7FBB37 /end MEASUREMENT
/begin MEASUREMENT mg_TriggerOverload_u8.XCP_SHELL_VAR.XCP_SHELL "" UBYTE ident 1 100 0 255 ECU_ADDRESS 0x7FBB38 /end MEASUREMENT
/begin MEASUREMENT mg_XcpAutoResetAfterStoreDaq_u8.XCP_SHELL_VAR.XCP_SHELL "" UBYTE ident 1 100 0 255 ECU_ADDRESS 0x7FBB39 /end MEASUREMENT
/begin MEASUREMENT mg_XcpBlockDownloadMaxBS_u8.XCP_SHELL_VAR.XCP_SHELL "" UBYTE ident 1 100 0 255 ECU_ADDRESS 0x7FBB3A /end MEASUREMENT
/begin MEASUREMENT mg_XcpBlockDownloadMinST_u8.XCP_SHELL_VAR.XCP_SHELL "" UBYTE ident 1 100 0 255 ECU_ADDRESS 0x7FBB3B /end MEASUREMENT
/begin MEASUREMENT mg_XcpBlockFlashMaxBS_u8.XCP_SHELL_VAR.XCP_SHELL "" UBYTE ident 1 100 0 255 ECU_ADDRESS 0x7FBB3C /end MEASUREMENT
/begin MEASUREMENT mg_XcpBlockFlashMinST_u8.XCP_SHELL_VAR.XCP_SHELL "" UBYTE ident 1 100 0 255 ECU_ADDRESS 0x7FBB3D /end MEASUREMENT
/begin MEASUREMENT mg_XcpCommModeBasic_u8.XCP_SHELL_VAR.XCP_SHELL "" UBYTE ident 1 100 0 255 ECU_ADDRESS 0x7FBB3E /end MEASUREMENT
/begin MEASUREMENT mg_XcpCommModeOptional_u8.XCP_SHELL_VAR.XCP_SHELL "" UBYTE ident 1 100 0 255 ECU_ADDRESS 0x7FBB3F /end MEASUREMENT
/begin MEASUREMENT mg_XcpCommModePgm_u8.XCP_SHELL_VAR.XCP_SHELL "" UBYTE ident 1 100 0 255 ECU_ADDRESS 0x7FBB40 /end MEASUREMENT
/begin MEASUREMENT mg_XcpConnectResetECU_u8.XCP_SHELL_VAR.XCP_SHELL "" UBYTE ident 1 100 0 255 ECU_ADDRESS 0x7FBB41 /end MEASUREMENT
/begin MEASUREMENT mg_XcpCtoMax_u8.XCP_SHELL_VAR.XCP_SHELL "" UBYTE ident 1 100 0 255 ECU_ADDRESS 0x7FBB43 /end MEASUREMENT
/begin MEASUREMENT mg_XcpCtoMaxPgm_u8.XCP_SHELL_VAR.XCP_SHELL "" UBYTE ident 1 100 0 255 ECU_ADDRESS 0x7FBB42 /end MEASUREMENT
/begin MEASUREMENT mg_XcpDaqKeyByte_u8.XCP_SHELL_VAR.XCP_SHELL "" UBYTE ident 1 100 0 255 ECU_ADDRESS 0x7FBB44 /end MEASUREMENT
/begin MEASUREMENT mg_XcpDaqListProperties_u8.XCP_SHELL_VAR.XCP_SHELL "" UBYTE ident 1 100 0 255 ECU_ADDRESS 0x7FBB45 /end MEASUREMENT
/begin MEASUREMENT mg_XcpDaqProperties_u8.XCP_SHELL_VAR.XCP_SHELL "" UBYTE ident 1 100 0 255 ECU_ADDRESS 0x7FBB46 /end MEASUREMENT
/begin MEASUREMENT mg_XcpDisableDaqTransmition_b.XCP_SHELL_VAR.XCP_SHELL "" UBYTE ident 1 100 0 1 BIT_MASK 0x1 ECU_ADDRESS 0x7FBB47 /end MEASUREMENT
/begin MEASUREMENT mg_XcpDtoMax_u16.XCP_SHELL_VAR.XCP_SHELL "" UWORD ident 1 100 0 65535 ECU_ADDRESS 0x7FBB30 /end MEASUREMENT
/begin MEASUREMENT mg_XcpEtasTool_u8.XCP_SHELL_VAR.XCP_SHELL "" UBYTE enum_XCP_ETASTool_e 1 100 0 1 ECU_ADDRESS 0x7FBB48 /end MEASUREMENT
/begin MEASUREMENT mg_XcpGranularityOdtEntrySizeDaq_u8.XCP_SHELL_VAR.XCP_SHELL "" UBYTE ident 1 100 0 255 ECU_ADDRESS 0x7FBB49 /end MEASUREMENT
/begin MEASUREMENT mg_XcpGranularityOdtEntrySizeStim_u8.XCP_SHELL_VAR.XCP_SHELL "" UBYTE ident 1 100 0 255 ECU_ADDRESS 0x7FBB4A /end MEASUREMENT
/begin MEASUREMENT mg_XcpMaxDaq_u16.XCP_SHELL_VAR.XCP_SHELL "" UBYTE ident 1 100 0 255 ECU_ADDRESS 0x7FBB4B /end MEASUREMENT
/begin MEASUREMENT mg_XcpMaxEventNo_u16.XCP_SHELL_VAR.XCP_SHELL "" UBYTE ident 1 100 0 255 ECU_ADDRESS 0x7FBB4C /end MEASUREMENT
/begin MEASUREMENT mg_XcpMaxOdtEntrySizeDaq_u8.XCP_SHELL_VAR.XCP_SHELL "" UBYTE ident 1 100 0 255 ECU_ADDRESS 0x7FBB4D /end MEASUREMENT
/begin MEASUREMENT mg_XcpMaxOdtEntrySizeStim_u8.XCP_SHELL_VAR.XCP_SHELL "" UBYTE ident 1 100 0 255 ECU_ADDRESS 0x7FBB4E /end MEASUREMENT
/begin MEASUREMENT mg_XcpMinDaq_u8.XCP_SHELL_VAR.XCP_SHELL "" UBYTE ident 1 100 0 255 ECU_ADDRESS 0x7FBB4F /end MEASUREMENT
/begin MEASUREMENT mg_XcpPagProperties_u8.XCP_SHELL_VAR.XCP_SHELL "" UBYTE ident 1 100 0 255 ECU_ADDRESS 0x7FBB50 /end MEASUREMENT
/begin MEASUREMENT mg_XcpResource_u8.XCP_SHELL_VAR.XCP_SHELL "" UBYTE ident 1 100 0 255 ECU_ADDRESS 0x7FBB52 /end MEASUREMENT
/begin MEASUREMENT mg_XcpResourceProtect_u8.XCP_SHELL_VAR.XCP_SHELL "" UBYTE ident 1 100 0 255 ECU_ADDRESS 0x7FBB51 /end MEASUREMENT
/begin MEASUREMENT mg_XcpSwitchBackground_u8.XCP_SHELL_VAR.XCP_SHELL "" UBYTE ident 1 100 0 255 ECU_ADDRESS 0x7FBB53 /end MEASUREMENT
/begin MEASUREMENT mg_XcpTestCase_u8_in.XCP_SHELL_VAR.XCP_SHELL "" UBYTE ident 1 100 0 255 ECU_ADDRESS 0x7FBB54 /end MEASUREMENT
/begin MEASUREMENT mg_XcpTestCase_u8_out.XCP_SHELL_VAR.XCP_SHELL "" UBYTE ident 1 100 0 255 ECU_ADDRESS 0x7FBB55 /end MEASUREMENT
/begin MEASUREMENT mg_XcpTestOdtOpt_u8.XCP_SHELL_VAR.XCP_SHELL "" UBYTE ident 1 100 0 255 ECU_ADDRESS 0x7FBB58 /end MEASUREMENT
/begin MEASUREMENT mg_XcpTestOdtOptResult_u8.XCP_SHELL_VAR.XCP_SHELL "" UBYTE ident 1 100 0 255 ECU_ADDRESS 0x7FBB56 /end MEASUREMENT
/begin MEASUREMENT mg_XcpTestOdtOptSendResult_u8.XCP_SHELL_VAR.XCP_SHELL "" UBYTE ident 1 100 0 255 ECU_ADDRESS 0x7FBB57 /end MEASUREMENT
/begin MEASUREMENT mg_XcpTickDurationEcu_f32.XCP_SHELL_VAR.XCP_SHELL "" FLOAT32_IEEE ident 1 100 1.e-009 1.e+037 ECU_ADDRESS 0x7FBB2C /end MEASUREMENT
/begin MEASUREMENT mg_XcpTimestampMode_u8.XCP_SHELL_VAR.XCP_SHELL "" UBYTE ident 1 100 0 255 ECU_ADDRESS 0x7FBB59 /end MEASUREMENT
/begin MEASUREMENT mg_XcpTimestampProp_u8.XCP_SHELL_VAR.XCP_SHELL "" UBYTE enum_XCP_TimestampProp_e 1 100 0 3 ECU_ADDRESS 0x7FBB5A /end MEASUREMENT
/begin MEASUREMENT mg_XcpTimestampTicks_u16.XCP_SHELL_VAR.XCP_SHELL "" UWORD ident 1 100 0 65535 ECU_ADDRESS 0x7FBB32 /end MEASUREMENT
/begin MEASUREMENT mg_XcpTrigDaqFailure_u8.XCP_SHELL_VAR.XCP_SHELL "" UBYTE ident 1 100 0 255 ECU_ADDRESS 0x7FBB5B /end MEASUREMENT
/begin MEASUREMENT mg_XcpTrigOdtFailure_u8.XCP_SHELL_VAR.XCP_SHELL "" UBYTE ident 1 100 0 255 ECU_ADDRESS 0x7FBB5C /end MEASUREMENT
/begin MEASUREMENT mg_XcpTrigOverload_u8.XCP_SHELL_VAR.XCP_SHELL "" UBYTE ident 1 100 0 255 ECU_ADDRESS 0x7FBB5D /end MEASUREMENT
/begin MEASUREMENT mg_XcpTrigResume_u8.XCP_SHELL_VAR.XCP_SHELL "" UBYTE ident 1 100 0 255 ECU_ADDRESS 0x7FBB5E /end MEASUREMENT
/begin MEASUREMENT minRunTime.R01_Mon.Restart_Raster_16T "" ULONG TickType2ms 1 100 0.0 1227133.512857143 ECU_ADDRESS 0x7FB7E4 /end MEASUREMENT
/begin MEASUREMENT minRunTime.R02_Mon.Restart_Raster_16T "" ULONG TickType2ms 1 100 0.0 1227133.512857143 ECU_ADDRESS 0x7FB7FC /end MEASUREMENT
/begin MEASUREMENT minRunTime.R03_Mon.Restart_Raster_16T "" ULONG TickType2ms 1 100 0.0 1227133.512857143 ECU_ADDRESS 0x7FB814 /end MEASUREMENT
/begin MEASUREMENT minRunTime.R04_Sync_Mon.Restart_Raster_16T "" ULONG TickType2ms 1 100 0.0 1227133.512857143 ECU_ADDRESS 0x7FB834 /end MEASUREMENT
/begin MEASUREMENT netRunTime.R01_Mon.Restart_Raster_16T "" ULONG TickType2ms 1 100 0.0 1227133.512857143 ECU_ADDRESS 0x7FB7E8 /end MEASUREMENT
/begin MEASUREMENT netRunTime.R02_Mon.Restart_Raster_16T "" ULONG TickType2ms 1 100 0.0 1227133.512857143 ECU_ADDRESS 0x7FB800 /end MEASUREMENT
/begin MEASUREMENT netRunTime.R03_Mon.Restart_Raster_16T "" ULONG TickType2ms 1 100 0.0 1227133.512857143 ECU_ADDRESS 0x7FB818 /end MEASUREMENT
/begin MEASUREMENT netRunTime.R04_Sync_Mon.Restart_Raster_16T "" ULONG TickType2ms 1 100 0.0 1227133.512857143 ECU_ADDRESS 0x7FB838 /end MEASUREMENT
/begin MEASUREMENT not_done_R01.raster_running "" UBYTE ident 1 100 0.0 255.0 ECU_ADDRESS 0x7FB783 /end MEASUREMENT
/begin MEASUREMENT not_done_R02.raster_running "" UBYTE ident 1 100 0.0 255.0 ECU_ADDRESS 0x7FB784 /end MEASUREMENT
/begin MEASUREMENT not_done_R03.raster_running "" UBYTE ident 1 100 0.0 255.0 ECU_ADDRESS 0x7FB785 /end MEASUREMENT
/begin MEASUREMENT not_done_R04.raster_running "" UBYTE ident 1 100 0.0 255.0 ECU_ADDRESS 0x7FB786 /end MEASUREMENT
/begin MEASUREMENT not_done_R05.raster_running "" UBYTE ident 1 100 0.0 255.0 ECU_ADDRESS 0x7FB787 /end MEASUREMENT
/begin MEASUREMENT not_done_R06.raster_running "" UBYTE ident 1 100 0.0 255.0 ECU_ADDRESS 0x7FB788 /end MEASUREMENT
/begin MEASUREMENT not_done_R07.raster_running "" UBYTE ident 1 100 0.0 255.0 ECU_ADDRESS 0x7FB789 /end MEASUREMENT
/begin MEASUREMENT not_done_R08.raster_running "" UBYTE ident 1 100 0.0 255.0 ECU_ADDRESS 0x7FB78A /end MEASUREMENT
/begin MEASUREMENT not_done_R09.raster_running "" UBYTE ident 1 100 0.0 255.0 ECU_ADDRESS 0x7FB78B /end MEASUREMENT
/begin MEASUREMENT not_done_R10.raster_running "" UBYTE ident 1 100 0.0 255.0 ECU_ADDRESS 0x7FB78C /end MEASUREMENT
/begin MEASUREMENT not_done_R11.raster_running "" UBYTE ident 1 100 0.0 255.0 ECU_ADDRESS 0x7FB78D /end MEASUREMENT
/begin MEASUREMENT not_done_R12.raster_running "" UBYTE ident 1 100 0.0 255.0 ECU_ADDRESS 0x7FB78E /end MEASUREMENT
/begin MEASUREMENT not_done_R13.raster_running "" UBYTE ident 1 100 0.0 255.0 ECU_ADDRESS 0x7FB78F /end MEASUREMENT
/begin MEASUREMENT not_done_R14.raster_running "" UBYTE ident 1 100 0.0 255.0 ECU_ADDRESS 0x7FB790 /end MEASUREMENT
/begin MEASUREMENT not_done_R15.raster_running "" UBYTE ident 1 100 0.0 255.0 ECU_ADDRESS 0x7FB791 /end MEASUREMENT
/begin MEASUREMENT not_done_R16.raster_running "" UBYTE ident 1 100 0.0 255.0 ECU_ADDRESS 0x7FB792 /end MEASUREMENT
/begin MEASUREMENT Replay_S16_1.Replay_Data "" SWORD ident 1 100 -32768 32767 ECU_ADDRESS 0x7FB7A4 /end MEASUREMENT
/begin MEASUREMENT Replay_S16_2.Replay_Data "" SWORD ident 1 100 -32768 32767 ECU_ADDRESS 0x7FB7A6 /end MEASUREMENT
/begin MEASUREMENT Replay_S16_3.Replay_Data "" SWORD ident 1 100 -32768 32767 ECU_ADDRESS 0x7FB7A8 /end MEASUREMENT
/begin MEASUREMENT Replay_S32_1.Replay_Data "" SLONG ident 1 100 -2147483648 2147483647 ECU_ADDRESS 0x7FB794 /end MEASUREMENT
/begin MEASUREMENT Replay_S32_2.Replay_Data "" SLONG ident 1 100 -2147483648 2147483647 ECU_ADDRESS 0x7FB798 /end MEASUREMENT
/begin MEASUREMENT Replay_S8_1.Replay_Data "" SBYTE ident 1 100 -128 127 ECU_ADDRESS 0x7FB7B0 /end MEASUREMENT
/begin MEASUREMENT Replay_S8_2.Replay_Data "" SBYTE ident 1 100 -128 127 ECU_ADDRESS 0x7FB7B1 /end MEASUREMENT
/begin MEASUREMENT Replay_S8_3.Replay_Data "" SBYTE ident 1 100 -128 127 ECU_ADDRESS 0x7FB7B2 /end MEASUREMENT
/begin MEASUREMENT Replay_S8_4.Replay_Data "" SBYTE ident 1 100 -128 127 ECU_ADDRESS 0x7FB7B3 /end MEASUREMENT
/begin MEASUREMENT Replay_U16_1.Replay_Data "" UWORD ident 1 100 0 65535 ECU_ADDRESS 0x7FB7AA /end MEASUREMENT
/begin MEASUREMENT Replay_U16_2.Replay_Data "" UWORD ident 1 100 0 65535 ECU_ADDRESS 0x7FB7AC /end MEASUREMENT
/begin MEASUREMENT Replay_U16_3.Replay_Data "" UWORD ident 1 100 0 65535 ECU_ADDRESS 0x7FB7AE /end MEASUREMENT
/begin MEASUREMENT Replay_U32_1.Replay_Data "" ULONG ident 1 100 0 4294967295 ECU_ADDRESS 0x7FB79C /end MEASUREMENT
/begin MEASUREMENT Replay_U32_2.Replay_Data "" ULONG ident 1 100 0 4294967295 ECU_ADDRESS 0x7FB7A0 /end MEASUREMENT
/begin MEASUREMENT Replay_U8_1.Replay_Data "" UBYTE ident 1 100 0 255 ECU_ADDRESS 0x7FB7B4 /end MEASUREMENT
/begin MEASUREMENT Replay_U8_2.Replay_Data "" UBYTE ident 1 100 0 255 ECU_ADDRESS 0x7FB7B5 /end MEASUREMENT
/begin MEASUREMENT Replay_U8_3.Replay_Data "" UBYTE ident 1 100 0 255 ECU_ADDRESS 0x7FB7B6 /end MEASUREMENT
/begin MEASUREMENT Replay_U8_4.Replay_Data "" UBYTE ident 1 100 0 255 ECU_ADDRESS 0x7FB7B7 /end MEASUREMENT
/begin MEASUREMENT RequestOutputDisable_100ms.RuntimeTaskFrame "" SBYTE ident 1 100 0 1 BIT_MASK 0x1 ECU_ADDRESS 0x7FB8A6 /end MEASUREMENT
/begin MEASUREMENT RequestOutputDisable_10ms.RuntimeTaskFrame "" SBYTE ident 1 100 0 1 BIT_MASK 0x1 ECU_ADDRESS 0x7FB8A7 /end MEASUREMENT
/begin MEASUREMENT RequestOutputDisable_50ms.RuntimeTaskFrame "" SBYTE ident 1 100 0 1 BIT_MASK 0x1 ECU_ADDRESS 0x7FB8A8 /end MEASUREMENT
/begin MEASUREMENT RequestOutputDisable_Bkgnd.RuntimeTaskFrame "" SBYTE ident 1 100 0 1 BIT_MASK 0x1 ECU_ADDRESS 0x7FB8A9 /end MEASUREMENT
/begin MEASUREMENT Reset.Reset_Schalter "" UBYTE ident 1 100 0 1 BIT_MASK 0x1 ECU_ADDRESS 0x7FB7B8 DISPLAY_IDENTIFIER Reset.Reset_Schalter_DISP_ID /end MEASUREMENT
/begin MEASUREMENT sdisc_sint16_Xcp_B04.Model_XcpByp_B04 "" SWORD ident 1 100 -32768 32767 ECU_ADDRESS 0x7FB5A6 /end MEASUREMENT
/begin MEASUREMENT sdisc_sint8_Xcp_B04.Model_XcpByp_B04 "" SBYTE ident 1 100 -128 127 ECU_ADDRESS 0x7FB5AF /end MEASUREMENT
/begin MEASUREMENT SIKO_Counters.SIKO_Module "SIKO supervisory counter cells" UWORD FastestTaskTicks_to_ms 1 100 0.0 131070.0 ECU_ADDRESS 0x7FB930 MATRIX_DIM 64 1 1 /end MEASUREMENT
/begin MEASUREMENT SIKO_DisableWDRetrigger.SIKO_Module "This is a diagnostic/functional message indicating that the internal WD will no longer be retriggered" SBYTE ident 1 100 0 1 BIT_MASK 0x1 ECU_ADDRESS 0x7FB9DF /end MEASUREMENT
/begin MEASUREMENT SIKO_OutputDisableDelay.SIKO_Module "Counter/timer to delay SIKO_RequestOutputDisable for WDA plausi checking" UBYTE ident 1 100 0 255 ECU_ADDRESS 0x7F900D /end MEASUREMENT
/begin MEASUREMENT SIKO_RequestOutputDisable.SIKO_Module "Request from SIKO to dio-/twpm-output etc." SBYTE ident 1 100 0 1 BIT_MASK 0x1 ECU_ADDRESS 0x7FB9E1 /end MEASUREMENT
/begin MEASUREMENT SIKO_RequestOutputDisableDelayed.SIKO_Module "Request from SIKO to dio-/twpm-output etc." SBYTE ident 1 100 0 1 BIT_MASK 0x1 ECU_ADDRESS 0x7FB9E2 /end MEASUREMENT
/begin MEASUREMENT SIKO_WDAHigh_FailureDelay_u8.SIKO_Module "WDA failure recognition delay counter" UBYTE ident 1 100 0 255 ECU_ADDRESS 0x7F900E /end MEASUREMENT
/begin MEASUREMENT SIKO_WDALow_FailureDelay_u8.SIKO_Module "WDA failure recognition delay counter" UBYTE ident 1 100 0 255 ECU_ADDRESS 0x7F900F /end MEASUREMENT
/begin MEASUREMENT SIKODIAG_ActualStackError.SIKO_Module "Displays the stack status (U16) after calling CheckSoftwareStack(). 0xFFFF if call failed." UWORD ident__ 1 100 0 255 ECU_ADDRESS 0x7FB9D6 /end MEASUREMENT
/begin MEASUREMENT SIKODIAG_aktCounterproblem.SIKO_Module "This is a diagnostic only message indicating that an error was detected while supervising the SIKO_Counters[] array" SBYTE ident 1 100 0 1 BIT_MASK 0x1 ECU_ADDRESS 0x7FB9DE /end MEASUREMENT
/begin MEASUREMENT SIKODIAG_Counterproblem.SIKO_Module "This is a diagnostic only message indicating that an error was detected while supervising the SIKO_Counters[] array" SBYTE ident 1 100 0 1 BIT_MASK 0x1 ECU_ADDRESS 0x7FB9D8 /end MEASUREMENT
/begin MEASUREMENT SIKODIAG_PercentEStackUsed.SIKO_Module "Displays usage of ERCOSek Stack" UBYTE ident_name 1 100 0 255 ECU_ADDRESS 0x7FB9D9 /end MEASUREMENT
/begin MEASUREMENT SIKODIAG_PercentUStackUsed.SIKO_Module "Displays usage of user stack" UBYTE ident_name 1 100 0 127 ECU_ADDRESS 0x7FB9DA /end MEASUREMENT
/begin MEASUREMENT SIKODIAG_StackError.SIKO_Module "true if CheckSoftwareStack() detected an error. VISU only." SBYTE ident 1 100 0 1 BIT_MASK 0x1 ECU_ADDRESS 0x7FB9E0 /end MEASUREMENT
/begin MEASUREMENT SIKODIAG_WDA_Active.SIKO_Module "True signals that the WDA line is active (low)" SBYTE ident 1 100 0 1 BIT_MASK 0x1 ECU_ADDRESS 0x7FB9DD /end MEASUREMENT
/begin MEASUREMENT SIKODIAG_WDAHigh_Failure.SIKO_Module "True signals that there is a hardware problem related to the WDA line" SBYTE ident 1 100 0 1 BIT_MASK 0x1 ECU_ADDRESS 0x7FB9DB /end MEASUREMENT
/begin MEASUREMENT SIKODIAG_WDALow_Failure.SIKO_Module "True signals that there is a hardware problem related to the WDA line" SBYTE ident 1 100 0 1 BIT_MASK 0x1 ECU_ADDRESS 0x7FB9DC /end MEASUREMENT
/begin MEASUREMENT SIKOERROR_BkgndVarInconsistent.RuntimeTaskFrame "Signals that ticks_per_activation is inconsistens to the init value (in bkgnd)" SBYTE ident 1 100 0 1 BIT_MASK 0x1 ECU_ADDRESS 0x7FB8AA /end MEASUREMENT
/begin MEASUREMENT ticks_per_activation.RuntimeTaskFrame "" UWORD ident_s 1 100 0.0 655.35 ECU_ADDRESS 0x7FB8A4 /end MEASUREMENT
/begin MEASUREMENT udisc_uint16_Xcp_B04.Model_XcpByp_B04 "" UWORD ident 1 100 0 65535 ECU_ADDRESS 0x7FB5A8 /end MEASUREMENT
/begin MEASUREMENT udisc_uint8_Xcp_B04.Model_XcpByp_B04 "" UBYTE ident 1 100 0 255 ECU_ADDRESS 0x7FB5B0 /end MEASUREMENT
/begin MEASUREMENT TimeSignal_F64_MSB_FIRST "" FLOAT64_IEEE ident 1 100 -1.e+037 1.e+037 ECU_ADDRESS 0x823738 /end MEASUREMENT
/begin MEASUREMENT TimeSignal_F64_MSB_LAST "" FLOAT64_IEEE ident 1 100 -1.e+037 1.e+037 ECU_ADDRESS 0x823740 BYTE_ORDER MSB_LAST /end MEASUREMENT
/begin MEASUREMENT TimeSignal_F32_MSB_FIRST_sec "" FLOAT32_IEEE formula_1_1000000000 1 100 -1.e+037 1.e+037 ECU_ADDRESS 0x823748 /end MEASUREMENT
/begin MEASUREMENT TimeSignal_F32_MSB_LAST_ms "" FLOAT32_IEEE formula_1_1000000 1 100 -1.e+037 1.e+037 ECU_ADDRESS 0x82374C BYTE_ORDER MSB_LAST /end MEASUREMENT
/begin MEASUREMENT TimeSignal_U32_MSB_FIRST_ms "" ULONG formula_1_1000 1 100 -1.e+037 1.e+037 ECU_ADDRESS 0x823750 /end MEASUREMENT
/begin MEASUREMENT TimeSignal_U32_MSB_LAST_us "" ULONG ident 1 100 -1.e+037 1.e+037 ECU_ADDRESS 0x823754 BYTE_ORDER MSB_LAST /end MEASUREMENT
/begin MEASUREMENT TimeSignal_U32_MSB_FIRST_10s "" ULONG formula_1_1000000 1 100 -1.e+037 1.e+037 ECU_ADDRESS 0x823758 /end MEASUREMENT
/begin MEASUREMENT TimeSignal_U32_MSB_LAST_abs "" ULONG formula_1_1000000 1 100 -1.e+037 1.e+037 ECU_ADDRESS 0x82375C BYTE_ORDER MSB_LAST /end MEASUREMENT
/begin MEASUREMENT TimeSignal_U32_MSB_FIRST_TD1ms "" ULONG formula_1_1000 1 100 -1.e+037 1.e+037 ECU_ADDRESS 0x823760 /end MEASUREMENT
/begin MEASUREMENT TimeSignal_U32_MSB_FIRST_TD10s "" ULONG formula_10_1 1 100 -1.e+037 1.e+037 ECU_ADDRESS 0x823764 /end MEASUREMENT
/begin MEASUREMENT TimeSignal_U16_MSB_FIRST "" UWORD formula_1_1000 1 100 -1.e+037 1.e+037 ECU_ADDRESS 0x823768 /end MEASUREMENT
/begin MEASUREMENT TimeSignal_U16_MSB_LAST "" UWORD formula_1_1000 1 100 -1.e+037 1.e+037 ECU_ADDRESS 0x82376A BYTE_ORDER MSB_LAST /end MEASUREMENT
/begin MEASUREMENT TimeSignal_U8_MSB_FIRST "" UBYTE formula_1_100 1 100 -1.e+037 1.e+037 ECU_ADDRESS 0x82376C /end MEASUREMENT
/begin MEASUREMENT TimeSignal_U8_MSB_LAST "" UBYTE formula_1_100 1 100 -1.e+037 1.e+037 ECU_ADDRESS 0x82376D BYTE_ORDER MSB_LAST /end MEASUREMENT
/begin MEASUREMENT VERSION_X "" UBYTE ident 1 100 0 255 ECU_ADDRESS 0x7FB526 /end MEASUREMENT
/begin MEASUREMENT VERSION_Y "" UBYTE ident 1 100 0 255 ECU_ADDRESS 0x7FB527 /end MEASUREMENT
/begin MEASUREMENT VERSION_Z "" UBYTE ident 1 100 0 255 ECU_ADDRESS 0x7FB528 /end MEASUREMENT
/begin MEASUREMENT WD_WDDiag_actRespTime_u8.Watchdog_Module "" UBYTE ident 1 100 0 255 ECU_ADDRESS 0x7FBAAD /end MEASUREMENT
/begin MEASUREMENT WD_WDDiag_ByteCounter.Watchdog_Module "" UBYTE ident 1 100 0 255 ECU_ADDRESS 0x7FBAA7 /end MEASUREMENT
/begin MEASUREMENT WD_WDDiag_CallRes.Watchdog_Module "" UBYTE ident 1 100 0 255 ECU_ADDRESS 0x7FBAA8 /end MEASUREMENT
/begin MEASUREMENT WD_WDDiag_fCy315_u16.Watchdog_Module "" UWORD ident 1 100 0 65535 ECU_ADDRESS 0x7FBAA0 /end MEASUREMENT
/begin MEASUREMENT WD_WDDiag_RespError.Watchdog_Module "" SBYTE ident 1 100 0 1 BIT_MASK 0x1 ECU_ADDRESS 0x7FBAA9 /end MEASUREMENT
/begin MEASUREMENT WD_WDDiag_RespStat.Watchdog_Module "" UBYTE ident 1 100 0 255 ECU_ADDRESS 0x7FBAAA /end MEASUREMENT
/begin MEASUREMENT WD_WDDiag_tiCurRespTime.Watchdog_Module "" ULONG ident 1 100 0 4294967295 ECU_ADDRESS 0x7FBA94 /end MEASUREMENT
/begin MEASUREMENT WD_WDDiag_tiLastReq_u32.Watchdog_Module "" ULONG ident 1 100 0 4294967295 ECU_ADDRESS 0x7FBA98 /end MEASUREMENT
/begin MEASUREMENT WD_WDDiag_TimerCFG.Watchdog_Module "" UBYTE ident 1 100 0 255 ECU_ADDRESS 0x7FBAAB /end MEASUREMENT
/begin MEASUREMENT WD_WDDiag_WDA_CY315INT.Watchdog_Module "" SBYTE ident 1 100 0 1 BIT_MASK 0x1 ECU_ADDRESS 0x7FBAAC /end MEASUREMENT
/begin MEASUREMENT WDMod_CY315ErrorCounter.Watchdog_Module "" UBYTE ident 1 100 0 255 ECU_ADDRESS 0x7FBAA2 /end MEASUREMENT
/begin MEASUREMENT WDMod_ErrorFlagCounters_u16.Watchdog_Module "Counters for the individual error flags of the CY315" UWORD ident 1 100 0 65535 ECU_ADDRESS 0x7FBA00 MATRIX_DIM 3 1 1 /end MEASUREMENT
/begin MEASUREMENT WDMod_fCy315_u16.Watchdog_Module "Value of 'MCy315_f_cu16'" UWORD ident 1 100 0 65535 ECU_ADDRESS 0x7FBA9E /end MEASUREMENT
/begin MEASUREMENT WDMod_Request.Watchdog_Module "" UBYTE ident 1 100 0 255 ECU_ADDRESS 0x7FBAA3 /end MEASUREMENT
/begin MEASUREMENT WDMod_RespTimeTicks_u32.Watchdog_Module "" ULONG ident 1 100 0 4294967295 ECU_ADDRESS 0x7FBA88 /end MEASUREMENT
/begin MEASUREMENT WDMod_State.Watchdog_Module "" UWORD ident 1 100 0 65535 ECU_ADDRESS 0x7FBA9C /end MEASUREMENT
/begin MEASUREMENT WDMod_stInitDone_b.Watchdog_Module "TRUE when the Watchdog init is done" SBYTE ident 1 100 0 1 BIT_MASK 0x1 ECU_ADDRESS 0x7FBAA4 /end MEASUREMENT
/begin MEASUREMENT WDMod_stTranOn_u8.Watchdog_Module "" SBYTE ident 1 100 0 1 BIT_MASK 0x1 ECU_ADDRESS 0x7FBAA5 /end MEASUREMENT
/begin MEASUREMENT WDMod_stTransData_u8.Watchdog_Module "Call result from SPI_ReadDataStatus()" UBYTE ident 1 100 0 255 ECU_ADDRESS 0x7FBAA6 /end MEASUREMENT
/begin MEASUREMENT WDMod_tiLastTr_u32.Watchdog_Module "" ULONG ident 1 100 0 4294967295 ECU_ADDRESS 0x7FBA8C /end MEASUREMENT
/begin MEASUREMENT WDMod_tiNextTr_u32.Watchdog_Module "" ULONG ident 1 100 0 4294967295 ECU_ADDRESS 0x7FBA90 /end MEASUREMENT
/begin MEASUREMENT WDMod_tiTrans_u32.Watchdog_Module "Timer array to log the last 32 response times" ULONG ident 1 100 0 4294967295 ECU_ADDRESS 0x7FBA08 MATRIX_DIM 32 1 1 /end MEASUREMENT
/begin MEASUREMENT XCP_ODT_tx_status.XCP_SHELL "" UBYTE ident 1 100 0 255 ECU_ADDRESS 0x7F9382 MATRIX_DIM 3 1 1 /end MEASUREMENT
/begin MEASUREMENT XCP_Status.XCP_SHELL_VAR.XCP_SHELL "" UBYTE ident 1 100 0 255 ECU_ADDRESS 0x7FBAE5 /end MEASUREMENT
/begin MEASUREMENT XCP_Temp.XCP_SHELL "" UWORD ident 1 100 0 65535 ECU_ADDRESS 0x7F9380 /end MEASUREMENT
/begin MEASUREMENT counter_uint64_RefSys "" A_UINT64 ident 1 100 0 18446744073709551615 ECU_ADDRESS 0x824000 /end MEASUREMENT
/begin MEASUREMENT counter_sint64_RefSys "" A_INT64 ident 1 100 -9223372036854775808 9223372036854775807 ECU_ADDRESS 0x824008 /end MEASUREMENT
/begin COMPU_METHOD enum_ConfigECU_e "" TAB_VERB "%8.4" "" COEFFS 0 1 0 0 0 1 COMPU_TAB_REF enum_ConfigECU_e_tab_ref /end COMPU_METHOD
/begin COMPU_METHOD enum_UDS_ADDRESS_MODE_E "" TAB_VERB "%8.4" "" COEFFS 0 1 0 0 0 1 COMPU_TAB_REF enum_UDS_ADDRESS_MODE_E_tab_ref /end COMPU_METHOD
/begin COMPU_METHOD enum_UDS_CAN_ID_MODE_FREERUN_E "" TAB_VERB "%8.4" "" COEFFS 0 1 0 0 0 1 COMPU_TAB_REF enum_UDS_CAN_ID_MODE_FREERUN_E_tab_ref /end COMPU_METHOD
/begin COMPU_METHOD enum_XCP_BitSTIM_e "" TAB_VERB "%8.4" "" COEFFS 0 1 0 0 0 1 COMPU_TAB_REF enum_XCP_BitSTIM_e_tab_ref /end COMPU_METHOD
/begin COMPU_METHOD enum_XCP_BitSTIMVERSION_e "" TAB_VERB "%8.4" "" COEFFS 0 1 0 0 0 1 COMPU_TAB_REF enum_XCP_BitSTIMVERSION_e_tab_ref /end COMPU_METHOD
/begin COMPU_METHOD enum_XCP_ByteOrder_e "" TAB_VERB "%8.4" "" COEFFS 0 1 0 0 0 1 COMPU_TAB_REF enum_XCP_ByteOrder_e_tab_ref /end COMPU_METHOD
/begin COMPU_METHOD enum_XCP_ChecksumType_e "" TAB_VERB "%8.4" "" COEFFS 0 1 0 0 0 1 COMPU_TAB_REF enum_XCP_ChecksumType_e_tab_ref /end COMPU_METHOD
/begin COMPU_METHOD enum_XCP_DaqConfigType_e "" TAB_VERB "%8.4" "" COEFFS 0 1 0 0 0 1 COMPU_TAB_REF enum_XCP_DaqConfigType_e_tab_ref /end COMPU_METHOD
/begin COMPU_METHOD enum_XCP_ERROR_TRIGGER_E "" TAB_VERB "%8.4" "" COEFFS 0 1 0 0 0 1 COMPU_TAB_REF enum_XCP_ERROR_TRIGGER_E_tab_ref /end COMPU_METHOD
/begin COMPU_METHOD enum_XCP_ETASTool_e "" TAB_VERB "%8.4" "" COEFFS 0 1 0 0 0 1 COMPU_TAB_REF enum_XCP_ETASTool_e_tab_ref /end COMPU_METHOD
/begin COMPU_METHOD enum_XCP_IdentType_e "" TAB_VERB "%8.4" "" COEFFS 0 1 0 0 0 1 COMPU_TAB_REF enum_XCP_IdentType_e_tab_ref /end COMPU_METHOD
/begin COMPU_METHOD enum_XCP_Overload_e "" TAB_VERB "%8.4" "" COEFFS 0 1 0 0 0 1 COMPU_TAB_REF enum_XCP_Overload_e_tab_ref /end COMPU_METHOD
/begin COMPU_METHOD enum_XCP_PagProperties_e "" TAB_VERB "%8.4" "" COEFFS 0 1 0 0 0 1 COMPU_TAB_REF enum_XCP_PagProperties_e_tab_ref /end COMPU_METHOD
/begin COMPU_METHOD enum_XCP_PIDoff_e "" TAB_VERB "%8.4" "" COEFFS 0 1 0 0 0 1 COMPU_TAB_REF enum_XCP_PIDoff_e_tab_ref /end COMPU_METHOD
/begin COMPU_METHOD enum_XCP_Prescaler_e "" TAB_VERB "%8.4" "" COEFFS 0 1 0 0 0 1 COMPU_TAB_REF enum_XCP_Prescaler_e_tab_ref /end COMPU_METHOD
/begin COMPU_METHOD enum_XCP_Resume_e "" TAB_VERB "%8.4" "" COEFFS 0 1 0 0 0 1 COMPU_TAB_REF enum_XCP_Resume_e_tab_ref /end COMPU_METHOD
/begin COMPU_METHOD enum_XCP_STATE_BYP "" TAB_VERB "%8.4" "" COEFFS 0 1 0 0 0 1 COMPU_TAB_REF enum_XCP_STATE_BYP_tab_ref /end COMPU_METHOD
/begin COMPU_METHOD enum_XCP_TimestampProp_e "" TAB_VERB "%8.4" "" COEFFS 0 1 0 0 0 1 COMPU_TAB_REF enum_XCP_TimestampProp_e_tab_ref /end COMPU_METHOD
/begin COMPU_METHOD enum_XCP_TimestampSize_e "" TAB_VERB "%8.4" "" COEFFS 0 1 0 0 0 1 COMPU_TAB_REF enum_XCP_TimestampSize_e_tab_ref /end COMPU_METHOD
/begin COMPU_METHOD enum_XCP_TimestampSupport_e "" TAB_VERB "%8.4" "" COEFFS 0 1 0 0 0 1 COMPU_TAB_REF enum_XCP_TimestampSupport_e_tab_ref /end COMPU_METHOD
/begin COMPU_METHOD enum_XCP_TimestampUnit_e "" TAB_VERB "%8.4" "" COEFFS 0 1 0 0 0 1 COMPU_TAB_REF enum_XCP_TimestampUnit_e_tab_ref /end COMPU_METHOD
/begin COMPU_METHOD enum_XCP_TimstampFix_e "" TAB_VERB "%8.4" "" COEFFS 0 1 0 0 0 1 COMPU_TAB_REF enum_XCP_TimstampFix_e_tab_ref /end COMPU_METHOD
/begin COMPU_METHOD FastestTaskTicks_to_ms "" RAT_FUNC "%12.4" "ms" COEFFS 0 0.5 0 0 0 1 /end COMPU_METHOD
/begin COMPU_METHOD formula_1_10 "" RAT_FUNC "%12.4" "" COEFFS 0 10 0 0 0 1 /end COMPU_METHOD
/begin COMPU_METHOD formula_1_100 "" RAT_FUNC "%12.4" "" COEFFS 0 100 0 0 0 1 /end COMPU_METHOD
/begin COMPU_METHOD formula_1_2 "" RAT_FUNC "%12.4" "" COEFFS 0 2 0 0 0 1 /end COMPU_METHOD
/begin COMPU_METHOD formula_10_1 "" RAT_FUNC "%12.4" "" COEFFS 0 0.1 0 0 0 1 /end COMPU_METHOD
/begin COMPU_METHOD ident "" RAT_FUNC "%12.4" "" COEFFS 0 1 0 0 0 1 /end COMPU_METHOD
/begin COMPU_METHOD ident__ "" RAT_FUNC "%8.4" "-" COEFFS 0 1 0 0 0 1 /end COMPU_METHOD
/begin COMPU_METHOD ident_DWords "" RAT_FUNC "%8.4" "DWords" COEFFS 0 1 0 0 0 1 /end COMPU_METHOD
/begin COMPU_METHOD ident_name "" RAT_FUNC "%8.4" "%" COEFFS 0 1 0 0 0 1 /end COMPU_METHOD
/begin COMPU_METHOD ident_s "" RAT_FUNC "%8.4" "s" COEFFS 0 1 0 0 0 1 /end COMPU_METHOD
/begin COMPU_METHOD TickTickSQRT "" RAT_FUNC "%12.4" "TicksTicksSQRT" COEFFS 0 1 0 0 0 1 /end COMPU_METHOD
/begin COMPU_METHOD formula_1_1000000000 "" RAT_FUNC "%12.4" "" COEFFS 0 1000000000 0 0 0 1 /end COMPU_METHOD
/begin COMPU_METHOD formula_1_1000000 "" RAT_FUNC "%12.4" "" COEFFS 0 1000000 0 0 0 1 /end COMPU_METHOD
/begin COMPU_METHOD formula_1_1000 "" RAT_FUNC "%12.4" "" COEFFS 0 1000 0 0 0 1 /end COMPU_METHOD
/begin COMPU_METHOD formula_10_1 "" RAT_FUNC "%12.4" "" COEFFS 0 1 0 0 0 10 /end COMPU_METHOD
/begin COMPU_METHOD TickType2ms "" RAT_FUNC "%12.4" "ms" COEFFS 0 3500.0 0 0 0 1 /end COMPU_METHOD
/begin COMPU_METHOD TPU_Per "Periodendauer in Sec." RAT_FUNC "%12.4" "s" COEFFS 0 10000 0 0 0 1 /end COMPU_METHOD
/begin COMPU_VTAB enum_ConfigECU_e_tab_ref "" TAB_VERB 2 0 "STIM_MSG_0" 1 "PARAMETER_1" DEFAULT_VALUE "Error" /end COMPU_VTAB
/begin COMPU_VTAB enum_UDS_ADDRESS_MODE_E_tab_ref "" TAB_VERB 2 0 "NORMAL_ADDRESSING" 1 "EXTENDED_ADDRESSING" DEFAULT_VALUE "Error" /end COMPU_VTAB
/begin COMPU_VTAB enum_UDS_CAN_ID_MODE_FREERUN_E_tab_ref "" TAB_VERB 4 0 "ALL_RASTER_ON_R1_START_0" 1 "EACH_RASTER_ON_Rx_START_1" 2 "ALL_RASTER_ON_R1_POOL_2" 3 "EACH_RASTER_ON_Rx_POOL_3" DEFAULT_VALUE "Error" /end COMPU_VTAB
/begin COMPU_VTAB enum_XCP_BitSTIM_e_tab_ref "" TAB_VERB 2 0 "NO_BITSTIM_SUPPORT_0" 1 "BITSTIM_SUPPORTED_1" DEFAULT_VALUE "Error" /end COMPU_VTAB
/begin COMPU_VTAB enum_XCP_BitSTIMVERSION_e_tab_ref "" TAB_VERB 2 0 "BITSTIM_OLD_V_0" 1 "BITSTIM_NEW_V_1" DEFAULT_VALUE "Error" /end COMPU_VTAB
/begin COMPU_VTAB enum_XCP_ByteOrder_e_tab_ref "" TAB_VERB 2 0 "INTEL_MSB_LAST_0" 1 "MOTOROLA_MSB_FIRST_1" DEFAULT_VALUE "Error" /end COMPU_VTAB
/begin COMPU_VTAB enum_XCP_ChecksumType_e_tab_ref "" TAB_VERB 10 0 "NOT_USED_0" 1 "XCP_ADD_11_1" 2 "XCP_ADD_12_2" 3 "XCP_ADD_14_3" 4 "XCP_ADD_22_4" 5 "XCP_ADD_24_5" 6 "XCP_ADD_44_6" 7 "XCP_CRC_16_7" 8 "XCP_CRC_16_CITT_8" 9 "XCP_CRC_32_9" DEFAULT_VALUE "Error" /end COMPU_VTAB
/begin COMPU_VTAB enum_XCP_DaqConfigType_e_tab_ref "" TAB_VERB 2 0 "STATIC_DAQ_0" 1 "DYNAMIC_DAQ_1" DEFAULT_VALUE "Error" /end COMPU_VTAB
/begin COMPU_VTAB enum_XCP_ERROR_TRIGGER_E_tab_ref "" TAB_VERB 3 0 "ERROR_TRIGGER_NO" 1 "ERROR_TRIGGER_ONCE" 2 "ERROR_TRIGGER_CYCLIC" DEFAULT_VALUE "Error" /end COMPU_VTAB
/begin COMPU_VTAB enum_XCP_ETASTool_e_tab_ref "" TAB_VERB 2 0 "INCA_0" 1 "INTECRIO_1" DEFAULT_VALUE "Error" /end COMPU_VTAB
/begin COMPU_VTAB enum_XCP_IdentType_e_tab_ref "" TAB_VERB 4 0 "ABSOLUTE_ODT_0" 1 "REL_ODT_DAQ_BYTE_1" 2 "REL_ODT_DAQ_WORD_2" 3 "REL_ODT_DAQ_WORD_ALIGNED_3" DEFAULT_VALUE "Error" /end COMPU_VTAB
/begin COMPU_VTAB enum_XCP_Overload_e_tab_ref "" TAB_VERB 4 0 "NO_OVERLOAD_INDENTICATION_0" 1 "MSB_OVERLOAD_INDENTICATION_1" 2 "EVENT_OVERLOAD_INDENTICATION_2" 3 "OVERLOAD_INDENTICATION_NOT_ALLOWED_3" DEFAULT_VALUE "Error" /end COMPU_VTAB
/begin COMPU_VTAB enum_XCP_PagProperties_e_tab_ref "" TAB_VERB 2 0 "NO_FREEZ_SUPPORT_0" 1 "FREEZ_SUPPORTED_1" DEFAULT_VALUE "Error" /end COMPU_VTAB
/begin COMPU_VTAB enum_XCP_PIDoff_e_tab_ref "" TAB_VERB 2 0 "NO_PID_OFF_SUPPORT_0" 1 "PID_OFF_SUPPORTED_1" DEFAULT_VALUE "Error" /end COMPU_VTAB
/begin COMPU_VTAB enum_XCP_Prescaler_e_tab_ref "" TAB_VERB 2 0 "NO_PRESCALER_SUPPORT_0" 1 "PRESCALER_SUPPORTED_1" DEFAULT_VALUE "Error" /end COMPU_VTAB
/begin COMPU_VTAB enum_XCP_Resume_e_tab_ref "" TAB_VERB 2 0 "NO_RESUME_SUPPORT_0" 1 "RESUME_SUPPORTED_1" DEFAULT_VALUE "Error" /end COMPU_VTAB
/begin COMPU_VTAB enum_XCP_STATE_BYP_tab_ref "" TAB_VERB 4 0 "IDLE_WAIT_TX_0" 1 "TX_WAIT_TXINT_1" 2 "TXINT_WAIT_RXINT_2" 3 "RXINT_WAIT_SAMPLE_3" DEFAULT_VALUE "Error" /end COMPU_VTAB
/begin COMPU_VTAB enum_XCP_TimestampProp_e_tab_ref "" TAB_VERB 4 0 "DWORD_0" 1 "DWORD_TO_TIMSTAMPSIZE_1" 2 "DWORD_BIT_SHIFTED_2" 3 "DWORD_TO_TIMESTAMPSIZE_BIT_SHIFTED_3" DEFAULT_VALUE "Error" /end COMPU_VTAB
/begin COMPU_VTAB enum_XCP_TimestampSize_e_tab_ref "" TAB_VERB 5 0 "TIMESTAMPSIZE_0" 1 "TIMESTAMPSIZE_1Byte_1" 2 "TIMESTAMPSIZE_2Byte_2" 3 "TIMESTAMPSIZE_NOT_ALLOWED_3" 4 "TIMESTAMPSIZE_4Byte_4" DEFAULT_VALUE "Error" /end COMPU_VTAB
/begin COMPU_VTAB enum_XCP_TimestampSupport_e_tab_ref "" TAB_VERB 2 0 "NO_TIMESTAMP_SUPPORT_0" 1 "TIMESTAMP_SUPPORTED_1" DEFAULT_VALUE "Error" /end COMPU_VTAB
/begin COMPU_VTAB enum_XCP_TimestampUnit_e_tab_ref "" TAB_VERB 10 0 "ONE_NANOSECOND_0" 1 "TEN_NANOSECOND_1" 2 "HUNDRED_NANOSECOND_2" 3 "ONE_MICORSECOND_3" 4 "TEN_MICROSECOND_4" 5 "HUNDRED_MICROSECOND_5" 6 "ONE_MILLISECOND_6" 7 "TEN_MILLISECOND_7" 8 "HUNDRED_MILLISECOND_8" 9 "ONE_SECOND_9" DEFAULT_VALUE "Error" /end COMPU_VTAB
/begin COMPU_VTAB enum_XCP_TimstampFix_e_tab_ref "" TAB_VERB 2 0 "NO_FIX_TIMESTAMP_0" 1 "FIX_TIMESTAMP_1" DEFAULT_VALUE "Error" /end COMPU_VTAB
/begin GROUP Model_XcpByp_B04 "" ROOT
 /begin REF_MEASUREMENT cont_sint16_1_100_Xcp_B04.Model_XcpByp_B04 cont_sint16_Xcp_B04.Model_XcpByp_B04 cont_sint8_1_10_Xcp_B04.Model_XcpByp_B04 cont_sint8_Xcp_B04.Model_XcpByp_B04 cont_uint16_1_2_Xcp_B04.Model_XcpByp_B04 cont_uint8_10_1_Xcp_B04.Model_XcpByp_B04 log_uint8_0_Xcp_B04.Model_XcpByp_B04 log_uint8_1_Xcp_B04.Model_XcpByp_B04 sdisc_sint16_Xcp_B04.Model_XcpByp_B04 sdisc_sint8_Xcp_B04.Model_XcpByp_B04 udisc_uint16_Xcp_B04.Model_XcpByp_B04 udisc_uint8_Xcp_B04.Model_XcpByp_B04 /end REF_MEASUREMENT
 /begin REF_CHARACTERISTIC p_cont_sint16_1_100_Xcp_B04.Model_XcpByp_B04 p_cont_sint16_Xcp_B04.Model_XcpByp_B04 p_cont_sint8_1_10_Xcp_B04.Model_XcpByp_B04 p_cont_sint8_Xcp_B04.Model_XcpByp_B04 p_cont_uint16_1_2_Xcp_B04.Model_XcpByp_B04 p_cont_uint8_10_1_Xcp_B04.Model_XcpByp_B04 p_log_uint8_0_Xcp_B04.Model_XcpByp_B04 p_log_uint8_1_Xcp_B04.Model_XcpByp_B04 p_sdisc_sint16_Xcp_B04.Model_XcpByp_B04 p_sdisc_sint8_Xcp_B04.Model_XcpByp_B04 p_udisc_uint16_Xcp_B04.Model_XcpByp_B04 p_udisc_uint8_Xcp_B04.Model_XcpByp_B04 /end REF_CHARACTERISTIC
/end GROUP
/begin GROUP OS_Counter "" ROOT
 /begin REF_MEASUREMENT Counter_2ms_Task.OS_Counter Counter_BG_Task.OS_Counter Counter_CANA_IRQ.OS_Counter Counter_CANB_IRQ.OS_Counter Counter_CANC_IRQ.OS_Counter Counter_ESTACK_OVFL.OS_Counter Counter_E_OS_FUNC_default.OS_Counter Counter_E_OS_ID.OS_Counter Counter_E_OS_LIMIT.OS_Counter Counter_E_OS_LIMIT_2ms.OS_Counter Counter_E_OS_LIMIT_R01.OS_Counter Counter_E_OS_LIMIT_R02.OS_Counter Counter_E_OS_LIMIT_R03.OS_Counter Counter_E_OS_LIMIT_old.OS_Counter Counter_E_OS_MISSING_TIMETABLE.OS_Counter Counter_E_OS_NOFUNC.OS_Counter Counter_E_OS_SERVICE_NOT_SUPPORTED.OS_Counter Counter_E_OS_SYS_STACK_default.OS_Counter Counter_E_OS_TIMETABLE_ALREADY_ACTIVE.OS_Counter Counter_E_OS_VALUE.OS_Counter Counter_OSTACK_OVFL.OS_Counter Counter_R01.OS_Counter Counter_R02.OS_Counter Counter_R03.OS_Counter Counter_USTACK_NFULL.OS_Counter Counter_USTACK_OVFL.OS_Counter Counter_default.OS_Counter /end REF_MEASUREMENT
 /begin REF_CHARACTERISTIC P_Delta_Counter_2ms_Task.OS_Counter P_Delta_Counter_BG_Task.OS_Counter P_Delta_Counter_CANA_IRQ.OS_Counter P_Delta_Counter_CANB_IRQ.OS_Counter P_Delta_Counter_CANC_IRQ.OS_Counter P_Delta_Counter_R01.OS_Counter P_Delta_Counter_R02.OS_Counter P_Delta_Counter_R03.OS_Counter P_Reset_Err_Counter.OS_Counter P_Reset_Task_Counter.OS_Counter /end REF_CHARACTERISTIC
/end GROUP
/begin GROUP R01 "" ROOT
 /begin REF_MEASUREMENT counter_sint16_R01.R01 counter_sint8_R01.R01 counter_uint16_R01.R01 counter_uint8_B01.R01 counter_uint8_R01.R01 /end REF_MEASUREMENT
 /begin SUB_GROUP E_sint16.R01 E_sint8.R01 E_uint16.R01 E_uint8.R01 I_sint16.R01 I_sint8.R01 I_uint16.R01 I_uint8.R01 /end SUB_GROUP
/end GROUP
/begin GROUP R01.Restart_Raster_16T ""
 /begin REF_MEASUREMENT asynchron_alarm_delta_t.R01.Restart_Raster_16T asynchron_alarm_table_index.R01.Restart_Raster_16T dT_Raster.R01.Restart_Raster_16T mem_alarm_cycle.R01.Restart_Raster_16T /end REF_MEASUREMENT
 /begin REF_CHARACTERISTIC Alarm_ID.R01.Restart_Raster_16T P_alarm_cycle.R01.Restart_Raster_16T P_alarm_cycle_delay.R01.Restart_Raster_16T P_asynchron_alarm_cycle.R01.Restart_Raster_16T asynchron_alarm_cycle_times_array.R01.Restart_Raster_16T /end REF_CHARACTERISTIC
/end GROUP
/begin GROUP R01_16bit "" ROOT /begin REF_MEASUREMENT l_R01Count16Bit_Temp_b.R01_16bit /end REF_MEASUREMENT /begin REF_CHARACTERISTIC p_R01Count16Bit_b.R01_16bit /end REF_CHARACTERISTIC
 /begin SUB_GROUP E_sint16_1.R01_16bit E_sint16_2.R01_16bit E_sint16_3.R01_16bit E_sint16_4.R01_16bit E_uint16_1.R01_16bit E_uint16_2.R01_16bit E_uint16_3.R01_16bit E_uint16_4.R01_16bit I_sint16_1.R01_16bit I_sint16_2.R01_16bit I_sint16_3.R01_16bit I_sint16_4.R01_16bit I_uint16_1.R01_16bit I_uint16_2.R01_16bit I_uint16_3.R01_16bit I_uint16_4.R01_16bit /end SUB_GROUP
/end GROUP
/begin GROUP R01_8bit "" ROOT /begin REF_MEASUREMENT l_R01Count8Bit_Temp_b.R01_8bit /end REF_MEASUREMENT /begin REF_CHARACTERISTIC p_R01Count8Bit_b.R01_8bit /end REF_CHARACTERISTIC
 /begin SUB_GROUP E_sint8_1.R01_8bit E_sint8_2.R01_8bit E_sint8_3.R01_8bit E_sint8_4.R01_8bit E_sint8_5.R01_8bit E_sint8_6.R01_8bit E_sint8_7.R01_8bit E_sint8_8.R01_8bit E_uint8_1.R01_8bit E_uint8_2.R01_8bit E_uint8_3.R01_8bit E_uint8_4.R01_8bit E_uint8_5.R01_8bit E_uint8_6.R01_8bit E_uint8_7.R01_8bit E_uint8_8.R01_8bit I_sint8_1.R01_8bit I_sint8_2.R01_8bit I_sint8_3.R01_8bit I_sint8_4.R01_8bit I_sint8_5.R01_8bit I_sint8_6.R01_8bit I_sint8_7.R01_8bit I_sint8_8.R01_8bit I_uint8_1.R01_8bit I_uint8_2.R01_8bit I_uint8_3.R01_8bit I_uint8_4.R01_8bit I_uint8_5.R01_8bit I_uint8_6.R01_8bit I_uint8_7.R01_8bit I_uint8_8.R01_8bit /end SUB_GROUP
/end GROUP
/begin GROUP R01_B "" ROOT
 /begin SUB_GROUP E_fl32.R01_B E_fl64.R01_B E_sint32.R01_B E_uint32.R01_B I_fl32.R01_B I_fl64.R01_B I_sint32.R01_B I_uint32.R01_B /end SUB_GROUP
/end GROUP
/begin GROUP R01_Mon.Restart_Raster_16T ""
 /begin REF_MEASUREMENT grossRunTime.R01_Mon.Restart_Raster_16T maxRunTime.R01_Mon.Restart_Raster_16T minRunTime.R01_Mon.Restart_Raster_16T netRunTime.R01_Mon.Restart_Raster_16T /end REF_MEASUREMENT
/end GROUP
/begin GROUP R02 "" ROOT
 /begin REF_MEASUREMENT counter_sint16_R02.R02 counter_sint8_R02.R02 counter_uint16_R02.R02 counter_uint8_B02.R02 counter_uint8_R02.R02 /end REF_MEASUREMENT
 /begin SUB_GROUP E_sint16.R02 E_sint8.R02 E_uint16.R02 E_uint8.R02 I_sint16.R02 I_sint8.R02 I_uint16.R02 I_uint8.R02 /end SUB_GROUP
/end GROUP
/begin GROUP R02.Restart_Raster_16T ""
 /begin REF_MEASUREMENT dT_Raster.R02.Restart_Raster_16T mem_alarm_cycle.R02.Restart_Raster_16T /end REF_MEASUREMENT
 /begin REF_CHARACTERISTIC Alarm_ID.R02.Restart_Raster_16T P_alarm_cycle.R02.Restart_Raster_16T P_alarm_cycle_delay.R02.Restart_Raster_16T /end REF_CHARACTERISTIC
/end GROUP
/begin GROUP R02_B "" ROOT
 /begin SUB_GROUP E_fl32.R02_B E_fl64.R02_B E_sint32.R02_B E_uint32.R02_B I_fl32.R02_B I_fl64.R02_B I_sint32.R02_B I_uint32.R02_B /end SUB_GROUP
/end GROUP
/begin GROUP R02_Mon.Restart_Raster_16T ""
 /begin REF_MEASUREMENT grossRunTime.R02_Mon.Restart_Raster_16T maxRunTime.R02_Mon.Restart_Raster_16T minRunTime.R02_Mon.Restart_Raster_16T netRunTime.R02_Mon.Restart_Raster_16T /end REF_MEASUREMENT
/end GROUP
/begin GROUP R03 "" ROOT
 /begin REF_MEASUREMENT counter_sint16_R03.R03 counter_sint8_R03.R03 counter_uint16_R03.R03 counter_uint8_R03.R03 /end REF_MEASUREMENT
 /begin SUB_GROUP E_sint16.R03 E_sint8.R03 E_uint16.R03 E_uint8.R03 I_sint16.R03 I_sint8.R03 I_uint16.R03 I_uint8.R03 /end SUB_GROUP
/end GROUP
/begin GROUP R03.Restart_Raster_16T ""
 /begin REF_MEASUREMENT dT_Raster.R03.Restart_Raster_16T mem_alarm_cycle.R03.Restart_Raster_16T /end REF_MEASUREMENT
 /begin REF_CHARACTERISTIC Alarm_ID.R03.Restart_Raster_16T P_alarm_cycle.R03.Restart_Raster_16T P_alarm_cycle_delay.R03.Restart_Raster_16T /end REF_CHARACTERISTIC
/end GROUP
/begin GROUP R03_B "" ROOT
 /begin SUB_GROUP E_fl32.R03_B E_fl64.R03_B E_sint32.R03_B E_uint32.R03_B I_fl32.R03_B I_fl64.R03_B I_sint32.R03_B I_uint32.R03_B /end SUB_GROUP
/end GROUP
/begin GROUP R03_Mon.Restart_Raster_16T ""
 /begin REF_MEASUREMENT grossRunTime.R03_Mon.Restart_Raster_16T maxRunTime.R03_Mon.Restart_Raster_16T minRunTime.R03_Mon.Restart_Raster_16T netRunTime.R03_Mon.Restart_Raster_16T /end REF_MEASUREMENT
/end GROUP
/begin GROUP R04 "" ROOT
 /begin REF_MEASUREMENT counter_sint16_R04.R04 counter_sint8_R04.R04 counter_uint16_R04.R04 counter_uint8_R04.R04 /end REF_MEASUREMENT
 /begin SUB_GROUP E_sint16.R04 E_sint8.R04 E_uint16.R04 E_uint8.R04 I_sint16.R04 I_sint8.R04 I_uint16.R04 I_uint8.R04 /end SUB_GROUP
/end GROUP
/begin GROUP R04_B "" ROOT
 /begin SUB_GROUP E_fl32.R04_B E_fl64.R04_B E_sint32.R04_B E_uint32.R04_B I_fl32.R04_B I_fl64.R04_B I_sint32.R04_B I_uint32.R04_B /end SUB_GROUP
/end GROUP
/begin GROUP R04_Sync.Restart_Raster_16T ""
 /begin REF_MEASUREMENT asynchron_alarm_delta_t.R04_Sync.Restart_Raster_16T asynchron_alarm_table_index.R04_Sync.Restart_Raster_16T dT_Raster.R04_Sync.Restart_Raster_16T mem_alarm_cycle.R04_Sync.Restart_Raster_16T /end REF_MEASUREMENT
 /begin REF_CHARACTERISTIC Alarm_ID.R04_Sync.Restart_Raster_16T P_alarm_cycle.R04_Sync.Restart_Raster_16T P_alarm_cycle_delay.R04_Sync.Restart_Raster_16T P_asynchron_alarm_cycle.R04_Sync.Restart_Raster_16T asynchron_alarm_cycle_times_array.R04_Sync.Restart_Raster_16T /end REF_CHARACTERISTIC
/end GROUP
/begin GROUP R04_Sync_Mon.Restart_Raster_16T ""
 /begin REF_MEASUREMENT grossRunTime.R04_Sync_Mon.Restart_Raster_16T maxRunTime.R04_Sync_Mon.Restart_Raster_16T minRunTime.R04_Sync_Mon.Restart_Raster_16T netRunTime.R04_Sync_Mon.Restart_Raster_16T /end REF_MEASUREMENT
/end GROUP
/begin GROUP R05 "" ROOT
 /begin REF_MEASUREMENT counter_sint16_R05.R05 counter_sint8_R05.R05 counter_uint16_R05.R05 counter_uint8_R05.R05 /end REF_MEASUREMENT
 /begin SUB_GROUP E_sint16.R05 E_sint8.R05 E_uint16.R05 E_uint8.R05 /end SUB_GROUP
/end GROUP
/begin GROUP R05.Restart_Raster_16T ""
 /begin REF_MEASUREMENT dT_Raster.R05.Restart_Raster_16T mem_alarm_cycle.R05.Restart_Raster_16T /end REF_MEASUREMENT
 /begin REF_CHARACTERISTIC Alarm_ID.R05.Restart_Raster_16T P_alarm_cycle.R05.Restart_Raster_16T P_alarm_cycle_delay.R05.Restart_Raster_16T /end REF_CHARACTERISTIC
/end GROUP
/begin GROUP R06 "" ROOT
 /begin REF_MEASUREMENT counter_sint16_R06.R06 counter_sint8_R06.R06 counter_uint16_R06.R06 counter_uint8_R06.R06 /end REF_MEASUREMENT
 /begin SUB_GROUP E_sint16.R06 E_sint8.R06 E_uint16.R06 E_uint8.R06 /end SUB_GROUP
/end GROUP
/begin GROUP R06.Restart_Raster_16T ""
 /begin REF_MEASUREMENT dT_Raster.R06.Restart_Raster_16T mem_alarm_cycle.R06.Restart_Raster_16T /end REF_MEASUREMENT
 /begin REF_CHARACTERISTIC Alarm_ID.R06.Restart_Raster_16T P_alarm_cycle.R06.Restart_Raster_16T P_alarm_cycle_delay.R06.Restart_Raster_16T /end REF_CHARACTERISTIC
/end GROUP
/begin GROUP R07 "" ROOT
 /begin REF_MEASUREMENT counter_sint16_R07.R07 counter_sint8_R07.R07 counter_uint16_R07.R07 counter_uint8_R07.R07 /end REF_MEASUREMENT
 /begin SUB_GROUP E_sint16.R07 E_sint8.R07 E_uint16.R07 E_uint8.R07 /end SUB_GROUP
/end GROUP
/begin GROUP R07.Restart_Raster_16T ""
 /begin REF_MEASUREMENT dT_Raster.R07.Restart_Raster_16T mem_alarm_cycle.R07.Restart_Raster_16T /end REF_MEASUREMENT
 /begin REF_CHARACTERISTIC Alarm_ID.R07.Restart_Raster_16T P_alarm_cycle.R07.Restart_Raster_16T P_alarm_cycle_delay.R07.Restart_Raster_16T /end REF_CHARACTERISTIC
/end GROUP
/begin GROUP R08 "" ROOT
 /begin REF_MEASUREMENT counter_sint16_R08.R08 counter_sint8_R08.R08 counter_uint16_R08.R08 counter_uint8_R08.R08 /end REF_MEASUREMENT
 /begin SUB_GROUP E_sint16.R08 E_sint8.R08 E_uint16.R08 E_uint8.R08 /end SUB_GROUP
/end GROUP
/begin GROUP R08.Restart_Raster_16T ""
 /begin REF_MEASUREMENT dT_Raster.R08.Restart_Raster_16T mem_alarm_cycle.R08.Restart_Raster_16T /end REF_MEASUREMENT
 /begin REF_CHARACTERISTIC Alarm_ID.R08.Restart_Raster_16T P_alarm_cycle.R08.Restart_Raster_16T P_alarm_cycle_delay.R08.Restart_Raster_16T /end REF_CHARACTERISTIC
/end GROUP
/begin GROUP R09 "" ROOT
 /begin REF_MEASUREMENT counter_sint16_R09.R09 counter_sint8_R09.R09 counter_uint16_R09.R09 counter_uint8_R09.R09 /end REF_MEASUREMENT
 /begin SUB_GROUP E_sint16.R09 E_sint8.R09 E_uint16.R09 E_uint8.R09 /end SUB_GROUP
/end GROUP
/begin GROUP R09.Restart_Raster_16T ""
 /begin REF_MEASUREMENT dT_Raster.R09.Restart_Raster_16T mem_alarm_cycle.R09.Restart_Raster_16T /end REF_MEASUREMENT
 /begin REF_CHARACTERISTIC Alarm_ID.R09.Restart_Raster_16T P_alarm_cycle.R09.Restart_Raster_16T P_alarm_cycle_delay.R09.Restart_Raster_16T /end REF_CHARACTERISTIC
/end GROUP
/begin GROUP R10 "" ROOT
 /begin REF_MEASUREMENT counter_sint16_R10.R10 counter_sint8_R10.R10 counter_uint16_R10.R10 counter_uint8_R10.R10 /end REF_MEASUREMENT
 /begin SUB_GROUP E_sint16.R10 E_sint8.R10 E_uint16.R10 E_uint8.R10 /end SUB_GROUP
/end GROUP
/begin GROUP R10.Restart_Raster_16T ""
 /begin REF_MEASUREMENT dT_Raster.R10.Restart_Raster_16T mem_alarm_cycle.R10.Restart_Raster_16T /end REF_MEASUREMENT
 /begin REF_CHARACTERISTIC Alarm_ID.R10.Restart_Raster_16T P_alarm_cycle.R10.Restart_Raster_16T P_alarm_cycle_delay.R10.Restart_Raster_16T /end REF_CHARACTERISTIC
/end GROUP
/begin GROUP R11 "" ROOT
 /begin REF_MEASUREMENT counter_sint16_R11.R11 counter_sint8_R11.R11 counter_uint16_R11.R11 counter_uint8_R11.R11 /end REF_MEASUREMENT
 /begin SUB_GROUP E_sint16.R11 E_sint8.R11 E_uint16.R11 E_uint8.R11 /end SUB_GROUP
/end GROUP
/begin GROUP R11.Restart_Raster_16T ""
 /begin REF_MEASUREMENT dT_Raster.R11.Restart_Raster_16T mem_alarm_cycle.R11.Restart_Raster_16T /end REF_MEASUREMENT
 /begin REF_CHARACTERISTIC Alarm_ID.R11.Restart_Raster_16T P_alarm_cycle.R11.Restart_Raster_16T P_alarm_cycle_delay.R11.Restart_Raster_16T /end REF_CHARACTERISTIC
/end GROUP
/begin GROUP R12 "" ROOT
 /begin REF_MEASUREMENT counter_sint16_R12.R12 counter_sint8_R12.R12 counter_uint16_R12.R12 counter_uint8_R12.R12 /end REF_MEASUREMENT
 /begin SUB_GROUP E_sint16.R12 E_sint8.R12 E_uint16.R12 E_uint8.R12 /end SUB_GROUP
/end GROUP
/begin GROUP R12.Restart_Raster_16T ""
 /begin REF_MEASUREMENT dT_Raster.R12.Restart_Raster_16T mem_alarm_cycle.R12.Restart_Raster_16T /end REF_MEASUREMENT
 /begin REF_CHARACTERISTIC Alarm_ID.R12.Restart_Raster_16T P_alarm_cycle.R12.Restart_Raster_16T P_alarm_cycle_delay.R12.Restart_Raster_16T /end REF_CHARACTERISTIC
/end GROUP
/begin GROUP R13 "" ROOT
 /begin REF_MEASUREMENT counter_sint16_R13.R13 counter_sint8_R13.R13 counter_uint16_R13.R13 counter_uint8_R13.R13 /end REF_MEASUREMENT
 /begin SUB_GROUP E_sint16.R13 E_sint8.R13 E_uint16.R13 E_uint8.R13 /end SUB_GROUP
/end GROUP
/begin GROUP R13.Restart_Raster_16T ""
 /begin REF_MEASUREMENT dT_Raster.R13.Restart_Raster_16T mem_alarm_cycle.R13.Restart_Raster_16T /end REF_MEASUREMENT
 /begin REF_CHARACTERISTIC Alarm_ID.R13.Restart_Raster_16T P_alarm_cycle.R13.Restart_Raster_16T P_alarm_cycle_delay.R13.Restart_Raster_16T /end REF_CHARACTERISTIC
/end GROUP
/begin GROUP R14 "" ROOT
 /begin REF_MEASUREMENT counter_sint16_R14.R14 counter_sint8_R14.R14 counter_uint16_R14.R14 counter_uint8_R14.R14 /end REF_MEASUREMENT
 /begin SUB_GROUP E_sint16.R14 E_sint8.R14 E_uint16.R14 E_uint8.R14 /end SUB_GROUP
/end GROUP
/begin GROUP R14.Restart_Raster_16T ""
 /begin REF_MEASUREMENT dT_Raster.R14.Restart_Raster_16T mem_alarm_cycle.R14.Restart_Raster_16T /end REF_MEASUREMENT
 /begin REF_CHARACTERISTIC Alarm_ID.R14.Restart_Raster_16T P_alarm_cycle.R14.Restart_Raster_16T P_alarm_cycle_delay.R14.Restart_Raster_16T /end REF_CHARACTERISTIC
/end GROUP
/begin GROUP R15 "" ROOT
 /begin REF_MEASUREMENT counter_sint16_R15.R15 counter_sint8_R15.R15 counter_uint16_R15.R15 counter_uint8_R15.R15 /end REF_MEASUREMENT
 /begin SUB_GROUP E_sint16.R15 E_sint8.R15 E_uint16.R15 E_uint8.R15 /end SUB_GROUP
/end GROUP
/begin GROUP R15.Restart_Raster_16T ""
 /begin REF_MEASUREMENT dT_Raster.R15.Restart_Raster_16T mem_alarm_cycle.R15.Restart_Raster_16T /end REF_MEASUREMENT
 /begin REF_CHARACTERISTIC Alarm_ID.R15.Restart_Raster_16T P_alarm_cycle.R15.Restart_Raster_16T P_alarm_cycle_delay.R15.Restart_Raster_16T /end REF_CHARACTERISTIC
/end GROUP
/begin GROUP R16 "" ROOT /begin REF_MEASUREMENT counter_sint8_R16.R16 counter_uint8_R16.R16 /end REF_MEASUREMENT /begin SUB_GROUP E_sint8.R16 E_uint8.R16 /end SUB_GROUP /end GROUP
/begin GROUP R16.Restart_Raster_16T ""
 /begin REF_MEASUREMENT dT_Raster.R16.Restart_Raster_16T mem_alarm_cycle.R16.Restart_Raster_16T /end REF_MEASUREMENT
 /begin REF_CHARACTERISTIC Alarm_ID.R16.Restart_Raster_16T P_alarm_cycle.R16.Restart_Raster_16T P_alarm_cycle_delay.R16.Restart_Raster_16T /end REF_CHARACTERISTIC
/end GROUP
/begin GROUP Replay_Data "" ROOT
 /begin REF_MEASUREMENT Counter.Replay_Data Do_Single_Step_alt.Replay_Data Replay_S16_1.Replay_Data Replay_S16_2.Replay_Data Replay_S16_3.Replay_Data Replay_S32_1.Replay_Data Replay_S32_2.Replay_Data Replay_S8_1.Replay_Data Replay_S8_2.Replay_Data Replay_S8_3.Replay_Data Replay_S8_4.Replay_Data Replay_U16_1.Replay_Data Replay_U16_2.Replay_Data Replay_U16_3.Replay_Data Replay_U32_1.Replay_Data Replay_U32_2.Replay_Data Replay_U8_1.Replay_Data Replay_U8_2.Replay_Data Replay_U8_3.Replay_Data Replay_U8_4.Replay_Data /end REF_MEASUREMENT
 /begin REF_CHARACTERISTIC P_Count_Single_Step.Replay_Data P_Counter_Max.Replay_Data P_Do_Single_Step.Replay_Data P_S16_1_Array.Replay_Data P_S16_2_Array.Replay_Data P_S16_3_Array.Replay_Data P_S32_1_Array.Replay_Data P_S32_2_Array.Replay_Data P_S8_1_Array.Replay_Data P_S8_2_Array.Replay_Data P_S8_3_Array.Replay_Data P_S8_4_Array.Replay_Data P_U16_1_Array.Replay_Data P_U16_2_Array.Replay_Data P_U16_3_Array.Replay_Data P_U32_1_Array.Replay_Data P_U32_2_Array.Replay_Data P_U8_1_Array.Replay_Data P_U8_2_Array.Replay_Data P_U8_3_Array.Replay_Data P_U8_4_Array.Replay_Data /end REF_CHARACTERISTIC
/end GROUP
/begin GROUP Reset_Schalter "" ROOT /begin REF_MEASUREMENT Reset.Reset_Schalter g_SoftResetECU_u8.Reset_Schalter /end REF_MEASUREMENT /begin REF_CHARACTERISTIC P_Reset.Reset_Schalter p_SoftResetECU_u8.Reset_Schalter /end REF_CHARACTERISTIC /begin SUB_GROUP EdgeRising.Reset_Schalter /end SUB_GROUP /end GROUP
/begin GROUP Restart_Raster_16T "" ROOT
 /begin REF_MEASUREMENT asynchron_alarm_delta_t.R01.Restart_Raster_16T asynchron_alarm_delta_t.R04_Sync.Restart_Raster_16T asynchron_alarm_table_index.R01.Restart_Raster_16T asynchron_alarm_table_index.R04_Sync.Restart_Raster_16T dT_Raster.R01.Restart_Raster_16T dT_Raster.R02.Restart_Raster_16T dT_Raster.R03.Restart_Raster_16T dT_Raster.R04_Sync.Restart_Raster_16T dT_Raster.R05.Restart_Raster_16T dT_Raster.R06.Restart_Raster_16T dT_Raster.R07.Restart_Raster_16T dT_Raster.R08.Restart_Raster_16T dT_Raster.R09.Restart_Raster_16T dT_Raster.R10.Restart_Raster_16T dT_Raster.R11.Restart_Raster_16T dT_Raster.R12.Restart_Raster_16T dT_Raster.R13.Restart_Raster_16T dT_Raster.R14.Restart_Raster_16T dT_Raster.R15.Restart_Raster_16T dT_Raster.R16.Restart_Raster_16T g_enableSyncR04burst_u8.Restart_Raster_16T grossRunTime.R01_Mon.Restart_Raster_16T grossRunTime.R02_Mon.Restart_Raster_16T grossRunTime.R03_Mon.Restart_Raster_16T grossRunTime.R04_Sync_Mon.Restart_Raster_16T maxRunTime.R01_Mon.Restart_Raster_16T maxRunTime.R02_Mon.Restart_Raster_16T maxRunTime.R03_Mon.Restart_Raster_16T maxRunTime.R04_Sync_Mon.Restart_Raster_16T mem_alarm_cycle.R01.Restart_Raster_16T mem_alarm_cycle.R02.Restart_Raster_16T mem_alarm_cycle.R03.Restart_Raster_16T mem_alarm_cycle.R04_Sync.Restart_Raster_16T mem_alarm_cycle.R05.Restart_Raster_16T mem_alarm_cycle.R06.Restart_Raster_16T mem_alarm_cycle.R07.Restart_Raster_16T mem_alarm_cycle.R08.Restart_Raster_16T mem_alarm_cycle.R09.Restart_Raster_16T mem_alarm_cycle.R10.Restart_Raster_16T mem_alarm_cycle.R11.Restart_Raster_16T mem_alarm_cycle.R12.Restart_Raster_16T mem_alarm_cycle.R13.Restart_Raster_16T mem_alarm_cycle.R14.Restart_Raster_16T mem_alarm_cycle.R15.Restart_Raster_16T mem_alarm_cycle.R16.Restart_Raster_16T minRunTime.R01_Mon.Restart_Raster_16T minRunTime.R02_Mon.Restart_Raster_16T minRunTime.R03_Mon.Restart_Raster_16T minRunTime.R04_Sync_Mon.Restart_Raster_16T netRunTime.R01_Mon.Restart_Raster_16T netRunTime.R02_Mon.Restart_Raster_16T netRunTime.R03_Mon.Restart_Raster_16T netRunTime.R04_Sync_Mon.Restart_Raster_16T /end REF_MEASUREMENT
 /begin REF_CHARACTERISTIC Alarm_ID.R01.Restart_Raster_16T Alarm_ID.R02.Restart_Raster_16T Alarm_ID.R03.Restart_Raster_16T Alarm_ID.R04_Sync.Restart_Raster_16T Alarm_ID.R05.Restart_Raster_16T Alarm_ID.R06.Restart_Raster_16T Alarm_ID.R07.Restart_Raster_16T Alarm_ID.R08.Restart_Raster_16T Alarm_ID.R09.Restart_Raster_16T Alarm_ID.R10.Restart_Raster_16T Alarm_ID.R11.Restart_Raster_16T Alarm_ID.R12.Restart_Raster_16T Alarm_ID.R13.Restart_Raster_16T Alarm_ID.R14.Restart_Raster_16T Alarm_ID.R15.Restart_Raster_16T Alarm_ID.R16.Restart_Raster_16T P_alarm_cycle.R01.Restart_Raster_16T P_alarm_cycle.R02.Restart_Raster_16T P_alarm_cycle.R03.Restart_Raster_16T P_alarm_cycle.R04_Sync.Restart_Raster_16T P_alarm_cycle.R05.Restart_Raster_16T P_alarm_cycle.R06.Restart_Raster_16T P_alarm_cycle.R07.Restart_Raster_16T P_alarm_cycle.R08.Restart_Raster_16T P_alarm_cycle.R09.Restart_Raster_16T P_alarm_cycle.R10.Restart_Raster_16T P_alarm_cycle.R11.Restart_Raster_16T P_alarm_cycle.R12.Restart_Raster_16T P_alarm_cycle.R13.Restart_Raster_16T P_alarm_cycle.R14.Restart_Raster_16T P_alarm_cycle.R15.Restart_Raster_16T P_alarm_cycle.R16.Restart_Raster_16T P_alarm_cycle_delay.R01.Restart_Raster_16T P_alarm_cycle_delay.R02.Restart_Raster_16T P_alarm_cycle_delay.R03.Restart_Raster_16T P_alarm_cycle_delay.R04_Sync.Restart_Raster_16T P_alarm_cycle_delay.R05.Restart_Raster_16T P_alarm_cycle_delay.R06.Restart_Raster_16T P_alarm_cycle_delay.R07.Restart_Raster_16T P_alarm_cycle_delay.R08.Restart_Raster_16T P_alarm_cycle_delay.R09.Restart_Raster_16T P_alarm_cycle_delay.R10.Restart_Raster_16T P_alarm_cycle_delay.R11.Restart_Raster_16T P_alarm_cycle_delay.R12.Restart_Raster_16T P_alarm_cycle_delay.R13.Restart_Raster_16T P_alarm_cycle_delay.R14.Restart_Raster_16T P_alarm_cycle_delay.R15.Restart_Raster_16T P_alarm_cycle_delay.R16.Restart_Raster_16T P_asynchron_alarm_cycle.R01.Restart_Raster_16T P_asynchron_alarm_cycle.R04_Sync.Restart_Raster_16T asynchron_alarm_cycle_times_array.R01.Restart_Raster_16T asynchron_alarm_cycle_times_array.R04_Sync.Restart_Raster_16T p_enableSyncR04burst_u8.Restart_Raster_16T /end REF_CHARACTERISTIC
 /begin SUB_GROUP AT2ms.Restart_Raster_16T ATRestartRaster.Restart_Raster_16T R01.Restart_Raster_16T R01_Mon.Restart_Raster_16T R02.Restart_Raster_16T R02_Mon.Restart_Raster_16T R03.Restart_Raster_16T R03_Mon.Restart_Raster_16T R04_Sync.Restart_Raster_16T R04_Sync_Mon.Restart_Raster_16T R05.Restart_Raster_16T R06.Restart_Raster_16T R07.Restart_Raster_16T R08.Restart_Raster_16T R09.Restart_Raster_16T R10.Restart_Raster_16T R11.Restart_Raster_16T R12.Restart_Raster_16T R13.Restart_Raster_16T R14.Restart_Raster_16T R15.Restart_Raster_16T R16.Restart_Raster_16T /end SUB_GROUP
/end GROUP
/begin GROUP RuntimeTaskFrame "" ROOT
 /begin REF_MEASUREMENT LocalTickBuffer_100ms.RuntimeTaskFrame LocalTickBuffer_10ms.RuntimeTaskFrame LocalTickBuffer_50ms.RuntimeTaskFrame LocalTickBuffer_Bkgnd.RuntimeTaskFrame RequestOutputDisable_100ms.RuntimeTaskFrame RequestOutputDisable_10ms.RuntimeTaskFrame RequestOutputDisable_50ms.RuntimeTaskFrame RequestOutputDisable_Bkgnd.RuntimeTaskFrame SIKOERROR_BkgndVarInconsistent.RuntimeTaskFrame ticks_per_activation.RuntimeTaskFrame /end REF_MEASUREMENT
 /begin REF_CHARACTERISTIC Ticks_per_activation_100ms.RuntimeTaskFrame Ticks_per_activation_10ms.RuntimeTaskFrame Ticks_per_activation_50ms.RuntimeTaskFrame Ticks_per_activation_Bkgnd.RuntimeTaskFrame Ticks_per_activation_initvalue.RuntimeTaskFrame /end REF_CHARACTERISTIC
/end GROUP
/begin GROUP SHELL.BASE ""
 /begin SUB_GROUP HWE_CAN_A.SHELL.BASE HWE_CAN_B.SHELL.BASE HWE_CAN_C.SHELL.BASE /end SUB_GROUP
/end GROUP
/begin GROUP SIKO_Module "" ROOT
 /begin REF_MEASUREMENT APPL_RequestOutputDisable.SIKO_Module Cyclic_RAMCheck_ActError.SIKO_Module Cyclic_RAMCheck_ActStatus.SIKO_Module Cyclic_ROMCheck_ActError.SIKO_Module Cyclic_ROMCheck_ActStatus.SIKO_Module EARDelayTime.SIKO_Module EHookOn75.SIKO_Module ERCOS_EStackSize.SIKO_Module ERCOS_EStackUsed.SIKO_Module ERCOS_StackStatus.SIKO_Module ERCOS_UStackSize.SIKO_Module ERCOS_UStackUsed.SIKO_Module HWE_RAMCheck_Err.SIKO_Module HWE_RAMCheck_Stat.SIKO_Module HWE_ROMCheck_Err.SIKO_Module HWE_ROMCheck_Stat.SIKO_Module SIKODIAG_ActualStackError.SIKO_Module SIKODIAG_Counterproblem.SIKO_Module SIKODIAG_PercentEStackUsed.SIKO_Module SIKODIAG_PercentUStackUsed.SIKO_Module SIKODIAG_StackError.SIKO_Module SIKODIAG_WDAHigh_Failure.SIKO_Module SIKODIAG_WDALow_Failure.SIKO_Module SIKODIAG_WDA_Active.SIKO_Module SIKODIAG_aktCounterproblem.SIKO_Module SIKO_Counters.SIKO_Module SIKO_DisableWDRetrigger.SIKO_Module SIKO_OutputDisableDelay.SIKO_Module SIKO_RequestOutputDisable.SIKO_Module SIKO_RequestOutputDisableDelayed.SIKO_Module SIKO_WDAHigh_FailureDelay_u8.SIKO_Module SIKO_WDALow_FailureDelay_u8.SIKO_Module /end REF_MEASUREMENT
 /begin REF_CHARACTERISTIC HWE_Enter_NL_Debug.SIKO_Module SIKO_AR_CounterReloads.SIKO_Module SIKO_CounterReloadDisable.SIKO_Module SIKO_CounterReloads.SIKO_Module SIKO_DisableCounterCheck.SIKO_Module SIKO_DisableOutputCheck.SIKO_Module SIKO_OutputDisableDelay_Cal.SIKO_Module SIKO_StackCheckDisable.SIKO_Module SIKO_StackCrashEnable.SIKO_Module SIKO_WDA_FailureDelay_Cal.SIKO_Module /end REF_CHARACTERISTIC
/end GROUP
/begin GROUP Type_Tests_EXTERN "" ROOT
 /begin REF_MEASUREMENT l_t01_bool_0.Type_Tests_EXTERN l_t01_bool_1.Type_Tests_EXTERN l_t01_bool_2.Type_Tests_EXTERN l_t01_bool_3.Type_Tests_EXTERN l_t01_bool_4.Type_Tests_EXTERN l_t01_bool_5.Type_Tests_EXTERN l_t01_bool_6.Type_Tests_EXTERN l_t01_bool_7.Type_Tests_EXTERN l_t01_f32_0.Type_Tests_EXTERN l_t01_f32_1.Type_Tests_EXTERN l_t01_f32_2.Type_Tests_EXTERN l_t01_f32_3.Type_Tests_EXTERN l_t01_f32_4.Type_Tests_EXTERN l_t01_f32_5.Type_Tests_EXTERN l_t01_f32_6.Type_Tests_EXTERN l_t01_f32_7.Type_Tests_EXTERN l_t01_f64_0.Type_Tests_EXTERN l_t01_f64_1.Type_Tests_EXTERN l_t01_f64_2.Type_Tests_EXTERN l_t01_f64_3.Type_Tests_EXTERN l_t01_f64_4.Type_Tests_EXTERN l_t01_f64_5.Type_Tests_EXTERN l_t01_f64_6.Type_Tests_EXTERN l_t01_f64_7.Type_Tests_EXTERN l_t01_s16_0.Type_Tests_EXTERN l_t01_s16_1.Type_Tests_EXTERN l_t01_s16_2.Type_Tests_EXTERN l_t01_s16_3.Type_Tests_EXTERN l_t01_s16_4.Type_Tests_EXTERN l_t01_s16_5.Type_Tests_EXTERN l_t01_s16_6.Type_Tests_EXTERN l_t01_s16_7.Type_Tests_EXTERN l_t01_s32_0.Type_Tests_EXTERN l_t01_s32_1.Type_Tests_EXTERN l_t01_s32_2.Type_Tests_EXTERN l_t01_s32_3.Type_Tests_EXTERN l_t01_s32_4.Type_Tests_EXTERN l_t01_s32_5.Type_Tests_EXTERN l_t01_s32_6.Type_Tests_EXTERN l_t01_s32_7.Type_Tests_EXTERN l_t01_s8_0.Type_Tests_EXTERN l_t01_s8_1.Type_Tests_EXTERN l_t01_s8_2.Type_Tests_EXTERN l_t01_s8_3.Type_Tests_EXTERN l_t01_s8_4.Type_Tests_EXTERN l_t01_s8_5.Type_Tests_EXTERN l_t01_s8_6.Type_Tests_EXTERN l_t01_s8_7.Type_Tests_EXTERN l_t01_u16_0.Type_Tests_EXTERN l_t01_u16_1.Type_Tests_EXTERN l_t01_u16_2.Type_Tests_EXTERN l_t01_u16_3.Type_Tests_EXTERN l_t01_u16_4.Type_Tests_EXTERN l_t01_u16_5.Type_Tests_EXTERN l_t01_u16_6.Type_Tests_EXTERN l_t01_u16_7.Type_Tests_EXTERN l_t01_u32_0.Type_Tests_EXTERN l_t01_u32_1.Type_Tests_EXTERN l_t01_u32_2.Type_Tests_EXTERN l_t01_u32_3.Type_Tests_EXTERN l_t01_u32_4.Type_Tests_EXTERN l_t01_u32_5.Type_Tests_EXTERN l_t01_u32_6.Type_Tests_EXTERN l_t01_u32_7.Type_Tests_EXTERN l_t01_u8_0.Type_Tests_EXTERN l_t01_u8_1.Type_Tests_EXTERN l_t01_u8_2.Type_Tests_EXTERN l_t01_u8_3.Type_Tests_EXTERN l_t01_u8_4.Type_Tests_EXTERN l_t01_u8_5.Type_Tests_EXTERN l_t01_u8_6.Type_Tests_EXTERN l_t01_u8_7.Type_Tests_EXTERN l_t02_bool_0.Type_Tests_EXTERN l_t02_bool_1.Type_Tests_EXTERN l_t02_bool_2.Type_Tests_EXTERN l_t02_bool_3.Type_Tests_EXTERN l_t02_bool_4.Type_Tests_EXTERN l_t02_bool_5.Type_Tests_EXTERN l_t02_bool_6.Type_Tests_EXTERN l_t02_bool_7.Type_Tests_EXTERN /end REF_MEASUREMENT
 /begin REF_CHARACTERISTIC p_t01_bool.Type_Tests_EXTERN p_t01_f32.Type_Tests_EXTERN p_t01_f64.Type_Tests_EXTERN p_t01_s16.Type_Tests_EXTERN p_t01_s32.Type_Tests_EXTERN p_t01_s8.Type_Tests_EXTERN p_t01_u16.Type_Tests_EXTERN p_t01_u32.Type_Tests_EXTERN p_t01_u8.Type_Tests_EXTERN p_t02_bool.Type_Tests_EXTERN /end REF_CHARACTERISTIC
/end GROUP
/begin GROUP UDS_100ms_R03_SLOW1.UdsSendList "" /begin REF_MEASUREMENT i_Raster_u8.UDS_100ms_R03_SLOW1.UdsSendList /end REF_MEASUREMENT
 /begin REF_CHARACTERISTIC pi_FirstCanID_u32.UDS_100ms_R03_SLOW1.UdsSendList pi_LastCanID_u32.UDS_100ms_R03_SLOW1.UdsSendList /end REF_CHARACTERISTIC
/end GROUP
/begin GROUP UDS_10ms_R01_FAST3.UdsSendList "" /begin REF_MEASUREMENT i_Raster_u8.UDS_10ms_R01_FAST3.UdsSendList /end REF_MEASUREMENT
 /begin REF_CHARACTERISTIC pi_FirstCanID_u32.UDS_10ms_R01_FAST3.UdsSendList pi_LastCanID_u32.UDS_10ms_R01_FAST3.UdsSendList /end REF_CHARACTERISTIC
/end GROUP
/begin GROUP UDS_50ms_R02_MEDIUM2.UdsSendList "" /begin REF_MEASUREMENT i_Raster_u8.UDS_50ms_R02_MEDIUM2.UdsSendList /end REF_MEASUREMENT
 /begin REF_CHARACTERISTIC pi_FirstCanID_u32.UDS_50ms_R02_MEDIUM2.UdsSendList pi_LastCanID_u32.UDS_50ms_R02_MEDIUM2.UdsSendList /end REF_CHARACTERISTIC
/end GROUP
/begin GROUP UdsLocIDs "" ROOT
 /begin REF_MEASUREMENT g_UdsBufLocId_au32.UdsLocIDs g_UdsLocId_pu32.UdsLocIDs g_UdsLocIds_apu32.UdsLocIDs /end REF_MEASUREMENT
 /begin REF_CHARACTERISTIC p_UDSmaxLocIds_u8.UdsLocIDs /end REF_CHARACTERISTIC
 /begin SUB_GROUP C_ClassUdsVIN.UdsLocIDs C_ClassUdsVIN2.UdsLocIDs /end SUB_GROUP
/end GROUP
/begin GROUP UdsSendList "" ROOT
 /begin REF_MEASUREMENT _g_UdsSendList_pu32.UdsSendList_save.UdsSendList c_NumLists_u8.UdsSendList g_UdsAddressing_u8.UdsSendList_save.UdsSendList g_UdsCanIDEcu_u32.UdsSendList_save.UdsSendList g_UdsCanIDInca_u32.UdsSendList_save.UdsSendList g_UdsID_TGT_ECU_u8.UdsSendList_save.UdsSendList g_UdsID_TGT_INCA_u8.UdsSendList_save.UdsSendList g_UdsRasterList_apu32.UdsSendList g_UdsSendList1Elem_u32.UdsSendList_save.UdsSendList g_UdsSendList1Val_u32.UdsSendList_save.UdsSendList g_UdsSendList_au32.UdsSendList g_UdsSendList_pu32.UdsSendList_save.UdsSendList g_UdsSendLists_apu32.UdsSendList i_Raster_u8.UDS_100ms_R03_SLOW1.UdsSendList i_Raster_u8.UDS_10ms_R01_FAST3.UdsSendList i_Raster_u8.UDS_50ms_R02_MEDIUM2.UdsSendList /end REF_MEASUREMENT
 /begin REF_CHARACTERISTIC p_UdsCanIDEcu_u32.UdsSendList_save.UdsSendList p_UdsCanIDInca_u32.UdsSendList_save.UdsSendList p_UdsCanIDMode_u8.UdsSendList p_UdsID_TGT_ECU_u8.UdsSendList_save.UdsSendList p_UdsID_TGT_INCA_u8.UdsSendList_save.UdsSendList p_UdsSendList1Elem_u32.UdsSendList_save.UdsSendList p_UdsSendList1Val_u32.UdsSendList_save.UdsSendList pi_FirstCanID_u32.UDS_100ms_R03_SLOW1.UdsSendList pi_FirstCanID_u32.UDS_10ms_R01_FAST3.UdsSendList pi_FirstCanID_u32.UDS_50ms_R02_MEDIUM2.UdsSendList pi_LastCanID_u32.UDS_100ms_R03_SLOW1.UdsSendList pi_LastCanID_u32.UDS_10ms_R01_FAST3.UdsSendList pi_LastCanID_u32.UDS_50ms_R02_MEDIUM2.UdsSendList /end REF_CHARACTERISTIC
 /begin SUB_GROUP C_ClassUdsSendList01.UdsSendList C_ClassUdsSendList02.UdsSendList C_ClassUdsSendList03.UdsSendList C_ClassUdsSendList04.UdsSendList C_ClassUdsSendList05.UdsSendList C_ClassUdsSendList06.UdsSendList C_ClassUdsSendList07.UdsSendList C_ClassUdsSendList08.UdsSendList C_ClassUdsSendList09.UdsSendList C_ClassUdsSendList10.UdsSendList C_ClassUdsSendList11.UdsSendList C_ClassUdsSendList12.UdsSendList C_ClassUdsSendList13.UdsSendList C_ClassUdsSendList14.UdsSendList C_ClassUdsSendList15.UdsSendList C_ClassUdsSendList16.UdsSendList C_ClassUdsSendList17.UdsSendList C_ClassUdsSendList18.UdsSendList C_ClassUdsSendList19.UdsSendList C_ClassUdsSendList20.UdsSendList C_ClassUdsSendList21.UdsSendList C_ClassUdsSendList22.UdsSendList C_ClassUdsSendList23.UdsSendList C_ClassUdsSendList24.UdsSendList UDS_100ms_R03_SLOW1.UdsSendList UDS_10ms_R01_FAST3.UdsSendList UDS_50ms_R02_MEDIUM2.UdsSendList UdsSendList_save.UdsSendList /end SUB_GROUP
/end GROUP
/begin GROUP UdsSendList_save.UdsSendList ""
 /begin REF_MEASUREMENT _g_UdsSendList_pu32.UdsSendList_save.UdsSendList g_UdsAddressing_u8.UdsSendList_save.UdsSendList g_UdsCanIDEcu_u32.UdsSendList_save.UdsSendList g_UdsCanIDInca_u32.UdsSendList_save.UdsSendList g_UdsID_TGT_ECU_u8.UdsSendList_save.UdsSendList g_UdsID_TGT_INCA_u8.UdsSendList_save.UdsSendList g_UdsSendList1Elem_u32.UdsSendList_save.UdsSendList g_UdsSendList1Val_u32.UdsSendList_save.UdsSendList g_UdsSendList_pu32.UdsSendList_save.UdsSendList /end REF_MEASUREMENT
 /begin REF_CHARACTERISTIC p_UdsCanIDEcu_u32.UdsSendList_save.UdsSendList p_UdsCanIDInca_u32.UdsSendList_save.UdsSendList p_UdsID_TGT_ECU_u8.UdsSendList_save.UdsSendList p_UdsID_TGT_INCA_u8.UdsSendList_save.UdsSendList p_UdsSendList1Elem_u32.UdsSendList_save.UdsSendList p_UdsSendList1Val_u32.UdsSendList_save.UdsSendList /end REF_CHARACTERISTIC
/end GROUP
/begin GROUP Watchdog_Module "" ROOT
 /begin REF_MEASUREMENT WDMod_CY315ErrorCounter.Watchdog_Module WDMod_ErrorFlagCounters_u16.Watchdog_Module WDMod_Request.Watchdog_Module WDMod_RespTimeTicks_u32.Watchdog_Module WDMod_State.Watchdog_Module WDMod_fCy315_u16.Watchdog_Module WDMod_stInitDone_b.Watchdog_Module WDMod_stTranOn_u8.Watchdog_Module WDMod_stTransData_u8.Watchdog_Module WDMod_tiLastTr_u32.Watchdog_Module WDMod_tiNextTr_u32.Watchdog_Module WDMod_tiTrans_u32.Watchdog_Module WD_WDDiag_ByteCounter.Watchdog_Module WD_WDDiag_CallRes.Watchdog_Module WD_WDDiag_RespError.Watchdog_Module WD_WDDiag_RespStat.Watchdog_Module WD_WDDiag_TimerCFG.Watchdog_Module WD_WDDiag_WDA_CY315INT.Watchdog_Module WD_WDDiag_actRespTime_u8.Watchdog_Module WD_WDDiag_fCy315_u16.Watchdog_Module WD_WDDiag_tiCurRespTime.Watchdog_Module WD_WDDiag_tiLastReq_u32.Watchdog_Module /end REF_MEASUREMENT
 /begin REF_CHARACTERISTIC WDMod_InvertAnswer_Cal.Watchdog_Module WDMod_WatchdogPeriod_Cal.Watchdog_Module /end REF_CHARACTERISTIC
/end GROUP
/begin GROUP XCP_ErrorHook.XCP_SHELL ""
 /begin REF_MEASUREMENT g_XcpNumError_u8.XCP_ErrorHook.XCP_SHELL g_XcpTriggerError_u8.XCP_ErrorHook.XCP_SHELL /end REF_MEASUREMENT
 /begin REF_CHARACTERISTIC p_XcpErrBasePat_au8.XCP_ErrorHook.XCP_SHELL p_XcpErrFilter_au8.XCP_ErrorHook.XCP_SHELL p_XcpErrorPrescaler_u8.XCP_ErrorHook.XCP_SHELL p_XcpNumError_u8.XCP_ErrorHook.XCP_SHELL p_XcpResponce_u8.XCP_ErrorHook.XCP_SHELL p_XcpTriggerError_u8.XCP_ErrorHook.XCP_SHELL /end REF_CHARACTERISTIC
/end GROUP
/begin GROUP XCP_Failure.XCP_SHELL ""
 /begin REF_MEASUREMENT g_XcpDisableDaqTransmition_b.XCP_Failure.XCP_SHELL g_XcpErrorClear_u8.XCP_Failure.XCP_SHELL g_XcpError_u8.XCP_Failure.XCP_SHELL g_XcpTestOdtOptResult_u8.XCP_Failure.XCP_SHELL g_XcpTrigDaqFailure_u8.XCP_Failure.XCP_SHELL g_XcpTrigOdtFailure_u8.XCP_Failure.XCP_SHELL g_XcpTrigOverload_u8.XCP_Failure.XCP_SHELL /end REF_MEASUREMENT
 /begin REF_CHARACTERISTIC p_XcpDisableDaqTransmition_b.XCP_Failure.XCP_SHELL p_XcpErrorClear_u8.XCP_Failure.XCP_SHELL p_XcpTestOdtOptSendResult_u8.XCP_Failure.XCP_SHELL p_XcpTestOdtOpt_u8.XCP_Failure.XCP_SHELL p_XcpTrigDaqFailure_u8.XCP_Failure.XCP_SHELL p_XcpTrigOdtFailure_u8.XCP_Failure.XCP_SHELL p_XcpTrigOverload_u8.XCP_Failure.XCP_SHELL /end REF_CHARACTERISTIC
/end GROUP
/begin GROUP XCP_PredefinedTypes "" ROOT
 /begin REF_MEASUREMENT g_Pre01_f32_0.XCP_PredefinedTypes g_Pre01_s16_0.XCP_PredefinedTypes g_Pre01_s32_0.XCP_PredefinedTypes g_Pre01_s8_0.XCP_PredefinedTypes g_Pre01_s8_1.XCP_PredefinedTypes g_Pre01_u16_0.XCP_PredefinedTypes g_Pre01_u32_0.XCP_PredefinedTypes g_Pre01_u8_0.XCP_PredefinedTypes g_Pre01_u8_1.XCP_PredefinedTypes /end REF_MEASUREMENT
 /begin REF_CHARACTERISTIC p_t01_f32.XCP_PredefinedTypes p_t01_s16.XCP_PredefinedTypes p_t01_s32.XCP_PredefinedTypes p_t01_s8.XCP_PredefinedTypes p_t01_u16.XCP_PredefinedTypes p_t01_u32.XCP_PredefinedTypes p_t01_u8.XCP_PredefinedTypes /end REF_CHARACTERISTIC
/end GROUP
/begin GROUP XCP_SHELL "" ROOT
 /begin REF_MEASUREMENT XCP_ODT_tx_status.XCP_SHELL XCP_Status.XCP_SHELL_VAR.XCP_SHELL XCP_Temp.XCP_SHELL c_power_u8.XCP_SHELL_VAR.XCP_SHELL debugflag.XCP_SHELL g_AcceptAllKeys_u8.XCP_SHELL_VAR.XCP_SHELL g_TriggerOverload_u8.XCP_SHELL_VAR.XCP_SHELL g_XcpAutoResetAfterStoreDaq_u8.XCP_SHELL_VAR.XCP_SHELL g_XcpBitStimSupport_u8.XCP_SHELL_VAR.XCP_SHELL g_XcpBitStimVersion_u8.XCP_SHELL_VAR.XCP_SHELL g_XcpBlockDownloadMaxBS_u8.XCP_SHELL_VAR.XCP_SHELL g_XcpBlockDownloadMinST_u8.XCP_SHELL_VAR.XCP_SHELL g_XcpBlockFlashMaxBS_u8.XCP_SHELL_VAR.XCP_SHELL g_XcpBlockFlashMinST_u8.XCP_SHELL_VAR.XCP_SHELL g_XcpByteOrder_u8.XCP_SHELL_VAR.XCP_SHELL g_XcpCommModeBasic_u8.XCP_SHELL_VAR.XCP_SHELL g_XcpCommModeOptional_u8.XCP_SHELL_VAR.XCP_SHELL g_XcpCommModePgm_u8.XCP_SHELL_VAR.XCP_SHELL g_XcpConnectResetECU_u8.XCP_SHELL_VAR.XCP_SHELL g_XcpCtoMaxPgm_u8.XCP_SHELL_VAR.XCP_SHELL g_XcpCtoMax_u8.XCP_SHELL_VAR.XCP_SHELL g_XcpDaqConfigType_u8.XCP_SHELL_VAR.XCP_SHELL g_XcpDaqKeyByte_u8.XCP_SHELL_VAR.XCP_SHELL g_XcpDaqListProperties_u8.XCP_SHELL_VAR.XCP_SHELL g_XcpDaqProperties_u8.XCP_SHELL_VAR.XCP_SHELL g_XcpDisableDaqTransmition_b.XCP_Failure.XCP_SHELL g_XcpDtoMax_u16.XCP_SHELL_VAR.XCP_SHELL g_XcpErrorClear_u8.XCP_Failure.XCP_SHELL g_XcpError_u8.XCP_Failure.XCP_SHELL g_XcpEtasTool_u8.XCP_SHELL_VAR.XCP_SHELL g_XcpGranularityOdtEntrySizeDaq_u8.XCP_SHELL_VAR.XCP_SHELL g_XcpGranularityOdtEntrySizeStim_u8.XCP_SHELL_VAR.XCP_SHELL g_XcpIdentFieldType_u8.XCP_SHELL_VAR.XCP_SHELL g_XcpMasterBlockmodeOn_u8.XCP_SHELL_VAR.XCP_SHELL g_XcpMasterBlockmodePgmOn_u8.XCP_SHELL_VAR.XCP_SHELL g_XcpMasterPowerOn_u8_unused.XCP_SHELL_VAR.XCP_SHELL g_XcpMaxDaq_u16.XCP_SHELL_VAR.XCP_SHELL g_XcpMaxEventNo_u16.XCP_SHELL_VAR.XCP_SHELL g_XcpMaxOdtEntrySizeDaq_u8.XCP_SHELL_VAR.XCP_SHELL g_XcpMaxOdtEntrySizeStim_u8.XCP_SHELL_VAR.XCP_SHELL g_XcpMaxPredefDaq_u8.XCP_SHELL_VAR.XCP_SHELL g_XcpMinDaq_u8.XCP_SHELL_VAR.XCP_SHELL g_XcpNumError_u8.XCP_ErrorHook.XCP_SHELL g_XcpOverloadType_u8.XCP_SHELL_VAR.XCP_SHELL g_XcpPIDoffSupport_u8.XCP_SHELL_VAR.XCP_SHELL g_XcpPagProperties_u8.XCP_SHELL_VAR.XCP_SHELL g_XcpPowerOn_u8.XCP_SHELL_VAR.XCP_SHELL g_XcpPrescalerSupport_u8.XCP_SHELL_VAR.XCP_SHELL g_XcpResetConfig_u8.XCP_SHELL_VAR.XCP_SHELL g_XcpResourceProtect_u8.XCP_SHELL_VAR.XCP_SHELL g_XcpResource_u8.XCP_SHELL_VAR.XCP_SHELL g_XcpResumeMasterConnectTimeoutCheck_u8.XCP_SHELL_VAR.XCP_SHELL g_XcpResumeMasterConnectTimeoutStart_u32.XCP_SHELL_VAR.XCP_SHELL g_XcpResumeMasterConnectTimeout_u32.XCP_SHELL_VAR.XCP_SHELL g_XcpResumeSupport_u8.XCP_SHELL_VAR.XCP_SHELL g_XcpSessStatus_u8.XCP_SHELL_VAR.XCP_SHELL g_XcpSessStatus_u8_nv.XCP_SHELL_VAR.XCP_SHELL g_XcpSlaveBlockmodeOn_u8.XCP_SHELL_VAR.XCP_SHELL g_XcpStateBypEv0_u8.XCP_SHELL g_XcpSwitchBackground_u8.XCP_SHELL_VAR.XCP_SHELL g_XcpTestOdtOptResult_u8.XCP_Failure.XCP_SHELL g_XcpTestOdtOptSendResult_u8.XCP_SHELL_VAR.XCP_SHELL g_XcpTestOdtOpt_u8.XCP_SHELL_VAR.XCP_SHELL g_XcpTickDurationEcu_f32.XCP_SHELL_VAR.XCP_SHELL g_XcpTickDurationPrescaler_f32.XCP_SHELL_VAR.XCP_SHELL g_XcpTickDuration_f32.XCP_SHELL_VAR.XCP_SHELL g_XcpTimestampFix_u8.XCP_SHELL_VAR.XCP_SHELL g_XcpTimestampMode_u8.XCP_SHELL_VAR.XCP_SHELL g_XcpTimestampProp_u8.XCP_SHELL_VAR.XCP_SHELL g_XcpTimestampSupport_u8.XCP_SHELL_VAR.XCP_SHELL g_XcpTimestampTicks_u16.XCP_SHELL_VAR.XCP_SHELL g_XcpTimestampUnit_u8.XCP_SHELL_VAR.XCP_SHELL g_XcpTimstampSize_u8.XCP_SHELL_VAR.XCP_SHELL g_XcpTrigDaqFailure_u8.XCP_Failure.XCP_SHELL g_XcpTrigOdtFailure_u8.XCP_Failure.XCP_SHELL g_XcpTrigOverload_u8.XCP_Failure.XCP_SHELL g_XcpTrigResume_u8.XCP_SHELL_VAR.XCP_SHELL g_XcpTriggerError_u8.XCP_ErrorHook.XCP_SHELL g_power_u8.XCP_SHELL_VAR.XCP_SHELL gm_XcpAddrOptimization_u8.XCP_SHELL_VAR.XCP_SHELL gm_XcpResumemodeCompare_u32.XCP_SHELL_VAR.XCP_SHELL gm_XcpResumemodeCounterEv0_u32.XCP_SHELL_VAR.XCP_SHELL gm_XcpResumemodeCounterEv1_u32.XCP_SHELL_VAR.XCP_SHELL gm_XcpResumemodeCounterEv2_u32.XCP_SHELL_VAR.XCP_SHELL gm_XcpResumemodeCounter_u32.XCP_SHELL_VAR.XCP_SHELL gm_XcpSizeOptimization_u8.XCP_SHELL_VAR.XCP_SHELL mg_AcceptAllKeys_u8.XCP_SHELL_VAR.XCP_SHELL mg_SwitchConfig_ECU_u8.XCP_SHELL_VAR.XCP_SHELL mg_TriggerOverload_u8.XCP_SHELL_VAR.XCP_SHELL mg_XcpAutoResetAfterStoreDaq_u8.XCP_SHELL_VAR.XCP_SHELL mg_XcpBlockDownloadMaxBS_u8.XCP_SHELL_VAR.XCP_SHELL mg_XcpBlockDownloadMinST_u8.XCP_SHELL_VAR.XCP_SHELL mg_XcpBlockFlashMaxBS_u8.XCP_SHELL_VAR.XCP_SHELL mg_XcpBlockFlashMinST_u8.XCP_SHELL_VAR.XCP_SHELL mg_XcpCommModeBasic_u8.XCP_SHELL_VAR.XCP_SHELL mg_XcpCommModeOptional_u8.XCP_SHELL_VAR.XCP_SHELL mg_XcpCommModePgm_u8.XCP_SHELL_VAR.XCP_SHELL mg_XcpConnectResetECU_u8.XCP_SHELL_VAR.XCP_SHELL mg_XcpCtoMaxPgm_u8.XCP_SHELL_VAR.XCP_SHELL mg_XcpCtoMax_u8.XCP_SHELL_VAR.XCP_SHELL mg_XcpDaqKeyByte_u8.XCP_SHELL_VAR.XCP_SHELL mg_XcpDaqListProperties_u8.XCP_SHELL_VAR.XCP_SHELL mg_XcpDaqProperties_u8.XCP_SHELL_VAR.XCP_SHELL mg_XcpDisableDaqTransmition_b.XCP_SHELL_VAR.XCP_SHELL mg_XcpDtoMax_u16.XCP_SHELL_VAR.XCP_SHELL mg_XcpEtasTool_u8.XCP_SHELL_VAR.XCP_SHELL mg_XcpGranularityOdtEntrySizeDaq_u8.XCP_SHELL_VAR.XCP_SHELL mg_XcpGranularityOdtEntrySizeStim_u8.XCP_SHELL_VAR.XCP_SHELL mg_XcpMaxDaq_u16.XCP_SHELL_VAR.XCP_SHELL mg_XcpMaxEventNo_u16.XCP_SHELL_VAR.XCP_SHELL mg_XcpMaxOdtEntrySizeDaq_u8.XCP_SHELL_VAR.XCP_SHELL mg_XcpMaxOdtEntrySizeStim_u8.XCP_SHELL_VAR.XCP_SHELL mg_XcpMinDaq_u8.XCP_SHELL_VAR.XCP_SHELL mg_XcpPagProperties_u8.XCP_SHELL_VAR.XCP_SHELL mg_XcpResourceProtect_u8.XCP_SHELL_VAR.XCP_SHELL mg_XcpResource_u8.XCP_SHELL_VAR.XCP_SHELL mg_XcpSwitchBackground_u8.XCP_SHELL_VAR.XCP_SHELL mg_XcpTestCase_u8_in.XCP_SHELL_VAR.XCP_SHELL mg_XcpTestCase_u8_out.XCP_SHELL_VAR.XCP_SHELL mg_XcpTestOdtOptResult_u8.XCP_SHELL_VAR.XCP_SHELL mg_XcpTestOdtOptSendResult_u8.XCP_SHELL_VAR.XCP_SHELL mg_XcpTestOdtOpt_u8.XCP_SHELL_VAR.XCP_SHELL mg_XcpTickDurationEcu_f32.XCP_SHELL_VAR.XCP_SHELL mg_XcpTimestampMode_u8.XCP_SHELL_VAR.XCP_SHELL mg_XcpTimestampProp_u8.XCP_SHELL_VAR.XCP_SHELL mg_XcpTimestampTicks_u16.XCP_SHELL_VAR.XCP_SHELL mg_XcpTrigDaqFailure_u8.XCP_SHELL_VAR.XCP_SHELL mg_XcpTrigOdtFailure_u8.XCP_SHELL_VAR.XCP_SHELL mg_XcpTrigOverload_u8.XCP_SHELL_VAR.XCP_SHELL mg_XcpTrigResume_u8.XCP_SHELL_VAR.XCP_SHELL mg_power_u8.XCP_SHELL_VAR.XCP_SHELL /end REF_MEASUREMENT
 /begin REF_CHARACTERISTIC XCP_Variants.XCP_SHELL p_AcceptAllKeys_u8.XCP_SHELL_VAR.XCP_SHELL p_SwitchConfig_ECU_u8.XCP_SHELL_VAR.XCP_SHELL p_TriggerOverload_u8.XCP_SHELL_VAR.XCP_SHELL p_XcpAutoResetAfterStoreDaq_u8.XCP_SHELL_VAR.XCP_SHELL p_XcpBitStimVersion_u8.XCP_SHELL_VAR.XCP_SHELL p_XcpBlockDownloadMaxBS_u8.XCP_SHELL_VAR.XCP_SHELL p_XcpBlockDownloadMinST_u8.XCP_SHELL_VAR.XCP_SHELL p_XcpBlockFlashMaxBS_u8.XCP_SHELL_VAR.XCP_SHELL p_XcpBlockFlashMinST_u8.XCP_SHELL_VAR.XCP_SHELL p_XcpChecksumByteOrder_u8.XCP_SHELL_VAR.XCP_SHELL p_XcpChecksumType_u8.XCP_SHELL_VAR.XCP_SHELL p_XcpCommModeBasic_u8.XCP_SHELL_VAR.XCP_SHELL p_XcpCommModeOptional_u8.XCP_SHELL_VAR.XCP_SHELL p_XcpCommModePgm_u8.XCP_SHELL_VAR.XCP_SHELL p_XcpConnectResetECU_u8.XCP_SHELL_VAR.XCP_SHELL p_XcpCtoMaxPgm_u8.XCP_SHELL_VAR.XCP_SHELL p_XcpCtoMax_u8.XCP_SHELL_VAR.XCP_SHELL p_XcpDaqKeyByte_u8.XCP_SHELL_VAR.XCP_SHELL p_XcpDaqListProperties_u8.XCP_SHELL_VAR.XCP_SHELL p_XcpDaqProperties_u8.XCP_SHELL_VAR.XCP_SHELL p_XcpDisableDaqTransmition_b.XCP_Failure.XCP_SHELL p_XcpDtoMax_u16.XCP_SHELL_VAR.XCP_SHELL p_XcpErrBasePat_au8.XCP_ErrorHook.XCP_SHELL p_XcpErrFilter_au8.XCP_ErrorHook.XCP_SHELL p_XcpErrorClear_u8.XCP_Failure.XCP_SHELL p_XcpErrorPrescaler_u8.XCP_ErrorHook.XCP_SHELL p_XcpEtasTool_u8.XCP_SHELL_VAR.XCP_SHELL p_XcpGranularityOdtEntrySizeDaq_u8.XCP_SHELL_VAR.XCP_SHELL p_XcpGranularityOdtEntrySizeStim_u8.XCP_SHELL_VAR.XCP_SHELL p_XcpMaxDaq_u16.XCP_SHELL_VAR.XCP_SHELL p_XcpMaxEventNo_u16.XCP_SHELL_VAR.XCP_SHELL p_XcpMaxOdtEntrySizeDaq_u8.XCP_SHELL_VAR.XCP_SHELL p_XcpMaxOdtEntrySizeStim_u8.XCP_SHELL_VAR.XCP_SHELL p_XcpMinDaq_u8.XCP_SHELL_VAR.XCP_SHELL p_XcpNumError_u8.XCP_ErrorHook.XCP_SHELL p_XcpPagProperties_u8.XCP_SHELL_VAR.XCP_SHELL p_XcpResourceProtect_u8.XCP_SHELL_VAR.XCP_SHELL p_XcpResource_u8.XCP_SHELL_VAR.XCP_SHELL p_XcpResponce_u8.XCP_ErrorHook.XCP_SHELL p_XcpSwitchBackground_u8.XCP_SHELL_VAR.XCP_SHELL p_XcpTestOdtOptSendResult_u8.XCP_Failure.XCP_SHELL p_XcpTestOdtOpt_u8.XCP_Failure.XCP_SHELL p_XcpTickDurationEcu_f32.XCP_SHELL_VAR.XCP_SHELL p_XcpTimestampMode_u8.XCP_SHELL_VAR.XCP_SHELL p_XcpTimestampProp_u8.XCP_SHELL_VAR.XCP_SHELL p_XcpTimestampTicks_u16.XCP_SHELL_VAR.XCP_SHELL p_XcpTrigDaqFailure_u8.XCP_Failure.XCP_SHELL p_XcpTrigOdtFailure_u8.XCP_Failure.XCP_SHELL p_XcpTrigOverload_u8.XCP_Failure.XCP_SHELL p_XcpTrigResume_u8.XCP_SHELL_VAR.XCP_SHELL p_XcpTriggerError_u8.XCP_ErrorHook.XCP_SHELL p_power_u8.XCP_SHELL_VAR.XCP_SHELL /end REF_CHARACTERISTIC
 /begin SUB_GROUP EV0_Roundtrip.XCP_SHELL EV0_Rx.XCP_SHELL EV0_Sample.XCP_SHELL EV0_Stim.XCP_SHELL EV0_Tx.XCP_SHELL XCP_ErrorHook.XCP_SHELL XCP_Failure.XCP_SHELL XCP_SHELL_VAR.XCP_SHELL /end SUB_GROUP
/end GROUP
/begin GROUP XCP_SHELL_VAR.XCP_SHELL ""
 /begin REF_MEASUREMENT XCP_Status.XCP_SHELL_VAR.XCP_SHELL c_power_u8.XCP_SHELL_VAR.XCP_SHELL g_AcceptAllKeys_u8.XCP_SHELL_VAR.XCP_SHELL g_TriggerOverload_u8.XCP_SHELL_VAR.XCP_SHELL g_XcpAutoResetAfterStoreDaq_u8.XCP_SHELL_VAR.XCP_SHELL g_XcpBitStimSupport_u8.XCP_SHELL_VAR.XCP_SHELL g_XcpBitStimVersion_u8.XCP_SHELL_VAR.XCP_SHELL g_XcpBlockDownloadMaxBS_u8.XCP_SHELL_VAR.XCP_SHELL g_XcpBlockDownloadMinST_u8.XCP_SHELL_VAR.XCP_SHELL g_XcpBlockFlashMaxBS_u8.XCP_SHELL_VAR.XCP_SHELL g_XcpBlockFlashMinST_u8.XCP_SHELL_VAR.XCP_SHELL g_XcpByteOrder_u8.XCP_SHELL_VAR.XCP_SHELL g_XcpCommModeBasic_u8.XCP_SHELL_VAR.XCP_SHELL g_XcpCommModeOptional_u8.XCP_SHELL_VAR.XCP_SHELL g_XcpCommModePgm_u8.XCP_SHELL_VAR.XCP_SHELL g_XcpConnectResetECU_u8.XCP_SHELL_VAR.XCP_SHELL g_XcpCtoMaxPgm_u8.XCP_SHELL_VAR.XCP_SHELL g_XcpCtoMax_u8.XCP_SHELL_VAR.XCP_SHELL g_XcpDaqConfigType_u8.XCP_SHELL_VAR.XCP_SHELL g_XcpDaqKeyByte_u8.XCP_SHELL_VAR.XCP_SHELL g_XcpDaqListProperties_u8.XCP_SHELL_VAR.XCP_SHELL g_XcpDaqProperties_u8.XCP_SHELL_VAR.XCP_SHELL g_XcpDtoMax_u16.XCP_SHELL_VAR.XCP_SHELL g_XcpEtasTool_u8.XCP_SHELL_VAR.XCP_SHELL g_XcpGranularityOdtEntrySizeDaq_u8.XCP_SHELL_VAR.XCP_SHELL g_XcpGranularityOdtEntrySizeStim_u8.XCP_SHELL_VAR.XCP_SHELL g_XcpIdentFieldType_u8.XCP_SHELL_VAR.XCP_SHELL g_XcpMasterBlockmodeOn_u8.XCP_SHELL_VAR.XCP_SHELL g_XcpMasterBlockmodePgmOn_u8.XCP_SHELL_VAR.XCP_SHELL g_XcpMasterPowerOn_u8_unused.XCP_SHELL_VAR.XCP_SHELL g_XcpMaxDaq_u16.XCP_SHELL_VAR.XCP_SHELL g_XcpMaxEventNo_u16.XCP_SHELL_VAR.XCP_SHELL g_XcpMaxOdtEntrySizeDaq_u8.XCP_SHELL_VAR.XCP_SHELL g_XcpMaxOdtEntrySizeStim_u8.XCP_SHELL_VAR.XCP_SHELL g_XcpMaxPredefDaq_u8.XCP_SHELL_VAR.XCP_SHELL g_XcpMinDaq_u8.XCP_SHELL_VAR.XCP_SHELL g_XcpOverloadType_u8.XCP_SHELL_VAR.XCP_SHELL g_XcpPIDoffSupport_u8.XCP_SHELL_VAR.XCP_SHELL g_XcpPagProperties_u8.XCP_SHELL_VAR.XCP_SHELL g_XcpPowerOn_u8.XCP_SHELL_VAR.XCP_SHELL g_XcpPrescalerSupport_u8.XCP_SHELL_VAR.XCP_SHELL g_XcpResetConfig_u8.XCP_SHELL_VAR.XCP_SHELL g_XcpResourceProtect_u8.XCP_SHELL_VAR.XCP_SHELL g_XcpResource_u8.XCP_SHELL_VAR.XCP_SHELL g_XcpResumeMasterConnectTimeoutCheck_u8.XCP_SHELL_VAR.XCP_SHELL g_XcpResumeMasterConnectTimeoutStart_u32.XCP_SHELL_VAR.XCP_SHELL g_XcpResumeMasterConnectTimeout_u32.XCP_SHELL_VAR.XCP_SHELL g_XcpResumeSupport_u8.XCP_SHELL_VAR.XCP_SHELL g_XcpSessStatus_u8.XCP_SHELL_VAR.XCP_SHELL g_XcpSessStatus_u8_nv.XCP_SHELL_VAR.XCP_SHELL g_XcpSlaveBlockmodeOn_u8.XCP_SHELL_VAR.XCP_SHELL g_XcpSwitchBackground_u8.XCP_SHELL_VAR.XCP_SHELL g_XcpTestOdtOptSendResult_u8.XCP_SHELL_VAR.XCP_SHELL g_XcpTestOdtOpt_u8.XCP_SHELL_VAR.XCP_SHELL g_XcpTickDurationEcu_f32.XCP_SHELL_VAR.XCP_SHELL g_XcpTickDurationPrescaler_f32.XCP_SHELL_VAR.XCP_SHELL g_XcpTickDuration_f32.XCP_SHELL_VAR.XCP_SHELL g_XcpTimestampFix_u8.XCP_SHELL_VAR.XCP_SHELL g_XcpTimestampMode_u8.XCP_SHELL_VAR.XCP_SHELL g_XcpTimestampProp_u8.XCP_SHELL_VAR.XCP_SHELL g_XcpTimestampSupport_u8.XCP_SHELL_VAR.XCP_SHELL g_XcpTimestampTicks_u16.XCP_SHELL_VAR.XCP_SHELL g_XcpTimestampUnit_u8.XCP_SHELL_VAR.XCP_SHELL g_XcpTimstampSize_u8.XCP_SHELL_VAR.XCP_SHELL g_XcpTrigResume_u8.XCP_SHELL_VAR.XCP_SHELL g_power_u8.XCP_SHELL_VAR.XCP_SHELL gm_XcpAddrOptimization_u8.XCP_SHELL_VAR.XCP_SHELL gm_XcpResumemodeCompare_u32.XCP_SHELL_VAR.XCP_SHELL gm_XcpResumemodeCounterEv0_u32.XCP_SHELL_VAR.XCP_SHELL gm_XcpResumemodeCounterEv1_u32.XCP_SHELL_VAR.XCP_SHELL gm_XcpResumemodeCounterEv2_u32.XCP_SHELL_VAR.XCP_SHELL gm_XcpResumemodeCounter_u32.XCP_SHELL_VAR.XCP_SHELL gm_XcpSizeOptimization_u8.XCP_SHELL_VAR.XCP_SHELL mg_AcceptAllKeys_u8.XCP_SHELL_VAR.XCP_SHELL mg_SwitchConfig_ECU_u8.XCP_SHELL_VAR.XCP_SHELL mg_TriggerOverload_u8.XCP_SHELL_VAR.XCP_SHELL mg_XcpAutoResetAfterStoreDaq_u8.XCP_SHELL_VAR.XCP_SHELL mg_XcpBlockDownloadMaxBS_u8.XCP_SHELL_VAR.XCP_SHELL mg_XcpBlockDownloadMinST_u8.XCP_SHELL_VAR.XCP_SHELL mg_XcpBlockFlashMaxBS_u8.XCP_SHELL_VAR.XCP_SHELL mg_XcpBlockFlashMinST_u8.XCP_SHELL_VAR.XCP_SHELL mg_XcpCommModeBasic_u8.XCP_SHELL_VAR.XCP_SHELL mg_XcpCommModeOptional_u8.XCP_SHELL_VAR.XCP_SHELL mg_XcpCommModePgm_u8.XCP_SHELL_VAR.XCP_SHELL mg_XcpConnectResetECU_u8.XCP_SHELL_VAR.XCP_SHELL mg_XcpCtoMaxPgm_u8.XCP_SHELL_VAR.XCP_SHELL mg_XcpCtoMax_u8.XCP_SHELL_VAR.XCP_SHELL mg_XcpDaqKeyByte_u8.XCP_SHELL_VAR.XCP_SHELL mg_XcpDaqListProperties_u8.XCP_SHELL_VAR.XCP_SHELL mg_XcpDaqProperties_u8.XCP_SHELL_VAR.XCP_SHELL mg_XcpDisableDaqTransmition_b.XCP_SHELL_VAR.XCP_SHELL mg_XcpDtoMax_u16.XCP_SHELL_VAR.XCP_SHELL mg_XcpEtasTool_u8.XCP_SHELL_VAR.XCP_SHELL mg_XcpGranularityOdtEntrySizeDaq_u8.XCP_SHELL_VAR.XCP_SHELL mg_XcpGranularityOdtEntrySizeStim_u8.XCP_SHELL_VAR.XCP_SHELL mg_XcpMaxDaq_u16.XCP_SHELL_VAR.XCP_SHELL mg_XcpMaxEventNo_u16.XCP_SHELL_VAR.XCP_SHELL mg_XcpMaxOdtEntrySizeDaq_u8.XCP_SHELL_VAR.XCP_SHELL mg_XcpMaxOdtEntrySizeStim_u8.XCP_SHELL_VAR.XCP_SHELL mg_XcpMinDaq_u8.XCP_SHELL_VAR.XCP_SHELL mg_XcpPagProperties_u8.XCP_SHELL_VAR.XCP_SHELL mg_XcpResourceProtect_u8.XCP_SHELL_VAR.XCP_SHELL mg_XcpResource_u8.XCP_SHELL_VAR.XCP_SHELL mg_XcpSwitchBackground_u8.XCP_SHELL_VAR.XCP_SHELL mg_XcpTestCase_u8_in.XCP_SHELL_VAR.XCP_SHELL mg_XcpTestCase_u8_out.XCP_SHELL_VAR.XCP_SHELL mg_XcpTestOdtOptResult_u8.XCP_SHELL_VAR.XCP_SHELL mg_XcpTestOdtOptSendResult_u8.XCP_SHELL_VAR.XCP_SHELL mg_XcpTestOdtOpt_u8.XCP_SHELL_VAR.XCP_SHELL mg_XcpTickDurationEcu_f32.XCP_SHELL_VAR.XCP_SHELL mg_XcpTimestampMode_u8.XCP_SHELL_VAR.XCP_SHELL mg_XcpTimestampProp_u8.XCP_SHELL_VAR.XCP_SHELL mg_XcpTimestampTicks_u16.XCP_SHELL_VAR.XCP_SHELL mg_XcpTrigDaqFailure_u8.XCP_SHELL_VAR.XCP_SHELL mg_XcpTrigOdtFailure_u8.XCP_SHELL_VAR.XCP_SHELL mg_XcpTrigOverload_u8.XCP_SHELL_VAR.XCP_SHELL mg_XcpTrigResume_u8.XCP_SHELL_VAR.XCP_SHELL mg_power_u8.XCP_SHELL_VAR.XCP_SHELL /end REF_MEASUREMENT
 /begin REF_CHARACTERISTIC p_AcceptAllKeys_u8.XCP_SHELL_VAR.XCP_SHELL p_SwitchConfig_ECU_u8.XCP_SHELL_VAR.XCP_SHELL p_TriggerOverload_u8.XCP_SHELL_VAR.XCP_SHELL p_XcpAutoResetAfterStoreDaq_u8.XCP_SHELL_VAR.XCP_SHELL p_XcpBitStimVersion_u8.XCP_SHELL_VAR.XCP_SHELL p_XcpBlockDownloadMaxBS_u8.XCP_SHELL_VAR.XCP_SHELL p_XcpBlockDownloadMinST_u8.XCP_SHELL_VAR.XCP_SHELL p_XcpBlockFlashMaxBS_u8.XCP_SHELL_VAR.XCP_SHELL p_XcpBlockFlashMinST_u8.XCP_SHELL_VAR.XCP_SHELL p_XcpChecksumByteOrder_u8.XCP_SHELL_VAR.XCP_SHELL p_XcpChecksumType_u8.XCP_SHELL_VAR.XCP_SHELL p_XcpCommModeBasic_u8.XCP_SHELL_VAR.XCP_SHELL p_XcpCommModeOptional_u8.XCP_SHELL_VAR.XCP_SHELL p_XcpCommModePgm_u8.XCP_SHELL_VAR.XCP_SHELL p_XcpConnectResetECU_u8.XCP_SHELL_VAR.XCP_SHELL p_XcpCtoMaxPgm_u8.XCP_SHELL_VAR.XCP_SHELL p_XcpCtoMax_u8.XCP_SHELL_VAR.XCP_SHELL p_XcpDaqKeyByte_u8.XCP_SHELL_VAR.XCP_SHELL p_XcpDaqListProperties_u8.XCP_SHELL_VAR.XCP_SHELL p_XcpDaqProperties_u8.XCP_SHELL_VAR.XCP_SHELL p_XcpDtoMax_u16.XCP_SHELL_VAR.XCP_SHELL p_XcpEtasTool_u8.XCP_SHELL_VAR.XCP_SHELL p_XcpGranularityOdtEntrySizeDaq_u8.XCP_SHELL_VAR.XCP_SHELL p_XcpGranularityOdtEntrySizeStim_u8.XCP_SHELL_VAR.XCP_SHELL p_XcpMaxDaq_u16.XCP_SHELL_VAR.XCP_SHELL p_XcpMaxEventNo_u16.XCP_SHELL_VAR.XCP_SHELL p_XcpMaxOdtEntrySizeDaq_u8.XCP_SHELL_VAR.XCP_SHELL p_XcpMaxOdtEntrySizeStim_u8.XCP_SHELL_VAR.XCP_SHELL p_XcpMinDaq_u8.XCP_SHELL_VAR.XCP_SHELL p_XcpPagProperties_u8.XCP_SHELL_VAR.XCP_SHELL p_XcpResourceProtect_u8.XCP_SHELL_VAR.XCP_SHELL p_XcpResource_u8.XCP_SHELL_VAR.XCP_SHELL p_XcpSwitchBackground_u8.XCP_SHELL_VAR.XCP_SHELL p_XcpTickDurationEcu_f32.XCP_SHELL_VAR.XCP_SHELL p_XcpTimestampMode_u8.XCP_SHELL_VAR.XCP_SHELL p_XcpTimestampProp_u8.XCP_SHELL_VAR.XCP_SHELL p_XcpTimestampTicks_u16.XCP_SHELL_VAR.XCP_SHELL p_XcpTrigResume_u8.XCP_SHELL_VAR.XCP_SHELL p_power_u8.XCP_SHELL_VAR.XCP_SHELL /end REF_CHARACTERISTIC
/end GROUP
/begin GROUP XCP_Type_Tests "" ROOT
 /begin REF_MEASUREMENT l_t01_f32_0.XCP_Type_Tests l_t01_f32_1.XCP_Type_Tests l_t01_f32_2.XCP_Type_Tests l_t01_f32_3.XCP_Type_Tests l_t01_f32_4.XCP_Type_Tests l_t01_f32_5.XCP_Type_Tests l_t01_f32_6.XCP_Type_Tests l_t01_f32_7.XCP_Type_Tests l_t01_f64_0.XCP_Type_Tests l_t01_f64_1.XCP_Type_Tests l_t01_f64_2.XCP_Type_Tests l_t01_f64_3.XCP_Type_Tests l_t01_f64_4.XCP_Type_Tests l_t01_f64_5.XCP_Type_Tests l_t01_f64_6.XCP_Type_Tests l_t01_f64_7.XCP_Type_Tests l_t01_s16_0.XCP_Type_Tests l_t01_s16_1.XCP_Type_Tests l_t01_s16_2.XCP_Type_Tests l_t01_s16_3.XCP_Type_Tests l_t01_s16_4.XCP_Type_Tests l_t01_s16_5.XCP_Type_Tests l_t01_s16_6.XCP_Type_Tests l_t01_s16_7.XCP_Type_Tests l_t01_s32_0.XCP_Type_Tests l_t01_s32_1.XCP_Type_Tests l_t01_s32_2.XCP_Type_Tests l_t01_s32_3.XCP_Type_Tests l_t01_s32_4.XCP_Type_Tests l_t01_s32_5.XCP_Type_Tests l_t01_s32_6.XCP_Type_Tests l_t01_s32_7.XCP_Type_Tests l_t01_s8_0.XCP_Type_Tests l_t01_s8_1.XCP_Type_Tests l_t01_s8_2.XCP_Type_Tests l_t01_s8_3.XCP_Type_Tests l_t01_s8_4.XCP_Type_Tests l_t01_s8_5.XCP_Type_Tests l_t01_s8_6.XCP_Type_Tests l_t01_s8_7.XCP_Type_Tests l_t01_u16_0.XCP_Type_Tests l_t01_u16_1.XCP_Type_Tests l_t01_u16_2.XCP_Type_Tests l_t01_u16_3.XCP_Type_Tests l_t01_u16_4.XCP_Type_Tests l_t01_u16_5.XCP_Type_Tests l_t01_u16_6.XCP_Type_Tests l_t01_u16_7.XCP_Type_Tests l_t01_u32_0.XCP_Type_Tests l_t01_u32_1.XCP_Type_Tests l_t01_u32_2.XCP_Type_Tests l_t01_u32_3.XCP_Type_Tests l_t01_u32_4.XCP_Type_Tests l_t01_u32_5.XCP_Type_Tests l_t01_u32_6.XCP_Type_Tests l_t01_u32_7.XCP_Type_Tests l_t01_u8_0.XCP_Type_Tests l_t01_u8_1.XCP_Type_Tests l_t01_u8_2.XCP_Type_Tests l_t01_u8_3.XCP_Type_Tests l_t01_u8_4.XCP_Type_Tests l_t01_u8_5.XCP_Type_Tests l_t01_u8_6.XCP_Type_Tests l_t01_u8_7.XCP_Type_Tests l_t01_u8_bool_0.XCP_Type_Tests l_t01_u8_bool_1.XCP_Type_Tests l_t01_u8_bool_2.XCP_Type_Tests l_t01_u8_bool_3.XCP_Type_Tests l_t01_u8_bool_4.XCP_Type_Tests l_t01_u8_bool_5.XCP_Type_Tests l_t01_u8_bool_6.XCP_Type_Tests l_t01_u8_bool_7.XCP_Type_Tests l_t02_u32_bool_0.XCP_Type_Tests l_t02_u32_bool_1.XCP_Type_Tests l_t02_u32_bool_2.XCP_Type_Tests l_t02_u32_bool_3.XCP_Type_Tests l_t02_u32_bool_4.XCP_Type_Tests l_t02_u32_bool_5.XCP_Type_Tests l_t02_u32_bool_6.XCP_Type_Tests l_t02_u32_bool_7.XCP_Type_Tests /end REF_MEASUREMENT
 /begin REF_CHARACTERISTIC p_t01_f32.XCP_Type_Tests p_t01_f64.XCP_Type_Tests p_t01_s16.XCP_Type_Tests p_t01_s32.XCP_Type_Tests p_t01_s8.XCP_Type_Tests p_t01_u16.XCP_Type_Tests p_t01_u32.XCP_Type_Tests p_t01_u8.XCP_Type_Tests p_t01_u8_bool.XCP_Type_Tests p_t02_u32_bool.XCP_Type_Tests /end REF_CHARACTERISTIC
/end GROUP
/begin GROUP counter_send_fast "" ROOT /begin REF_MEASUREMENT counter_uint8_send_fast.counter_send_fast /end REF_MEASUREMENT /begin SUB_GROUP E_uint8.counter_send_fast /end SUB_GROUP /end GROUP
/begin GROUP raster_running "" ROOT
 /begin REF_MEASUREMENT counter_uint8_R01_old.raster_running counter_uint8_R02_old.raster_running counter_uint8_R03_old.raster_running counter_uint8_R04_old.raster_running counter_uint8_R05_old.raster_running counter_uint8_R06_old.raster_running counter_uint8_R07_old.raster_running counter_uint8_R08_old.raster_running counter_uint8_R09_old.raster_running counter_uint8_R10_old.raster_running counter_uint8_R11_old.raster_running counter_uint8_R12_old.raster_running counter_uint8_R13_old.raster_running counter_uint8_R14_old.raster_running counter_uint8_R15_old.raster_running counter_uint8_R16_old.raster_running cycle_raster.raster_running not_done_R01.raster_running not_done_R02.raster_running not_done_R03.raster_running not_done_R04.raster_running not_done_R05.raster_running not_done_R06.raster_running not_done_R07.raster_running not_done_R08.raster_running not_done_R09.raster_running not_done_R10.raster_running not_done_R11.raster_running not_done_R12.raster_running not_done_R13.raster_running not_done_R14.raster_running not_done_R15.raster_running not_done_R16.raster_running /end REF_MEASUREMENT
 /begin REF_CHARACTERISTIC P_reset_task_not_running_counter.raster_running /end REF_CHARACTERISTIC
/end GROUP
/begin GROUP TimeSignal "" ROOT
 /begin REF_MEASUREMENT TimeSignal_F64_MSB_FIRST TimeSignal_F64_MSB_LAST TimeSignal_F32_MSB_FIRST TimeSignal_F32_MSB_LAST /end REF_MEASUREMENT
/end GROUP
/begin RECORD_LAYOUT STANDARD_MAP_R64R64R64 FNC_VALUES 5 FLOAT64_IEEE COLUMN_DIR DIRECT AXIS_PTS_X 3 FLOAT64_IEEE INDEX_INCR DIRECT AXIS_PTS_Y 4 FLOAT64_IEEE INDEX_INCR DIRECT NO_AXIS_PTS_X 1 UWORD NO_AXIS_PTS_Y 2 UWORD /end RECORD_LAYOUT
/begin RECORD_LAYOUT STANDARD_VALUE_BIT FNC_VALUES 1 UBYTE COLUMN_DIR DIRECT /end RECORD_LAYOUT
/begin RECORD_LAYOUT STANDARD_VALUE_R32 FNC_VALUES 1 FLOAT32_IEEE COLUMN_DIR DIRECT /end RECORD_LAYOUT
/begin RECORD_LAYOUT STANDARD_VALUE_R64 FNC_VALUES 1 FLOAT64_IEEE COLUMN_DIR DIRECT /end RECORD_LAYOUT
/begin RECORD_LAYOUT STANDARD_VALUE_S16 FNC_VALUES 1 SWORD COLUMN_DIR DIRECT /end RECORD_LAYOUT
/begin RECORD_LAYOUT STANDARD_VALUE_S32 FNC_VALUES 1 SLONG COLUMN_DIR DIRECT /end RECORD_LAYOUT
/begin RECORD_LAYOUT STANDARD_VALUE_S8 FNC_VALUES 1 SBYTE COLUMN_DIR DIRECT /end RECORD_LAYOUT
/begin RECORD_LAYOUT STANDARD_VALUE_U16 FNC_VALUES 1 UWORD COLUMN_DIR DIRECT /end RECORD_LAYOUT
/begin RECORD_LAYOUT STANDARD_VALUE_U32 FNC_VALUES 1 ULONG COLUMN_DIR DIRECT /end RECORD_LAYOUT
/begin RECORD_LAYOUT STANDARD_VALUE_U8 FNC_VALUES 1 UBYTE COLUMN_DIR DIRECT /end RECORD_LAYOUT
/end MODULE
/end PROJECT
