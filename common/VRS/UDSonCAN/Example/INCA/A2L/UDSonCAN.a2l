ASAP2_VERSION 1 61
/begin PROJECT HWA_UDSonCAN_ReferenceSystem "Modified for UDSonCAN Tests with new CalMeasure Mapping"
/begin HEADER "" VERSION "000" PROJECT_NO ASD /end HEADER
/begin MODULE HWA_UDSonCAN_ReferenceSystem "Modified for UDSonCAN Tests with new CalMeasure Mapping"
/begin MOD_COMMON "2013-05-06 09:52:20	create by ETASHexVirtualAddressTableHeaderV2" BYTE_ORDER MSB_FIRST ALIGNMENT_BYTE 1 ALIGNMENT_WORD 2 ALIGNMENT_LONG 4 ALIGNMENT_FLOAT32_IEEE 4 ALIGNMENT_FLOAT64_IEEE 8 /end MOD_COMMON
/begin CHARACTERISTIC bypass_B01_enable.Model_Byp_B01 "" VALUE 0x1D7F98 STANDARD_VALUE_U8 0.0 ident 0 1 BIT_MASK 0x1 DISPLAY_IDENTIFIER Bypass_R01_Enable /end CHARACTERISTIC
/begin CHARACTERISTIC bypass_B02_enable.Model_Byp_B02 "" VALUE 0x1D7FAE STANDARD_VALUE_U8 0.0 ident 0 1 BIT_MASK 0x1 DISPLAY_IDENTIFIER Bypass_R02_Enable /end CHARACTERISTIC
/begin CHARACTERISTIC cont_sint16_1_100_bypEnable_B01.Model_Byp_B01 "" VALUE 0x1D7F82 STANDARD_VALUE_U8 0.0 ident 0 1 BIT_MASK 0x1 DISPLAY_IDENTIFIER cont_sint16_1_100_bypEnable_B01.Model_Byp_B01_DISP_ID /end CHARACTERISTIC
/begin CHARACTERISTIC cont_sint16_1_100_bypEnable_B02.Model_Byp_B02 "" VALUE 0x1D7FAF STANDARD_VALUE_U8 0.0 ident 0 1 BIT_MASK 0x1 DISPLAY_IDENTIFIER cont_sint16_1_100_bypEnable_B02.Model_Byp_B02_DISP_ID /end CHARACTERISTIC
/begin CHARACTERISTIC cont_sint16_1_100_offset_B01.Model_Byp_B01 "" VALUE 0x1c2A48 STANDARD_VALUE_U8 0.0 ident 0 255 DISPLAY_IDENTIFIER cont_sint16_1_100_offset_B01.Model_Byp_B01_DISP_ID /end CHARACTERISTIC
/begin CHARACTERISTIC cont_sint16_1_100_offset_B02.Model_Byp_B02 "" VALUE 0x1c2A56 STANDARD_VALUE_U8 0.0 ident 0 255 DISPLAY_IDENTIFIER cont_sint16_1_100_offset_B02.Model_Byp_B02_DISP_ID /end CHARACTERISTIC
/begin CHARACTERISTIC cont_sint16_bypEnable_B01.Model_Byp_B01 "" VALUE 0x1D7F83 STANDARD_VALUE_U8 0.0 ident 0 1 BIT_MASK 0x1 DISPLAY_IDENTIFIER cont_sint16_bypEnable_B01.Model_Byp_B01_DISP_ID /end CHARACTERISTIC
/begin CHARACTERISTIC cont_sint16_bypEnable_B02.Model_Byp_B02 "" VALUE 0x1D7FB0 STANDARD_VALUE_U8 0.0 ident 0 1 BIT_MASK 0x1 DISPLAY_IDENTIFIER cont_sint16_bypEnable_B02.Model_Byp_B02_DISP_ID /end CHARACTERISTIC
/begin CHARACTERISTIC cont_sint16_offset_B01.Model_Byp_B01 "" VALUE 0x1c2A49 STANDARD_VALUE_U8 0.0 ident 0 255 DISPLAY_IDENTIFIER cont_sint16_offset_B01.Model_Byp_B01_DISP_ID /end CHARACTERISTIC
/begin CHARACTERISTIC cont_sint16_offset_B02.Model_Byp_B02 "" VALUE 0x1c2A57 STANDARD_VALUE_U8 0.0 ident 0 255 DISPLAY_IDENTIFIER cont_sint16_offset_B02.Model_Byp_B02_DISP_ID /end CHARACTERISTIC
/begin CHARACTERISTIC cont_sint8_1_10_bypEnable_B01.Model_Byp_B01 "" VALUE 0x1D7F84 STANDARD_VALUE_U8 0.0 ident 0 1 BIT_MASK 0x1 DISPLAY_IDENTIFIER cont_sint8_1_10_bypEnable_B01.Model_Byp_B01_DISP_ID /end CHARACTERISTIC
/begin CHARACTERISTIC cont_sint8_1_10_bypEnable_B02.Model_Byp_B02 "" VALUE 0x1D7FB1 STANDARD_VALUE_U8 0.0 ident 0 1 BIT_MASK 0x1 DISPLAY_IDENTIFIER cont_sint8_1_10_bypEnable_B02.Model_Byp_B02_DISP_ID /end CHARACTERISTIC
/begin CHARACTERISTIC cont_sint8_1_10_offset_B01.Model_Byp_B01 "" VALUE 0x1c2A4A STANDARD_VALUE_U8 0.0 ident 0 255 DISPLAY_IDENTIFIER cont_sint8_1_10_offset_B01.Model_Byp_B01_DISP_ID /end CHARACTERISTIC
/begin CHARACTERISTIC cont_sint8_1_10_offset_B02.Model_Byp_B02 "" VALUE 0x1c2A58 STANDARD_VALUE_U8 0.0 ident 0 255 DISPLAY_IDENTIFIER cont_sint8_1_10_offset_B02.Model_Byp_B02_DISP_ID /end CHARACTERISTIC
/begin CHARACTERISTIC cont_sint8_bypEnable_B01.Model_Byp_B01 "" VALUE 0x1D7F85 STANDARD_VALUE_U8 0.0 ident 0 1 BIT_MASK 0x1 DISPLAY_IDENTIFIER cont_sint8_bypEnable_B01.Model_Byp_B01_DISP_ID /end CHARACTERISTIC
/begin CHARACTERISTIC cont_sint8_bypEnable_B02.Model_Byp_B02 "" VALUE 0x1D7FB2 STANDARD_VALUE_U8 0.0 ident 0 1 BIT_MASK 0x1 DISPLAY_IDENTIFIER cont_sint8_bypEnable_B02.Model_Byp_B02_DISP_ID /end CHARACTERISTIC
/begin CHARACTERISTIC cont_sint8_offset_B01.Model_Byp_B01 "" VALUE 0x1c2A4B STANDARD_VALUE_U8 0.0 ident 0 255 DISPLAY_IDENTIFIER cont_sint8_offset_B01.Model_Byp_B01_DISP_ID /end CHARACTERISTIC
/begin CHARACTERISTIC cont_sint8_offset_B02.Model_Byp_B02 "" VALUE 0x1c2A59 STANDARD_VALUE_U8 0.0 ident 0 255 DISPLAY_IDENTIFIER cont_sint8_offset_B02.Model_Byp_B02_DISP_ID /end CHARACTERISTIC
/begin CHARACTERISTIC cont_uint16_1_2_bypEnable_B01.Model_Byp_B01 "" VALUE 0x1D7F86 STANDARD_VALUE_U8 0.0 ident 0 1 BIT_MASK 0x1 DISPLAY_IDENTIFIER cont_uint16_1_2_bypEnable_B01.Model_Byp_B01_DISP_ID /end CHARACTERISTIC
/begin CHARACTERISTIC cont_uint16_1_2_bypEnable_B02.Model_Byp_B02 "" VALUE 0x1D7FB3 STANDARD_VALUE_U8 0.0 ident 0 1 BIT_MASK 0x1 DISPLAY_IDENTIFIER cont_uint16_1_2_bypEnable_B02.Model_Byp_B02_DISP_ID /end CHARACTERISTIC
/begin CHARACTERISTIC cont_uint16_1_2_offset_B01.Model_Byp_B01 "" VALUE 0x1c2A4C STANDARD_VALUE_U8 0.0 ident 0 255 DISPLAY_IDENTIFIER cont_uint16_1_2_offset_B01.Model_Byp_B01_DISP_ID /end CHARACTERISTIC
/begin CHARACTERISTIC cont_uint16_1_2_offset_B02.Model_Byp_B02 "" VALUE 0x1c2A5A STANDARD_VALUE_U8 0.0 ident 0 255 DISPLAY_IDENTIFIER cont_uint16_1_2_offset_B02.Model_Byp_B02_DISP_ID /end CHARACTERISTIC
/begin CHARACTERISTIC cont_uint8_10_1_bypEnable_B01.Model_Byp_B01 "" VALUE 0x1D7F87 STANDARD_VALUE_U8 0.0 ident 0 1 BIT_MASK 0x1 DISPLAY_IDENTIFIER cont_uint8_10_1_bypEnable_B01.Model_Byp_B01_DISP_ID /end CHARACTERISTIC
/begin CHARACTERISTIC cont_uint8_10_1_bypEnable_B02.Model_Byp_B02 "" VALUE 0x1D7FB4 STANDARD_VALUE_U8 0.0 ident 0 1 BIT_MASK 0x1 DISPLAY_IDENTIFIER cont_uint8_10_1_bypEnable_B02.Model_Byp_B02_DISP_ID /end CHARACTERISTIC
/begin CHARACTERISTIC cont_uint8_10_1_offset_B01.Model_Byp_B01 "" VALUE 0x1c2A4D STANDARD_VALUE_U8 0.0 ident 0 255 DISPLAY_IDENTIFIER cont_uint8_10_1_offset_B01.Model_Byp_B01_DISP_ID /end CHARACTERISTIC
/begin CHARACTERISTIC cont_uint8_10_1_offset_B02.Model_Byp_B02 "" VALUE 0x1c2A5B STANDARD_VALUE_U8 0.0 ident 0 255 DISPLAY_IDENTIFIER cont_uint8_10_1_offset_B02.Model_Byp_B02_DISP_ID /end CHARACTERISTIC
/begin CHARACTERISTIC COUNT.FEA_performance_array "" VALUE 0x1D25E4 STANDARD_VALUE_U8 0.0 ident 0 255 /end CHARACTERISTIC
/begin CHARACTERISTIC Cuboid3D.Map_Mod "" MAP 0x1D30E8 STANDARD_MAP_R32R32R32 0.0 ident -1.e+037 1.e+037 /begin AXIS_DESCR STD_AXIS NO_INPUT_QUANTITY ident 12 -1.e+037 1.e+037 /end AXIS_DESCR /begin AXIS_DESCR STD_AXIS NO_INPUT_QUANTITY ident 2 -1.e+037 1.e+037 /end AXIS_DESCR /end CHARACTERISTIC
/begin CHARACTERISTIC Cuboid3D_1.Map_Mod "" MAP 0x1D3184 STANDARD_MAP_R32R32R32 0.0 ident -1.e+037 1.e+037 /begin AXIS_DESCR STD_AXIS M_In_Cuboid_X.Map_Mod ident 4 -1.e+037 1.e+037 /end AXIS_DESCR /begin AXIS_DESCR STD_AXIS M_In_Cuboid_Y.Map_Mod ident 3 -1.e+037 1.e+037 /end AXIS_DESCR /end CHARACTERISTIC
/begin CHARACTERISTIC Cuboid3D_2.Map_Mod "" MAP 0x1D31D4 STANDARD_MAP_R32R32R32 0.0 ident -1.e+037 1.e+037 /begin AXIS_DESCR STD_AXIS M_In_Cuboid_X.Map_Mod ident 4 -1.e+037 1.e+037 /end AXIS_DESCR /begin AXIS_DESCR STD_AXIS M_In_Cuboid_Y.Map_Mod ident 3 -1.e+037 1.e+037 /end AXIS_DESCR /end CHARACTERISTIC
/begin CHARACTERISTIC Cuboid3D_3.Map_Mod "" CURVE 0x1D30D4 STANDARD_CURVE_R32R32 0.0 ident -1.e+037 1.e+037 /begin AXIS_DESCR STD_AXIS M_In_Cuboid_Z.Map_Mod ident 2 -1.e+037 1.e+037 /end AXIS_DESCR /end CHARACTERISTIC
/begin CHARACTERISTIC Group_Two_D_1.Map_Mod "" MAP 0x1D2770 STANDARD_GROUP_R32 0.0 ident -1.e+037 1.e+037
 /begin AXIS_DESCR COM_AXIS M_In_X_Dist.Map_Mod ident 7 -1.e+037 1.e+037 AXIS_PTS_REF X_distrib.Map_Mod /end AXIS_DESCR
 /begin AXIS_DESCR COM_AXIS M_In_Y_Dist.Map_Mod ident 8 -1.e+037 1.e+037 AXIS_PTS_REF Y_distrib.Map_Mod /end AXIS_DESCR
/end CHARACTERISTIC
/begin CHARACTERISTIC Group_Two_D_2.Map_Mod "" MAP 0x1D2850 STANDARD_GROUP_R32 0.0 ident -1.e+037 1.e+037
 /begin AXIS_DESCR COM_AXIS M_In_X_Dist.Map_Mod ident 7 -1.e+037 1.e+037 AXIS_PTS_REF X_distrib.Map_Mod /end AXIS_DESCR
 /begin AXIS_DESCR COM_AXIS M_In_Y_Dist.Map_Mod ident 8 -1.e+037 1.e+037 AXIS_PTS_REF Y_distrib_2.Map_Mod /end AXIS_DESCR
/end CHARACTERISTIC
/begin CHARACTERISTIC Group_Two_D_3.Map_Mod "" MAP 0x1D2930 STANDARD_GROUP_R32 0.0 ident -1.e+037 1.e+037
 /begin AXIS_DESCR COM_AXIS M_In_X_Dist.Map_Mod ident 7 -1.e+037 1.e+037 AXIS_PTS_REF X_distrib_2.Map_Mod /end AXIS_DESCR
 /begin AXIS_DESCR COM_AXIS M_In_Y_Dist.Map_Mod ident 8 -1.e+037 1.e+037 AXIS_PTS_REF Y_distrib_2.Map_Mod /end AXIS_DESCR
/end CHARACTERISTIC
/begin CHARACTERISTIC log_uint8_0_bitOffset_B01.Model_Byp_B01 "" VALUE 0x1c2A4E STANDARD_VALUE_U8 0.0 ident 0 7 DISPLAY_IDENTIFIER log_uint8_0_bitOffset_B01.Model_Byp_B01_DISP_ID /end CHARACTERISTIC
/begin CHARACTERISTIC log_uint8_0_bitOffset_B02.Model_Byp_B02 "" VALUE 0x1c2A5C STANDARD_VALUE_U8 0.0 ident 0 7 DISPLAY_IDENTIFIER log_uint8_0_bitOffset_B02.Model_Byp_B02_DISP_ID /end CHARACTERISTIC
/begin CHARACTERISTIC log_uint8_0_bypEnable_B01.Model_Byp_B01 "" VALUE 0x1D7F88 STANDARD_VALUE_U8 0.0 ident 0 1 BIT_MASK 0x1 DISPLAY_IDENTIFIER log_uint8_0_bypEnable_B01.Model_Byp_B01_DISP_ID /end CHARACTERISTIC
/begin CHARACTERISTIC log_uint8_0_bypEnable_B02.Model_Byp_B02 "" VALUE 0x1D7FB5 STANDARD_VALUE_U8 0.0 ident 0 1 BIT_MASK 0x1 DISPLAY_IDENTIFIER log_uint8_0_bypEnable_B02.Model_Byp_B02_DISP_ID /end CHARACTERISTIC
/begin CHARACTERISTIC log_uint8_0_offset_B01.Model_Byp_B01 "" VALUE 0x1c2A4F STANDARD_VALUE_U8 0.0 ident 0 255 DISPLAY_IDENTIFIER log_uint8_0_offset_B01.Model_Byp_B01_DISP_ID /end CHARACTERISTIC
/begin CHARACTERISTIC log_uint8_0_offset_B02.Model_Byp_B02 "" VALUE 0x1c2A5D STANDARD_VALUE_U8 0.0 ident 0 255 DISPLAY_IDENTIFIER log_uint8_0_offset_B02.Model_Byp_B02_DISP_ID /end CHARACTERISTIC
/begin CHARACTERISTIC log_uint8_1_bitOffset_B01.Model_Byp_B01 "" VALUE 0x1c2A50 STANDARD_VALUE_U8 0.0 ident 0 7 DISPLAY_IDENTIFIER log_uint8_1_bitOffset_B01.Model_Byp_B01_DISP_ID /end CHARACTERISTIC
/begin CHARACTERISTIC log_uint8_1_bitOffset_B02.Model_Byp_B02 "" VALUE 0x1c2A5E STANDARD_VALUE_U8 0.0 ident 0 7 DISPLAY_IDENTIFIER log_uint8_1_bitOffset_B02.Model_Byp_B02_DISP_ID /end CHARACTERISTIC
/begin CHARACTERISTIC log_uint8_1_bypEnable_B01.Model_Byp_B01 "" VALUE 0x1D7F89 STANDARD_VALUE_U8 0.0 ident 0 1 BIT_MASK 0x1 DISPLAY_IDENTIFIER log_uint8_1_bypEnable_B01.Model_Byp_B01_DISP_ID /end CHARACTERISTIC
/begin CHARACTERISTIC log_uint8_1_bypEnable_B02.Model_Byp_B02 "" VALUE 0x1D7FB6 STANDARD_VALUE_U8 0.0 ident 0 1 BIT_MASK 0x1 DISPLAY_IDENTIFIER log_uint8_1_bypEnable_B02.Model_Byp_B02_DISP_ID /end CHARACTERISTIC
/begin CHARACTERISTIC log_uint8_1_offset_B01.Model_Byp_B01 "" VALUE 0x1c2A51 STANDARD_VALUE_U8 0.0 ident 0 255 DISPLAY_IDENTIFIER log_uint8_1_offset_B01.Model_Byp_B01_DISP_ID /end CHARACTERISTIC
/begin CHARACTERISTIC log_uint8_1_offset_B02.Model_Byp_B02 "" VALUE 0x1c2A5F STANDARD_VALUE_U8 0.0 ident 0 255 DISPLAY_IDENTIFIER log_uint8_1_offset_B02.Model_Byp_B02_DISP_ID /end CHARACTERISTIC
/begin CHARACTERISTIC p_cont_sint16_1_100_B01.Model_Byp_B01 "" VALUE 0x1D7F78 STANDARD_VALUE_S16 0.0 formula_1_100 -327.68 327.67 DISPLAY_IDENTIFIER p_cont_sint16_1_100_B01.Model_Byp_B01_DISP_ID /end CHARACTERISTIC
/begin CHARACTERISTIC p_cont_sint16_1_100_B02.Model_Byp_B02 "" VALUE 0x1D7FA4 STANDARD_VALUE_S16 0.0 formula_1_100 -327.68 327.67 DISPLAY_IDENTIFIER p_cont_sint16_1_100_B02.Model_Byp_B02_DISP_ID /end CHARACTERISTIC
/begin CHARACTERISTIC p_cont_sint16_1_100_Xcp_B01.Model_XcpByp_B01 "" VALUE 0x1D7FC4 STANDARD_VALUE_S16 0.0 formula_1_100 -327.68 327.67 /end CHARACTERISTIC
/begin CHARACTERISTIC p_cont_sint16_1_100_Xcp_B02.Model_XcpByp_B02 "" VALUE 0x1D7FD6 STANDARD_VALUE_S16 0.0 formula_1_100 -327.68 327.67 /end CHARACTERISTIC
/begin CHARACTERISTIC p_cont_sint16_1_100_Xcp_B03.Model_XcpByp_B03 "" VALUE 0x1D7FE8 STANDARD_VALUE_S16 0.0 formula_1_100 -327.68 327.67 /end CHARACTERISTIC
/begin CHARACTERISTIC p_cont_sint16_B01.Model_Byp_B01 "" VALUE 0x1D7F7A STANDARD_VALUE_S16 0.0 ident -32768.0 32767.0 DISPLAY_IDENTIFIER p_cont_sint16_B01.Model_Byp_B01_DISP_ID /end CHARACTERISTIC
/begin CHARACTERISTIC p_cont_sint16_B02.Model_Byp_B02 "" VALUE 0x1D7FA6 STANDARD_VALUE_S16 0.0 ident -32768.0 32767.0 DISPLAY_IDENTIFIER p_cont_sint16_B02.Model_Byp_B02_DISP_ID /end CHARACTERISTIC
/begin CHARACTERISTIC p_cont_sint16_Xcp_B01.Model_XcpByp_B01 "" VALUE 0x1D7FC6 STANDARD_VALUE_S16 0.0 ident -32768.0 32767.0 /end CHARACTERISTIC
/begin CHARACTERISTIC p_cont_sint16_Xcp_B02.Model_XcpByp_B02 "" VALUE 0x1D7FD8 STANDARD_VALUE_S16 0.0 ident -32768.0 32767.0 /end CHARACTERISTIC
/begin CHARACTERISTIC p_cont_sint16_Xcp_B03.Model_XcpByp_B03 "" VALUE 0x1D7FEA STANDARD_VALUE_S16 0.0 ident -32768.0 32767.0 /end CHARACTERISTIC
/begin CHARACTERISTIC p_cont_sint8_1_10_B01.Model_Byp_B01 "" VALUE 0x1D7F8A STANDARD_VALUE_S8 0.0 formula_1_10 -12.8 12.7 DISPLAY_IDENTIFIER p_cont_sint8_1_10_B01.Model_Byp_B01_DISP_ID /end CHARACTERISTIC
/begin CHARACTERISTIC p_cont_sint8_1_10_B02.Model_Byp_B02 "" VALUE 0x1D7FB7 STANDARD_VALUE_S8 0.0 formula_1_10 -12.8 12.7 DISPLAY_IDENTIFIER p_cont_sint8_1_10_B02.Model_Byp_B02_DISP_ID /end CHARACTERISTIC
/begin CHARACTERISTIC p_cont_sint8_1_10_Xcp_B01.Model_XcpByp_B01 "" VALUE 0x1D7FCE STANDARD_VALUE_S8 0.0 formula_1_10 -12.8 12.7 /end CHARACTERISTIC
/begin CHARACTERISTIC p_cont_sint8_1_10_Xcp_B02.Model_XcpByp_B02 "" VALUE 0x1D7FE0 STANDARD_VALUE_S8 0.0 formula_1_10 -12.8 12.7 /end CHARACTERISTIC
/begin CHARACTERISTIC p_cont_sint8_1_10_Xcp_B03.Model_XcpByp_B03 "" VALUE 0x1D7FF2 STANDARD_VALUE_S8 0.0 formula_1_10 -12.8 12.7 /end CHARACTERISTIC
/begin CHARACTERISTIC p_cont_sint8_B01.Model_Byp_B01 "" VALUE 0x1D7F8B STANDARD_VALUE_S8 0.0 ident -128.0 127.0 DISPLAY_IDENTIFIER p_cont_sint8_B01.Model_Byp_B01_DISP_ID /end CHARACTERISTIC
/begin CHARACTERISTIC p_cont_sint8_B02.Model_Byp_B02 "" VALUE 0x1D7FB8 STANDARD_VALUE_S8 0.0 ident -128.0 127.0 DISPLAY_IDENTIFIER p_cont_sint8_B02.Model_Byp_B02_DISP_ID /end CHARACTERISTIC
/begin CHARACTERISTIC p_cont_sint8_Xcp_B01.Model_XcpByp_B01 "" VALUE 0x1D7FCF STANDARD_VALUE_S8 0.0 ident -128.0 127.0 /end CHARACTERISTIC
/begin CHARACTERISTIC p_cont_sint8_Xcp_B02.Model_XcpByp_B02 "" VALUE 0x1D7FE1 STANDARD_VALUE_S8 0.0 ident -128.0 127.0 /end CHARACTERISTIC
/begin CHARACTERISTIC p_cont_sint8_Xcp_B03.Model_XcpByp_B03 "" VALUE 0x1D7FF3 STANDARD_VALUE_S8 0.0 ident -128.0 127.0 /end CHARACTERISTIC
/begin CHARACTERISTIC p_cont_uint16_1_2_B01.Model_Byp_B01 "" VALUE 0x1D7F7C STANDARD_VALUE_U16 0.0 formula_1_2 0.0 32767.5 DISPLAY_IDENTIFIER p_cont_uint16_1_2_B01.Model_Byp_B01_DISP_ID /end CHARACTERISTIC
/begin CHARACTERISTIC p_cont_uint16_1_2_B02.Model_Byp_B02 "" VALUE 0x1D7FA8 STANDARD_VALUE_U16 0.0 formula_1_2 0.0 32767.5 DISPLAY_IDENTIFIER p_cont_uint16_1_2_B02.Model_Byp_B02_DISP_ID /end CHARACTERISTIC
/begin CHARACTERISTIC p_cont_uint16_1_2_Xcp_B01.Model_XcpByp_B01 "" VALUE 0x1D7FC8 STANDARD_VALUE_U16 0.0 formula_1_2 0.0 32767.5 /end CHARACTERISTIC
/begin CHARACTERISTIC p_cont_uint16_1_2_Xcp_B02.Model_XcpByp_B02 "" VALUE 0x1D7FDA STANDARD_VALUE_U16 0.0 formula_1_2 0.0 32767.5 /end CHARACTERISTIC
/begin CHARACTERISTIC p_cont_uint16_1_2_Xcp_B03.Model_XcpByp_B03 "" VALUE 0x1D7FEC STANDARD_VALUE_U16 0.0 formula_1_2 0.0 32767.5 /end CHARACTERISTIC
/begin CHARACTERISTIC p_cont_uint8_10_1_B01.Model_Byp_B01 "" VALUE 0x1D7F8C STANDARD_VALUE_U8 0.0 formula_10_1 0.0 2550.0 DISPLAY_IDENTIFIER p_cont_uint8_10_1_B01.Model_Byp_B01_DISP_ID /end CHARACTERISTIC
/begin CHARACTERISTIC p_cont_uint8_10_1_B02.Model_Byp_B02 "" VALUE 0x1D7FB9 STANDARD_VALUE_U8 0.0 formula_10_1 0.0 2550.0 DISPLAY_IDENTIFIER p_cont_uint8_10_1_B02.Model_Byp_B02_DISP_ID /end CHARACTERISTIC
/begin CHARACTERISTIC p_cont_uint8_10_1_Xcp_B01.Model_XcpByp_B01 "" VALUE 0x1D7FD0 STANDARD_VALUE_U8 0.0 formula_10_1 0.0 2550.0 /end CHARACTERISTIC
/begin CHARACTERISTIC p_cont_uint8_10_1_Xcp_B02.Model_XcpByp_B02 "" VALUE 0x1D7FE2 STANDARD_VALUE_U8 0.0 formula_10_1 0.0 2550.0 /end CHARACTERISTIC
/begin CHARACTERISTIC p_cont_uint8_10_1_Xcp_B03.Model_XcpByp_B03 "" VALUE 0x1D7FF4 STANDARD_VALUE_U8 0.0 formula_10_1 0.0 2550.0 /end CHARACTERISTIC
/begin CHARACTERISTIC P_Do_Maps.Maps_Raster_1 "" VALUE 0x1D3224 STANDARD_VALUE_U8 0.0 ident 0 1 BIT_MASK 0x1 /end CHARACTERISTIC
/begin CHARACTERISTIC P_Do_Maps.Maps_Raster_2 "" VALUE 0x1D4BE8 STANDARD_VALUE_U8 0.0 ident 0 1 BIT_MASK 0x1 /end CHARACTERISTIC
/begin CHARACTERISTIC P_Do_Maps.Maps_Raster_3 "" VALUE 0x1D65AC STANDARD_VALUE_U8 0.0 ident 0 1 BIT_MASK 0x1 /end CHARACTERISTIC
/begin CHARACTERISTIC P_F32_1.M_Ultimate "" VALUE 0x1D2708 STANDARD_VALUE_R32 0.0 ident -1.e+037 1.e+037 /end CHARACTERISTIC
/* begin C:/ETAS/ASCET513/target/mpc555/Add_ToolChain/ASAP_Templates\P_F32_FORMULA.a2l inserted by script merge_Tab.pl */
/begin CHARACTERISTIC P_F32_IDENT.FORMULA "" VALUE 0x1D26C8 STANDARD_VALUE_R32 0.0 ident -1.e+037 1.e+037 /end CHARACTERISTIC
/begin CHARACTERISTIC P_F32_RAT_FUNC.FORMULA "" VALUE 0x1D26C8 STANDARD_VALUE_R32 0.0 Test_axx_bx_c_div_dxx_ex_f -1.e+037 1.e+037 /end CHARACTERISTIC
/begin CHARACTERISTIC P_F32_TAB_INTP.FORMULA "" VALUE 0x1D26C8 STANDARD_VALUE_R32 0.0 TestCmTabIntp -1.e+037 1.e+037 /end CHARACTERISTIC
/begin CHARACTERISTIC P_F32_TAB_NOINTP.FORMULA "" VALUE 0x1D26C8 STANDARD_VALUE_R32 0.0 TestCmTabNoIntp -1.e+037 1.e+037 /end CHARACTERISTIC
/begin CHARACTERISTIC P_F32_TAB_VERB.FORMULA "" VALUE 0x1D26C8 STANDARD_VALUE_R32 0.0 TestCmTabVerb -1.e+037 1.e+037 /end CHARACTERISTIC
/begin CHARACTERISTIC P_F64_1.M_Ultimate "" VALUE 0x1D2700 STANDARD_VALUE_R64 0.0 ident -1.e+037 1.e+037 /end CHARACTERISTIC
/* begin C:/ETAS/ASCET513/target/mpc555/Add_ToolChain/ASAP_Templates\P_F64_FORMULA.a2l inserted by script merge_Tab.pl */
/begin CHARACTERISTIC P_F64_IDENT.FORMULA "" VALUE 0x1D26C0 STANDARD_VALUE_R64 0.0 ident -1.e+037 1.e+037 /end CHARACTERISTIC
/begin CHARACTERISTIC P_F64_RAT_FUNC.FORMULA "" VALUE 0x1D26C0 STANDARD_VALUE_R64 0.0 Test_axx_bx_c_div_dxx_ex_f -1.e+037 1.e+037 /end CHARACTERISTIC
/begin CHARACTERISTIC P_F64_TAB_INTP.FORMULA "" VALUE 0x1D26C0 STANDARD_VALUE_R64 0.0 TestCmTabIntp -1.e+037 1.e+037 /end CHARACTERISTIC
/begin CHARACTERISTIC P_F64_TAB_NOINTP.FORMULA "" VALUE 0x1D26C0 STANDARD_VALUE_R64 0.0 TestCmTabNoIntp -1.e+037 1.e+037 /end CHARACTERISTIC
/begin CHARACTERISTIC P_F64_TAB_VERB.FORMULA "" VALUE 0x1D26C0 STANDARD_VALUE_R64 0.0 TestCmTabVerb -1.e+037 1.e+037 /end CHARACTERISTIC
/begin CHARACTERISTIC p_Impl_u8.FORMULA "" VALUE 0x1D26DA STANDARD_VALUE_U8 0.0 ident 0.0 255.0 /end CHARACTERISTIC
/begin CHARACTERISTIC P_In_Cuboid_X.Map_Mod "" VALUE 0x1D2758 STANDARD_VALUE_R32 0.0 ident -1.e+037 1.e+037 /end CHARACTERISTIC
/begin CHARACTERISTIC P_In_Cuboid_Y.Map_Mod "" VALUE 0x1D275C STANDARD_VALUE_R32 0.0 ident -1.e+037 1.e+037 /end CHARACTERISTIC
/begin CHARACTERISTIC P_In_Cuboid_Z.Map_Mod "" VALUE 0x1D2760 STANDARD_VALUE_R32 0.0 ident -1.e+037 1.e+037 /end CHARACTERISTIC
/begin CHARACTERISTIC P_In_Cuboid_Z2.Map_Mod "" VALUE 0x1D2764 STANDARD_VALUE_R32 0.0 ident -1.e+037 1.e+037 /end CHARACTERISTIC
/begin CHARACTERISTIC P_In_X_Two_D.Map_Mod "" VALUE 0x1D2768 STANDARD_VALUE_R32 0.0 ident -1.e+037 1.e+037 /end CHARACTERISTIC
/begin CHARACTERISTIC P_In_Y_Two_D.Map_Mod "" VALUE 0x1D276C STANDARD_VALUE_R32 0.0 ident -1.e+037 1.e+037 /end CHARACTERISTIC
/begin CHARACTERISTIC p_log_uint8_0_B01.Model_Byp_B01 "" VALUE 0x1D7F8D STANDARD_VALUE_U8 0.0 ident 0 1 BIT_MASK 0x1 DISPLAY_IDENTIFIER p_log_uint8_0_B01.Model_Byp_B01_DISP_ID /end CHARACTERISTIC
/begin CHARACTERISTIC p_log_uint8_0_B02.Model_Byp_B02 "" VALUE 0x1D7FBA STANDARD_VALUE_U8 0.0 ident 0 1 BIT_MASK 0x1 DISPLAY_IDENTIFIER p_log_uint8_0_B02.Model_Byp_B02_DISP_ID /end CHARACTERISTIC
/begin CHARACTERISTIC p_log_uint8_0_Xcp_B01.Model_XcpByp_B01 "" VALUE 0x1D7FD1 STANDARD_VALUE_U8 0.0 ident 0 1 BIT_MASK 0x1 /end CHARACTERISTIC
/begin CHARACTERISTIC p_log_uint8_0_Xcp_B02.Model_XcpByp_B02 "" VALUE 0x1D7FE3 STANDARD_VALUE_U8 0.0 ident 0 1 BIT_MASK 0x1 /end CHARACTERISTIC
/begin CHARACTERISTIC p_log_uint8_0_Xcp_B03.Model_XcpByp_B03 "" VALUE 0x1D7FF5 STANDARD_VALUE_U8 0.0 ident 0 1 BIT_MASK 0x1 /end CHARACTERISTIC
/begin CHARACTERISTIC p_log_uint8_1_B01.Model_Byp_B01 "" VALUE 0x1D7F8E STANDARD_VALUE_U8 0.0 ident 0 1 BIT_MASK 0x1 DISPLAY_IDENTIFIER p_log_uint8_1_B01.Model_Byp_B01_DISP_ID /end CHARACTERISTIC
/begin CHARACTERISTIC p_log_uint8_1_B02.Model_Byp_B02 "" VALUE 0x1D7FBB STANDARD_VALUE_U8 0.0 ident 0 1 BIT_MASK 0x1 DISPLAY_IDENTIFIER p_log_uint8_1_B02.Model_Byp_B02_DISP_ID /end CHARACTERISTIC
/begin CHARACTERISTIC p_log_uint8_1_Xcp_B01.Model_XcpByp_B01 "" VALUE 0x1D7FD2 STANDARD_VALUE_U8 0.0 ident 0 1 BIT_MASK 0x1 /end CHARACTERISTIC
/begin CHARACTERISTIC p_log_uint8_1_Xcp_B02.Model_XcpByp_B02 "" VALUE 0x1D7FE4 STANDARD_VALUE_U8 0.0 ident 0 1 BIT_MASK 0x1 /end CHARACTERISTIC
/begin CHARACTERISTIC p_log_uint8_1_Xcp_B03.Model_XcpByp_B03 "" VALUE 0x1D7FF6 STANDARD_VALUE_U8 0.0 ident 0 1 BIT_MASK 0x1 /end CHARACTERISTIC
/begin CHARACTERISTIC P_Op_Val_u8.M_Ultimate "" VALUE 0x1D272A STANDARD_VALUE_U8 0.0 ident 0 255 /end CHARACTERISTIC
/begin CHARACTERISTIC P_Operation_case.M_Ultimate "" VALUE 0x1D272B STANDARD_VALUE_U8 0.0 ident 0 255 /end CHARACTERISTIC
/begin CHARACTERISTIC P_Result_case.M_Ultimate "" VALUE 0x1D270C STANDARD_VALUE_U32 0.0 ident 0 4294967295 /end CHARACTERISTIC
/begin CHARACTERISTIC P_S16_1.M_Ultimate "" VALUE 0x1D271C STANDARD_VALUE_S16 0.0 ident -32768.0 32767.0 /end CHARACTERISTIC
/* begin C:/ETAS/ASCET513/target/mpc555/Add_ToolChain/ASAP_Templates\P_S16_FORMULA.a2l inserted by script merge_Tab.pl */
/begin CHARACTERISTIC P_S16_IDENT.FORMULA "" VALUE 0x1D26D4 STANDARD_VALUE_S16 0.0 ident -32768.0 32767.0 /end CHARACTERISTIC
/begin CHARACTERISTIC P_S16_RAT_FUNC.FORMULA "" VALUE 0x1D26D4 STANDARD_VALUE_S16 0.0 Test_axx_bx_c_div_dxx_ex_f -32768.0 32767.0 /end CHARACTERISTIC
/begin CHARACTERISTIC P_S16_TAB_INTP.FORMULA "" VALUE 0x1D26D4 STANDARD_VALUE_S16 0.0 TestCmTabIntp -32768.0 32767.0 /end CHARACTERISTIC
/begin CHARACTERISTIC P_S16_TAB_NOINTP.FORMULA "" VALUE 0x1D26D4 STANDARD_VALUE_S16 0.0 TestCmTabNoIntp -32768.0 32767.0 /end CHARACTERISTIC
/begin CHARACTERISTIC P_S16_TAB_VERB.FORMULA "" VALUE 0x1D26D4 STANDARD_VALUE_S16 0.0 TestCmTabVerb -32768.0 32767.0 /end CHARACTERISTIC
/begin CHARACTERISTIC P_S32_1.M_Ultimate "" VALUE 0x1D2710 STANDARD_VALUE_S32 0.0 ident -2147483648.0 2147483647.0 /end CHARACTERISTIC
/* begin C:/ETAS/ASCET513/target/mpc555/Add_ToolChain/ASAP_Templates\P_S32_FORMULA.a2l inserted by script merge_Tab.pl */
/begin CHARACTERISTIC P_S32_IDENT.FORMULA "" VALUE 0x1D26CC STANDARD_VALUE_S32 0.0 ident -2147483648.0 2147483647.0 /end CHARACTERISTIC
/begin CHARACTERISTIC P_S32_RAT_FUNC.FORMULA "" VALUE 0x1D26CC STANDARD_VALUE_S32 0.0 Test_axx_bx_c_div_dxx_ex_f -2147483648.0 2147483647.0 /end CHARACTERISTIC
/begin CHARACTERISTIC P_S32_TAB_INTP.FORMULA "" VALUE 0x1D26CC STANDARD_VALUE_S32 0.0 TestCmTabIntp -2147483648.0 2147483647.0 /end CHARACTERISTIC
/begin CHARACTERISTIC P_S32_TAB_NOINTP.FORMULA "" VALUE 0x1D26CC STANDARD_VALUE_S32 0.0 TestCmTabNoIntp -2147483648.0 2147483647.0 /end CHARACTERISTIC
/begin CHARACTERISTIC P_S32_TAB_VERB.FORMULA "" VALUE 0x1D26CC STANDARD_VALUE_S32 0.0 TestCmTabVerb -2147483648.0 2147483647.0 /end CHARACTERISTIC
/begin CHARACTERISTIC P_S8_1.M_Ultimate "" VALUE 0x1D2720 STANDARD_VALUE_S8 0.0 ident -128.0 127.0 /end CHARACTERISTIC
/* begin C:/ETAS/ASCET513/target/mpc555/Add_ToolChain/ASAP_Templates\P_S8_FORMULA.a2l inserted by script merge_Tab.pl */
/begin CHARACTERISTIC P_S8_IDENT.FORMULA "" VALUE 0x1D26D8 STANDARD_VALUE_S8 0.0 ident -128.0 127.0 /end CHARACTERISTIC
/begin CHARACTERISTIC P_S8_RAT_FUNC.FORMULA "" VALUE 0x1D26D8 STANDARD_VALUE_S8 0.0 Test_axx_bx_c_div_dxx_ex_f -128.0 127.0 /end CHARACTERISTIC
/begin CHARACTERISTIC P_S8_TAB_INTP.FORMULA "" VALUE 0x1D26D8 STANDARD_VALUE_S8 0.0 TestCmTabIntp -128.0 127.0 /end CHARACTERISTIC
/begin CHARACTERISTIC P_S8_TAB_NOINTP.FORMULA "" VALUE 0x1D26D8 STANDARD_VALUE_S8 0.0 TestCmTabNoIntp -128.0 127.0 /end CHARACTERISTIC
/begin CHARACTERISTIC P_S8_TAB_VERB.FORMULA "" VALUE 0x1D26D8 STANDARD_VALUE_S8 0.0 TestCmTabVerb -128.0 127.0 /end CHARACTERISTIC
/* /end C:/ETAS/ASCET513/target/mpc555/Add_ToolChain/ASAP_Templates\P_S8_FORMULA.a2l inserted by script merge_Tab.pl */
/begin CHARACTERISTIC p_sdisc_sint16_B01.Model_Byp_B01 "" VALUE 0x1D7F7E STANDARD_VALUE_S16 0.0 ident -32768 32767 DISPLAY_IDENTIFIER p_sdisc_sint16_B01.Model_Byp_B01_DISP_ID /end CHARACTERISTIC
/begin CHARACTERISTIC p_sdisc_sint16_B02.Model_Byp_B02 "" VALUE 0x1D7FAA STANDARD_VALUE_S16 0.0 ident -32768 32767 DISPLAY_IDENTIFIER p_sdisc_sint16_B02.Model_Byp_B02_DISP_ID /end CHARACTERISTIC
/begin CHARACTERISTIC p_sdisc_sint16_Xcp_B01.Model_XcpByp_B01 "" VALUE 0x1D7FCA STANDARD_VALUE_S16 0.0 ident -32768 32767 /end CHARACTERISTIC
/begin CHARACTERISTIC p_sdisc_sint16_Xcp_B02.Model_XcpByp_B02 "" VALUE 0x1D7FDC STANDARD_VALUE_S16 0.0 ident -32768 32767 /end CHARACTERISTIC
/begin CHARACTERISTIC p_sdisc_sint16_Xcp_B03.Model_XcpByp_B03 "" VALUE 0x1D7FEE STANDARD_VALUE_S16 0.0 ident -32768 32767 /end CHARACTERISTIC
/begin CHARACTERISTIC p_sdisc_sint8_B01.Model_Byp_B01 "" VALUE 0x1D7F8F STANDARD_VALUE_S8 0.0 ident -128 127 DISPLAY_IDENTIFIER p_sdisc_sint8_B01.Model_Byp_B01_DISP_ID /end CHARACTERISTIC
/begin CHARACTERISTIC p_sdisc_sint8_B02.Model_Byp_B02 "" VALUE 0x1D7FBC STANDARD_VALUE_S8 0.0 ident -128 127 DISPLAY_IDENTIFIER p_sdisc_sint8_B02.Model_Byp_B02_DISP_ID /end CHARACTERISTIC
/begin CHARACTERISTIC p_sdisc_sint8_Xcp_B01.Model_XcpByp_B01 "" VALUE 0x1D7FD3 STANDARD_VALUE_S8 0.0 ident -128 127 /end CHARACTERISTIC
/begin CHARACTERISTIC p_sdisc_sint8_Xcp_B02.Model_XcpByp_B02 "" VALUE 0x1D7FE5 STANDARD_VALUE_S8 0.0 ident -128 127 /end CHARACTERISTIC
/begin CHARACTERISTIC p_sdisc_sint8_Xcp_B03.Model_XcpByp_B03 "" VALUE 0x1D7FF7 STANDARD_VALUE_S8 0.0 ident -128 127 /end CHARACTERISTIC
/begin CHARACTERISTIC P_Stimu_case.M_Ultimate "" VALUE 0x1D2714 STANDARD_VALUE_U32 0.0 ident 0 4294967295 /end CHARACTERISTIC
/begin CHARACTERISTIC P_Stimu01_u8.M_Ultimate "" VALUE 0x1D2729 STANDARD_VALUE_U8 0.0 ident 0 255 /end CHARACTERISTIC
/begin CHARACTERISTIC P_Stimu02_u8.M_Ultimate "" VALUE 0x1D2728 STANDARD_VALUE_U8 0.0 ident 0 255 /end CHARACTERISTIC
/begin CHARACTERISTIC P_U16_1.M_Ultimate "" VALUE 0x1D271E STANDARD_VALUE_U16 0.0 ident 0.0 65535.0 /end CHARACTERISTIC
/* begin C:/ETAS/ASCET513/target/mpc555/Add_ToolChain/ASAP_Templates\P_U16_FORMULA.a2l inserted by script merge_Tab.pl */
/begin CHARACTERISTIC P_U16_IDENT.FORMULA "" VALUE 0x1D26D6 STANDARD_VALUE_U16 0.0 ident 0.0 65535.0 /end CHARACTERISTIC
/begin CHARACTERISTIC P_U16_RAT_FUNC.FORMULA "" VALUE 0x1D26D6 STANDARD_VALUE_U16 0.0 Test_axx_bx_c_div_dxx_ex_f 0.0 65535.0 /end CHARACTERISTIC
/begin CHARACTERISTIC P_U16_TAB_INTP.FORMULA "" VALUE 0x1D26D6 STANDARD_VALUE_U16 0.0 TestCmTabIntp 0.0 65535.0 /end CHARACTERISTIC
/begin CHARACTERISTIC P_U16_TAB_NOINTP.FORMULA "" VALUE 0x1D26D6 STANDARD_VALUE_U16 0.0 TestCmTabNoIntp 0.0 65535.0 /end CHARACTERISTIC
/begin CHARACTERISTIC P_U16_TAB_VERB.FORMULA "" VALUE 0x1D26D6 STANDARD_VALUE_U16 0.0 TestCmTabVerb 0.0 65535.0 /end CHARACTERISTIC
/begin CHARACTERISTIC P_U32_1.M_Ultimate "" VALUE 0x1D2718 STANDARD_VALUE_U32 0.0 ident 0.0 4294967295.0 /end CHARACTERISTIC
/* begin C:/ETAS/ASCET513/target/mpc555/Add_ToolChain/ASAP_Templates\P_U32_FORMULA.a2l inserted by script merge_Tab.pl */
/begin CHARACTERISTIC P_U32_IDENT.FORMULA "" VALUE 0x1D26D0 STANDARD_VALUE_U32 0.0 ident 0.0 4294967295.0 /end CHARACTERISTIC
/begin CHARACTERISTIC P_U32_RAT_FUNC.FORMULA "" VALUE 0x1D26D0 STANDARD_VALUE_U32 0.0 Test_axx_bx_c_div_dxx_ex_f 0.0 4294967295.0 /end CHARACTERISTIC
/begin CHARACTERISTIC P_U32_TAB_INTP.FORMULA "" VALUE 0x1D26D0 STANDARD_VALUE_U32 0.0 TestCmTabIntp 0.0 4294967295.0 /end CHARACTERISTIC
/begin CHARACTERISTIC P_U32_TAB_NOINTP.FORMULA "" VALUE 0x1D26D0 STANDARD_VALUE_U32 0.0 TestCmTabNoIntp 0.0 4294967295.0 /end CHARACTERISTIC
/begin CHARACTERISTIC P_U32_TAB_VERB.FORMULA "" VALUE 0x1D26D0 STANDARD_VALUE_U32 0.0 TestCmTabVerb 0.0 4294967295.0 /end CHARACTERISTIC
/begin CHARACTERISTIC P_U8_1.M_Ultimate "" VALUE 0x1D2721 STANDARD_VALUE_U8 0.0 ident 0.0 255.0 /end CHARACTERISTIC
/* begin C:/ETAS/ASCET513/target/mpc555/Add_ToolChain/ASAP_Templates\P_U8_FORMULA.a2l inserted by script merge_Tab.pl */
/begin CHARACTERISTIC P_U8_IDENT.FORMULA "" VALUE 0x1D26D9 STANDARD_VALUE_U8 0.0 ident 0.0 255.0 /end CHARACTERISTIC
/begin CHARACTERISTIC P_U8_RAT_FUNC.FORMULA "" VALUE 0x1D26D9 STANDARD_VALUE_U8 0.0 Test_axx_bx_c_div_dxx_ex_f 0.0 255.0 /end CHARACTERISTIC
/begin CHARACTERISTIC P_U8_TAB_INTP.FORMULA "" VALUE 0x1D26D9 STANDARD_VALUE_U8 0.0 TestCmTabIntp 0.0 255.0 /end CHARACTERISTIC
/begin CHARACTERISTIC P_U8_TAB_NOINTP.FORMULA "" VALUE 0x1D26D9 STANDARD_VALUE_U8 0.0 TestCmTabNoIntp 0.0 255.0 /end CHARACTERISTIC
/begin CHARACTERISTIC P_U8_TAB_VERB.FORMULA "" VALUE 0x1D26D9 STANDARD_VALUE_U8 0.0 TestCmTabVerb 0 255 /end CHARACTERISTIC
/* /end C:/ETAS/ASCET513/target/mpc555/Add_ToolChain/ASAP_Templates\P_U8_FORMULA.a2l inserted by script merge_Tab.pl */
/begin CHARACTERISTIC p_udisc_uint16_B01.Model_Byp_B01 "" VALUE 0x1D7F80 STANDARD_VALUE_U16 0.0 ident 0 65535 DISPLAY_IDENTIFIER p_udisc_uint16_B01.Model_Byp_B01_DISP_ID /end CHARACTERISTIC
/begin CHARACTERISTIC p_udisc_uint16_B02.Model_Byp_B02 "" VALUE 0x1D7FAC STANDARD_VALUE_U16 0.0 ident 0 65535 DISPLAY_IDENTIFIER p_udisc_uint16_B02.Model_Byp_B02_DISP_ID /end CHARACTERISTIC
/begin CHARACTERISTIC p_udisc_uint16_Xcp_B01.Model_XcpByp_B01 "" VALUE 0x1D7FCC STANDARD_VALUE_U16 0.0 ident 0 65535 /end CHARACTERISTIC
/begin CHARACTERISTIC p_udisc_uint16_Xcp_B02.Model_XcpByp_B02 "" VALUE 0x1D7FDE STANDARD_VALUE_U16 0.0 ident 0 65535 /end CHARACTERISTIC
/begin CHARACTERISTIC p_udisc_uint16_Xcp_B03.Model_XcpByp_B03 "" VALUE 0x1D7FF0 STANDARD_VALUE_U16 0.0 ident 0 65535 /end CHARACTERISTIC
/begin CHARACTERISTIC p_udisc_uint8_B01.Model_Byp_B01 "" VALUE 0x1D7F90 STANDARD_VALUE_U8 0.0 ident 0 255 DISPLAY_IDENTIFIER p_udisc_uint8_B01.Model_Byp_B01_DISP_ID /end CHARACTERISTIC
/begin CHARACTERISTIC p_udisc_uint8_B02.Model_Byp_B02 "" VALUE 0x1D7FBD STANDARD_VALUE_U8 0.0 ident 0 255 DISPLAY_IDENTIFIER p_udisc_uint8_B02.Model_Byp_B02_DISP_ID /end CHARACTERISTIC
/begin CHARACTERISTIC p_udisc_uint8_Xcp_B01.Model_XcpByp_B01 "" VALUE 0x1D7FD4 STANDARD_VALUE_U8 0.0 ident 0 255 /end CHARACTERISTIC
/begin CHARACTERISTIC p_udisc_uint8_Xcp_B02.Model_XcpByp_B02 "" VALUE 0x1D7FE6 STANDARD_VALUE_U8 0.0 ident 0 255 /end CHARACTERISTIC
/begin CHARACTERISTIC p_udisc_uint8_Xcp_B03.Model_XcpByp_B03 "" VALUE 0x1D7FF8 STANDARD_VALUE_U8 0.0 ident 0 255 /end CHARACTERISTIC
/begin CHARACTERISTIC param.FEA_performance_array "" VAL_BLK 0x1D251C STANDARD_VALUE_R32 0.0 ident -1.e+037 1.e+037 MATRIX_DIM 50 1 1 /end CHARACTERISTIC
/begin CHARACTERISTIC Param_00.FEA_performance_scalar "" VALUE 0x1D25EC STANDARD_VALUE_R32 0.0 ident -1.e+037 1.e+037 /end CHARACTERISTIC
/begin CHARACTERISTIC Param_01.FEA_performance_scalar "" VALUE 0x1D25F0 STANDARD_VALUE_R32 0.0 ident -1.e+037 1.e+037 /end CHARACTERISTIC
/begin CHARACTERISTIC Param_02.FEA_performance_scalar "" VALUE 0x1D25F4 STANDARD_VALUE_R32 0.0 ident -1.e+037 1.e+037 /end CHARACTERISTIC
/begin CHARACTERISTIC Param_03.FEA_performance_scalar "" VALUE 0x1D25F8 STANDARD_VALUE_R32 0.0 ident -1.e+037 1.e+037 /end CHARACTERISTIC
/begin CHARACTERISTIC Param_04.FEA_performance_scalar "" VALUE 0x1D25FC STANDARD_VALUE_R32 0.0 ident -1.e+037 1.e+037 /end CHARACTERISTIC
/begin CHARACTERISTIC Param_05.FEA_performance_scalar "" VALUE 0x1D2600 STANDARD_VALUE_R32 0.0 ident -1.e+037 1.e+037 /end CHARACTERISTIC
/begin CHARACTERISTIC Param_06.FEA_performance_scalar "" VALUE 0x1D2604 STANDARD_VALUE_R32 0.0 ident -1.e+037 1.e+037 /end CHARACTERISTIC
/begin CHARACTERISTIC Param_07.FEA_performance_scalar "" VALUE 0x1D2608 STANDARD_VALUE_R32 0.0 ident -1.e+037 1.e+037 /end CHARACTERISTIC
/begin CHARACTERISTIC Param_08.FEA_performance_scalar "" VALUE 0x1D260C STANDARD_VALUE_R32 0.0 ident -1.e+037 1.e+037 /end CHARACTERISTIC
/begin CHARACTERISTIC Param_09.FEA_performance_scalar "" VALUE 0x1D2610 STANDARD_VALUE_R32 0.0 ident -1.e+037 1.e+037 /end CHARACTERISTIC
/begin CHARACTERISTIC Param_10.FEA_performance_scalar "" VALUE 0x1D2614 STANDARD_VALUE_R32 0.0 ident -1.e+037 1.e+037 /end CHARACTERISTIC
/begin CHARACTERISTIC Param_11.FEA_performance_scalar "" VALUE 0x1D2618 STANDARD_VALUE_R32 0.0 ident -1.e+037 1.e+037 /end CHARACTERISTIC
/begin CHARACTERISTIC Param_12.FEA_performance_scalar "" VALUE 0x1D261C STANDARD_VALUE_R32 0.0 ident -1.e+037 1.e+037 /end CHARACTERISTIC
/begin CHARACTERISTIC Param_13.FEA_performance_scalar "" VALUE 0x1D2620 STANDARD_VALUE_R32 0.0 ident -1.e+037 1.e+037 /end CHARACTERISTIC
/begin CHARACTERISTIC Param_14.FEA_performance_scalar "" VALUE 0x1D2624 STANDARD_VALUE_R32 0.0 ident -1.e+037 1.e+037 /end CHARACTERISTIC
/begin CHARACTERISTIC Param_15.FEA_performance_scalar "" VALUE 0x1D2628 STANDARD_VALUE_R32 0.0 ident -1.e+037 1.e+037 /end CHARACTERISTIC
/begin CHARACTERISTIC Param_16.FEA_performance_scalar "" VALUE 0x1D262C STANDARD_VALUE_R32 0.0 ident -1.e+037 1.e+037 /end CHARACTERISTIC
/begin CHARACTERISTIC Param_17.FEA_performance_scalar "" VALUE 0x1D2630 STANDARD_VALUE_R32 0.0 ident -1.e+037 1.e+037 /end CHARACTERISTIC
/begin CHARACTERISTIC Param_18.FEA_performance_scalar "" VALUE 0x1D2634 STANDARD_VALUE_R32 0.0 ident -1.e+037 1.e+037 /end CHARACTERISTIC
/begin CHARACTERISTIC Param_19.FEA_performance_scalar "" VALUE 0x1D2638 STANDARD_VALUE_R32 0.0 ident -1.e+037 1.e+037 /end CHARACTERISTIC
/begin CHARACTERISTIC Param_20.FEA_performance_scalar "" VALUE 0x1D263C STANDARD_VALUE_R32 0.0 ident -1.e+037 1.e+037 /end CHARACTERISTIC
/begin CHARACTERISTIC Param_21.FEA_performance_scalar "" VALUE 0x1D2640 STANDARD_VALUE_R32 0.0 ident -1.e+037 1.e+037 /end CHARACTERISTIC
/begin CHARACTERISTIC Param_22.FEA_performance_scalar "" VALUE 0x1D2644 STANDARD_VALUE_R32 0.0 ident -1.e+037 1.e+037 /end CHARACTERISTIC
/begin CHARACTERISTIC Param_23.FEA_performance_scalar "" VALUE 0x1D2648 STANDARD_VALUE_R32 0.0 ident -1.e+037 1.e+037 /end CHARACTERISTIC
/begin CHARACTERISTIC Param_24.FEA_performance_scalar "" VALUE 0x1D264C STANDARD_VALUE_R32 0.0 ident -1.e+037 1.e+037 /end CHARACTERISTIC
/begin CHARACTERISTIC Param_25.FEA_performance_scalar "" VALUE 0x1D2650 STANDARD_VALUE_R32 0.0 ident -1.e+037 1.e+037 /end CHARACTERISTIC
/begin CHARACTERISTIC Param_26.FEA_performance_scalar "" VALUE 0x1D2654 STANDARD_VALUE_R32 0.0 ident -1.e+037 1.e+037 /end CHARACTERISTIC
/begin CHARACTERISTIC Param_27.FEA_performance_scalar "" VALUE 0x1D2658 STANDARD_VALUE_R32 0.0 ident -1.e+037 1.e+037 /end CHARACTERISTIC
/begin CHARACTERISTIC Param_28.FEA_performance_scalar "" VALUE 0x1D265C STANDARD_VALUE_R32 0.0 ident -1.e+037 1.e+037 /end CHARACTERISTIC
/begin CHARACTERISTIC Param_29.FEA_performance_scalar "" VALUE 0x1D2660 STANDARD_VALUE_R32 0.0 ident -1.e+037 1.e+037 /end CHARACTERISTIC
/begin CHARACTERISTIC Param_30.FEA_performance_scalar "" VALUE 0x1D2664 STANDARD_VALUE_R32 0.0 ident -1.e+037 1.e+037 /end CHARACTERISTIC
/begin CHARACTERISTIC Param_31.FEA_performance_scalar "" VALUE 0x1D2668 STANDARD_VALUE_R32 0.0 ident -1.e+037 1.e+037 /end CHARACTERISTIC
/begin CHARACTERISTIC Param_32.FEA_performance_scalar "" VALUE 0x1D266C STANDARD_VALUE_R32 0.0 ident -1.e+037 1.e+037 /end CHARACTERISTIC
/begin CHARACTERISTIC Param_33.FEA_performance_scalar "" VALUE 0x1D2670 STANDARD_VALUE_R32 0.0 ident -1.e+037 1.e+037 /end CHARACTERISTIC
/begin CHARACTERISTIC Param_34.FEA_performance_scalar "" VALUE 0x1D2674 STANDARD_VALUE_R32 0.0 ident -1.e+037 1.e+037 /end CHARACTERISTIC
/begin CHARACTERISTIC Param_35.FEA_performance_scalar "" VALUE 0x1D2678 STANDARD_VALUE_R32 0.0 ident -1.e+037 1.e+037 /end CHARACTERISTIC
/begin CHARACTERISTIC Param_36.FEA_performance_scalar "" VALUE 0x1D267C STANDARD_VALUE_R32 0.0 ident -1.e+037 1.e+037 /end CHARACTERISTIC
/begin CHARACTERISTIC Param_37.FEA_performance_scalar "" VALUE 0x1D2680 STANDARD_VALUE_R32 0.0 ident -1.e+037 1.e+037 /end CHARACTERISTIC
/begin CHARACTERISTIC Param_38.FEA_performance_scalar "" VALUE 0x1D2684 STANDARD_VALUE_R32 0.0 ident -1.e+037 1.e+037 /end CHARACTERISTIC
/begin CHARACTERISTIC Param_39.FEA_performance_scalar "" VALUE 0x1D2688 STANDARD_VALUE_R32 0.0 ident -1.e+037 1.e+037 /end CHARACTERISTIC
/begin CHARACTERISTIC Param_40.FEA_performance_scalar "" VALUE 0x1D268C STANDARD_VALUE_R32 0.0 ident -1.e+037 1.e+037 /end CHARACTERISTIC
/begin CHARACTERISTIC Param_41.FEA_performance_scalar "" VALUE 0x1D2690 STANDARD_VALUE_R32 0.0 ident -1.e+037 1.e+037 /end CHARACTERISTIC
/begin CHARACTERISTIC Param_42.FEA_performance_scalar "" VALUE 0x1D2694 STANDARD_VALUE_R32 0.0 ident -1.e+037 1.e+037 /end CHARACTERISTIC
/begin CHARACTERISTIC Param_43.FEA_performance_scalar "" VALUE 0x1D2698 STANDARD_VALUE_R32 0.0 ident -1.e+037 1.e+037 /end CHARACTERISTIC
/begin CHARACTERISTIC Param_44.FEA_performance_scalar "" VALUE 0x1D269C STANDARD_VALUE_R32 0.0 ident -1.e+037 1.e+037 /end CHARACTERISTIC
/begin CHARACTERISTIC Param_45.FEA_performance_scalar "" VALUE 0x1D26A0 STANDARD_VALUE_R32 0.0 ident -1.e+037 1.e+037 /end CHARACTERISTIC
/begin CHARACTERISTIC Param_46.FEA_performance_scalar "" VALUE 0x1D26A4 STANDARD_VALUE_R32 0.0 ident -1.e+037 1.e+037 /end CHARACTERISTIC
/begin CHARACTERISTIC Param_47.FEA_performance_scalar "" VALUE 0x1D26A8 STANDARD_VALUE_R32 0.0 ident -1.e+037 1.e+037 /end CHARACTERISTIC
/begin CHARACTERISTIC Param_48.FEA_performance_scalar "" VALUE 0x1D26AC STANDARD_VALUE_R32 0.0 ident -1.e+037 1.e+037 /end CHARACTERISTIC
/begin CHARACTERISTIC Param_49.FEA_performance_scalar "" VALUE 0x1D26B0 STANDARD_VALUE_R32 0.0 ident -1.e+037 1.e+037 /end CHARACTERISTIC
/begin CHARACTERISTIC sdisc_sint16_bypEnable_B01.Model_Byp_B01 "" VALUE 0x1D7F91 STANDARD_VALUE_U8 0.0 ident 0 1 BIT_MASK 0x1 DISPLAY_IDENTIFIER sdisc_sint16_bypEnable_B01.Model_Byp_B01_DISP_ID /end CHARACTERISTIC
/begin CHARACTERISTIC sdisc_sint16_bypEnable_B02.Model_Byp_B02 "" VALUE 0x1D7FBE STANDARD_VALUE_U8 0.0 ident 0 1 BIT_MASK 0x1 DISPLAY_IDENTIFIER sdisc_sint16_bypEnable_B02.Model_Byp_B02_DISP_ID /end CHARACTERISTIC
/begin CHARACTERISTIC sdisc_sint16_offset_B01.Model_Byp_B01 "" VALUE 0x1c2A52 STANDARD_VALUE_U8 0.0 ident 0 255 DISPLAY_IDENTIFIER sdisc_sint16_offset_B01.Model_Byp_B01_DISP_ID /end CHARACTERISTIC
/begin CHARACTERISTIC sdisc_sint16_offset_B02.Model_Byp_B02 "" VALUE 0x1c2A60 STANDARD_VALUE_U8 0.0 ident 0 255 DISPLAY_IDENTIFIER sdisc_sint16_offset_B02.Model_Byp_B02_DISP_ID /end CHARACTERISTIC
/begin CHARACTERISTIC sdisc_sint8_bypEnable_B01.Model_Byp_B01 "" VALUE 0x1D7F92 STANDARD_VALUE_U8 0.0 ident 0 1 BIT_MASK 0x1 DISPLAY_IDENTIFIER sdisc_sint8_bypEnable_B01.Model_Byp_B01_DISP_ID /end CHARACTERISTIC
/begin CHARACTERISTIC sdisc_sint8_bypEnable_B02.Model_Byp_B02 "" VALUE 0x1D7FBF STANDARD_VALUE_U8 0.0 ident 0 1 BIT_MASK 0x1 DISPLAY_IDENTIFIER sdisc_sint8_bypEnable_B02.Model_Byp_B02_DISP_ID /end CHARACTERISTIC
/begin CHARACTERISTIC sdisc_sint8_offset_B01.Model_Byp_B01 "" VALUE 0x1c2A53 STANDARD_VALUE_U8 0.0 ident 0 255 DISPLAY_IDENTIFIER sdisc_sint8_offset_B01.Model_Byp_B01_DISP_ID /end CHARACTERISTIC
/begin CHARACTERISTIC sdisc_sint8_offset_B02.Model_Byp_B02 "" VALUE 0x1c2A61 STANDARD_VALUE_U8 0.0 ident 0 255 DISPLAY_IDENTIFIER sdisc_sint8_offset_B02.Model_Byp_B02_DISP_ID /end CHARACTERISTIC
/* begin C:/ETAS/ASCET513/target/mpc555/Add_ToolChain/ASAP_Templates\TestCuboid_3D_FixAxisPnt_f32.a2l inserted by script merge_Cuboid.pl */
/begin CHARACTERISTIC TestCuboid_3D_FixAxisPnt_f32.Map_Mod "" CUBOID 0x1D2FC0 Cuboid_3D_Fix_F32F32F32F32 0 ident -1.e+037 1.e+037 /begin AXIS_DESCR STD_AXIS M_In_Cuboid_X.Map_Mod ident 4 -1.e+037 1.e+037 /end AXIS_DESCR /begin AXIS_DESCR STD_AXIS M_In_Cuboid_Y.Map_Mod ident 3 -1.e+037 1.e+037 /end AXIS_DESCR /begin AXIS_DESCR STD_AXIS M_In_Cuboid_Z.Map_Mod ident 2 -1.e+037 1.e+037 /end AXIS_DESCR /end CHARACTERISTIC
/begin RECORD_LAYOUT Cuboid_3D_Fix_F32F32F32F32 FIX_NO_AXIS_PTS_X 4 FIX_NO_AXIS_PTS_Y 3 FIX_NO_AXIS_PTS_Z 2 AXIS_PTS_X 1 FLOAT32_IEEE INDEX_INCR DIRECT AXIS_PTS_Y 2 FLOAT32_IEEE INDEX_INCR DIRECT AXIS_PTS_Z 3 FLOAT32_IEEE INDEX_INCR DIRECT FNC_VALUES 4 FLOAT32_IEEE ROW_DIR DIRECT /end RECORD_LAYOUT
/* /end C:/ETAS/ASCET513/target/mpc555/Add_ToolChain/ASAP_Templates\TestCuboid_3D_FixAxisPnt_f32.a2l inserted by script merge_Cuboid.pl */ /* begin C:/ETAS/ASCET513/target/mpc555/Add_ToolChain/ASAP_Templates\TestCuboid_3D_VarNoAxisPnt.a2l inserted by script merge_Cuboid.pl */
/begin CHARACTERISTIC TestCuboid_3D_VarNoAxisPnt.Map_Mod "" CUBOID 0x1D3044 Cuboid_3D_F32F32F32F32 0 ident -1.e+037 1.e+037 /begin AXIS_DESCR STD_AXIS M_In_Cuboid_X.Map_Mod ident 4 -1.e+037 1.e+037 /end AXIS_DESCR /begin AXIS_DESCR STD_AXIS M_In_Cuboid_Y.Map_Mod ident 3 -1.e+037 1.e+037 /end AXIS_DESCR
 /begin AXIS_DESCR /* z-axis */ STD_AXIS M_In_Cuboid_Z.Map_Mod ident 2 -1.e+037 1.e+037 /end AXIS_DESCR
/end CHARACTERISTIC
/begin RECORD_LAYOUT Cuboid_3D_F32F32F32F32 NO_AXIS_PTS_X 1 SLONG NO_AXIS_PTS_Y 2 SLONG NO_AXIS_PTS_Z 3 SLONG AXIS_PTS_X 4 FLOAT32_IEEE INDEX_INCR DIRECT AXIS_PTS_Y 5 FLOAT32_IEEE INDEX_INCR DIRECT AXIS_PTS_Z 6 FLOAT32_IEEE INDEX_INCR DIRECT FNC_VALUES 7 FLOAT32_IEEE ROW_DIR DIRECT /end RECORD_LAYOUT
/* /end C:/ETAS/ASCET513/target/mpc555/Add_ToolChain/ASAP_Templates\TestCuboid_3D_VarNoAxisPnt.a2l inserted by script merge_Cuboid.pl */ /* begin C:/ETAS/ASCET513/target/mpc555/Add_ToolChain/ASAP_Templates\TestCuboid_4D_FixAxisPnt_f32.a2l inserted by script merge_Cuboid.pl */
/begin CHARACTERISTIC TestCuboid_4D_FixAxisPnt_f32.Map_Mod "" CUBE_4 0x1D2ED4 Cuboid_4D_Fix_F32F32F32F32F32 0 ident -1.e+037 1.e+037 /begin AXIS_DESCR STD_AXIS M_In_Cuboid_X.Map_Mod ident 4 -1.e+037 1.e+037 /end AXIS_DESCR /begin AXIS_DESCR STD_AXIS M_In_Cuboid_Y.Map_Mod ident 3 -1.e+037 1.e+037 /end AXIS_DESCR /begin AXIS_DESCR STD_AXIS M_In_Cuboid_Z.Map_Mod ident 2 -1.e+037 1.e+037 /end AXIS_DESCR /begin AXIS_DESCR STD_AXIS M_In_Cuboid_Z2.Map_Mod ident 2 -1.e+037 1.e+037 /end AXIS_DESCR /end CHARACTERISTIC
/begin RECORD_LAYOUT Cuboid_4D_Fix_F32F32F32F32F32 FIX_NO_AXIS_PTS_X 4 FIX_NO_AXIS_PTS_Y 3 FIX_NO_AXIS_PTS_Z 2 FIX_NO_AXIS_PTS_4 2 AXIS_PTS_X 1 FLOAT32_IEEE INDEX_INCR DIRECT AXIS_PTS_Y 2 FLOAT32_IEEE INDEX_INCR DIRECT AXIS_PTS_Z 3 FLOAT32_IEEE INDEX_INCR DIRECT AXIS_PTS_4 4 FLOAT32_IEEE INDEX_INCR DIRECT FNC_VALUES 5 FLOAT32_IEEE ROW_DIR DIRECT /end RECORD_LAYOUT
/* /end C:/ETAS/ASCET513/target/mpc555/Add_ToolChain/ASAP_Templates\TestCuboid_4D_FixAxisPnt_f32.a2l inserted by script merge_Cuboid.pl */ /* begin C:/ETAS/ASCET513/target/mpc555/Add_ToolChain/ASAP_Templates\TestCuboid_4D_VarNoAxisPnt.a2l inserted by script merge_Cuboid.pl */
/begin CHARACTERISTIC TestCuboid_4D_VarNoAxisPnt.Map_Mod "" CUBE_4 0x1D2DD8 Cuboid_4D_F32F32F32F32F32 0 ident -1.e+037 1.e+037 /begin AXIS_DESCR STD_AXIS M_In_Cuboid_X.Map_Mod ident 4 -1.e+037 1.e+037 /end AXIS_DESCR /begin AXIS_DESCR STD_AXIS M_In_Cuboid_Y.Map_Mod ident 3 -1.e+037 1.e+037 /end AXIS_DESCR /begin AXIS_DESCR STD_AXIS M_In_Cuboid_Z.Map_Mod ident 2 -1.e+037 1.e+037 /end AXIS_DESCR /begin AXIS_DESCR STD_AXIS M_In_Cuboid_Z2.Map_Mod ident 2 -1.e+037 1.e+037 /end AXIS_DESCR /end CHARACTERISTIC
/begin RECORD_LAYOUT Cuboid_4D_F32F32F32F32F32 NO_AXIS_PTS_X 1 SLONG NO_AXIS_PTS_Y 2 SLONG NO_AXIS_PTS_Z 3 SLONG NO_AXIS_PTS_4 4 SLONG AXIS_PTS_X 5 FLOAT32_IEEE INDEX_INCR DIRECT AXIS_PTS_Y 6 FLOAT32_IEEE INDEX_INCR DIRECT AXIS_PTS_Z 7 FLOAT32_IEEE INDEX_INCR DIRECT AXIS_PTS_4 8 FLOAT32_IEEE INDEX_INCR DIRECT FNC_VALUES 9 FLOAT32_IEEE ROW_DIR DIRECT /end RECORD_LAYOUT
/* /end C:/ETAS/ASCET513/target/mpc555/Add_ToolChain/ASAP_Templates\TestCuboid_4D_VarNoAxisPnt.a2l inserted by script merge_Cuboid.pl */ /* begin C:/ETAS/ASCET513/target/mpc555/Add_ToolChain/ASAP_Templates\TestCuboid_4D_WFST.a2l inserted by script merge_Cuboid.pl */
/begin CHARACTERISTIC TestCuboid_4D_WFST.Map_Mod "" CUBE_4 0x1D2CD8 Cuboid_4D_WSFT_F32F32F32F32 0 ident -1.e+037 1.e+037 /begin AXIS_DESCR STD_AXIS M_In_Cuboid_X.Map_Mod ident 4 -1.e+037 1.e+037 /end AXIS_DESCR /begin AXIS_DESCR STD_AXIS M_In_Cuboid_Y.Map_Mod ident 3 -1.e+037 1.e+037 /end AXIS_DESCR /begin AXIS_DESCR STD_AXIS M_In_Cuboid_Z.Map_Mod ident 2 -1.e+037 1.e+037 /end AXIS_DESCR /begin AXIS_DESCR STD_AXIS M_In_Cuboid_Z2.Map_Mod ident 2 -1.e+037 1.e+037 /end AXIS_DESCR /end CHARACTERISTIC
/begin RECORD_LAYOUT Cuboid_4D_WSFT_F32F32F32F32 NO_AXIS_PTS_X 1 SLONG NO_AXIS_PTS_Y 2 SLONG NO_AXIS_PTS_Z 3 SLONG NO_AXIS_PTS_4 4 SLONG RESERVED 5 SLONG AXIS_PTS_X 6 FLOAT32_IEEE INDEX_INCR DIRECT AXIS_PTS_Y 7 FLOAT32_IEEE INDEX_INCR DIRECT AXIS_PTS_Z 8 FLOAT32_IEEE INDEX_INCR DIRECT AXIS_PTS_4 9 FLOAT32_IEEE INDEX_INCR DIRECT FNC_VALUES 10 FLOAT32_IEEE ROW_DIR DIRECT /end RECORD_LAYOUT
/begin CHARACTERISTIC Threshold.FEA_performance_array "" VALUE 0x1D2518 STANDARD_VALUE_R32 0.0 ident -1.e+037 1.e+037 /end CHARACTERISTIC
/begin CHARACTERISTIC Threshold.FEA_performance_scalar "" VALUE 0x1D26B4 STANDARD_VALUE_R32 0.0 ident -1.e+037 1.e+037 /end CHARACTERISTIC
/begin CHARACTERISTIC Two_D.Map_Mod "" MAP 0x1D2A10 STANDARD_MAP_R64R64R64 0.0 ident -1.e+037 1.e+037 /begin AXIS_DESCR STD_AXIS M_In_X_Two_D.Map_Mod ident 7 -1.e+037 1.e+037 /end AXIS_DESCR /begin AXIS_DESCR STD_AXIS M_In_Y_Two_D.Map_Mod ident 8 -1.e+037 1.e+037 /end AXIS_DESCR /end CHARACTERISTIC
/begin CHARACTERISTIC udisc_uint16_bypEnable_B01.Model_Byp_B01 "" VALUE 0x1D7F93 STANDARD_VALUE_U8 0.0 ident 0 1 BIT_MASK 0x1 DISPLAY_IDENTIFIER udisc_uint16_bypEnable_B01.Model_Byp_B01_DISP_ID /end CHARACTERISTIC
/begin CHARACTERISTIC udisc_uint16_bypEnable_B02.Model_Byp_B02 "" VALUE 0x1D7FC0 STANDARD_VALUE_U8 0.0 ident 0 1 BIT_MASK 0x1 DISPLAY_IDENTIFIER udisc_uint16_bypEnable_B02.Model_Byp_B02_DISP_ID /end CHARACTERISTIC
/begin CHARACTERISTIC udisc_uint16_offset_B01.Model_Byp_B01 "" VALUE 0x1c2A54 STANDARD_VALUE_U8 0.0 ident 0 255 DISPLAY_IDENTIFIER udisc_uint16_offset_B01.Model_Byp_B01_DISP_ID /end CHARACTERISTIC
/begin CHARACTERISTIC udisc_uint16_offset_B02.Model_Byp_B02 "" VALUE 0x1c2A62 STANDARD_VALUE_U8 0.0 ident 0 255 DISPLAY_IDENTIFIER udisc_uint16_offset_B02.Model_Byp_B02_DISP_ID /end CHARACTERISTIC
/begin CHARACTERISTIC udisc_uint8_bypEnable_B01.Model_Byp_B01 "" VALUE 0x1D7F94 STANDARD_VALUE_U8 0.0 ident 0 1 BIT_MASK 0x1 DISPLAY_IDENTIFIER udisc_uint8_bypEnable_B01.Model_Byp_B01_DISP_ID /end CHARACTERISTIC
/begin CHARACTERISTIC udisc_uint8_bypEnable_B02.Model_Byp_B02 "" VALUE 0x1D7FC1 STANDARD_VALUE_U8 0.0 ident 0 1 BIT_MASK 0x1 DISPLAY_IDENTIFIER udisc_uint8_bypEnable_B02.Model_Byp_B02_DISP_ID /end CHARACTERISTIC
/begin CHARACTERISTIC udisc_uint8_offset_B01.Model_Byp_B01 "" VALUE 0x1c2A55 STANDARD_VALUE_U8 0.0 ident 0 255 DISPLAY_IDENTIFIER udisc_uint8_offset_B01.Model_Byp_B01_DISP_ID /end CHARACTERISTIC
/begin CHARACTERISTIC udisc_uint8_offset_B02.Model_Byp_B02 "" VALUE 0x1c2A63 STANDARD_VALUE_U8 0.0 ident 0 255 DISPLAY_IDENTIFIER udisc_uint8_offset_B02.Model_Byp_B02_DISP_ID /end CHARACTERISTIC
/begin AXIS_PTS X_distrib.Map_Mod "" 0x1D2C50 M_In_X_Dist.Map_Mod STANDARD_DIST_R32 0.0 ident 7 -1.e+037 1.e+037 /end AXIS_PTS
/begin AXIS_PTS X_distrib_2.Map_Mod "" 0x1D2C70 M_In_X_Dist.Map_Mod STANDARD_DIST_R32 0.0 ident 7 -1.e+037 1.e+037 /end AXIS_PTS
/begin AXIS_PTS Y_distrib.Map_Mod "" 0x1D2C90 M_In_Y_Dist.Map_Mod STANDARD_DIST_R32 0.0 ident 8 -1.e+037 1.e+037 /end AXIS_PTS
/begin AXIS_PTS Y_distrib_2.Map_Mod "" 0x1D2CB4 M_In_Y_Dist.Map_Mod STANDARD_DIST_R32 0.0 ident 8 -1.e+037 1.e+037 /end AXIS_PTS
/begin MEASUREMENT B_cntr_B01_ok.clsCounter_B01.Model_Byp_B01 "" UBYTE ident 1 100 0 1 BIT_MASK 0x1 ECU_ADDRESS 0x7F8570 DISPLAY_IDENTIFIER B_cntr_B01_ok.clsCounter_B01.Model_Byp_B01_DISP_ID /end MEASUREMENT
/begin MEASUREMENT B_cntr_B02_ok.clsCounter_B02.Model_Byp_B02 "" SBYTE ident 1 100 0 1 BIT_MASK 0x1 ECU_ADDRESS 0x7F8573 DISPLAY_IDENTIFIER B_cntr_B02_ok.clsCounter_B02.Model_Byp_B02_DISP_ID /end MEASUREMENT
/begin MEASUREMENT buffer.EdgeRising.Reset_Schalter "" UBYTE ident 1 100 0 1 ECU_ADDRESS 0x7FB488 DISPLAY_IDENTIFIER buffer.EdgeRising.Reset_Schalter_DISP_ID /end MEASUREMENT
/begin MEASUREMENT bypass_B01_state.Model_Byp_B01 "" UBYTE ident 1 100 0 1 BIT_MASK 0x1 ECU_ADDRESS 0x7FB542 DISPLAY_IDENTIFIER bypass_B01_state.Model_Byp_B01_DISP_ID /end MEASUREMENT
/begin MEASUREMENT bypass_B02_state.Model_Byp_B02 "" UBYTE ident 1 100 0 1 BIT_MASK 0x1 ECU_ADDRESS 0x7FB562 DISPLAY_IDENTIFIER bypass_B02_state.Model_Byp_B02_DISP_ID /end MEASUREMENT
/begin MEASUREMENT cntrold_B01.clsCounter_B01.Model_Byp_B01 "" UBYTE ident 1 100 0 255 ECU_ADDRESS 0x7F8571 DISPLAY_IDENTIFIER cntrold_B01.clsCounter_B01.Model_Byp_B01_DISP_ID /end MEASUREMENT
/begin MEASUREMENT cntrold_B02.clsCounter_B02.Model_Byp_B02 "" UBYTE ident 1 100 0 255 ECU_ADDRESS 0x7F8574 DISPLAY_IDENTIFIER cntrold_B02.clsCounter_B02.Model_Byp_B02_DISP_ID /end MEASUREMENT
/begin MEASUREMENT cont_sint16_1_100_B01.Model_Byp_B01 "" SWORD formula_1_100 1 100 -327.68 327.67 ECU_ADDRESS 0x7FB538 DISPLAY_IDENTIFIER cont_sint16_1_100_B01.Model_Byp_B01_DISP_ID /end MEASUREMENT
/begin MEASUREMENT cont_sint16_1_100_B02.Model_Byp_B02 "" SWORD formula_1_100 1 100 -327.68 327.67 ECU_ADDRESS 0x7FB558 DISPLAY_IDENTIFIER cont_sint16_1_100_B02.Model_Byp_B02_DISP_ID /end MEASUREMENT
/begin MEASUREMENT cont_sint16_1_100_offset_cpy_B01.Model_Byp_B01 "" UBYTE ident 1 100 0 255 ECU_ADDRESS 0x7FB52A DISPLAY_IDENTIFIER cont_sint16_1_100_offset_cpy_B01.Model_Byp_B01_DISP_ID /end MEASUREMENT
/begin MEASUREMENT cont_sint16_1_100_offset_cpy_B02.Model_Byp_B02 "" UBYTE ident 1 100 0 255 ECU_ADDRESS 0x7FB54A DISPLAY_IDENTIFIER cont_sint16_1_100_offset_cpy_B02.Model_Byp_B02_DISP_ID /end MEASUREMENT
/begin MEASUREMENT cont_sint16_1_100_Xcp_B01.Model_XcpByp_B01 "" SWORD formula_1_100 1 100 -327.68 327.67 ECU_ADDRESS 0x7FB56A /end MEASUREMENT
/begin MEASUREMENT cont_sint16_1_100_Xcp_B02.Model_XcpByp_B02 "" SWORD formula_1_100 1 100 -327.68 327.67 ECU_ADDRESS 0x7FB57C /end MEASUREMENT
/begin MEASUREMENT cont_sint16_1_100_Xcp_B03.Model_XcpByp_B03 "" SWORD formula_1_100 1 100 -327.68 327.67 ECU_ADDRESS 0x7FB58E /end MEASUREMENT
/begin MEASUREMENT cont_sint16_B01.Model_Byp_B01 "" SWORD ident 1 100 -32768 32767.0 ECU_ADDRESS 0x7FB53A DISPLAY_IDENTIFIER cont_sint16_B01.Model_Byp_B01_DISP_ID /end MEASUREMENT
/begin MEASUREMENT cont_sint16_B02.Model_Byp_B02 "" SWORD ident 1 100 -32768 32767.0 ECU_ADDRESS 0x7FB55A DISPLAY_IDENTIFIER cont_sint16_B02.Model_Byp_B02_DISP_ID /end MEASUREMENT
/begin MEASUREMENT cont_sint16_offset_cpy_B01.Model_Byp_B01 "" UBYTE ident 1 100 0 255 ECU_ADDRESS 0x7FB52B DISPLAY_IDENTIFIER cont_sint16_offset_cpy_B01.Model_Byp_B01_DISP_ID /end MEASUREMENT
/begin MEASUREMENT cont_sint16_offset_cpy_B02.Model_Byp_B02 "" UBYTE ident 1 100 0 255 ECU_ADDRESS 0x7FB54B DISPLAY_IDENTIFIER cont_sint16_offset_cpy_B02.Model_Byp_B02_DISP_ID /end MEASUREMENT
/begin MEASUREMENT cont_sint16_Xcp_B01.Model_XcpByp_B01 "" SWORD ident 1 100 -32768 32767.0 ECU_ADDRESS 0x7FB56C /end MEASUREMENT
/begin MEASUREMENT cont_sint16_Xcp_B02.Model_XcpByp_B02 "" SWORD ident 1 100 -32768 32767.0 ECU_ADDRESS 0x7FB57E /end MEASUREMENT
/begin MEASUREMENT cont_sint16_Xcp_B03.Model_XcpByp_B03 "" SWORD ident 1 100 -32768 32767.0 ECU_ADDRESS 0x7FB590 /end MEASUREMENT
/begin MEASUREMENT cont_sint8_1_10_B01.Model_Byp_B01 "" SBYTE formula_1_10 1 100 -12.8 12.7 ECU_ADDRESS 0x7FB543 DISPLAY_IDENTIFIER cont_sint8_1_10_B01.Model_Byp_B01_DISP_ID /end MEASUREMENT
/begin MEASUREMENT cont_sint8_1_10_B02.Model_Byp_B02 "" SBYTE formula_1_10 1 100 -12.8 12.7 ECU_ADDRESS 0x7FB563 DISPLAY_IDENTIFIER cont_sint8_1_10_B02.Model_Byp_B02_DISP_ID /end MEASUREMENT
/begin MEASUREMENT cont_sint8_1_10_offset_cpy_B01.Model_Byp_B01 "" UBYTE ident 1 100 0 255 ECU_ADDRESS 0x7FB52C DISPLAY_IDENTIFIER cont_sint8_1_10_offset_cpy_B01.Model_Byp_B01_DISP_ID /end MEASUREMENT
/begin MEASUREMENT cont_sint8_1_10_offset_cpy_B02.Model_Byp_B02 "" UBYTE ident 1 100 0 255 ECU_ADDRESS 0x7FB54C DISPLAY_IDENTIFIER cont_sint8_1_10_offset_cpy_B02.Model_Byp_B02_DISP_ID /end MEASUREMENT
/begin MEASUREMENT cont_sint8_1_10_Xcp_B01.Model_XcpByp_B01 "" SBYTE formula_1_10 1 100 -12.8 12.7 ECU_ADDRESS 0x7FB574 /end MEASUREMENT
/begin MEASUREMENT cont_sint8_1_10_Xcp_B02.Model_XcpByp_B02 "" SBYTE formula_1_10 1 100 -12.8 12.7 ECU_ADDRESS 0x7FB586 /end MEASUREMENT
/begin MEASUREMENT cont_sint8_1_10_Xcp_B03.Model_XcpByp_B03 "" SBYTE formula_1_10 1 100 -12.8 12.7 ECU_ADDRESS 0x7FB598 /end MEASUREMENT
/begin MEASUREMENT cont_sint8_B01.Model_Byp_B01 "" SBYTE ident 1 100 -128.0 127.0 ECU_ADDRESS 0x7FB544 DISPLAY_IDENTIFIER cont_sint8_B01.Model_Byp_B01_DISP_ID /end MEASUREMENT
/begin MEASUREMENT cont_sint8_B02.Model_Byp_B02 "" SBYTE ident 1 100 -128.0 127.0 ECU_ADDRESS 0x7FB564 DISPLAY_IDENTIFIER cont_sint8_B02.Model_Byp_B02_DISP_ID /end MEASUREMENT
/begin MEASUREMENT cont_sint8_offset_cpy_B01.Model_Byp_B01 "" UBYTE ident 1 100 0 255 ECU_ADDRESS 0x7FB52D DISPLAY_IDENTIFIER cont_sint8_offset_cpy_B01.Model_Byp_B01_DISP_ID /end MEASUREMENT
/begin MEASUREMENT cont_sint8_offset_cpy_B02.Model_Byp_B02 "" UBYTE ident 1 100 0 255 ECU_ADDRESS 0x7FB54D DISPLAY_IDENTIFIER cont_sint8_offset_cpy_B02.Model_Byp_B02_DISP_ID /end MEASUREMENT
/begin MEASUREMENT cont_sint8_Xcp_B01.Model_XcpByp_B01 "" SBYTE ident 1 100 -128.0 127.0 ECU_ADDRESS 0x7FB575 /end MEASUREMENT
/begin MEASUREMENT cont_sint8_Xcp_B02.Model_XcpByp_B02 "" SBYTE ident 1 100 -128.0 127.0 ECU_ADDRESS 0x7FB587 /end MEASUREMENT
/begin MEASUREMENT cont_sint8_Xcp_B03.Model_XcpByp_B03 "" SBYTE ident 1 100 -128.0 127.0 ECU_ADDRESS 0x7FB599 /end MEASUREMENT
/begin MEASUREMENT cont_uint16_1_2_B01.Model_Byp_B01 "" UWORD formula_1_2 1 100 0.0 32767.5 ECU_ADDRESS 0x7FB53C DISPLAY_IDENTIFIER cont_uint16_1_2_B01.Model_Byp_B01_DISP_ID /end MEASUREMENT
/begin MEASUREMENT cont_uint16_1_2_B02.Model_Byp_B02 "" UWORD formula_1_2 1 100 0.0 32767.5 ECU_ADDRESS 0x7FB55C DISPLAY_IDENTIFIER cont_uint16_1_2_B02.Model_Byp_B02_DISP_ID /end MEASUREMENT
/begin MEASUREMENT cont_uint16_1_2_offset_cpy_B01.Model_Byp_B01 "" UBYTE ident 1 100 0 255 ECU_ADDRESS 0x7FB52E DISPLAY_IDENTIFIER cont_uint16_1_2_offset_cpy_B01.Model_Byp_B01_DISP_ID /end MEASUREMENT
/begin MEASUREMENT cont_uint16_1_2_offset_cpy_B02.Model_Byp_B02 "" UBYTE ident 1 100 0 255 ECU_ADDRESS 0x7FB54E DISPLAY_IDENTIFIER cont_uint16_1_2_offset_cpy_B02.Model_Byp_B02_DISP_ID /end MEASUREMENT
/begin MEASUREMENT cont_uint16_1_2_Xcp_B01.Model_XcpByp_B01 "" UWORD formula_1_2 1 100 0.0 32767.5 ECU_ADDRESS 0x7FB56E /end MEASUREMENT
/begin MEASUREMENT cont_uint16_1_2_Xcp_B02.Model_XcpByp_B02 "" UWORD formula_1_2 1 100 0.0 32767.5 ECU_ADDRESS 0x7FB580 /end MEASUREMENT
/begin MEASUREMENT cont_uint16_1_2_Xcp_B03.Model_XcpByp_B03 "" UWORD formula_1_2 1 100 0.0 32767.5 ECU_ADDRESS 0x7FB592 /end MEASUREMENT
/begin MEASUREMENT cont_uint8_10_1_B01.Model_Byp_B01 "" UBYTE formula_10_1 1 100 0.0 2550.0 ECU_ADDRESS 0x7FB545 DISPLAY_IDENTIFIER cont_uint8_10_1_B01.Model_Byp_B01_DISP_ID /end MEASUREMENT
/begin MEASUREMENT cont_uint8_10_1_B02.Model_Byp_B02 "" UBYTE formula_10_1 1 100 0.0 2550.0 ECU_ADDRESS 0x7FB565 DISPLAY_IDENTIFIER cont_uint8_10_1_B02.Model_Byp_B02_DISP_ID /end MEASUREMENT
/begin MEASUREMENT cont_uint8_10_1_offset_cpy_B01.Model_Byp_B01 "" UBYTE ident 1 100 0 255 ECU_ADDRESS 0x7FB52F DISPLAY_IDENTIFIER cont_uint8_10_1_offset_cpy_B01.Model_Byp_B01_DISP_ID /end MEASUREMENT
/begin MEASUREMENT cont_uint8_10_1_offset_cpy_B02.Model_Byp_B02 "" UBYTE ident 1 100 0 255 ECU_ADDRESS 0x7FB54F DISPLAY_IDENTIFIER cont_uint8_10_1_offset_cpy_B02.Model_Byp_B02_DISP_ID /end MEASUREMENT
/begin MEASUREMENT cont_uint8_10_1_Xcp_B01.Model_XcpByp_B01 "" UBYTE formula_10_1 1 100 0.0 2550.0 ECU_ADDRESS 0x7FB576 /end MEASUREMENT
/begin MEASUREMENT cont_uint8_10_1_Xcp_B02.Model_XcpByp_B02 "" UBYTE formula_10_1 1 100 0.0 2550.0 ECU_ADDRESS 0x7FB588 /end MEASUREMENT
/begin MEASUREMENT cont_uint8_10_1_Xcp_B03.Model_XcpByp_B03 "" UBYTE formula_10_1 1 100 0.0 2550.0 ECU_ADDRESS 0x7FB59A /end MEASUREMENT
/begin MEASUREMENT errcntr_B01.clsCounter_B01.Model_Byp_B01 "" UBYTE ident 1 100 0 255 ECU_ADDRESS 0x7F8572 DISPLAY_IDENTIFIER errcntr_B01.clsCounter_B01.Model_Byp_B01_DISP_ID /end MEASUREMENT
/begin MEASUREMENT errcntr_B02.clsCounter_B02.Model_Byp_B02 "" UBYTE ident 1 100 0 255 ECU_ADDRESS 0x7F8575 DISPLAY_IDENTIFIER errcntr_B02.clsCounter_B02.Model_Byp_B02_DISP_ID /end MEASUREMENT
/begin MEASUREMENT fl32_01.I_fl32.R01_B "" FLOAT32_IEEE ident 1 100 -9.999999999999998e+036 9.999999999999998e+036 ECU_ADDRESS 0x7F8D58 /end MEASUREMENT
/begin MEASUREMENT fl32_01.I_fl32.R02_B "" FLOAT32_IEEE ident 1 100 -9.999999999999998e+036 9.999999999999998e+036 ECU_ADDRESS 0x7F8DF8 /end MEASUREMENT
/begin MEASUREMENT fl32_01.I_fl32.R03_B "" FLOAT32_IEEE ident 1 100 -9.999999999999998e+036 9.999999999999998e+036 ECU_ADDRESS 0x7F8E98 /end MEASUREMENT
/begin MEASUREMENT fl32_01.I_fl32.R04_B "" FLOAT32_IEEE ident 1 100 -9.999999999999998e+036 9.999999999999998e+036 ECU_ADDRESS 0x7F8F38 /end MEASUREMENT
/begin MEASUREMENT fl32_01.M_Ultimate "" FLOAT32_IEEE ident 1 100 -1.e+037 1.e+037 ECU_ADDRESS 0x7FB4C0 /end MEASUREMENT
/begin MEASUREMENT fl32_02.I_fl32.R01_B "" FLOAT32_IEEE ident 1 100 -9.999999999999998e+036 9.999999999999998e+036 ECU_ADDRESS 0x7F8D5C /end MEASUREMENT
/begin MEASUREMENT fl32_02.I_fl32.R02_B "" FLOAT32_IEEE ident 1 100 -9.999999999999998e+036 9.999999999999998e+036 ECU_ADDRESS 0x7F8DFC /end MEASUREMENT
/begin MEASUREMENT fl32_02.I_fl32.R03_B "" FLOAT32_IEEE ident 1 100 -9.999999999999998e+036 9.999999999999998e+036 ECU_ADDRESS 0x7F8E9C /end MEASUREMENT
/begin MEASUREMENT fl32_02.I_fl32.R04_B "" FLOAT32_IEEE ident 1 100 -9.999999999999998e+036 9.999999999999998e+036 ECU_ADDRESS 0x7F8F3C /end MEASUREMENT
/begin MEASUREMENT fl32_03.I_fl32.R01_B "" FLOAT32_IEEE ident 1 100 -9.999999999999998e+036 9.999999999999998e+036 ECU_ADDRESS 0x7F8D60 /end MEASUREMENT
/begin MEASUREMENT fl32_03.I_fl32.R02_B "" FLOAT32_IEEE ident 1 100 -9.999999999999998e+036 9.999999999999998e+036 ECU_ADDRESS 0x7F8E00 /end MEASUREMENT
/begin MEASUREMENT fl32_03.I_fl32.R03_B "" FLOAT32_IEEE ident 1 100 -9.999999999999998e+036 9.999999999999998e+036 ECU_ADDRESS 0x7F8EA0 /end MEASUREMENT
/begin MEASUREMENT fl32_03.I_fl32.R04_B "" FLOAT32_IEEE ident 1 100 -9.999999999999998e+036 9.999999999999998e+036 ECU_ADDRESS 0x7F8F40 /end MEASUREMENT
/begin MEASUREMENT fl32_04.I_fl32.R01_B "" FLOAT32_IEEE ident 1 100 -9.999999999999998e+036 9.999999999999998e+036 ECU_ADDRESS 0x7F8D64 /end MEASUREMENT
/begin MEASUREMENT fl32_04.I_fl32.R02_B "" FLOAT32_IEEE ident 1 100 -9.999999999999998e+036 9.999999999999998e+036 ECU_ADDRESS 0x7F8E04 /end MEASUREMENT
/begin MEASUREMENT fl32_04.I_fl32.R03_B "" FLOAT32_IEEE ident 1 100 -9.999999999999998e+036 9.999999999999998e+036 ECU_ADDRESS 0x7F8EA4 /end MEASUREMENT
/begin MEASUREMENT fl32_04.I_fl32.R04_B "" FLOAT32_IEEE ident 1 100 -9.999999999999998e+036 9.999999999999998e+036 ECU_ADDRESS 0x7F8F44 /end MEASUREMENT
/begin MEASUREMENT fl32_05.I_fl32.R01_B "" FLOAT32_IEEE ident 1 100 -9.999999999999998e+036 9.999999999999998e+036 ECU_ADDRESS 0x7F8D68 /end MEASUREMENT
/begin MEASUREMENT fl32_05.I_fl32.R02_B "" FLOAT32_IEEE ident 1 100 -9.999999999999998e+036 9.999999999999998e+036 ECU_ADDRESS 0x7F8E08 /end MEASUREMENT
/begin MEASUREMENT fl32_05.I_fl32.R03_B "" FLOAT32_IEEE ident 1 100 -9.999999999999998e+036 9.999999999999998e+036 ECU_ADDRESS 0x7F8EA8 /end MEASUREMENT
/begin MEASUREMENT fl32_05.I_fl32.R04_B "" FLOAT32_IEEE ident 1 100 -9.999999999999998e+036 9.999999999999998e+036 ECU_ADDRESS 0x7F8F48 /end MEASUREMENT
/begin MEASUREMENT fl32_06.I_fl32.R01_B "" FLOAT32_IEEE ident 1 100 -9.999999999999998e+036 9.999999999999998e+036 ECU_ADDRESS 0x7F8D6C /end MEASUREMENT
/begin MEASUREMENT fl32_06.I_fl32.R02_B "" FLOAT32_IEEE ident 1 100 -9.999999999999998e+036 9.999999999999998e+036 ECU_ADDRESS 0x7F8E0C /end MEASUREMENT
/begin MEASUREMENT fl32_06.I_fl32.R03_B "" FLOAT32_IEEE ident 1 100 -9.999999999999998e+036 9.999999999999998e+036 ECU_ADDRESS 0x7F8EAC /end MEASUREMENT
/begin MEASUREMENT fl32_06.I_fl32.R04_B "" FLOAT32_IEEE ident 1 100 -9.999999999999998e+036 9.999999999999998e+036 ECU_ADDRESS 0x7F8F4C /end MEASUREMENT
/begin MEASUREMENT fl32_07.I_fl32.R01_B "" FLOAT32_IEEE ident 1 100 -9.999999999999998e+036 9.999999999999998e+036 ECU_ADDRESS 0x7F8D70 /end MEASUREMENT
/begin MEASUREMENT fl32_07.I_fl32.R02_B "" FLOAT32_IEEE ident 1 100 -9.999999999999998e+036 9.999999999999998e+036 ECU_ADDRESS 0x7F8E10 /end MEASUREMENT
/begin MEASUREMENT fl32_07.I_fl32.R03_B "" FLOAT32_IEEE ident 1 100 -9.999999999999998e+036 9.999999999999998e+036 ECU_ADDRESS 0x7F8EB0 /end MEASUREMENT
/begin MEASUREMENT fl32_07.I_fl32.R04_B "" FLOAT32_IEEE ident 1 100 -9.999999999999998e+036 9.999999999999998e+036 ECU_ADDRESS 0x7F8F50 /end MEASUREMENT
/begin MEASUREMENT fl32_08.I_fl32.R01_B "" FLOAT32_IEEE ident 1 100 -9.999999999999998e+036 9.999999999999998e+036 ECU_ADDRESS 0x7F8D74 /end MEASUREMENT
/begin MEASUREMENT fl32_08.I_fl32.R02_B "" FLOAT32_IEEE ident 1 100 -9.999999999999998e+036 9.999999999999998e+036 ECU_ADDRESS 0x7F8E14 /end MEASUREMENT
/begin MEASUREMENT fl32_08.I_fl32.R03_B "" FLOAT32_IEEE ident 1 100 -9.999999999999998e+036 9.999999999999998e+036 ECU_ADDRESS 0x7F8EB4 /end MEASUREMENT
/begin MEASUREMENT fl32_08.I_fl32.R04_B "" FLOAT32_IEEE ident 1 100 -9.999999999999998e+036 9.999999999999998e+036 ECU_ADDRESS 0x7F8F54 /end MEASUREMENT
/begin MEASUREMENT fl64_01.I_fl64.R01_B "" FLOAT64_IEEE ident 1 100 -1.e+037 1.e+037 ECU_ADDRESS 0x7F8D78 /end MEASUREMENT
/begin MEASUREMENT fl64_01.I_fl64.R02_B "" FLOAT64_IEEE ident 1 100 -1.e+037 1.e+037 ECU_ADDRESS 0x7F8E18 /end MEASUREMENT
/begin MEASUREMENT fl64_01.I_fl64.R03_B "" FLOAT64_IEEE ident 1 100 -1.e+037 1.e+037 ECU_ADDRESS 0x7F8EB8 /end MEASUREMENT
/begin MEASUREMENT fl64_01.I_fl64.R04_B "" FLOAT64_IEEE ident 1 100 -1.e+037 1.e+037 ECU_ADDRESS 0x7F8F58 /end MEASUREMENT
/begin MEASUREMENT fl64_01.M_Ultimate "" FLOAT64_IEEE ident 1 100 -1.e+037 1.e+037 ECU_ADDRESS 0x7FB4B8 /end MEASUREMENT
/begin MEASUREMENT fl64_02.I_fl64.R01_B "" FLOAT64_IEEE ident 1 100 -1.e+037 1.e+037 ECU_ADDRESS 0x7F8D80 /end MEASUREMENT
/begin MEASUREMENT fl64_02.I_fl64.R02_B "" FLOAT64_IEEE ident 1 100 -1.e+037 1.e+037 ECU_ADDRESS 0x7F8E20 /end MEASUREMENT
/begin MEASUREMENT fl64_02.I_fl64.R03_B "" FLOAT64_IEEE ident 1 100 -1.e+037 1.e+037 ECU_ADDRESS 0x7F8EC0 /end MEASUREMENT
/begin MEASUREMENT fl64_02.I_fl64.R04_B "" FLOAT64_IEEE ident 1 100 -1.e+037 1.e+037 ECU_ADDRESS 0x7F8F60 /end MEASUREMENT
/begin MEASUREMENT fl64_03.I_fl64.R01_B "" FLOAT64_IEEE ident 1 100 -1.e+037 1.e+037 ECU_ADDRESS 0x7F8D88 /end MEASUREMENT
/begin MEASUREMENT fl64_03.I_fl64.R02_B "" FLOAT64_IEEE ident 1 100 -1.e+037 1.e+037 ECU_ADDRESS 0x7F8E28 /end MEASUREMENT
/begin MEASUREMENT fl64_03.I_fl64.R03_B "" FLOAT64_IEEE ident 1 100 -1.e+037 1.e+037 ECU_ADDRESS 0x7F8EC8 /end MEASUREMENT
/begin MEASUREMENT fl64_03.I_fl64.R04_B "" FLOAT64_IEEE ident 1 100 -1.e+037 1.e+037 ECU_ADDRESS 0x7F8F68 /end MEASUREMENT
/begin MEASUREMENT fl64_04.I_fl64.R01_B "" FLOAT64_IEEE ident 1 100 -1.e+037 1.e+037 ECU_ADDRESS 0x7F8D90 /end MEASUREMENT
/begin MEASUREMENT fl64_04.I_fl64.R02_B "" FLOAT64_IEEE ident 1 100 -1.e+037 1.e+037 ECU_ADDRESS 0x7F8E30 /end MEASUREMENT
/begin MEASUREMENT fl64_04.I_fl64.R03_B "" FLOAT64_IEEE ident 1 100 -1.e+037 1.e+037 ECU_ADDRESS 0x7F8ED0 /end MEASUREMENT
/begin MEASUREMENT fl64_04.I_fl64.R04_B "" FLOAT64_IEEE ident 1 100 -1.e+037 1.e+037 ECU_ADDRESS 0x7F8F70 /end MEASUREMENT
/begin MEASUREMENT fl64_05.I_fl64.R01_B "" FLOAT64_IEEE ident 1 100 -1.e+037 1.e+037 ECU_ADDRESS 0x7F8D98 /end MEASUREMENT
/begin MEASUREMENT fl64_05.I_fl64.R02_B "" FLOAT64_IEEE ident 1 100 -1.e+037 1.e+037 ECU_ADDRESS 0x7F8E38 /end MEASUREMENT
/begin MEASUREMENT fl64_05.I_fl64.R03_B "" FLOAT64_IEEE ident 1 100 -1.e+037 1.e+037 ECU_ADDRESS 0x7F8ED8 /end MEASUREMENT
/begin MEASUREMENT fl64_05.I_fl64.R04_B "" FLOAT64_IEEE ident 1 100 -1.e+037 1.e+037 ECU_ADDRESS 0x7F8F78 /end MEASUREMENT
/begin MEASUREMENT fl64_06.I_fl64.R01_B "" FLOAT64_IEEE ident 1 100 -1.e+037 1.e+037 ECU_ADDRESS 0x7F8DA0 /end MEASUREMENT
/begin MEASUREMENT fl64_06.I_fl64.R02_B "" FLOAT64_IEEE ident 1 100 -1.e+037 1.e+037 ECU_ADDRESS 0x7F8E40 /end MEASUREMENT
/begin MEASUREMENT fl64_06.I_fl64.R03_B "" FLOAT64_IEEE ident 1 100 -1.e+037 1.e+037 ECU_ADDRESS 0x7F8EE0 /end MEASUREMENT
/begin MEASUREMENT fl64_06.I_fl64.R04_B "" FLOAT64_IEEE ident 1 100 -1.e+037 1.e+037 ECU_ADDRESS 0x7F8F80 /end MEASUREMENT
/begin MEASUREMENT fl64_07.I_fl64.R01_B "" FLOAT64_IEEE ident 1 100 -1.e+037 1.e+037 ECU_ADDRESS 0x7F8DA8 /end MEASUREMENT
/begin MEASUREMENT fl64_07.I_fl64.R02_B "" FLOAT64_IEEE ident 1 100 -1.e+037 1.e+037 ECU_ADDRESS 0x7F8E48 /end MEASUREMENT
/begin MEASUREMENT fl64_07.I_fl64.R03_B "" FLOAT64_IEEE ident 1 100 -1.e+037 1.e+037 ECU_ADDRESS 0x7F8EE8 /end MEASUREMENT
/begin MEASUREMENT fl64_07.I_fl64.R04_B "" FLOAT64_IEEE ident 1 100 -1.e+037 1.e+037 ECU_ADDRESS 0x7F8F88 /end MEASUREMENT
/begin MEASUREMENT fl64_08.I_fl64.R01_B "" FLOAT64_IEEE ident 1 100 -1.e+037 1.e+037 ECU_ADDRESS 0x7F8DB0 /end MEASUREMENT
/begin MEASUREMENT fl64_08.I_fl64.R02_B "" FLOAT64_IEEE ident 1 100 -1.e+037 1.e+037 ECU_ADDRESS 0x7F8E50 /end MEASUREMENT
/begin MEASUREMENT fl64_08.I_fl64.R03_B "" FLOAT64_IEEE ident 1 100 -1.e+037 1.e+037 ECU_ADDRESS 0x7F8EF0 /end MEASUREMENT
/begin MEASUREMENT fl64_08.I_fl64.R04_B "" FLOAT64_IEEE ident 1 100 -1.e+037 1.e+037 ECU_ADDRESS 0x7F8F90 /end MEASUREMENT
/begin MEASUREMENT i.FEA_performance_array "" UBYTE ident 1 100 0 255 ECU_ADDRESS 0x7F8954 /end MEASUREMENT
/begin MEASUREMENT log_uint8_0_B01.Model_Byp_B01 "" UBYTE ident 1 100 0 1 BIT_MASK 0x1 ECU_ADDRESS 0x7FB546 DISPLAY_IDENTIFIER log_uint8_0_B01.Model_Byp_B01_DISP_ID /end MEASUREMENT
/begin MEASUREMENT log_uint8_0_B02.Model_Byp_B02 "" UBYTE ident 1 100 0 1 BIT_MASK 0x1 ECU_ADDRESS 0x7FB566 DISPLAY_IDENTIFIER log_uint8_0_B02.Model_Byp_B02_DISP_ID /end MEASUREMENT
/begin MEASUREMENT log_uint8_0_bitOffset_cpy_B01.Model_Byp_B01 "" UBYTE ident 1 100 0 7 ECU_ADDRESS 0x7FB530 DISPLAY_IDENTIFIER log_uint8_0_bitOffset_cpy_B01.Model_Byp_B01_DISP_ID /end MEASUREMENT
/begin MEASUREMENT log_uint8_0_bitOffset_cpy_B02.Model_Byp_B02 "" UBYTE ident 1 100 0 7 ECU_ADDRESS 0x7FB550 DISPLAY_IDENTIFIER log_uint8_0_bitOffset_cpy_B02.Model_Byp_B02_DISP_ID /end MEASUREMENT
/begin MEASUREMENT log_uint8_0_offset_cpy_B01.Model_Byp_B01 "" UBYTE ident 1 100 0 255 ECU_ADDRESS 0x7FB531 DISPLAY_IDENTIFIER log_uint8_0_offset_cpy_B01.Model_Byp_B01_DISP_ID /end MEASUREMENT
/begin MEASUREMENT log_uint8_0_offset_cpy_B02.Model_Byp_B02 "" UBYTE ident 1 100 0 255 ECU_ADDRESS 0x7FB551 DISPLAY_IDENTIFIER log_uint8_0_offset_cpy_B02.Model_Byp_B02_DISP_ID /end MEASUREMENT
/begin MEASUREMENT log_uint8_0_Xcp_B01.Model_XcpByp_B01 "" UBYTE ident 1 100 0 1 BIT_MASK 0x1 ECU_ADDRESS 0x7FB577 /end MEASUREMENT
/begin MEASUREMENT log_uint8_0_Xcp_B02.Model_XcpByp_B02 "" UBYTE ident 1 100 0 1 BIT_MASK 0x1 ECU_ADDRESS 0x7FB589 /end MEASUREMENT
/begin MEASUREMENT log_uint8_0_Xcp_B03.Model_XcpByp_B03 "" UBYTE ident 1 100 0 1 BIT_MASK 0x1 ECU_ADDRESS 0x7FB59B /end MEASUREMENT
/begin MEASUREMENT log_uint8_1_B01.Model_Byp_B01 "" UBYTE ident 1 100 0 1 BIT_MASK 0x1 ECU_ADDRESS 0x7FB547 DISPLAY_IDENTIFIER log_uint8_1_B01.Model_Byp_B01_DISP_ID /end MEASUREMENT
/begin MEASUREMENT log_uint8_1_B02.Model_Byp_B02 "" UBYTE ident 1 100 0 1 BIT_MASK 0x1 ECU_ADDRESS 0x7FB567 DISPLAY_IDENTIFIER log_uint8_1_B02.Model_Byp_B02_DISP_ID /end MEASUREMENT
/begin MEASUREMENT log_uint8_1_bitOffset_cpy_B01.Model_Byp_B01 "" UBYTE ident 1 100 0 7 ECU_ADDRESS 0x7FB532 DISPLAY_IDENTIFIER log_uint8_1_bitOffset_cpy_B01.Model_Byp_B01_DISP_ID /end MEASUREMENT
/begin MEASUREMENT log_uint8_1_bitOffset_cpy_B02.Model_Byp_B02 "" UBYTE ident 1 100 0 7 ECU_ADDRESS 0x7FB552 DISPLAY_IDENTIFIER log_uint8_1_bitOffset_cpy_B02.Model_Byp_B02_DISP_ID /end MEASUREMENT
/begin MEASUREMENT log_uint8_1_offset_cpy_B01.Model_Byp_B01 "" UBYTE ident 1 100 0 255 ECU_ADDRESS 0x7FB533 DISPLAY_IDENTIFIER log_uint8_1_offset_cpy_B01.Model_Byp_B01_DISP_ID /end MEASUREMENT
/begin MEASUREMENT log_uint8_1_offset_cpy_B02.Model_Byp_B02 "" UBYTE ident 1 100 0 255 ECU_ADDRESS 0x7FB553 DISPLAY_IDENTIFIER log_uint8_1_offset_cpy_B02.Model_Byp_B02_DISP_ID /end MEASUREMENT
/begin MEASUREMENT log_uint8_1_Xcp_B01.Model_XcpByp_B01 "" UBYTE ident 1 100 0 1 BIT_MASK 0x1 ECU_ADDRESS 0x7FB578 /end MEASUREMENT
/begin MEASUREMENT log_uint8_1_Xcp_B02.Model_XcpByp_B02 "" UBYTE ident 1 100 0 1 BIT_MASK 0x1 ECU_ADDRESS 0x7FB58A /end MEASUREMENT
/begin MEASUREMENT log_uint8_1_Xcp_B03.Model_XcpByp_B03 "" UBYTE ident 1 100 0 1 BIT_MASK 0x1 ECU_ADDRESS 0x7FB59C /end MEASUREMENT
/* begin C:/ETAS/ASCET513/target/mpc555/Add_ToolChain/ASAP_Templates\M_F32_FORMULA.a2l inserted by script merge_Tab.pl */
/begin MEASUREMENT M_F32_IDENT.FORMULA "" FLOAT32_IEEE ident 1 100 -1.e+037 1.e+037 ECU_ADDRESS 0x822790 /end MEASUREMENT
/begin MEASUREMENT M_F32_TAB_INTP.FORMULA "" FLOAT32_IEEE TestCmTabIntp 1 100 -1.e+037 1.e+037 ECU_ADDRESS 0x822790 /end MEASUREMENT
/begin MEASUREMENT M_F32_TAB_NOINTP.FORMULA "" FLOAT32_IEEE TestCmTabNoIntp 1 100 -1.e+037 1.e+037 ECU_ADDRESS 0x822790 /end MEASUREMENT
/begin MEASUREMENT M_F32_TAB_VERB.FORMULA "" FLOAT32_IEEE TestCmTabVerb 1 100 -1.e+037 1.e+037 ECU_ADDRESS 0x822790 /end MEASUREMENT
/begin MEASUREMENT M_F32_RAT_FUNC.FORMULA "" FLOAT32_IEEE Test_axx_bx_c_div_dxx_ex_f 1 100 -1.e+037 1.e+037 ECU_ADDRESS 0x822790 /end MEASUREMENT
/* begin C:/ETAS/ASCET513/target/mpc555/Add_ToolChain/ASAP_Templates\M_F64_FORMULA.a2l inserted by script merge_Tab.pl */
/begin MEASUREMENT M_F64_IDENT.FORMULA "" FLOAT64_IEEE ident 1 100 -1.e+037 1.e+037 ECU_ADDRESS 0x822788 /end MEASUREMENT
/begin MEASUREMENT M_F64_TAB_INTP.FORMULA "" FLOAT64_IEEE TestCmTabIntp 1 100 -1.e+037 1.e+037 ECU_ADDRESS 0x822788 /end MEASUREMENT
/begin MEASUREMENT M_F64_TAB_NOINTP.FORMULA "" FLOAT64_IEEE TestCmTabNoIntp 1 100 -1.e+037 1.e+037 ECU_ADDRESS 0x822788 /end MEASUREMENT
/begin MEASUREMENT M_F64_TAB_VERB.FORMULA "" FLOAT64_IEEE TestCmTabVerb 1 100 -1.e+037 1.e+037 ECU_ADDRESS 0x822788 /end MEASUREMENT
/begin MEASUREMENT M_F64_RAT_FUNC.FORMULA "" FLOAT64_IEEE Test_axx_bx_c_div_dxx_ex_f 1 100 -1.e+037 1.e+037 ECU_ADDRESS 0x822788 /end MEASUREMENT
/begin MEASUREMENT M_In_Cuboid_X.Map_Mod "" FLOAT32_IEEE ident 1 100 -1.e+037 1.e+037 ECU_ADDRESS 0x82284C /end MEASUREMENT
/begin MEASUREMENT M_In_Cuboid_Y.Map_Mod "" FLOAT32_IEEE ident 1 100 -1.e+037 1.e+037 ECU_ADDRESS 0x822850 /end MEASUREMENT
/begin MEASUREMENT M_In_Cuboid_Z.Map_Mod "" FLOAT32_IEEE ident 1 100 -1.e+037 1.e+037 ECU_ADDRESS 0x822854 /end MEASUREMENT
/begin MEASUREMENT M_In_Cuboid_Z2.Map_Mod "" FLOAT32_IEEE ident 1 100 -1.e+037 1.e+037 ECU_ADDRESS 0x822858 /end MEASUREMENT
/begin MEASUREMENT M_In_X_Dist.Map_Mod "" FLOAT32_IEEE ident 1 100 -1.e+037 1.e+037 ECU_ADDRESS 0x82285C /end MEASUREMENT
/begin MEASUREMENT M_In_X_Two_D.Map_Mod "" FLOAT32_IEEE ident 1 100 -1.e+037 1.e+037 ECU_ADDRESS 0x822860 /end MEASUREMENT
/begin MEASUREMENT M_In_Y_Dist.Map_Mod "" FLOAT32_IEEE ident 1 100 -1.e+037 1.e+037 ECU_ADDRESS 0x822864 /end MEASUREMENT
/begin MEASUREMENT M_In_Y_Two_D.Map_Mod "" FLOAT32_IEEE ident 1 100 -1.e+037 1.e+037 ECU_ADDRESS 0x822868 /end MEASUREMENT
/begin MEASUREMENT M_Out_Cuboid3D_1.Map_Mod "" FLOAT32_IEEE ident 1 100 -1.e+037 1.e+037 ECU_ADDRESS 0x82286C /end MEASUREMENT
/begin MEASUREMENT M_Out_Cuboid3D_2.Map_Mod "" FLOAT32_IEEE ident 1 100 -1.e+037 1.e+037 ECU_ADDRESS 0x822870 /end MEASUREMENT
/begin MEASUREMENT M_Out_Cuboid3D_3.Map_Mod "" FLOAT32_IEEE ident 1 100 -1.e+037 1.e+037 ECU_ADDRESS 0x822874 /end MEASUREMENT
/begin MEASUREMENT M_Out_Group_1.Map_Mod "" FLOAT32_IEEE ident 1 100 -1.e+037 1.e+037 ECU_ADDRESS 0x822878 /end MEASUREMENT
/begin MEASUREMENT M_Out_Group_2.Map_Mod "" FLOAT32_IEEE ident 1 100 -1.e+037 1.e+037 ECU_ADDRESS 0x82287C /end MEASUREMENT
/begin MEASUREMENT M_Out_Group_3.Map_Mod "" FLOAT32_IEEE ident 1 100 -1.e+037 1.e+037 ECU_ADDRESS 0x822880 /end MEASUREMENT
/begin MEASUREMENT M_Out_X_Two_D.Map_Mod "" FLOAT32_IEEE ident 1 100 -1.e+037 1.e+037 ECU_ADDRESS 0x822884 /end MEASUREMENT
/* begin C:/ETAS/ASCET513/target/mpc555/Add_ToolChain/ASAP_Templates\M_S16_FORMULA.a2l inserted by script merge_Tab.pl */
/begin MEASUREMENT M_S16_IDENT.FORMULA "" SWORD ident 1 100 -32768.0 32767.0 ECU_ADDRESS 0x82279C /end MEASUREMENT
/begin MEASUREMENT M_S16_TAB_INTP.FORMULA "" SWORD TestCmTabIntp 1 100 -32768.0 32767.0 ECU_ADDRESS 0x82279C /end MEASUREMENT
/begin MEASUREMENT M_S16_TAB_NOINTP.FORMULA "" SWORD TestCmTabNoIntp 1 100 -32768.0 32767.0 ECU_ADDRESS 0x82279C /end MEASUREMENT
/begin MEASUREMENT M_S16_TAB_VERB.FORMULA "" SWORD TestCmTabVerb 1 100 -32768.0 32767.0 ECU_ADDRESS 0x82279C /end MEASUREMENT
/begin MEASUREMENT M_S16_RAT_FUNC.FORMULA "" SWORD Test_axx_bx_c_div_dxx_ex_f 1 100 -32768.0 32767.0 ECU_ADDRESS 0x82279C /end MEASUREMENT
/* begin C:/ETAS/ASCET513/target/mpc555/Add_ToolChain/ASAP_Templates\M_S32_FORMULA.a2l inserted by script merge_Tab.pl */
/begin MEASUREMENT M_S32_IDENT.FORMULA "" SLONG ident 1 100 -2147483648.0 2147483647.0 ECU_ADDRESS 0x822794 /end MEASUREMENT
/begin MEASUREMENT M_S32_TAB_INTP.FORMULA "" SLONG TestCmTabIntp 1 100 -2147483648.0 2147483647.0 ECU_ADDRESS 0x822794 /end MEASUREMENT
/begin MEASUREMENT M_S32_TAB_NOINTP.FORMULA "" SLONG TestCmTabNoIntp 1 100 -2147483648.0 2147483647.0 ECU_ADDRESS 0x822794 /end MEASUREMENT
/begin MEASUREMENT M_S32_TAB_VERB.FORMULA "" SLONG TestCmTabVerb 1 100 -2147483648.0 2147483647.0 ECU_ADDRESS 0x822794 /end MEASUREMENT
/begin MEASUREMENT M_S32_RAT_FUNC.FORMULA "" SLONG Test_axx_bx_c_div_dxx_ex_f 1 100 -2147483648.0 2147483647.0 ECU_ADDRESS 0x822794 /end MEASUREMENT
/* begin C:/ETAS/ASCET513/target/mpc555/Add_ToolChain/ASAP_Templates\M_S8_FORMULA.a2l inserted by script merge_Tab.pl */
/begin MEASUREMENT M_S8_IDENT.FORMULA "" SBYTE ident 1 100 -128.0 127.0 ECU_ADDRESS 0x8227A0 /end MEASUREMENT
/begin MEASUREMENT M_S8_TAB_INTP.FORMULA "" SBYTE TestCmTabIntp 1 100 -128.0 127.0 ECU_ADDRESS 0x8227A0 /end MEASUREMENT
/begin MEASUREMENT M_S8_TAB_NOINTP.FORMULA "" SBYTE TestCmTabNoIntp 1 100 -128.0 127.0 ECU_ADDRESS 0x8227A0 /end MEASUREMENT
/begin MEASUREMENT M_S8_TAB_VERB.FORMULA "" SBYTE TestCmTabVerb 1 100 -128.0 127.0 ECU_ADDRESS 0x8227A0 /end MEASUREMENT
/begin MEASUREMENT M_S8_RAT_FUNC.FORMULA "" SBYTE Test_axx_bx_c_div_dxx_ex_f 1 100 -128.0 127.0 ECU_ADDRESS 0x8227A0 /end MEASUREMENT
/* begin C:/ETAS/ASCET513/target/mpc555/Add_ToolChain/ASAP_Templates\M_U16_FORMULA.a2l inserted by script merge_Tab.pl */
/begin MEASUREMENT M_U16_IDENT.FORMULA "" UWORD ident 1 100 0.0 65535.0 ECU_ADDRESS 0x82279E /end MEASUREMENT
/begin MEASUREMENT M_U16_TAB_INTP.FORMULA "" UWORD TestCmTabIntp 1 100 0.0 65535.0 ECU_ADDRESS 0x82279E /end MEASUREMENT
/begin MEASUREMENT M_U16_TAB_NOINTP.FORMULA "" UWORD TestCmTabNoIntp 1 100 0.0 65535.0 ECU_ADDRESS 0x82279E /end MEASUREMENT
/begin MEASUREMENT M_U16_TAB_VERB.FORMULA "" UWORD TestCmTabVerb 1 100 0.0 65535.0 ECU_ADDRESS 0x82279E /end MEASUREMENT
/begin MEASUREMENT M_U16_RAT_FUNC.FORMULA "" UWORD Test_axx_bx_c_div_dxx_ex_f 1 100 0.0 65535.0 ECU_ADDRESS 0x82279E /end MEASUREMENT
/* begin C:/ETAS/ASCET513/target/mpc555/Add_ToolChain/ASAP_Templates\M_U32_FORMULA.a2l inserted by script merge_Tab.pl */
/begin MEASUREMENT M_U32_IDENT.FORMULA "" ULONG ident 1 100 0.0 4294967295.0 ECU_ADDRESS 0x822798 /end MEASUREMENT
/begin MEASUREMENT M_U32_TAB_INTP.FORMULA "" ULONG TestCmTabIntp 1 100 0.0 4294967295.0 ECU_ADDRESS 0x822798 /end MEASUREMENT
/begin MEASUREMENT M_U32_TAB_NOINTP.FORMULA "" ULONG TestCmTabNoIntp 1 100 0.0 4294967295.0 ECU_ADDRESS 0x822798 /end MEASUREMENT
/begin MEASUREMENT M_U32_TAB_VERB.FORMULA "" ULONG TestCmTabVerb 1 100 0.0 4294967295.0 ECU_ADDRESS 0x822798 /end MEASUREMENT
/begin MEASUREMENT M_U32_RAT_FUNC.FORMULA "" ULONG Test_axx_bx_c_div_dxx_ex_f 1 100 0.0 4294967295.0 ECU_ADDRESS 0x822798 /end MEASUREMENT
/* begin C:/ETAS/ASCET513/target/mpc555/Add_ToolChain/ASAP_Templates\M_U8_FORMULA.a2l inserted by script merge_Tab.pl */
/begin MEASUREMENT M_U8_IDENT.FORMULA "" UBYTE ident 1 100 0.0 255.0 ECU_ADDRESS 0x8227A1 /end MEASUREMENT
/begin MEASUREMENT M_U8_TAB_INTP.FORMULA "" UBYTE TestCmTabIntp 1 100 0.0 255.0 ECU_ADDRESS 0x8227A1 /end MEASUREMENT
/begin COMPU_METHOD TestCmTabIntp "Test Compu Method for TAB_INTP" TAB_INTP "%7.1" "M9U unit" COMPU_TAB_REF TestCtTabIntp /end COMPU_METHOD
/begin COMPU_TAB TestCtTabIntp "conversion table for TestCtTabIntp" TAB_INTP 15 -9999999999 -9999999999 -2147483648 -2147483648 -32768 -32768 -255 -43.0 -128 -20.0 -100 -10.0 0 0.0 100 10.0 127 20.0 255 43.0 32767 100000 65535 250000 2147483647 2147483647 4294967295 4294967295 9999999999 9999999999 /end COMPU_TAB
/begin MEASUREMENT M_U8_TAB_NOINTP.FORMULA "" UBYTE TestCmTabNoIntp 1 100 0.0 255.0 ECU_ADDRESS 0x8227A1 /end MEASUREMENT
/begin COMPU_METHOD TestCmTabNoIntp "Test Compu Method for TAB_NOINTP" TAB_NOINTP "%7.1" "M9U unit" COMPU_TAB_REF TestCtTabNoIntp /end COMPU_METHOD
/begin COMPU_TAB TestCtTabNoIntp "conversion table for TestCtTabNoIntp" TAB_NOINTP 15 -9999999999 -9999999999 -2147483648 -2147483648 -32768 -32768 -255 -43.0 -128 -20.0 -100 -10.0 0 0.0 100 10.0 127 20.0 255 43.0 32767 100000 65535 250000 2147483647 2147483647 4294967295 4294967295 9999999999 9999999999 /end COMPU_TAB
/begin MEASUREMENT M_U8_TAB_VERB.FORMULA "" UBYTE TestCmTabVerb 1 100 0.0 255.0 ECU_ADDRESS 0x8227A1 /end MEASUREMENT
/begin COMPU_METHOD TestCmTabVerb "Test Compu Method for TAB_VERB" TAB_VERB "%7.1" "M9U unit" COMPU_TAB_REF TestCtTabVerb /end COMPU_METHOD
/begin COMPU_VTAB TestCtTabVerb "conversion table for TestCtTabVerb" TAB_VERB 15 -9999999999 "-9999999999" -2147483648 "-2147483648" -32768 "-32768" -255 "-zweifuenffuenf" -128 "-einszweiacht" -100 "-einhundert" 0 "null" 100 "einhundert" 127 "einszweisieben" 255 "zweifuenffuenf" 32767 "+32767" 65535 "+65535" 2147483647 "+2147483647" 4294967295 "+4294967295" 9999999999 "+9999999999" DEFAULT_VALUE "unknown" /end COMPU_VTAB
/begin MEASUREMENT M_U8_RAT_FUNC.FORMULA "" UBYTE Test_axx_bx_c_div_dxx_ex_f 1 100 0.0 255.0 ECU_ADDRESS 0x8227A1 /end MEASUREMENT
/begin MEASUREMENT oldSignal.EdgeRising.Reset_Schalter "" UBYTE ident 1 100 0 1 ECU_ADDRESS 0x7FB489 DISPLAY_IDENTIFIER oldSignal.EdgeRising.Reset_Schalter_DISP_ID /end MEASUREMENT
/begin MEASUREMENT Result.FEA_performance_array "" ULONG ident 1 100 0 255 ECU_ADDRESS 0x7F8948 /end MEASUREMENT
/begin MEASUREMENT Result.FEA_performance_scalar "" ULONG ident 1 100 0 255 ECU_ADDRESS 0x7F8958 /end MEASUREMENT
/begin MEASUREMENT ResultShort.FEA_performance_scalar "" ULONG ident 1 100 0 255 ECU_ADDRESS 0x7F895C /end MEASUREMENT
/begin MEASUREMENT RM01_Op_u8.M_Ultimate "" UBYTE ident 1 100 0 255 ECU_ADDRESS 0x7FB520 /end MEASUREMENT
/begin MEASUREMENT RM01_Par01_u8.M_Ultimate "" FLOAT64_IEEE ident 1 100 -1.e+037 1.e+037 ECU_ADDRESS 0x7FB4D8 /end MEASUREMENT
/begin MEASUREMENT RM01_Par02_u8.M_Ultimate "" FLOAT64_IEEE ident 1 100 -1.e+037 1.e+037 ECU_ADDRESS 0x7FB4E0 /end MEASUREMENT
/begin MEASUREMENT RM01_Res_u8.M_Ultimate "" FLOAT64_IEEE ident 1 100 -1.e+037 1.e+037 ECU_ADDRESS 0x7FB4E8 /end MEASUREMENT
/begin MEASUREMENT s_uint8_01.M_Ultimate "" FLOAT64_IEEE ident 1 100 -1.e+037 1.e+037 ECU_ADDRESS 0x7FB510 /end MEASUREMENT
/begin MEASUREMENT sdisc_sint16_B01.Model_Byp_B01 "" SWORD ident 1 100 -32768 32767 ECU_ADDRESS 0x7FB53E DISPLAY_IDENTIFIER sdisc_sint16_B01.Model_Byp_B01_DISP_ID /end MEASUREMENT
/begin MEASUREMENT sdisc_sint16_B02.Model_Byp_B02 "" SWORD ident 1 100 -32768 32767 ECU_ADDRESS 0x7FB55E DISPLAY_IDENTIFIER sdisc_sint16_B02.Model_Byp_B02_DISP_ID /end MEASUREMENT
/begin MEASUREMENT sdisc_sint16_offset_cpy_B01.Model_Byp_B01 "" UBYTE ident 1 100 0 255 ECU_ADDRESS 0x7FB534 DISPLAY_IDENTIFIER sdisc_sint16_offset_cpy_B01.Model_Byp_B01_DISP_ID /end MEASUREMENT
/begin MEASUREMENT sdisc_sint16_offset_cpy_B02.Model_Byp_B02 "" UBYTE ident 1 100 0 255 ECU_ADDRESS 0x7FB554 DISPLAY_IDENTIFIER sdisc_sint16_offset_cpy_B02.Model_Byp_B02_DISP_ID /end MEASUREMENT
/begin MEASUREMENT sdisc_sint16_Xcp_B01.Model_XcpByp_B01 "" SWORD ident 1 100 -32768 32767 ECU_ADDRESS 0x7FB570 /end MEASUREMENT
/begin MEASUREMENT sdisc_sint16_Xcp_B02.Model_XcpByp_B02 "" SWORD ident 1 100 -32768 32767 ECU_ADDRESS 0x7FB582 /end MEASUREMENT
/begin MEASUREMENT sdisc_sint16_Xcp_B03.Model_XcpByp_B03 "" SWORD ident 1 100 -32768 32767 ECU_ADDRESS 0x7FB594 /end MEASUREMENT
/begin MEASUREMENT sdisc_sint8_B01.Model_Byp_B01 "" SBYTE ident 1 100 -128 127 ECU_ADDRESS 0x7FB548 DISPLAY_IDENTIFIER sdisc_sint8_B01.Model_Byp_B01_DISP_ID /end MEASUREMENT
/begin MEASUREMENT sdisc_sint8_B02.Model_Byp_B02 "" SBYTE ident 1 100 -128 127 ECU_ADDRESS 0x7FB568 DISPLAY_IDENTIFIER sdisc_sint8_B02.Model_Byp_B02_DISP_ID /end MEASUREMENT
/begin MEASUREMENT sdisc_sint8_offset_cpy_B01.Model_Byp_B01 "" UBYTE ident 1 100 0 255 ECU_ADDRESS 0x7FB535 DISPLAY_IDENTIFIER sdisc_sint8_offset_cpy_B01.Model_Byp_B01_DISP_ID /end MEASUREMENT
/begin MEASUREMENT sdisc_sint8_offset_cpy_B02.Model_Byp_B02 "" UBYTE ident 1 100 0 255 ECU_ADDRESS 0x7FB555 DISPLAY_IDENTIFIER sdisc_sint8_offset_cpy_B02.Model_Byp_B02_DISP_ID /end MEASUREMENT
/begin MEASUREMENT sdisc_sint8_Xcp_B01.Model_XcpByp_B01 "" SBYTE ident 1 100 -128 127 ECU_ADDRESS 0x7FB579 /end MEASUREMENT
/begin MEASUREMENT sdisc_sint8_Xcp_B02.Model_XcpByp_B02 "" SBYTE ident 1 100 -128 127 ECU_ADDRESS 0x7FB58B /end MEASUREMENT
/begin MEASUREMENT sdisc_sint8_Xcp_B03.Model_XcpByp_B03 "" SBYTE ident 1 100 -128 127 ECU_ADDRESS 0x7FB59D /end MEASUREMENT
/begin MEASUREMENT sint16_01.I_sint16.R01 "" SWORD ident 1 100 -32768 32767 ECU_ADDRESS 0x7FB652 DISPLAY_IDENTIFIER sint16_01.I_sint16.R01_DISP_ID_R01 /end MEASUREMENT
/begin MEASUREMENT sint16_01.I_sint16.R02 "" SWORD ident 1 100 -32768 32767 ECU_ADDRESS 0x7FB68A DISPLAY_IDENTIFIER sint16_01.I_sint16.R02_DISP_ID_R02 /end MEASUREMENT
/begin MEASUREMENT sint16_01.I_sint16.R03 "" SWORD ident 1 100 -32768 32767 ECU_ADDRESS 0x7FB6C2 DISPLAY_IDENTIFIER sint16_01.I_sint16.R03_DISP_ID_R03 /end MEASUREMENT
/begin MEASUREMENT sint16_01.I_sint16.R04 "" SWORD ident 1 100 -32768 32767 ECU_ADDRESS 0x7FB6F8 /end MEASUREMENT
/begin MEASUREMENT sint16_01.I_sint16_1.R01_16bit "" SWORD ident 1 100 -32768 32767 ECU_ADDRESS 0x7F8C56 /end MEASUREMENT
/begin MEASUREMENT sint16_01.I_sint16_2.R01_16bit "" SWORD ident 1 100 -32768 32767 ECU_ADDRESS 0x7F8C66 /end MEASUREMENT
/begin MEASUREMENT sint16_01.I_sint16_3.R01_16bit "" SWORD ident 1 100 -32768 32767 ECU_ADDRESS 0x7F8C76 /end MEASUREMENT
/begin MEASUREMENT sint16_01.I_sint16_4.R01_16bit "" SWORD ident 1 100 -32768 32767 ECU_ADDRESS 0x7F8C86 /end MEASUREMENT
/begin MEASUREMENT sint16_01.M_Ultimate "" SWORD ident 1 100 -32768 32767 ECU_ADDRESS 0x7FB4CC /end MEASUREMENT
/begin MEASUREMENT sint16_02.I_sint16.R01 "" SWORD ident 1 100 -32768 32767 ECU_ADDRESS 0x7FB654 DISPLAY_IDENTIFIER sint16_02.I_sint16.R01_DISP_ID_R01 /end MEASUREMENT
/begin MEASUREMENT sint16_02.I_sint16.R02 "" SWORD ident 1 100 -32768 32767 ECU_ADDRESS 0x7FB68C DISPLAY_IDENTIFIER sint16_02.I_sint16.R02_DISP_ID_R02 /end MEASUREMENT
/begin MEASUREMENT sint16_02.I_sint16.R03 "" SWORD ident 1 100 -32768 32767 ECU_ADDRESS 0x7FB6C4 DISPLAY_IDENTIFIER sint16_02.I_sint16.R03_DISP_ID_R03 /end MEASUREMENT
/begin MEASUREMENT sint16_02.I_sint16.R04 "" SWORD ident 1 100 -32768 32767 ECU_ADDRESS 0x7FB6FA /end MEASUREMENT
/begin MEASUREMENT sint16_02.I_sint16_1.R01_16bit "" SWORD ident 1 100 -32768 32767 ECU_ADDRESS 0x7F8C58 /end MEASUREMENT
/begin MEASUREMENT sint16_02.I_sint16_2.R01_16bit "" SWORD ident 1 100 -32768 32767 ECU_ADDRESS 0x7F8C68 /end MEASUREMENT
/begin MEASUREMENT sint16_02.I_sint16_3.R01_16bit "" SWORD ident 1 100 -32768 32767 ECU_ADDRESS 0x7F8C78 /end MEASUREMENT
/begin MEASUREMENT sint16_02.I_sint16_4.R01_16bit "" SWORD ident 1 100 -32768 32767 ECU_ADDRESS 0x7F8C88 /end MEASUREMENT
/begin MEASUREMENT sint16_03.I_sint16.R01 "" SWORD ident 1 100 -32768 32767 ECU_ADDRESS 0x7FB656 DISPLAY_IDENTIFIER sint16_03.I_sint16.R01_DISP_ID_R01 /end MEASUREMENT
/begin MEASUREMENT sint16_03.I_sint16.R02 "" SWORD ident 1 100 -32768 32767 ECU_ADDRESS 0x7FB68E DISPLAY_IDENTIFIER sint16_03.I_sint16.R02_DISP_ID_R02 /end MEASUREMENT
/begin MEASUREMENT sint16_03.I_sint16.R03 "" SWORD ident 1 100 -32768 32767 ECU_ADDRESS 0x7FB6C6 DISPLAY_IDENTIFIER sint16_03.I_sint16.R03_DISP_ID_R03 /end MEASUREMENT
/begin MEASUREMENT sint16_03.I_sint16.R04 "" SWORD ident 1 100 -32768 32767 ECU_ADDRESS 0x7FB6FC /end MEASUREMENT
/begin MEASUREMENT sint16_03.I_sint16_1.R01_16bit "" SWORD ident 1 100 -32768 32767 ECU_ADDRESS 0x7F8C5A /end MEASUREMENT
/begin MEASUREMENT sint16_03.I_sint16_2.R01_16bit "" SWORD ident 1 100 -32768 32767 ECU_ADDRESS 0x7F8C6A /end MEASUREMENT
/begin MEASUREMENT sint16_03.I_sint16_3.R01_16bit "" SWORD ident 1 100 -32768 32767 ECU_ADDRESS 0x7F8C7A /end MEASUREMENT
/begin MEASUREMENT sint16_03.I_sint16_4.R01_16bit "" SWORD ident 1 100 -32768 32767 ECU_ADDRESS 0x7F8C8A /end MEASUREMENT
/begin MEASUREMENT sint16_04.I_sint16.R01 "" SWORD ident 1 100 -32768 32767 ECU_ADDRESS 0x7FB658 DISPLAY_IDENTIFIER sint16_04.I_sint16.R01_DISP_ID_R01 /end MEASUREMENT
/begin MEASUREMENT sint16_04.I_sint16.R02 "" SWORD ident 1 100 -32768 32767 ECU_ADDRESS 0x7FB690 DISPLAY_IDENTIFIER sint16_04.I_sint16.R02_DISP_ID_R02 /end MEASUREMENT
/begin MEASUREMENT sint16_04.I_sint16.R03 "" SWORD ident 1 100 -32768 32767 ECU_ADDRESS 0x7FB6C8 DISPLAY_IDENTIFIER sint16_04.I_sint16.R03_DISP_ID_R03 /end MEASUREMENT
/begin MEASUREMENT sint16_04.I_sint16.R04 "" SWORD ident 1 100 -32768 32767 ECU_ADDRESS 0x7FB6FE /end MEASUREMENT
/begin MEASUREMENT sint16_04.I_sint16_1.R01_16bit "" SWORD ident 1 100 -32768 32767 ECU_ADDRESS 0x7F8C5C /end MEASUREMENT
/begin MEASUREMENT sint16_04.I_sint16_2.R01_16bit "" SWORD ident 1 100 -32768 32767 ECU_ADDRESS 0x7F8C6C /end MEASUREMENT
/begin MEASUREMENT sint16_04.I_sint16_3.R01_16bit "" SWORD ident 1 100 -32768 32767 ECU_ADDRESS 0x7F8C7C /end MEASUREMENT
/begin MEASUREMENT sint16_04.I_sint16_4.R01_16bit "" SWORD ident 1 100 -32768 32767 ECU_ADDRESS 0x7F8C8C /end MEASUREMENT
/begin MEASUREMENT sint16_05.I_sint16.R01 "" SWORD ident 1 100 -32768 32767 ECU_ADDRESS 0x7FB65A DISPLAY_IDENTIFIER sint16_05.I_sint16.R01_DISP_ID_R01 /end MEASUREMENT
/begin MEASUREMENT sint16_05.I_sint16.R02 "" SWORD ident 1 100 -32768 32767 ECU_ADDRESS 0x7FB692 DISPLAY_IDENTIFIER sint16_05.I_sint16.R02_DISP_ID_R02 /end MEASUREMENT
/begin MEASUREMENT sint16_05.I_sint16.R03 "" SWORD ident 1 100 -32768 32767 ECU_ADDRESS 0x7FB6CA DISPLAY_IDENTIFIER sint16_05.I_sint16.R03_DISP_ID_R03 /end MEASUREMENT
/begin MEASUREMENT sint16_05.I_sint16.R04 "" SWORD ident 1 100 -32768 32767 ECU_ADDRESS 0x7FB700 /end MEASUREMENT
/begin MEASUREMENT sint16_05.I_sint16_1.R01_16bit "" SWORD ident 1 100 -32768 32767 ECU_ADDRESS 0x7F8C5E /end MEASUREMENT
/begin MEASUREMENT sint16_05.I_sint16_2.R01_16bit "" SWORD ident 1 100 -32768 32767 ECU_ADDRESS 0x7F8C6E /end MEASUREMENT
/begin MEASUREMENT sint16_05.I_sint16_3.R01_16bit "" SWORD ident 1 100 -32768 32767 ECU_ADDRESS 0x7F8C7E /end MEASUREMENT
/begin MEASUREMENT sint16_05.I_sint16_4.R01_16bit "" SWORD ident 1 100 -32768 32767 ECU_ADDRESS 0x7F8C8E /end MEASUREMENT
/begin MEASUREMENT sint16_06.I_sint16.R01 "" SWORD ident 1 100 -32768 32767 ECU_ADDRESS 0x7FB65C DISPLAY_IDENTIFIER sint16_06.I_sint16.R01_DISP_ID_R01 /end MEASUREMENT
/begin MEASUREMENT sint16_06.I_sint16.R02 "" SWORD ident 1 100 -32768 32767 ECU_ADDRESS 0x7FB694 DISPLAY_IDENTIFIER sint16_06.I_sint16.R02_DISP_ID_R02 /end MEASUREMENT
/begin MEASUREMENT sint16_06.I_sint16.R03 "" SWORD ident 1 100 -32768 32767 ECU_ADDRESS 0x7FB6CC DISPLAY_IDENTIFIER sint16_06.I_sint16.R03_DISP_ID_R03 /end MEASUREMENT
/begin MEASUREMENT sint16_06.I_sint16.R04 "" SWORD ident 1 100 -32768 32767 ECU_ADDRESS 0x7FB702 /end MEASUREMENT
/begin MEASUREMENT sint16_06.I_sint16_1.R01_16bit "" SWORD ident 1 100 -32768 32767 ECU_ADDRESS 0x7F8C60 /end MEASUREMENT
/begin MEASUREMENT sint16_06.I_sint16_2.R01_16bit "" SWORD ident 1 100 -32768 32767 ECU_ADDRESS 0x7F8C70 /end MEASUREMENT
/begin MEASUREMENT sint16_06.I_sint16_3.R01_16bit "" SWORD ident 1 100 -32768 32767 ECU_ADDRESS 0x7F8C80 /end MEASUREMENT
/begin MEASUREMENT sint16_06.I_sint16_4.R01_16bit "" SWORD ident 1 100 -32768 32767 ECU_ADDRESS 0x7F8C90 /end MEASUREMENT
/begin MEASUREMENT sint16_07.I_sint16.R01 "" SWORD ident 1 100 -32768 32767 ECU_ADDRESS 0x7FB65E DISPLAY_IDENTIFIER sint16_07.I_sint16.R01_DISP_ID_R01 /end MEASUREMENT
/begin MEASUREMENT sint16_07.I_sint16.R02 "" SWORD ident 1 100 -32768 32767 ECU_ADDRESS 0x7FB696 DISPLAY_IDENTIFIER sint16_07.I_sint16.R02_DISP_ID_R02 /end MEASUREMENT
/begin MEASUREMENT sint16_07.I_sint16.R03 "" SWORD ident 1 100 -32768 32767 ECU_ADDRESS 0x7FB6CE DISPLAY_IDENTIFIER sint16_07.I_sint16.R03_DISP_ID_R03 /end MEASUREMENT
/begin MEASUREMENT sint16_07.I_sint16.R04 "" SWORD ident 1 100 -32768 32767 ECU_ADDRESS 0x7FB704 /end MEASUREMENT
/begin MEASUREMENT sint16_07.I_sint16_1.R01_16bit "" SWORD ident 1 100 -32768 32767 ECU_ADDRESS 0x7F8C62 /end MEASUREMENT
/begin MEASUREMENT sint16_07.I_sint16_2.R01_16bit "" SWORD ident 1 100 -32768 32767 ECU_ADDRESS 0x7F8C72 /end MEASUREMENT
/begin MEASUREMENT sint16_07.I_sint16_3.R01_16bit "" SWORD ident 1 100 -32768 32767 ECU_ADDRESS 0x7F8C82 /end MEASUREMENT
/begin MEASUREMENT sint16_07.I_sint16_4.R01_16bit "" SWORD ident 1 100 -32768 32767 ECU_ADDRESS 0x7F8C92 /end MEASUREMENT
/begin MEASUREMENT sint16_08.I_sint16.R01 "" SWORD ident 1 100 -32768 32767 ECU_ADDRESS 0x7FB660 DISPLAY_IDENTIFIER sint16_08.I_sint16.R01_DISP_ID_R01 /end MEASUREMENT
/begin MEASUREMENT sint16_08.I_sint16.R02 "" SWORD ident 1 100 -32768 32767 ECU_ADDRESS 0x7FB698 DISPLAY_IDENTIFIER sint16_08.I_sint16.R02_DISP_ID_R02 /end MEASUREMENT
/begin MEASUREMENT sint16_08.I_sint16.R03 "" SWORD ident 1 100 -32768 32767 ECU_ADDRESS 0x7FB6D0 DISPLAY_IDENTIFIER sint16_08.I_sint16.R03_DISP_ID_R03 /end MEASUREMENT
/begin MEASUREMENT sint16_08.I_sint16.R04 "" SWORD ident 1 100 -32768 32767 ECU_ADDRESS 0x7FB706 /end MEASUREMENT
/begin MEASUREMENT sint16_08.I_sint16_1.R01_16bit "" SWORD ident 1 100 -32768 32767 ECU_ADDRESS 0x7F8C64 /end MEASUREMENT
/begin MEASUREMENT sint16_08.I_sint16_2.R01_16bit "" SWORD ident 1 100 -32768 32767 ECU_ADDRESS 0x7F8C74 /end MEASUREMENT
/begin MEASUREMENT sint16_08.I_sint16_3.R01_16bit "" SWORD ident 1 100 -32768 32767 ECU_ADDRESS 0x7F8C84 /end MEASUREMENT
/begin MEASUREMENT sint16_08.I_sint16_4.R01_16bit "" SWORD ident 1 100 -32768 32767 ECU_ADDRESS 0x7F8C94 /end MEASUREMENT
/begin MEASUREMENT sint32_01.I_sint32.R01_B "" SLONG ident 1 100 -2147483648 2147483647 ECU_ADDRESS 0x7F8DB8 /end MEASUREMENT
/begin MEASUREMENT sint32_01.I_sint32.R02_B "" SLONG ident 1 100 -2147483648 2147483647 ECU_ADDRESS 0x7F8E58 /end MEASUREMENT
/begin MEASUREMENT sint32_01.I_sint32.R03_B "" SLONG ident 1 100 -2147483648 2147483647 ECU_ADDRESS 0x7F8EF8 /end MEASUREMENT
/begin MEASUREMENT sint32_01.I_sint32.R04_B "" SLONG ident 1 100 -2147483648 2147483647 ECU_ADDRESS 0x7F8F98 /end MEASUREMENT
/begin MEASUREMENT sint32_01.M_Ultimate "" SLONG ident 1 100 -2147483648 2147483647 ECU_ADDRESS 0x7FB4C4 /end MEASUREMENT
/begin MEASUREMENT sint32_02.I_sint32.R01_B "" SLONG ident 1 100 -2147483648 2147483647 ECU_ADDRESS 0x7F8DBC /end MEASUREMENT
/begin MEASUREMENT sint32_02.I_sint32.R02_B "" SLONG ident 1 100 -2147483648 2147483647 ECU_ADDRESS 0x7F8E5C /end MEASUREMENT
/begin MEASUREMENT sint32_02.I_sint32.R03_B "" SLONG ident 1 100 -2147483648 2147483647 ECU_ADDRESS 0x7F8EFC /end MEASUREMENT
/begin MEASUREMENT sint32_02.I_sint32.R04_B "" SLONG ident 1 100 -2147483648 2147483647 ECU_ADDRESS 0x7F8F9C /end MEASUREMENT
/begin MEASUREMENT sint32_03.I_sint32.R01_B "" SLONG ident 1 100 -2147483648 2147483647 ECU_ADDRESS 0x7F8DC0 /end MEASUREMENT
/begin MEASUREMENT sint32_03.I_sint32.R02_B "" SLONG ident 1 100 -2147483648 2147483647 ECU_ADDRESS 0x7F8E60 /end MEASUREMENT
/begin MEASUREMENT sint32_03.I_sint32.R03_B "" SLONG ident 1 100 -2147483648 2147483647 ECU_ADDRESS 0x7F8F00 /end MEASUREMENT
/begin MEASUREMENT sint32_03.I_sint32.R04_B "" SLONG ident 1 100 -2147483648 2147483647 ECU_ADDRESS 0x7F8FA0 /end MEASUREMENT
/begin MEASUREMENT sint32_04.I_sint32.R01_B "" SLONG ident 1 100 -2147483648 2147483647 ECU_ADDRESS 0x7F8DC4 /end MEASUREMENT
/begin MEASUREMENT sint32_04.I_sint32.R02_B "" SLONG ident 1 100 -2147483648 2147483647 ECU_ADDRESS 0x7F8E64 /end MEASUREMENT
/begin MEASUREMENT sint32_04.I_sint32.R03_B "" SLONG ident 1 100 -2147483648 2147483647 ECU_ADDRESS 0x7F8F04 /end MEASUREMENT
/begin MEASUREMENT sint32_04.I_sint32.R04_B "" SLONG ident 1 100 -2147483648 2147483647 ECU_ADDRESS 0x7F8FA4 /end MEASUREMENT
/begin MEASUREMENT sint32_05.I_sint32.R01_B "" SLONG ident 1 100 -2147483648 2147483647 ECU_ADDRESS 0x7F8DC8 /end MEASUREMENT
/begin MEASUREMENT sint32_05.I_sint32.R02_B "" SLONG ident 1 100 -2147483648 2147483647 ECU_ADDRESS 0x7F8E68 /end MEASUREMENT
/begin MEASUREMENT sint32_05.I_sint32.R03_B "" SLONG ident 1 100 -2147483648 2147483647 ECU_ADDRESS 0x7F8F08 /end MEASUREMENT
/begin MEASUREMENT sint32_05.I_sint32.R04_B "" SLONG ident 1 100 -2147483648 2147483647 ECU_ADDRESS 0x7F8FA8 /end MEASUREMENT
/begin MEASUREMENT sint32_06.I_sint32.R01_B "" SLONG ident 1 100 -2147483648 2147483647 ECU_ADDRESS 0x7F8DCC /end MEASUREMENT
/begin MEASUREMENT sint32_06.I_sint32.R02_B "" SLONG ident 1 100 -2147483648 2147483647 ECU_ADDRESS 0x7F8E6C /end MEASUREMENT
/begin MEASUREMENT sint32_06.I_sint32.R03_B "" SLONG ident 1 100 -2147483648 2147483647 ECU_ADDRESS 0x7F8F0C /end MEASUREMENT
/begin MEASUREMENT sint32_06.I_sint32.R04_B "" SLONG ident 1 100 -2147483648 2147483647 ECU_ADDRESS 0x7F8FAC /end MEASUREMENT
/begin MEASUREMENT sint32_07.I_sint32.R01_B "" SLONG ident 1 100 -2147483648 2147483647 ECU_ADDRESS 0x7F8DD0 /end MEASUREMENT
/begin MEASUREMENT sint32_07.I_sint32.R02_B "" SLONG ident 1 100 -2147483648 2147483647 ECU_ADDRESS 0x7F8E70 /end MEASUREMENT
/begin MEASUREMENT sint32_07.I_sint32.R03_B "" SLONG ident 1 100 -2147483648 2147483647 ECU_ADDRESS 0x7F8F10 /end MEASUREMENT
/begin MEASUREMENT sint32_07.I_sint32.R04_B "" SLONG ident 1 100 -2147483648 2147483647 ECU_ADDRESS 0x7F8FB0 /end MEASUREMENT
/begin MEASUREMENT sint32_08.I_sint32.R01_B "" SLONG ident 1 100 -2147483648 2147483647 ECU_ADDRESS 0x7F8DD4 /end MEASUREMENT
/begin MEASUREMENT sint32_08.I_sint32.R02_B "" SLONG ident 1 100 -2147483648 2147483647 ECU_ADDRESS 0x7F8E74 /end MEASUREMENT
/begin MEASUREMENT sint32_08.I_sint32.R03_B "" SLONG ident 1 100 -2147483648 2147483647 ECU_ADDRESS 0x7F8F14 /end MEASUREMENT
/begin MEASUREMENT sint32_08.I_sint32.R04_B "" SLONG ident 1 100 -2147483648 2147483647 ECU_ADDRESS 0x7F8FB4 /end MEASUREMENT
/begin MEASUREMENT sint8_01.I_sint8.R01 "" SBYTE ident 1 100 -128 127 ECU_ADDRESS 0x7FB662 DISPLAY_IDENTIFIER sint8_01.I_sint8.R01_DISP_ID_R01 /end MEASUREMENT
/begin MEASUREMENT sint8_01.I_sint8.R02 "" SBYTE ident 1 100 -128 127 ECU_ADDRESS 0x7FB69A DISPLAY_IDENTIFIER sint8_01.I_sint8.R02_DISP_ID_R02 /end MEASUREMENT
/begin MEASUREMENT sint8_01.I_sint8.R03 "" SBYTE ident 1 100 -128 127 ECU_ADDRESS 0x7FB6D2 DISPLAY_IDENTIFIER sint8_01.I_sint8.R03_DISP_ID_R03 /end MEASUREMENT
/begin MEASUREMENT sint8_01.I_sint8.R04 "" SBYTE ident 1 100 -128 127 ECU_ADDRESS 0x7FB708 /end MEASUREMENT
/begin MEASUREMENT sint8_01.I_sint8_1.R01_8bit "" SBYTE ident 1 100 -128 127 ECU_ADDRESS 0x7F8CD7 /end MEASUREMENT
/begin MEASUREMENT sint8_01.I_sint8_2.R01_8bit "" SBYTE ident 1 100 -128 127 ECU_ADDRESS 0x7F8CDF /end MEASUREMENT
/begin MEASUREMENT sint8_01.I_sint8_3.R01_8bit "" SBYTE ident 1 100 -128 127 ECU_ADDRESS 0x7F8CE7 /end MEASUREMENT
/begin MEASUREMENT sint8_01.I_sint8_4.R01_8bit "" SBYTE ident 1 100 -128 127 ECU_ADDRESS 0x7F8CEF /end MEASUREMENT
/begin MEASUREMENT sint8_01.I_sint8_5.R01_8bit "" SBYTE ident 1 100 -128 127 ECU_ADDRESS 0x7F8CF7 /end MEASUREMENT
/begin MEASUREMENT sint8_01.I_sint8_6.R01_8bit "" SBYTE ident 1 100 -128 127 ECU_ADDRESS 0x7F8CFF /end MEASUREMENT
/begin MEASUREMENT sint8_01.I_sint8_7.R01_8bit "" SBYTE ident 1 100 -128 127 ECU_ADDRESS 0x7F8D07 /end MEASUREMENT
/begin MEASUREMENT sint8_01.I_sint8_8.R01_8bit "" SBYTE ident 1 100 -128 127 ECU_ADDRESS 0x7F8D0F /end MEASUREMENT
/begin MEASUREMENT sint8_01.M_Ultimate "" SBYTE ident 1 100 -128 127 ECU_ADDRESS 0x7FB4D0 /end MEASUREMENT
/begin MEASUREMENT sint8_02.I_sint8.R01 "" SBYTE ident 1 100 -128 127 ECU_ADDRESS 0x7FB663 DISPLAY_IDENTIFIER sint8_02.I_sint8.R01_DISP_ID_R01 /end MEASUREMENT
/begin MEASUREMENT sint8_02.I_sint8.R02 "" SBYTE ident 1 100 -128 127 ECU_ADDRESS 0x7FB69B DISPLAY_IDENTIFIER sint8_02.I_sint8.R02_DISP_ID_R02 /end MEASUREMENT
/begin MEASUREMENT sint8_02.I_sint8.R03 "" SBYTE ident 1 100 -128 127 ECU_ADDRESS 0x7FB6D3 DISPLAY_IDENTIFIER sint8_02.I_sint8.R03_DISP_ID_R03 /end MEASUREMENT
/begin MEASUREMENT sint8_02.I_sint8.R04 "" SBYTE ident 1 100 -128 127 ECU_ADDRESS 0x7FB709 /end MEASUREMENT
/begin MEASUREMENT sint8_02.I_sint8_1.R01_8bit "" SBYTE ident 1 100 -128 127 ECU_ADDRESS 0x7F8CD8 /end MEASUREMENT
/begin MEASUREMENT sint8_02.I_sint8_2.R01_8bit "" SBYTE ident 1 100 -128 127 ECU_ADDRESS 0x7F8CE0 /end MEASUREMENT
/begin MEASUREMENT sint8_02.I_sint8_3.R01_8bit "" SBYTE ident 1 100 -128 127 ECU_ADDRESS 0x7F8CE8 /end MEASUREMENT
/begin MEASUREMENT sint8_02.I_sint8_4.R01_8bit "" SBYTE ident 1 100 -128 127 ECU_ADDRESS 0x7F8CF0 /end MEASUREMENT
/begin MEASUREMENT sint8_02.I_sint8_5.R01_8bit "" SBYTE ident 1 100 -128 127 ECU_ADDRESS 0x7F8CF8 /end MEASUREMENT
/begin MEASUREMENT sint8_02.I_sint8_6.R01_8bit "" SBYTE ident 1 100 -128 127 ECU_ADDRESS 0x7F8D00 /end MEASUREMENT
/begin MEASUREMENT sint8_02.I_sint8_7.R01_8bit "" SBYTE ident 1 100 -128 127 ECU_ADDRESS 0x7F8D08 /end MEASUREMENT
/begin MEASUREMENT sint8_02.I_sint8_8.R01_8bit "" SBYTE ident 1 100 -128 127 ECU_ADDRESS 0x7F8D10 /end MEASUREMENT
/begin MEASUREMENT sint8_03.I_sint8.R01 "" SBYTE ident 1 100 -128 127 ECU_ADDRESS 0x7FB664 DISPLAY_IDENTIFIER sint8_03.I_sint8.R01_DISP_ID_R01 /end MEASUREMENT
/begin MEASUREMENT sint8_03.I_sint8.R02 "" SBYTE ident 1 100 -128 127 ECU_ADDRESS 0x7FB69C DISPLAY_IDENTIFIER sint8_03.I_sint8.R02_DISP_ID_R02 /end MEASUREMENT
/begin MEASUREMENT sint8_03.I_sint8.R03 "" SBYTE ident 1 100 -128 127 ECU_ADDRESS 0x7FB6D4 DISPLAY_IDENTIFIER sint8_03.I_sint8.R03_DISP_ID_R03 /end MEASUREMENT
/begin MEASUREMENT sint8_03.I_sint8.R04 "" SBYTE ident 1 100 -128 127 ECU_ADDRESS 0x7FB70A /end MEASUREMENT
/begin MEASUREMENT sint8_03.I_sint8_1.R01_8bit "" SBYTE ident 1 100 -128 127 ECU_ADDRESS 0x7F8CD9 /end MEASUREMENT
/begin MEASUREMENT sint8_03.I_sint8_2.R01_8bit "" SBYTE ident 1 100 -128 127 ECU_ADDRESS 0x7F8CE1 /end MEASUREMENT
/begin MEASUREMENT sint8_03.I_sint8_3.R01_8bit "" SBYTE ident 1 100 -128 127 ECU_ADDRESS 0x7F8CE9 /end MEASUREMENT
/begin MEASUREMENT sint8_03.I_sint8_4.R01_8bit "" SBYTE ident 1 100 -128 127 ECU_ADDRESS 0x7F8CF1 /end MEASUREMENT
/begin MEASUREMENT sint8_03.I_sint8_5.R01_8bit "" SBYTE ident 1 100 -128 127 ECU_ADDRESS 0x7F8CF9 /end MEASUREMENT
/begin MEASUREMENT sint8_03.I_sint8_6.R01_8bit "" SBYTE ident 1 100 -128 127 ECU_ADDRESS 0x7F8D01 /end MEASUREMENT
/begin MEASUREMENT sint8_03.I_sint8_7.R01_8bit "" SBYTE ident 1 100 -128 127 ECU_ADDRESS 0x7F8D09 /end MEASUREMENT
/begin MEASUREMENT sint8_03.I_sint8_8.R01_8bit "" SBYTE ident 1 100 -128 127 ECU_ADDRESS 0x7F8D11 /end MEASUREMENT
/begin MEASUREMENT sint8_04.I_sint8.R01 "" SBYTE ident 1 100 -128 127 ECU_ADDRESS 0x7FB665 DISPLAY_IDENTIFIER sint8_04.I_sint8.R01_DISP_ID_R01 /end MEASUREMENT
/begin MEASUREMENT sint8_04.I_sint8.R02 "" SBYTE ident 1 100 -128 127 ECU_ADDRESS 0x7FB69D DISPLAY_IDENTIFIER sint8_04.I_sint8.R02_DISP_ID_R02 /end MEASUREMENT
/begin MEASUREMENT sint8_04.I_sint8.R03 "" SBYTE ident 1 100 -128 127 ECU_ADDRESS 0x7FB6D5 DISPLAY_IDENTIFIER sint8_04.I_sint8.R03_DISP_ID_R03 /end MEASUREMENT
/begin MEASUREMENT sint8_04.I_sint8.R04 "" SBYTE ident 1 100 -128 127 ECU_ADDRESS 0x7FB70B /end MEASUREMENT
/begin MEASUREMENT sint8_04.I_sint8_1.R01_8bit "" SBYTE ident 1 100 -128 127 ECU_ADDRESS 0x7F8CDA /end MEASUREMENT
/begin MEASUREMENT sint8_04.I_sint8_2.R01_8bit "" SBYTE ident 1 100 -128 127 ECU_ADDRESS 0x7F8CE2 /end MEASUREMENT
/begin MEASUREMENT sint8_04.I_sint8_3.R01_8bit "" SBYTE ident 1 100 -128 127 ECU_ADDRESS 0x7F8CEA /end MEASUREMENT
/begin MEASUREMENT sint8_04.I_sint8_4.R01_8bit "" SBYTE ident 1 100 -128 127 ECU_ADDRESS 0x7F8CF2 /end MEASUREMENT
/begin MEASUREMENT sint8_04.I_sint8_5.R01_8bit "" SBYTE ident 1 100 -128 127 ECU_ADDRESS 0x7F8CFA /end MEASUREMENT
/begin MEASUREMENT sint8_04.I_sint8_6.R01_8bit "" SBYTE ident 1 100 -128 127 ECU_ADDRESS 0x7F8D02 /end MEASUREMENT
/begin MEASUREMENT sint8_04.I_sint8_7.R01_8bit "" SBYTE ident 1 100 -128 127 ECU_ADDRESS 0x7F8D0A /end MEASUREMENT
/begin MEASUREMENT sint8_04.I_sint8_8.R01_8bit "" SBYTE ident 1 100 -128 127 ECU_ADDRESS 0x7F8D12 /end MEASUREMENT
/begin MEASUREMENT sint8_05.I_sint8.R01 "" SBYTE ident 1 100 -128 127 ECU_ADDRESS 0x7FB666 DISPLAY_IDENTIFIER sint8_05.I_sint8.R01_DISP_ID_R01 /end MEASUREMENT
/begin MEASUREMENT sint8_05.I_sint8.R02 "" SBYTE ident 1 100 -128 127 ECU_ADDRESS 0x7FB69E DISPLAY_IDENTIFIER sint8_05.I_sint8.R02_DISP_ID_R02 /end MEASUREMENT
/begin MEASUREMENT sint8_05.I_sint8.R03 "" SBYTE ident 1 100 -128 127 ECU_ADDRESS 0x7FB6D6 DISPLAY_IDENTIFIER sint8_05.I_sint8.R03_DISP_ID_R03 /end MEASUREMENT
/begin MEASUREMENT sint8_05.I_sint8.R04 "" SBYTE ident 1 100 -128 127 ECU_ADDRESS 0x7FB70C /end MEASUREMENT
/begin MEASUREMENT sint8_05.I_sint8_1.R01_8bit "" SBYTE ident 1 100 -128 127 ECU_ADDRESS 0x7F8CDB /end MEASUREMENT
/begin MEASUREMENT sint8_05.I_sint8_2.R01_8bit "" SBYTE ident 1 100 -128 127 ECU_ADDRESS 0x7F8CE3 /end MEASUREMENT
/begin MEASUREMENT sint8_05.I_sint8_3.R01_8bit "" SBYTE ident 1 100 -128 127 ECU_ADDRESS 0x7F8CEB /end MEASUREMENT
/begin MEASUREMENT sint8_05.I_sint8_4.R01_8bit "" SBYTE ident 1 100 -128 127 ECU_ADDRESS 0x7F8CF3 /end MEASUREMENT
/begin MEASUREMENT sint8_05.I_sint8_5.R01_8bit "" SBYTE ident 1 100 -128 127 ECU_ADDRESS 0x7F8CFB /end MEASUREMENT
/begin MEASUREMENT sint8_05.I_sint8_6.R01_8bit "" SBYTE ident 1 100 -128 127 ECU_ADDRESS 0x7F8D03 /end MEASUREMENT
/begin MEASUREMENT sint8_05.I_sint8_7.R01_8bit "" SBYTE ident 1 100 -128 127 ECU_ADDRESS 0x7F8D0B /end MEASUREMENT
/begin MEASUREMENT sint8_05.I_sint8_8.R01_8bit "" SBYTE ident 1 100 -128 127 ECU_ADDRESS 0x7F8D13 /end MEASUREMENT
/begin MEASUREMENT sint8_06.I_sint8.R01 "" SBYTE ident 1 100 -128 127 ECU_ADDRESS 0x7FB667 DISPLAY_IDENTIFIER sint8_06.I_sint8.R01_DISP_ID_R01 /end MEASUREMENT
/begin MEASUREMENT sint8_06.I_sint8.R02 "" SBYTE ident 1 100 -128 127 ECU_ADDRESS 0x7FB69F DISPLAY_IDENTIFIER sint8_06.I_sint8.R02_DISP_ID_R02 /end MEASUREMENT
/begin MEASUREMENT sint8_06.I_sint8.R03 "" SBYTE ident 1 100 -128 127 ECU_ADDRESS 0x7FB6D7 DISPLAY_IDENTIFIER sint8_06.I_sint8.R03_DISP_ID_R03 /end MEASUREMENT
/begin MEASUREMENT sint8_06.I_sint8.R04 "" SBYTE ident 1 100 -128 127 ECU_ADDRESS 0x7FB70D /end MEASUREMENT
/begin MEASUREMENT sint8_06.I_sint8_1.R01_8bit "" SBYTE ident 1 100 -128 127 ECU_ADDRESS 0x7F8CDC /end MEASUREMENT
/begin MEASUREMENT sint8_06.I_sint8_2.R01_8bit "" SBYTE ident 1 100 -128 127 ECU_ADDRESS 0x7F8CE4 /end MEASUREMENT
/begin MEASUREMENT sint8_06.I_sint8_3.R01_8bit "" SBYTE ident 1 100 -128 127 ECU_ADDRESS 0x7F8CEC /end MEASUREMENT
/begin MEASUREMENT sint8_06.I_sint8_4.R01_8bit "" SBYTE ident 1 100 -128 127 ECU_ADDRESS 0x7F8CF4 /end MEASUREMENT
/begin MEASUREMENT sint8_06.I_sint8_5.R01_8bit "" SBYTE ident 1 100 -128 127 ECU_ADDRESS 0x7F8CFC /end MEASUREMENT
/begin MEASUREMENT sint8_06.I_sint8_6.R01_8bit "" SBYTE ident 1 100 -128 127 ECU_ADDRESS 0x7F8D04 /end MEASUREMENT
/begin MEASUREMENT sint8_06.I_sint8_7.R01_8bit "" SBYTE ident 1 100 -128 127 ECU_ADDRESS 0x7F8D0C /end MEASUREMENT
/begin MEASUREMENT sint8_06.I_sint8_8.R01_8bit "" SBYTE ident 1 100 -128 127 ECU_ADDRESS 0x7F8D14 /end MEASUREMENT
/begin MEASUREMENT sint8_07.I_sint8.R01 "" SBYTE ident 1 100 -128 127 ECU_ADDRESS 0x7FB668 DISPLAY_IDENTIFIER sint8_07.I_sint8.R01_DISP_ID_R01 /end MEASUREMENT
/begin MEASUREMENT sint8_07.I_sint8.R02 "" SBYTE ident 1 100 -128 127 ECU_ADDRESS 0x7FB6A0 DISPLAY_IDENTIFIER sint8_07.I_sint8.R02_DISP_ID_R02 /end MEASUREMENT
/begin MEASUREMENT sint8_07.I_sint8.R03 "" SBYTE ident 1 100 -128 127 ECU_ADDRESS 0x7FB6D8 DISPLAY_IDENTIFIER sint8_07.I_sint8.R03_DISP_ID_R03 /end MEASUREMENT
/begin MEASUREMENT sint8_07.I_sint8.R04 "" SBYTE ident 1 100 -128 127 ECU_ADDRESS 0x7FB70E /end MEASUREMENT
/begin MEASUREMENT sint8_07.I_sint8_1.R01_8bit "" SBYTE ident 1 100 -128 127 ECU_ADDRESS 0x7F8CDD /end MEASUREMENT
/begin MEASUREMENT sint8_07.I_sint8_2.R01_8bit "" SBYTE ident 1 100 -128 127 ECU_ADDRESS 0x7F8CE5 /end MEASUREMENT
/begin MEASUREMENT sint8_07.I_sint8_3.R01_8bit "" SBYTE ident 1 100 -128 127 ECU_ADDRESS 0x7F8CED /end MEASUREMENT
/begin MEASUREMENT sint8_07.I_sint8_4.R01_8bit "" SBYTE ident 1 100 -128 127 ECU_ADDRESS 0x7F8CF5 /end MEASUREMENT
/begin MEASUREMENT sint8_07.I_sint8_5.R01_8bit "" SBYTE ident 1 100 -128 127 ECU_ADDRESS 0x7F8CFD /end MEASUREMENT
/begin MEASUREMENT sint8_07.I_sint8_6.R01_8bit "" SBYTE ident 1 100 -128 127 ECU_ADDRESS 0x7F8D05 /end MEASUREMENT
/begin MEASUREMENT sint8_07.I_sint8_7.R01_8bit "" SBYTE ident 1 100 -128 127 ECU_ADDRESS 0x7F8D0D /end MEASUREMENT
/begin MEASUREMENT sint8_07.I_sint8_8.R01_8bit "" SBYTE ident 1 100 -128 127 ECU_ADDRESS 0x7F8D15 /end MEASUREMENT
/begin MEASUREMENT sint8_08.I_sint8.R01 "" SBYTE ident 1 100 -128 127 ECU_ADDRESS 0x7FB669 DISPLAY_IDENTIFIER sint8_08.I_sint8.R01_DISP_ID_R01 /end MEASUREMENT
/begin MEASUREMENT sint8_08.I_sint8.R02 "" SBYTE ident 1 100 -128 127 ECU_ADDRESS 0x7FB6A1 DISPLAY_IDENTIFIER sint8_08.I_sint8.R02_DISP_ID_R02 /end MEASUREMENT
/begin MEASUREMENT sint8_08.I_sint8.R03 "" SBYTE ident 1 100 -128 127 ECU_ADDRESS 0x7FB6D9 DISPLAY_IDENTIFIER sint8_08.I_sint8.R03_DISP_ID_R03 /end MEASUREMENT
/begin MEASUREMENT sint8_08.I_sint8.R04 "" SBYTE ident 1 100 -128 127 ECU_ADDRESS 0x7FB70F /end MEASUREMENT
/begin MEASUREMENT sint8_08.I_sint8_1.R01_8bit "" SBYTE ident 1 100 -128 127 ECU_ADDRESS 0x7F8CDE /end MEASUREMENT
/begin MEASUREMENT sint8_08.I_sint8_2.R01_8bit "" SBYTE ident 1 100 -128 127 ECU_ADDRESS 0x7F8CE6 /end MEASUREMENT
/begin MEASUREMENT sint8_08.I_sint8_3.R01_8bit "" SBYTE ident 1 100 -128 127 ECU_ADDRESS 0x7F8CEE /end MEASUREMENT
/begin MEASUREMENT sint8_08.I_sint8_4.R01_8bit "" SBYTE ident 1 100 -128 127 ECU_ADDRESS 0x7F8CF6 /end MEASUREMENT
/begin MEASUREMENT sint8_08.I_sint8_5.R01_8bit "" SBYTE ident 1 100 -128 127 ECU_ADDRESS 0x7F8CFE /end MEASUREMENT
/begin MEASUREMENT sint8_08.I_sint8_6.R01_8bit "" SBYTE ident 1 100 -128 127 ECU_ADDRESS 0x7F8D06 /end MEASUREMENT
/begin MEASUREMENT sint8_08.I_sint8_7.R01_8bit "" SBYTE ident 1 100 -128 127 ECU_ADDRESS 0x7F8D0E /end MEASUREMENT
/begin MEASUREMENT sint8_08.I_sint8_8.R01_8bit "" SBYTE ident 1 100 -128 127 ECU_ADDRESS 0x7F8D16 /end MEASUREMENT
/begin MEASUREMENT SM_Err01_log.M_Ultimate "" UBYTE ident 1 100 0 1 BIT_MASK 0x1 ECU_ADDRESS 0x7FB521 /end MEASUREMENT
/begin MEASUREMENT SM01_Par01_u8.M_Ultimate "" ULONG ident 1 100 0 4294967295 ECU_ADDRESS 0x7FB518 /end MEASUREMENT
/begin MEASUREMENT SM01_Par02_u8.M_Ultimate "" ULONG ident 1 100 0 4294967295 ECU_ADDRESS 0x7FB51C /end MEASUREMENT
/begin MEASUREMENT SM01_Res_u8.M_Ultimate "" FLOAT64_IEEE ident 1 100 -1.e+037 1.e+037 ECU_ADDRESS 0x7FB4F0 /end MEASUREMENT
/begin MEASUREMENT SRM_Err01_log.M_Ultimate "" UBYTE ident 1 100 0 1 BIT_MASK 0x1 ECU_ADDRESS 0x7FB522 /end MEASUREMENT
/begin MEASUREMENT SRM_Stimu_Count01_u8.M_Ultimate "" FLOAT64_IEEE ident 1 100 -1.e+037 1.e+037 ECU_ADDRESS 0x7FB508 /end MEASUREMENT
/begin MEASUREMENT SRM01_Res_u8.M_Ultimate "" FLOAT64_IEEE ident 1 100 -1.e+037 1.e+037 ECU_ADDRESS 0x7FB4F8 /end MEASUREMENT
/begin MEASUREMENT SRM02_Res_u8.M_Ultimate "" FLOAT64_IEEE ident 1 100 -1.e+037 1.e+037 ECU_ADDRESS 0x7FB500 /end MEASUREMENT
/begin MEASUREMENT TheLastMax.FEA_performance_scalar "" FLOAT32_IEEE ident 1 100 -1.e+037 1.e+037 ECU_ADDRESS 0x7F8960 /end MEASUREMENT
/begin MEASUREMENT TheLastMaxShort.FEA_performance_scalar "" FLOAT32_IEEE ident 1 100 -1.e+037 1.e+037 ECU_ADDRESS 0x7F8964 /end MEASUREMENT
/begin MEASUREMENT TheLastMin.FEA_performance_scalar "" FLOAT32_IEEE ident 1 100 -1.e+037 1.e+037 ECU_ADDRESS 0x7F8968 /end MEASUREMENT
/begin MEASUREMENT TheLastMinShort.FEA_performance_scalar "" FLOAT32_IEEE ident 1 100 -1.e+037 1.e+037 ECU_ADDRESS 0x7F896C /end MEASUREMENT
/begin MEASUREMENT TheMax.FEA_performance_array "" FLOAT32_IEEE ident 1 100 -1.e+037 1.e+037 ECU_ADDRESS 0x7F894C /end MEASUREMENT
/begin MEASUREMENT TheMax.FEA_performance_scalar "" FLOAT32_IEEE ident 1 100 -1.e+037 1.e+037 ECU_ADDRESS 0x7F8970 /end MEASUREMENT
/begin MEASUREMENT TheMaxShort.FEA_performance_scalar "" FLOAT32_IEEE ident 1 100 -1.e+037 1.e+037 ECU_ADDRESS 0x7F8974 /end MEASUREMENT
/begin MEASUREMENT TheMin.FEA_performance_array "" FLOAT32_IEEE ident 1 100 -1.e+037 1.e+037 ECU_ADDRESS 0x7F8950 /end MEASUREMENT
/begin MEASUREMENT TheMin.FEA_performance_scalar "" FLOAT32_IEEE ident 1 100 -1.e+037 1.e+037 ECU_ADDRESS 0x7F8978 /end MEASUREMENT
/begin MEASUREMENT TheMinShort.FEA_performance_scalar "" FLOAT32_IEEE ident 1 100 -1.e+037 1.e+037 ECU_ADDRESS 0x7F897C /end MEASUREMENT
/begin MEASUREMENT udisc_uint16_B01.Model_Byp_B01 "" UWORD ident 1 100 0 65535 ECU_ADDRESS 0x7FB540 DISPLAY_IDENTIFIER udisc_uint16_B01.Model_Byp_B01_DISP_ID /end MEASUREMENT
/begin MEASUREMENT udisc_uint16_B02.Model_Byp_B02 "" UWORD ident 1 100 0 65535 ECU_ADDRESS 0x7FB560 DISPLAY_IDENTIFIER udisc_uint16_B02.Model_Byp_B02_DISP_ID /end MEASUREMENT
/begin MEASUREMENT udisc_uint16_offset_cpy_B01.Model_Byp_B01 "" UBYTE ident 1 100 0 255 ECU_ADDRESS 0x7FB536 DISPLAY_IDENTIFIER udisc_uint16_offset_cpy_B01.Model_Byp_B01_DISP_ID /end MEASUREMENT
/begin MEASUREMENT udisc_uint16_offset_cpy_B02.Model_Byp_B02 "" UBYTE ident 1 100 0 255 ECU_ADDRESS 0x7FB556 DISPLAY_IDENTIFIER udisc_uint16_offset_cpy_B02.Model_Byp_B02_DISP_ID /end MEASUREMENT
/begin MEASUREMENT udisc_uint16_Xcp_B01.Model_XcpByp_B01 "" UWORD ident 1 100 0 65535 ECU_ADDRESS 0x7FB572 /end MEASUREMENT
/begin MEASUREMENT udisc_uint16_Xcp_B02.Model_XcpByp_B02 "" UWORD ident 1 100 0 65535 ECU_ADDRESS 0x7FB584 /end MEASUREMENT
/begin MEASUREMENT udisc_uint16_Xcp_B03.Model_XcpByp_B03 "" UWORD ident 1 100 0 65535 ECU_ADDRESS 0x7FB596 /end MEASUREMENT
/begin MEASUREMENT udisc_uint8_B01.Model_Byp_B01 "" UBYTE ident 1 100 0 255 ECU_ADDRESS 0x7FB549 DISPLAY_IDENTIFIER udisc_uint8_B01.Model_Byp_B01_DISP_ID /end MEASUREMENT
/begin MEASUREMENT udisc_uint8_B02.Model_Byp_B02 "" UBYTE ident 1 100 0 255 ECU_ADDRESS 0x7FB569 DISPLAY_IDENTIFIER udisc_uint8_B02.Model_Byp_B02_DISP_ID /end MEASUREMENT
/begin MEASUREMENT udisc_uint8_offset_cpy_B01.Model_Byp_B01 "" UBYTE ident 1 100 0 255 ECU_ADDRESS 0x7FB537 DISPLAY_IDENTIFIER udisc_uint8_offset_cpy_B01.Model_Byp_B01_DISP_ID /end MEASUREMENT
/begin MEASUREMENT udisc_uint8_offset_cpy_B02.Model_Byp_B02 "" UBYTE ident 1 100 0 255 ECU_ADDRESS 0x7FB557 DISPLAY_IDENTIFIER udisc_uint8_offset_cpy_B02.Model_Byp_B02_DISP_ID /end MEASUREMENT
/begin MEASUREMENT udisc_uint8_Xcp_B01.Model_XcpByp_B01 "" UBYTE ident 1 100 0 255 ECU_ADDRESS 0x7FB57A /end MEASUREMENT
/begin MEASUREMENT udisc_uint8_Xcp_B02.Model_XcpByp_B02 "" UBYTE ident 1 100 0 255 ECU_ADDRESS 0x7FB58C /end MEASUREMENT
/begin MEASUREMENT udisc_uint8_Xcp_B03.Model_XcpByp_B03 "" UBYTE ident 1 100 0 255 ECU_ADDRESS 0x7FB59E /end MEASUREMENT
/begin MEASUREMENT uint16_01.I_uint16.R01 "" UWORD ident 1 100 0 65535 ECU_ADDRESS 0x7FB66A DISPLAY_IDENTIFIER uint16_01.I_uint16.R01_DISP_ID_R01 /end MEASUREMENT
/begin MEASUREMENT uint16_01.I_uint16.R02 "" UWORD ident 1 100 0 65535 ECU_ADDRESS 0x7FB6A2 DISPLAY_IDENTIFIER uint16_01.I_uint16.R02_DISP_ID_R02 /end MEASUREMENT
/begin MEASUREMENT uint16_01.I_uint16.R03 "" UWORD ident 1 100 0 65535 ECU_ADDRESS 0x7FB6DA DISPLAY_IDENTIFIER uint16_01.I_uint16.R03_DISP_ID_R03 /end MEASUREMENT
/begin MEASUREMENT uint16_01.I_uint16.R04 "" UWORD ident 1 100 0 65535 ECU_ADDRESS 0x7FB710 /end MEASUREMENT
/begin MEASUREMENT uint16_01.I_uint16_1.R01_16bit "" UWORD ident 1 100 0 65535 ECU_ADDRESS 0x7F8C96 /end MEASUREMENT
/begin MEASUREMENT uint16_01.I_uint16_2.R01_16bit "" UWORD ident 1 100 0 65535 ECU_ADDRESS 0x7F8CA6 /end MEASUREMENT
/begin MEASUREMENT uint16_01.I_uint16_3.R01_16bit "" UWORD ident 1 100 0 65535 ECU_ADDRESS 0x7F8CB6 /end MEASUREMENT
/begin MEASUREMENT uint16_01.I_uint16_4.R01_16bit "" UWORD ident 1 100 0 65535 ECU_ADDRESS 0x7F8CC6 /end MEASUREMENT
/begin MEASUREMENT uint16_01.M_Ultimate "" UWORD ident 1 100 0 65535 ECU_ADDRESS 0x7FB4CE /end MEASUREMENT
/begin MEASUREMENT uint16_02.I_uint16.R01 "" UWORD ident 1 100 0 65535 ECU_ADDRESS 0x7FB66C DISPLAY_IDENTIFIER uint16_02.I_uint16.R01_DISP_ID_R01 /end MEASUREMENT
/begin MEASUREMENT uint16_02.I_uint16.R02 "" UWORD ident 1 100 0 65535 ECU_ADDRESS 0x7FB6A4 DISPLAY_IDENTIFIER uint16_02.I_uint16.R02_DISP_ID_R02 /end MEASUREMENT
/begin MEASUREMENT uint16_02.I_uint16.R03 "" UWORD ident 1 100 0 65535 ECU_ADDRESS 0x7FB6DC DISPLAY_IDENTIFIER uint16_02.I_uint16.R03_DISP_ID_R03 /end MEASUREMENT
/begin MEASUREMENT uint16_02.I_uint16.R04 "" UWORD ident 1 100 0 65535 ECU_ADDRESS 0x7FB712 /end MEASUREMENT
/begin MEASUREMENT uint16_02.I_uint16_1.R01_16bit "" UWORD ident 1 100 0 65535 ECU_ADDRESS 0x7F8C98 /end MEASUREMENT
/begin MEASUREMENT uint16_02.I_uint16_2.R01_16bit "" UWORD ident 1 100 0 65535 ECU_ADDRESS 0x7F8CA8 /end MEASUREMENT
/begin MEASUREMENT uint16_02.I_uint16_3.R01_16bit "" UWORD ident 1 100 0 65535 ECU_ADDRESS 0x7F8CB8 /end MEASUREMENT
/begin MEASUREMENT uint16_02.I_uint16_4.R01_16bit "" UWORD ident 1 100 0 65535 ECU_ADDRESS 0x7F8CC8 /end MEASUREMENT
/begin MEASUREMENT uint16_03.I_uint16.R01 "" UWORD ident 1 100 0 65535 ECU_ADDRESS 0x7FB66E DISPLAY_IDENTIFIER uint16_03.I_uint16.R01_DISP_ID_R01 /end MEASUREMENT
/begin MEASUREMENT uint16_03.I_uint16.R02 "" UWORD ident 1 100 0 65535 ECU_ADDRESS 0x7FB6A6 DISPLAY_IDENTIFIER uint16_03.I_uint16.R02_DISP_ID_R02 /end MEASUREMENT
/begin MEASUREMENT uint16_03.I_uint16.R03 "" UWORD ident 1 100 0 65535 ECU_ADDRESS 0x7FB6DE DISPLAY_IDENTIFIER uint16_03.I_uint16.R03_DISP_ID_R03 /end MEASUREMENT
/begin MEASUREMENT uint16_03.I_uint16.R04 "" UWORD ident 1 100 0 65535 ECU_ADDRESS 0x7FB714 /end MEASUREMENT
/begin MEASUREMENT uint16_03.I_uint16_1.R01_16bit "" UWORD ident 1 100 0 65535 ECU_ADDRESS 0x7F8C9A /end MEASUREMENT
/begin MEASUREMENT uint16_03.I_uint16_2.R01_16bit "" UWORD ident 1 100 0 65535 ECU_ADDRESS 0x7F8CAA /end MEASUREMENT
/begin MEASUREMENT uint16_03.I_uint16_3.R01_16bit "" UWORD ident 1 100 0 65535 ECU_ADDRESS 0x7F8CBA /end MEASUREMENT
/begin MEASUREMENT uint16_03.I_uint16_4.R01_16bit "" UWORD ident 1 100 0 65535 ECU_ADDRESS 0x7F8CCA /end MEASUREMENT
/begin MEASUREMENT uint16_04.I_uint16.R01 "" UWORD ident 1 100 0 65535 ECU_ADDRESS 0x7FB670 DISPLAY_IDENTIFIER uint16_04.I_uint16.R01_DISP_ID_R01 /end MEASUREMENT
/begin MEASUREMENT uint16_04.I_uint16.R02 "" UWORD ident 1 100 0 65535 ECU_ADDRESS 0x7FB6A8 DISPLAY_IDENTIFIER uint16_04.I_uint16.R02_DISP_ID_R02 /end MEASUREMENT
/begin MEASUREMENT uint16_04.I_uint16.R03 "" UWORD ident 1 100 0 65535 ECU_ADDRESS 0x7FB6E0 DISPLAY_IDENTIFIER uint16_04.I_uint16.R03_DISP_ID_R03 /end MEASUREMENT
/begin MEASUREMENT uint16_04.I_uint16.R04 "" UWORD ident 1 100 0 65535 ECU_ADDRESS 0x7FB716 /end MEASUREMENT
/begin MEASUREMENT uint16_04.I_uint16_1.R01_16bit "" UWORD ident 1 100 0 65535 ECU_ADDRESS 0x7F8C9C /end MEASUREMENT
/begin MEASUREMENT uint16_04.I_uint16_2.R01_16bit "" UWORD ident 1 100 0 65535 ECU_ADDRESS 0x7F8CAC /end MEASUREMENT
/begin MEASUREMENT uint16_04.I_uint16_3.R01_16bit "" UWORD ident 1 100 0 65535 ECU_ADDRESS 0x7F8CBC /end MEASUREMENT
/begin MEASUREMENT uint16_04.I_uint16_4.R01_16bit "" UWORD ident 1 100 0 65535 ECU_ADDRESS 0x7F8CCC /end MEASUREMENT
/begin MEASUREMENT uint16_05.I_uint16.R01 "" UWORD ident 1 100 0 65535 ECU_ADDRESS 0x7FB672 DISPLAY_IDENTIFIER uint16_05.I_uint16.R01_DISP_ID_R01 /end MEASUREMENT
/begin MEASUREMENT uint16_05.I_uint16.R02 "" UWORD ident 1 100 0 65535 ECU_ADDRESS 0x7FB6AA DISPLAY_IDENTIFIER uint16_05.I_uint16.R02_DISP_ID_R02 /end MEASUREMENT
/begin MEASUREMENT uint16_05.I_uint16.R03 "" UWORD ident 1 100 0 65535 ECU_ADDRESS 0x7FB6E2 DISPLAY_IDENTIFIER uint16_05.I_uint16.R03_DISP_ID_R03 /end MEASUREMENT
/begin MEASUREMENT uint16_05.I_uint16.R04 "" UWORD ident 1 100 0 65535 ECU_ADDRESS 0x7FB718 /end MEASUREMENT
/begin MEASUREMENT uint16_05.I_uint16_1.R01_16bit "" UWORD ident 1 100 0 65535 ECU_ADDRESS 0x7F8C9E /end MEASUREMENT
/begin MEASUREMENT uint16_05.I_uint16_2.R01_16bit "" UWORD ident 1 100 0 65535 ECU_ADDRESS 0x7F8CAE /end MEASUREMENT
/begin MEASUREMENT uint16_05.I_uint16_3.R01_16bit "" UWORD ident 1 100 0 65535 ECU_ADDRESS 0x7F8CBE /end MEASUREMENT
/begin MEASUREMENT uint16_05.I_uint16_4.R01_16bit "" UWORD ident 1 100 0 65535 ECU_ADDRESS 0x7F8CCE /end MEASUREMENT
/begin MEASUREMENT uint16_06.I_uint16.R01 "" UWORD ident 1 100 0 65535 ECU_ADDRESS 0x7FB674 DISPLAY_IDENTIFIER uint16_06.I_uint16.R01_DISP_ID_R01 /end MEASUREMENT
/begin MEASUREMENT uint16_06.I_uint16.R02 "" UWORD ident 1 100 0 65535 ECU_ADDRESS 0x7FB6AC DISPLAY_IDENTIFIER uint16_06.I_uint16.R02_DISP_ID_R02 /end MEASUREMENT
/begin MEASUREMENT uint16_06.I_uint16.R03 "" UWORD ident 1 100 0 65535 ECU_ADDRESS 0x7FB6E4 DISPLAY_IDENTIFIER uint16_06.I_uint16.R03_DISP_ID_R03 /end MEASUREMENT
/begin MEASUREMENT uint16_06.I_uint16.R04 "" UWORD ident 1 100 0 65535 ECU_ADDRESS 0x7FB71A /end MEASUREMENT
/begin MEASUREMENT uint16_06.I_uint16_1.R01_16bit "" UWORD ident 1 100 0 65535 ECU_ADDRESS 0x7F8CA0 /end MEASUREMENT
/begin MEASUREMENT uint16_06.I_uint16_2.R01_16bit "" UWORD ident 1 100 0 65535 ECU_ADDRESS 0x7F8CB0 /end MEASUREMENT
/begin MEASUREMENT uint16_06.I_uint16_3.R01_16bit "" UWORD ident 1 100 0 65535 ECU_ADDRESS 0x7F8CC0 /end MEASUREMENT
/begin MEASUREMENT uint16_06.I_uint16_4.R01_16bit "" UWORD ident 1 100 0 65535 ECU_ADDRESS 0x7F8CD0 /end MEASUREMENT
/begin MEASUREMENT uint16_07.I_uint16.R01 "" UWORD ident 1 100 0 65535 ECU_ADDRESS 0x7FB676 DISPLAY_IDENTIFIER uint16_07.I_uint16.R01_DISP_ID_R01 /end MEASUREMENT
/begin MEASUREMENT uint16_07.I_uint16.R02 "" UWORD ident 1 100 0 65535 ECU_ADDRESS 0x7FB6AE DISPLAY_IDENTIFIER uint16_07.I_uint16.R02_DISP_ID_R02 /end MEASUREMENT
/begin MEASUREMENT uint16_07.I_uint16.R03 "" UWORD ident 1 100 0 65535 ECU_ADDRESS 0x7FB6E6 DISPLAY_IDENTIFIER uint16_07.I_uint16.R03_DISP_ID_R03 /end MEASUREMENT
/begin MEASUREMENT uint16_07.I_uint16.R04 "" UWORD ident 1 100 0 65535 ECU_ADDRESS 0x7FB71C /end MEASUREMENT
/begin MEASUREMENT uint16_07.I_uint16_1.R01_16bit "" UWORD ident 1 100 0 65535 ECU_ADDRESS 0x7F8CA2 /end MEASUREMENT
/begin MEASUREMENT uint16_07.I_uint16_2.R01_16bit "" UWORD ident 1 100 0 65535 ECU_ADDRESS 0x7F8CB2 /end MEASUREMENT
/begin MEASUREMENT uint16_07.I_uint16_3.R01_16bit "" UWORD ident 1 100 0 65535 ECU_ADDRESS 0x7F8CC2 /end MEASUREMENT
/begin MEASUREMENT uint16_07.I_uint16_4.R01_16bit "" UWORD ident 1 100 0 65535 ECU_ADDRESS 0x7F8CD2 /end MEASUREMENT
/begin MEASUREMENT uint16_08.I_uint16.R01 "" UWORD ident 1 100 0 65535 ECU_ADDRESS 0x7FB678 DISPLAY_IDENTIFIER uint16_08.I_uint16.R01_DISP_ID_R01 /end MEASUREMENT
/begin MEASUREMENT uint16_08.I_uint16.R02 "" UWORD ident 1 100 0 65535 ECU_ADDRESS 0x7FB6B0 DISPLAY_IDENTIFIER uint16_08.I_uint16.R02_DISP_ID_R02 /end MEASUREMENT
/begin MEASUREMENT uint16_08.I_uint16.R03 "" UWORD ident 1 100 0 65535 ECU_ADDRESS 0x7FB6E8 DISPLAY_IDENTIFIER uint16_08.I_uint16.R03_DISP_ID_R03 /end MEASUREMENT
/begin MEASUREMENT uint16_08.I_uint16.R04 "" UWORD ident 1 100 0 65535 ECU_ADDRESS 0x7FB71E /end MEASUREMENT
/begin MEASUREMENT uint16_08.I_uint16_1.R01_16bit "" UWORD ident 1 100 0 65535 ECU_ADDRESS 0x7F8CA4 /end MEASUREMENT
/begin MEASUREMENT uint16_08.I_uint16_2.R01_16bit "" UWORD ident 1 100 0 65535 ECU_ADDRESS 0x7F8CB4 /end MEASUREMENT
/begin MEASUREMENT uint16_08.I_uint16_3.R01_16bit "" UWORD ident 1 100 0 65535 ECU_ADDRESS 0x7F8CC4 /end MEASUREMENT
/begin MEASUREMENT uint16_08.I_uint16_4.R01_16bit "" UWORD ident 1 100 0 65535 ECU_ADDRESS 0x7F8CD4 /end MEASUREMENT
/begin MEASUREMENT uint32_01.I_uint32.R01_B "" ULONG ident 1 100 0 4294967295 ECU_ADDRESS 0x7F8DD8 /end MEASUREMENT
/begin MEASUREMENT uint32_01.I_uint32.R02_B "" ULONG ident 1 100 0 4294967295 ECU_ADDRESS 0x7F8E78 /end MEASUREMENT
/begin MEASUREMENT uint32_01.I_uint32.R03_B "" ULONG ident 1 100 0 4294967295 ECU_ADDRESS 0x7F8F18 /end MEASUREMENT
/begin MEASUREMENT uint32_01.I_uint32.R04_B "" ULONG ident 1 100 0 4294967295 ECU_ADDRESS 0x7F8FB8 /end MEASUREMENT
/begin MEASUREMENT uint32_01.M_Ultimate "" ULONG ident 1 100 0 4294967295 ECU_ADDRESS 0x7FB4C8 /end MEASUREMENT
/begin MEASUREMENT uint32_02.I_uint32.R01_B "" ULONG ident 1 100 0 4294967295 ECU_ADDRESS 0x7F8DDC /end MEASUREMENT
/begin MEASUREMENT uint32_02.I_uint32.R02_B "" ULONG ident 1 100 0 4294967295 ECU_ADDRESS 0x7F8E7C /end MEASUREMENT
/begin MEASUREMENT uint32_02.I_uint32.R03_B "" ULONG ident 1 100 0 4294967295 ECU_ADDRESS 0x7F8F1C /end MEASUREMENT
/begin MEASUREMENT uint32_02.I_uint32.R04_B "" ULONG ident 1 100 0 4294967295 ECU_ADDRESS 0x7F8FBC /end MEASUREMENT
/begin MEASUREMENT uint32_03.I_uint32.R01_B "" ULONG ident 1 100 0 4294967295 ECU_ADDRESS 0x7F8DE0 /end MEASUREMENT
/begin MEASUREMENT uint32_03.I_uint32.R02_B "" ULONG ident 1 100 0 4294967295 ECU_ADDRESS 0x7F8E80 /end MEASUREMENT
/begin MEASUREMENT uint32_03.I_uint32.R03_B "" ULONG ident 1 100 0 4294967295 ECU_ADDRESS 0x7F8F20 /end MEASUREMENT
/begin MEASUREMENT uint32_03.I_uint32.R04_B "" ULONG ident 1 100 0 4294967295 ECU_ADDRESS 0x7F8FC0 /end MEASUREMENT
/begin MEASUREMENT uint32_04.I_uint32.R01_B "" ULONG ident 1 100 0 4294967295 ECU_ADDRESS 0x7F8DE4 /end MEASUREMENT
/begin MEASUREMENT uint32_04.I_uint32.R02_B "" ULONG ident 1 100 0 4294967295 ECU_ADDRESS 0x7F8E84 /end MEASUREMENT
/begin MEASUREMENT uint32_04.I_uint32.R03_B "" ULONG ident 1 100 0 4294967295 ECU_ADDRESS 0x7F8F24 /end MEASUREMENT
/begin MEASUREMENT uint32_04.I_uint32.R04_B "" ULONG ident 1 100 0 4294967295 ECU_ADDRESS 0x7F8FC4 /end MEASUREMENT
/begin MEASUREMENT uint32_05.I_uint32.R01_B "" ULONG ident 1 100 0 4294967295 ECU_ADDRESS 0x7F8DE8 /end MEASUREMENT
/begin MEASUREMENT uint32_05.I_uint32.R02_B "" ULONG ident 1 100 0 4294967295 ECU_ADDRESS 0x7F8E88 /end MEASUREMENT
/begin MEASUREMENT uint32_05.I_uint32.R03_B "" ULONG ident 1 100 0 4294967295 ECU_ADDRESS 0x7F8F28 /end MEASUREMENT
/begin MEASUREMENT uint32_05.I_uint32.R04_B "" ULONG ident 1 100 0 4294967295 ECU_ADDRESS 0x7F8FC8 /end MEASUREMENT
/begin MEASUREMENT uint32_06.I_uint32.R01_B "" ULONG ident 1 100 0 4294967295 ECU_ADDRESS 0x7F8DEC /end MEASUREMENT
/begin MEASUREMENT uint32_06.I_uint32.R02_B "" ULONG ident 1 100 0 4294967295 ECU_ADDRESS 0x7F8E8C /end MEASUREMENT
/begin MEASUREMENT uint32_06.I_uint32.R03_B "" ULONG ident 1 100 0 4294967295 ECU_ADDRESS 0x7F8F2C /end MEASUREMENT
/begin MEASUREMENT uint32_06.I_uint32.R04_B "" ULONG ident 1 100 0 4294967295 ECU_ADDRESS 0x7F8FCC /end MEASUREMENT
/begin MEASUREMENT uint32_07.I_uint32.R01_B "" ULONG ident 1 100 0 4294967295 ECU_ADDRESS 0x7F8DF0 /end MEASUREMENT
/begin MEASUREMENT uint32_07.I_uint32.R02_B "" ULONG ident 1 100 0 4294967295 ECU_ADDRESS 0x7F8E90 /end MEASUREMENT
/begin MEASUREMENT uint32_07.I_uint32.R03_B "" ULONG ident 1 100 0 4294967295 ECU_ADDRESS 0x7F8F30 /end MEASUREMENT
/begin MEASUREMENT uint32_07.I_uint32.R04_B "" ULONG ident 1 100 0 4294967295 ECU_ADDRESS 0x7F8FD0 /end MEASUREMENT
/begin MEASUREMENT uint32_08.I_uint32.R01_B "" ULONG ident 1 100 0 4294967295 ECU_ADDRESS 0x7F8DF4 /end MEASUREMENT
/begin MEASUREMENT uint32_08.I_uint32.R02_B "" ULONG ident 1 100 0 4294967295 ECU_ADDRESS 0x7F8E94 /end MEASUREMENT
/begin MEASUREMENT uint32_08.I_uint32.R03_B "" ULONG ident 1 100 0 4294967295 ECU_ADDRESS 0x7F8F34 /end MEASUREMENT
/begin MEASUREMENT uint32_08.I_uint32.R04_B "" ULONG ident 1 100 0 4294967295 ECU_ADDRESS 0x7F8FD4 /end MEASUREMENT
/begin MEASUREMENT uint8_01.I_uint8.R01 "" UBYTE ident 1 100 0 255 ECU_ADDRESS 0x7FB67A DISPLAY_IDENTIFIER uint8_01.I_uint8.R01_DISP_ID_R01 /end MEASUREMENT
/begin MEASUREMENT uint8_01.I_uint8.R02 "" UBYTE ident 1 100 0 255 ECU_ADDRESS 0x7FB6B2 DISPLAY_IDENTIFIER uint8_01.I_uint8.R02_DISP_ID_R02 /end MEASUREMENT
/begin MEASUREMENT uint8_01.I_uint8.R03 "" UBYTE ident 1 100 0 255 ECU_ADDRESS 0x7FB6EA DISPLAY_IDENTIFIER uint8_01.I_uint8.R03_DISP_ID_R03 /end MEASUREMENT
/begin MEASUREMENT uint8_01.I_uint8.R04 "" UBYTE ident 1 100 0 255 ECU_ADDRESS 0x7FB720 /end MEASUREMENT
/begin MEASUREMENT uint8_01.I_uint8_1.R01_8bit "" UBYTE ident 1 100 0 255 ECU_ADDRESS 0x7F8D17 /end MEASUREMENT
/begin MEASUREMENT uint8_01.I_uint8_2.R01_8bit "" UBYTE ident 1 100 0 255 ECU_ADDRESS 0x7F8D1F /end MEASUREMENT
/begin MEASUREMENT uint8_01.I_uint8_3.R01_8bit "" UBYTE ident 1 100 0 255 ECU_ADDRESS 0x7F8D27 /end MEASUREMENT
/begin MEASUREMENT uint8_01.I_uint8_4.R01_8bit "" UBYTE ident 1 100 0 255 ECU_ADDRESS 0x7F8D2F /end MEASUREMENT
/begin MEASUREMENT uint8_01.I_uint8_5.R01_8bit "" UBYTE ident 1 100 0 255 ECU_ADDRESS 0x7F8D37 /end MEASUREMENT
/begin MEASUREMENT uint8_01.I_uint8_6.R01_8bit "" UBYTE ident 1 100 0 255 ECU_ADDRESS 0x7F8D3F /end MEASUREMENT
/begin MEASUREMENT uint8_01.I_uint8_7.R01_8bit "" UBYTE ident 1 100 0 255 ECU_ADDRESS 0x7F8D47 /end MEASUREMENT
/begin MEASUREMENT uint8_01.I_uint8_8.R01_8bit "" UBYTE ident 1 100 0 255 ECU_ADDRESS 0x7F8D4F /end MEASUREMENT
/begin MEASUREMENT uint8_01.M_Ultimate "" UBYTE ident 1 100 0 255 ECU_ADDRESS 0x7FB4D1 /end MEASUREMENT
/begin MEASUREMENT uint8_02.I_uint8.R01 "" UBYTE ident 1 100 0 255 ECU_ADDRESS 0x7FB67B DISPLAY_IDENTIFIER uint8_02.I_uint8.R01_DISP_ID_R01 /end MEASUREMENT
/begin MEASUREMENT uint8_02.I_uint8.R02 "" UBYTE ident 1 100 0 255 ECU_ADDRESS 0x7FB6B3 DISPLAY_IDENTIFIER uint8_02.I_uint8.R02_DISP_ID_R02 /end MEASUREMENT
/begin MEASUREMENT uint8_02.I_uint8.R03 "" UBYTE ident 1 100 0 255 ECU_ADDRESS 0x7FB6EB DISPLAY_IDENTIFIER uint8_02.I_uint8.R03_DISP_ID_R03 /end MEASUREMENT
/begin MEASUREMENT uint8_02.I_uint8.R04 "" UBYTE ident 1 100 0 255 ECU_ADDRESS 0x7FB721 /end MEASUREMENT
/begin MEASUREMENT uint8_02.I_uint8_1.R01_8bit "" UBYTE ident 1 100 0 255 ECU_ADDRESS 0x7F8D18 /end MEASUREMENT
/begin MEASUREMENT uint8_02.I_uint8_2.R01_8bit "" UBYTE ident 1 100 0 255 ECU_ADDRESS 0x7F8D20 /end MEASUREMENT
/begin MEASUREMENT uint8_02.I_uint8_3.R01_8bit "" UBYTE ident 1 100 0 255 ECU_ADDRESS 0x7F8D28 /end MEASUREMENT
/begin MEASUREMENT uint8_02.I_uint8_4.R01_8bit "" UBYTE ident 1 100 0 255 ECU_ADDRESS 0x7F8D30 /end MEASUREMENT
/begin MEASUREMENT uint8_02.I_uint8_5.R01_8bit "" UBYTE ident 1 100 0 255 ECU_ADDRESS 0x7F8D38 /end MEASUREMENT
/begin MEASUREMENT uint8_02.I_uint8_6.R01_8bit "" UBYTE ident 1 100 0 255 ECU_ADDRESS 0x7F8D40 /end MEASUREMENT
/begin MEASUREMENT uint8_02.I_uint8_7.R01_8bit "" UBYTE ident 1 100 0 255 ECU_ADDRESS 0x7F8D48 /end MEASUREMENT
/begin MEASUREMENT uint8_02.I_uint8_8.R01_8bit "" UBYTE ident 1 100 0 255 ECU_ADDRESS 0x7F8D50 /end MEASUREMENT
/begin MEASUREMENT uint8_03.I_uint8.R01 "" UBYTE ident 1 100 0 255 ECU_ADDRESS 0x7FB67C DISPLAY_IDENTIFIER uint8_03.I_uint8.R01_DISP_ID_R01 /end MEASUREMENT
/begin MEASUREMENT uint8_03.I_uint8.R02 "" UBYTE ident 1 100 0 255 ECU_ADDRESS 0x7FB6B4 DISPLAY_IDENTIFIER uint8_03.I_uint8.R02_DISP_ID_R02 /end MEASUREMENT
/begin MEASUREMENT uint8_03.I_uint8.R03 "" UBYTE ident 1 100 0 255 ECU_ADDRESS 0x7FB6EC DISPLAY_IDENTIFIER uint8_03.I_uint8.R03_DISP_ID_R03 /end MEASUREMENT
/begin MEASUREMENT uint8_03.I_uint8.R04 "" UBYTE ident 1 100 0 255 ECU_ADDRESS 0x7FB722 /end MEASUREMENT
/begin MEASUREMENT uint8_03.I_uint8_1.R01_8bit "" UBYTE ident 1 100 0 255 ECU_ADDRESS 0x7F8D19 /end MEASUREMENT
/begin MEASUREMENT uint8_03.I_uint8_2.R01_8bit "" UBYTE ident 1 100 0 255 ECU_ADDRESS 0x7F8D21 /end MEASUREMENT
/begin MEASUREMENT uint8_03.I_uint8_3.R01_8bit "" UBYTE ident 1 100 0 255 ECU_ADDRESS 0x7F8D29 /end MEASUREMENT
/begin MEASUREMENT uint8_03.I_uint8_4.R01_8bit "" UBYTE ident 1 100 0 255 ECU_ADDRESS 0x7F8D31 /end MEASUREMENT
/begin MEASUREMENT uint8_03.I_uint8_5.R01_8bit "" UBYTE ident 1 100 0 255 ECU_ADDRESS 0x7F8D39 /end MEASUREMENT
/begin MEASUREMENT uint8_03.I_uint8_6.R01_8bit "" UBYTE ident 1 100 0 255 ECU_ADDRESS 0x7F8D41 /end MEASUREMENT
/begin MEASUREMENT uint8_03.I_uint8_7.R01_8bit "" UBYTE ident 1 100 0 255 ECU_ADDRESS 0x7F8D49 /end MEASUREMENT
/begin MEASUREMENT uint8_03.I_uint8_8.R01_8bit "" UBYTE ident 1 100 0 255 ECU_ADDRESS 0x7F8D51 /end MEASUREMENT
/begin MEASUREMENT uint8_04.I_uint8.R01 "" UBYTE ident 1 100 0 255 ECU_ADDRESS 0x7FB67D DISPLAY_IDENTIFIER uint8_04.I_uint8.R01_DISP_ID_R01 /end MEASUREMENT
/begin MEASUREMENT uint8_04.I_uint8.R02 "" UBYTE ident 1 100 0 255 ECU_ADDRESS 0x7FB6B5 DISPLAY_IDENTIFIER uint8_04.I_uint8.R02_DISP_ID_R02 /end MEASUREMENT
/begin MEASUREMENT uint8_04.I_uint8.R03 "" UBYTE ident 1 100 0 255 ECU_ADDRESS 0x7FB6ED DISPLAY_IDENTIFIER uint8_04.I_uint8.R03_DISP_ID_R03 /end MEASUREMENT
/begin MEASUREMENT uint8_04.I_uint8.R04 "" UBYTE ident 1 100 0 255 ECU_ADDRESS 0x7FB723 /end MEASUREMENT
/begin MEASUREMENT uint8_04.I_uint8_1.R01_8bit "" UBYTE ident 1 100 0 255 ECU_ADDRESS 0x7F8D1A /end MEASUREMENT
/begin MEASUREMENT uint8_04.I_uint8_2.R01_8bit "" UBYTE ident 1 100 0 255 ECU_ADDRESS 0x7F8D22 /end MEASUREMENT
/begin MEASUREMENT uint8_04.I_uint8_3.R01_8bit "" UBYTE ident 1 100 0 255 ECU_ADDRESS 0x7F8D2A /end MEASUREMENT
/begin MEASUREMENT uint8_04.I_uint8_4.R01_8bit "" UBYTE ident 1 100 0 255 ECU_ADDRESS 0x7F8D32 /end MEASUREMENT
/begin MEASUREMENT uint8_04.I_uint8_5.R01_8bit "" UBYTE ident 1 100 0 255 ECU_ADDRESS 0x7F8D3A /end MEASUREMENT
/begin MEASUREMENT uint8_04.I_uint8_6.R01_8bit "" UBYTE ident 1 100 0 255 ECU_ADDRESS 0x7F8D42 /end MEASUREMENT
/begin MEASUREMENT uint8_04.I_uint8_7.R01_8bit "" UBYTE ident 1 100 0 255 ECU_ADDRESS 0x7F8D4A /end MEASUREMENT
/begin MEASUREMENT uint8_04.I_uint8_8.R01_8bit "" UBYTE ident 1 100 0 255 ECU_ADDRESS 0x7F8D52 /end MEASUREMENT
/begin MEASUREMENT uint8_05.I_uint8.R01 "" UBYTE ident 1 100 0 255 ECU_ADDRESS 0x7FB67E DISPLAY_IDENTIFIER uint8_05.I_uint8.R01_DISP_ID_R01 /end MEASUREMENT
/begin MEASUREMENT uint8_05.I_uint8.R02 "" UBYTE ident 1 100 0 255 ECU_ADDRESS 0x7FB6B6 DISPLAY_IDENTIFIER uint8_05.I_uint8.R02_DISP_ID_R02 /end MEASUREMENT
/begin MEASUREMENT uint8_05.I_uint8.R03 "" UBYTE ident 1 100 0 255 ECU_ADDRESS 0x7FB6EE DISPLAY_IDENTIFIER uint8_05.I_uint8.R03_DISP_ID_R03 /end MEASUREMENT
/begin MEASUREMENT uint8_05.I_uint8.R04 "" UBYTE ident 1 100 0 255 ECU_ADDRESS 0x7FB724 /end MEASUREMENT
/begin MEASUREMENT uint8_05.I_uint8_1.R01_8bit "" UBYTE ident 1 100 0 255 ECU_ADDRESS 0x7F8D1B /end MEASUREMENT
/begin MEASUREMENT uint8_05.I_uint8_2.R01_8bit "" UBYTE ident 1 100 0 255 ECU_ADDRESS 0x7F8D23 /end MEASUREMENT
/begin MEASUREMENT uint8_05.I_uint8_3.R01_8bit "" UBYTE ident 1 100 0 255 ECU_ADDRESS 0x7F8D2B /end MEASUREMENT
/begin MEASUREMENT uint8_05.I_uint8_4.R01_8bit "" UBYTE ident 1 100 0 255 ECU_ADDRESS 0x7F8D33 /end MEASUREMENT
/begin MEASUREMENT uint8_05.I_uint8_5.R01_8bit "" UBYTE ident 1 100 0 255 ECU_ADDRESS 0x7F8D3B /end MEASUREMENT
/begin MEASUREMENT uint8_05.I_uint8_6.R01_8bit "" UBYTE ident 1 100 0 255 ECU_ADDRESS 0x7F8D43 /end MEASUREMENT
/begin MEASUREMENT uint8_05.I_uint8_7.R01_8bit "" UBYTE ident 1 100 0 255 ECU_ADDRESS 0x7F8D4B /end MEASUREMENT
/begin MEASUREMENT uint8_05.I_uint8_8.R01_8bit "" UBYTE ident 1 100 0 255 ECU_ADDRESS 0x7F8D53 /end MEASUREMENT
/begin MEASUREMENT uint8_06.I_uint8.R01 "" UBYTE ident 1 100 0 255 ECU_ADDRESS 0x7FB67F DISPLAY_IDENTIFIER uint8_06.I_uint8.R01_DISP_ID_R01 /end MEASUREMENT
/begin MEASUREMENT uint8_06.I_uint8.R02 "" UBYTE ident 1 100 0 255 ECU_ADDRESS 0x7FB6B7 DISPLAY_IDENTIFIER uint8_06.I_uint8.R02_DISP_ID_R02 /end MEASUREMENT
/begin MEASUREMENT uint8_06.I_uint8.R03 "" UBYTE ident 1 100 0 255 ECU_ADDRESS 0x7FB6EF DISPLAY_IDENTIFIER uint8_06.I_uint8.R03_DISP_ID_R03 /end MEASUREMENT
/begin MEASUREMENT uint8_06.I_uint8.R04 "" UBYTE ident 1 100 0 255 ECU_ADDRESS 0x7FB725 /end MEASUREMENT
/begin MEASUREMENT uint8_06.I_uint8_1.R01_8bit "" UBYTE ident 1 100 0 255 ECU_ADDRESS 0x7F8D1C /end MEASUREMENT
/begin MEASUREMENT uint8_06.I_uint8_2.R01_8bit "" UBYTE ident 1 100 0 255 ECU_ADDRESS 0x7F8D24 /end MEASUREMENT
/begin MEASUREMENT uint8_06.I_uint8_3.R01_8bit "" UBYTE ident 1 100 0 255 ECU_ADDRESS 0x7F8D2C /end MEASUREMENT
/begin MEASUREMENT uint8_06.I_uint8_4.R01_8bit "" UBYTE ident 1 100 0 255 ECU_ADDRESS 0x7F8D34 /end MEASUREMENT
/begin MEASUREMENT uint8_06.I_uint8_5.R01_8bit "" UBYTE ident 1 100 0 255 ECU_ADDRESS 0x7F8D3C /end MEASUREMENT
/begin MEASUREMENT uint8_06.I_uint8_6.R01_8bit "" UBYTE ident 1 100 0 255 ECU_ADDRESS 0x7F8D44 /end MEASUREMENT
/begin MEASUREMENT uint8_06.I_uint8_7.R01_8bit "" UBYTE ident 1 100 0 255 ECU_ADDRESS 0x7F8D4C /end MEASUREMENT
/begin MEASUREMENT uint8_06.I_uint8_8.R01_8bit "" UBYTE ident 1 100 0 255 ECU_ADDRESS 0x7F8D54 /end MEASUREMENT
/begin MEASUREMENT uint8_07.I_uint8.R01 "" UBYTE ident 1 100 0 255 ECU_ADDRESS 0x7FB680 DISPLAY_IDENTIFIER uint8_07.I_uint8.R01_DISP_ID_R01 /end MEASUREMENT
/begin MEASUREMENT uint8_07.I_uint8.R02 "" UBYTE ident 1 100 0 255 ECU_ADDRESS 0x7FB6B8 DISPLAY_IDENTIFIER uint8_07.I_uint8.R02_DISP_ID_R02 /end MEASUREMENT
/begin MEASUREMENT uint8_07.I_uint8.R03 "" UBYTE ident 1 100 0 255 ECU_ADDRESS 0x7FB6F0 DISPLAY_IDENTIFIER uint8_07.I_uint8.R03_DISP_ID_R03 /end MEASUREMENT
/begin MEASUREMENT uint8_07.I_uint8.R04 "" UBYTE ident 1 100 0 255 ECU_ADDRESS 0x7FB726 /end MEASUREMENT
/begin MEASUREMENT uint8_07.I_uint8_1.R01_8bit "" UBYTE ident 1 100 0 255 ECU_ADDRESS 0x7F8D1D /end MEASUREMENT
/begin MEASUREMENT uint8_07.I_uint8_2.R01_8bit "" UBYTE ident 1 100 0 255 ECU_ADDRESS 0x7F8D25 /end MEASUREMENT
/begin MEASUREMENT uint8_07.I_uint8_3.R01_8bit "" UBYTE ident 1 100 0 255 ECU_ADDRESS 0x7F8D2D /end MEASUREMENT
/begin MEASUREMENT uint8_07.I_uint8_4.R01_8bit "" UBYTE ident 1 100 0 255 ECU_ADDRESS 0x7F8D35 /end MEASUREMENT
/begin MEASUREMENT uint8_07.I_uint8_5.R01_8bit "" UBYTE ident 1 100 0 255 ECU_ADDRESS 0x7F8D3D /end MEASUREMENT
/begin MEASUREMENT uint8_07.I_uint8_6.R01_8bit "" UBYTE ident 1 100 0 255 ECU_ADDRESS 0x7F8D45 /end MEASUREMENT
/begin MEASUREMENT uint8_07.I_uint8_7.R01_8bit "" UBYTE ident 1 100 0 255 ECU_ADDRESS 0x7F8D4D /end MEASUREMENT
/begin MEASUREMENT uint8_07.I_uint8_8.R01_8bit "" UBYTE ident 1 100 0 255 ECU_ADDRESS 0x7F8D55 /end MEASUREMENT
/begin MEASUREMENT uint8_08.I_uint8.R01 "" UBYTE ident 1 100 0 255 ECU_ADDRESS 0x7FB681 DISPLAY_IDENTIFIER uint8_08.I_uint8.R01_DISP_ID_R01 /end MEASUREMENT
/begin MEASUREMENT uint8_08.I_uint8.R02 "" UBYTE ident 1 100 0 255 ECU_ADDRESS 0x7FB6B9 DISPLAY_IDENTIFIER uint8_08.I_uint8.R02_DISP_ID_R02 /end MEASUREMENT
/begin MEASUREMENT uint8_08.I_uint8.R03 "" UBYTE ident 1 100 0 255 ECU_ADDRESS 0x7FB6F1 DISPLAY_IDENTIFIER uint8_08.I_uint8.R03_DISP_ID_R03 /end MEASUREMENT
/begin MEASUREMENT uint8_08.I_uint8.R04 "" UBYTE ident 1 100 0 255 ECU_ADDRESS 0x7FB727 /end MEASUREMENT
/begin MEASUREMENT uint8_08.I_uint8_1.R01_8bit "" UBYTE ident 1 100 0 255 ECU_ADDRESS 0x7F8D1E /end MEASUREMENT
/begin MEASUREMENT uint8_08.I_uint8_2.R01_8bit "" UBYTE ident 1 100 0 255 ECU_ADDRESS 0x7F8D26 /end MEASUREMENT
/begin MEASUREMENT uint8_08.I_uint8_3.R01_8bit "" UBYTE ident 1 100 0 255 ECU_ADDRESS 0x7F8D2E /end MEASUREMENT
/begin MEASUREMENT uint8_08.I_uint8_4.R01_8bit "" UBYTE ident 1 100 0 255 ECU_ADDRESS 0x7F8D36 /end MEASUREMENT
/begin MEASUREMENT uint8_08.I_uint8_5.R01_8bit "" UBYTE ident 1 100 0 255 ECU_ADDRESS 0x7F8D3E /end MEASUREMENT
/begin MEASUREMENT uint8_08.I_uint8_6.R01_8bit "" UBYTE ident 1 100 0 255 ECU_ADDRESS 0x7F8D46 /end MEASUREMENT
/begin MEASUREMENT uint8_08.I_uint8_7.R01_8bit "" UBYTE ident 1 100 0 255 ECU_ADDRESS 0x7F8D4E /end MEASUREMENT
/begin MEASUREMENT uint8_08.I_uint8_8.R01_8bit "" UBYTE ident 1 100 0 255 ECU_ADDRESS 0x7F8D56 /end MEASUREMENT
/* begin C:/ETAS/ASCET513/target/mpc555/Add_ToolChain/ASAP_Templates\v_Formula_u8.a2l inserted by script merge_Tab.pl */
/begin MEASUREMENT v_Formula_u8.FORMULA "" UBYTE Test_0xx_16x_8s_div_0xx_1x_16s 1 100 0.0 255.0 ECU_ADDRESS 0x8227A2 /end MEASUREMENT
/begin MEASUREMENT v_Impl_u8.FORMULA "" UBYTE ident 1 100 0 255 ECU_ADDRESS 0x8227A3 /end MEASUREMENT
/* begin C:/ETAS/ASCET513/target/mpc555/Add_ToolChain/ASAP_Templates\v_TabIntp_u8.a2l inserted by script merge_Tab.pl */
/begin MEASUREMENT v_TabIntp_u8.FORMULA "" UBYTE TestCmTabIntpU8 1 100 0.0 255.0 ECU_ADDRESS 0x8227A4 /end MEASUREMENT
/begin COMPU_METHOD TestCmTabIntpU8 "Test Compu Method for TAB_INTP" TAB_INTP "%7.1" "M9U unit" COMPU_TAB_REF TestCtTabIntpU8 /end COMPU_METHOD
/begin COMPU_TAB TestCtTabIntpU8 "conversion table for TestCtTabIntpU8" TAB_INTP 6 0 0.0 20 5.0 100 10.0 127 20.0 200 30.0 255 43.0 /end COMPU_TAB
/begin COMPU_METHOD formula_1_10 "" RAT_FUNC "%12.4" "" COEFFS 0 10 0 0 0 1 /end COMPU_METHOD
/begin COMPU_METHOD formula_1_100 "" RAT_FUNC "%12.4" "" COEFFS 0 100 0 0 0 1 /end COMPU_METHOD
/begin COMPU_METHOD formula_1_2 "" RAT_FUNC "%12.4" "" COEFFS 0 2 0 0 0 1 /end COMPU_METHOD
/begin COMPU_METHOD formula_10_1 "" RAT_FUNC "%12.4" "" COEFFS 0 0.1 0 0 0 1 /end COMPU_METHOD
/begin COMPU_METHOD ident "" RAT_FUNC "%12.4" "" COEFFS 0 1 0 0 0 1 /end COMPU_METHOD
/begin COMPU_METHOD qx10ms_Ticks_to_Sec "" RAT_FUNC "%12.4" "[s]" COEFFS 0 100.0 0 0 0 1 /end COMPU_METHOD
/begin COMPU_METHOD Test_0xx_16x_8s_div_0xx_1x_16s "16x-8 / x-16" RAT_FUNC "%12.4" "" COEFFS 0 16 -8 0 1 -16 /end COMPU_METHOD
/begin COMPU_METHOD Test_axx_bx_c_div_dxx_ex_f "" RAT_FUNC "%12.4" "Form_0_1_0_0_0_1" COEFFS 0 1 0 0 0 1 /end COMPU_METHOD
/begin COMPU_METHOD TickTick "" RAT_FUNC "%12.4" "TicksTicks" COEFFS 0 1 0 0 0 1 /end COMPU_METHOD
/begin COMPU_METHOD formula_10_1 "" RAT_FUNC "%12.4" "" COEFFS 0 1 0 0 0 10 /end COMPU_METHOD
/begin GROUP EdgeRising.Reset_Schalter ""
 /begin REF_MEASUREMENT buffer.EdgeRising.Reset_Schalter oldSignal.EdgeRising.Reset_Schalter /end REF_MEASUREMENT
/end GROUP
/begin GROUP FEA_performance_array "" ROOT
 /begin REF_MEASUREMENT Result.FEA_performance_array TheMax.FEA_performance_array TheMin.FEA_performance_array i.FEA_performance_array /end REF_MEASUREMENT
 /begin REF_CHARACTERISTIC COUNT.FEA_performance_array Threshold.FEA_performance_array param.FEA_performance_array /end REF_CHARACTERISTIC
/end GROUP
/begin GROUP FEA_performance_scalar "" ROOT
 /begin REF_MEASUREMENT Result.FEA_performance_scalar ResultShort.FEA_performance_scalar TheLastMax.FEA_performance_scalar TheLastMaxShort.FEA_performance_scalar TheLastMin.FEA_performance_scalar TheLastMinShort.FEA_performance_scalar TheMax.FEA_performance_scalar TheMaxShort.FEA_performance_scalar TheMin.FEA_performance_scalar TheMinShort.FEA_performance_scalar /end REF_MEASUREMENT
 /begin REF_CHARACTERISTIC Param_00.FEA_performance_scalar Param_01.FEA_performance_scalar Param_02.FEA_performance_scalar Param_03.FEA_performance_scalar Param_04.FEA_performance_scalar Param_05.FEA_performance_scalar Param_06.FEA_performance_scalar Param_07.FEA_performance_scalar Param_08.FEA_performance_scalar Param_09.FEA_performance_scalar Param_10.FEA_performance_scalar Param_11.FEA_performance_scalar Param_12.FEA_performance_scalar Param_13.FEA_performance_scalar Param_14.FEA_performance_scalar Param_15.FEA_performance_scalar Param_16.FEA_performance_scalar Param_17.FEA_performance_scalar Param_18.FEA_performance_scalar Param_19.FEA_performance_scalar Param_20.FEA_performance_scalar Param_21.FEA_performance_scalar Param_22.FEA_performance_scalar Param_23.FEA_performance_scalar Param_24.FEA_performance_scalar Param_25.FEA_performance_scalar Param_26.FEA_performance_scalar Param_27.FEA_performance_scalar Param_28.FEA_performance_scalar Param_29.FEA_performance_scalar Param_30.FEA_performance_scalar Param_31.FEA_performance_scalar Param_32.FEA_performance_scalar Param_33.FEA_performance_scalar Param_34.FEA_performance_scalar Param_35.FEA_performance_scalar Param_36.FEA_performance_scalar Param_37.FEA_performance_scalar Param_38.FEA_performance_scalar Param_39.FEA_performance_scalar Param_40.FEA_performance_scalar Param_41.FEA_performance_scalar Param_42.FEA_performance_scalar Param_43.FEA_performance_scalar Param_44.FEA_performance_scalar Param_45.FEA_performance_scalar Param_46.FEA_performance_scalar Param_47.FEA_performance_scalar Param_48.FEA_performance_scalar Param_49.FEA_performance_scalar Threshold.FEA_performance_scalar /end REF_CHARACTERISTIC
/end GROUP
/begin GROUP FORMULA "" ROOT
 /begin REF_MEASUREMENT M_F32_IDENT.FORMULA M_F32_RAT_FUNC.FORMULA M_F32_TAB_INTP.FORMULA M_F32_TAB_NOINTP.FORMULA M_F32_TAB_VERB.FORMULA M_F64_IDENT.FORMULA M_F64_RAT_FUNC.FORMULA M_F64_TAB_INTP.FORMULA M_F64_TAB_NOINTP.FORMULA M_F64_TAB_VERB.FORMULA M_S16_IDENT.FORMULA M_S16_RAT_FUNC.FORMULA M_S16_TAB_INTP.FORMULA M_S16_TAB_NOINTP.FORMULA M_S16_TAB_VERB.FORMULA M_S32_IDENT.FORMULA M_S32_RAT_FUNC.FORMULA M_S32_TAB_INTP.FORMULA M_S32_TAB_NOINTP.FORMULA M_S32_TAB_VERB.FORMULA M_S8_IDENT.FORMULA M_S8_RAT_FUNC.FORMULA M_S8_TAB_INTP.FORMULA M_S8_TAB_NOINTP.FORMULA M_S8_TAB_VERB.FORMULA M_U16_IDENT.FORMULA M_U16_RAT_FUNC.FORMULA M_U16_TAB_INTP.FORMULA M_U16_TAB_NOINTP.FORMULA M_U16_TAB_VERB.FORMULA M_U32_IDENT.FORMULA M_U32_RAT_FUNC.FORMULA M_U32_TAB_INTP.FORMULA M_U32_TAB_NOINTP.FORMULA M_U32_TAB_VERB.FORMULA M_U8_IDENT.FORMULA M_U8_RAT_FUNC.FORMULA M_U8_TAB_INTP.FORMULA M_U8_TAB_NOINTP.FORMULA M_U8_TAB_VERB.FORMULA v_Formula_u8.FORMULA v_Impl_u8.FORMULA v_TabIntp_u8.FORMULA /end REF_MEASUREMENT
 /begin REF_CHARACTERISTIC P_F32_IDENT.FORMULA P_F32_RAT_FUNC.FORMULA P_F32_TAB_INTP.FORMULA P_F32_TAB_NOINTP.FORMULA P_F32_TAB_VERB.FORMULA P_F64_IDENT.FORMULA P_F64_RAT_FUNC.FORMULA P_F64_TAB_INTP.FORMULA P_F64_TAB_NOINTP.FORMULA P_F64_TAB_VERB.FORMULA P_S16_IDENT.FORMULA P_S16_RAT_FUNC.FORMULA P_S16_TAB_INTP.FORMULA P_S16_TAB_NOINTP.FORMULA P_S16_TAB_VERB.FORMULA P_S32_IDENT.FORMULA P_S32_RAT_FUNC.FORMULA P_S32_TAB_INTP.FORMULA P_S32_TAB_NOINTP.FORMULA P_S32_TAB_VERB.FORMULA P_S8_IDENT.FORMULA P_S8_RAT_FUNC.FORMULA P_S8_TAB_INTP.FORMULA P_S8_TAB_NOINTP.FORMULA P_S8_TAB_VERB.FORMULA P_U16_IDENT.FORMULA P_U16_RAT_FUNC.FORMULA P_U16_TAB_INTP.FORMULA P_U16_TAB_NOINTP.FORMULA P_U16_TAB_VERB.FORMULA P_U32_IDENT.FORMULA P_U32_RAT_FUNC.FORMULA P_U32_TAB_INTP.FORMULA P_U32_TAB_NOINTP.FORMULA P_U32_TAB_VERB.FORMULA P_U8_IDENT.FORMULA P_U8_RAT_FUNC.FORMULA P_U8_TAB_INTP.FORMULA P_U8_TAB_NOINTP.FORMULA P_U8_TAB_VERB.FORMULA p_Impl_u8.FORMULA /end REF_CHARACTERISTIC
/end GROUP
/begin GROUP HWE.BASE "" /begin SUB_GROUP Time_Calc.HWE.BASE /end SUB_GROUP /end GROUP
/begin GROUP I_fl32.R01_B ""
 /begin REF_MEASUREMENT fl32_01.I_fl32.R01_B fl32_02.I_fl32.R01_B fl32_03.I_fl32.R01_B fl32_04.I_fl32.R01_B fl32_05.I_fl32.R01_B fl32_06.I_fl32.R01_B fl32_07.I_fl32.R01_B fl32_08.I_fl32.R01_B /end REF_MEASUREMENT
/end GROUP
/begin GROUP I_fl32.R02_B ""
 /begin REF_MEASUREMENT fl32_01.I_fl32.R02_B fl32_02.I_fl32.R02_B fl32_03.I_fl32.R02_B fl32_04.I_fl32.R02_B fl32_05.I_fl32.R02_B fl32_06.I_fl32.R02_B fl32_07.I_fl32.R02_B fl32_08.I_fl32.R02_B /end REF_MEASUREMENT
/end GROUP
/begin GROUP I_fl32.R03_B ""
 /begin REF_MEASUREMENT fl32_01.I_fl32.R03_B fl32_02.I_fl32.R03_B fl32_03.I_fl32.R03_B fl32_04.I_fl32.R03_B fl32_05.I_fl32.R03_B fl32_06.I_fl32.R03_B fl32_07.I_fl32.R03_B fl32_08.I_fl32.R03_B /end REF_MEASUREMENT
/end GROUP
/begin GROUP I_fl32.R04_B ""
 /begin REF_MEASUREMENT fl32_01.I_fl32.R04_B fl32_02.I_fl32.R04_B fl32_03.I_fl32.R04_B fl32_04.I_fl32.R04_B fl32_05.I_fl32.R04_B fl32_06.I_fl32.R04_B fl32_07.I_fl32.R04_B fl32_08.I_fl32.R04_B /end REF_MEASUREMENT
/end GROUP
/begin GROUP I_fl64.R01_B ""
 /begin REF_MEASUREMENT fl64_01.I_fl64.R01_B fl64_02.I_fl64.R01_B fl64_03.I_fl64.R01_B fl64_04.I_fl64.R01_B fl64_05.I_fl64.R01_B fl64_06.I_fl64.R01_B fl64_07.I_fl64.R01_B fl64_08.I_fl64.R01_B /end REF_MEASUREMENT
/end GROUP
/begin GROUP I_fl64.R02_B ""
 /begin REF_MEASUREMENT fl64_01.I_fl64.R02_B fl64_02.I_fl64.R02_B fl64_03.I_fl64.R02_B fl64_04.I_fl64.R02_B fl64_05.I_fl64.R02_B fl64_06.I_fl64.R02_B fl64_07.I_fl64.R02_B fl64_08.I_fl64.R02_B /end REF_MEASUREMENT
/end GROUP
/begin GROUP I_fl64.R03_B ""
 /begin REF_MEASUREMENT fl64_01.I_fl64.R03_B fl64_02.I_fl64.R03_B fl64_03.I_fl64.R03_B fl64_04.I_fl64.R03_B fl64_05.I_fl64.R03_B fl64_06.I_fl64.R03_B fl64_07.I_fl64.R03_B fl64_08.I_fl64.R03_B /end REF_MEASUREMENT
/end GROUP
/begin GROUP I_fl64.R04_B ""
 /begin REF_MEASUREMENT fl64_01.I_fl64.R04_B fl64_02.I_fl64.R04_B fl64_03.I_fl64.R04_B fl64_04.I_fl64.R04_B fl64_05.I_fl64.R04_B fl64_06.I_fl64.R04_B fl64_07.I_fl64.R04_B fl64_08.I_fl64.R04_B /end REF_MEASUREMENT
/end GROUP
/begin GROUP I_sint16.R01 ""
 /begin REF_MEASUREMENT sint16_01.I_sint16.R01 sint16_02.I_sint16.R01 sint16_03.I_sint16.R01 sint16_04.I_sint16.R01 sint16_05.I_sint16.R01 sint16_06.I_sint16.R01 sint16_07.I_sint16.R01 sint16_08.I_sint16.R01 /end REF_MEASUREMENT
/end GROUP
/begin GROUP I_sint16.R02 ""
 /begin REF_MEASUREMENT sint16_01.I_sint16.R02 sint16_02.I_sint16.R02 sint16_03.I_sint16.R02 sint16_04.I_sint16.R02 sint16_05.I_sint16.R02 sint16_06.I_sint16.R02 sint16_07.I_sint16.R02 sint16_08.I_sint16.R02 /end REF_MEASUREMENT
/end GROUP
/begin GROUP I_sint16.R03 ""
 /begin REF_MEASUREMENT sint16_01.I_sint16.R03 sint16_02.I_sint16.R03 sint16_03.I_sint16.R03 sint16_04.I_sint16.R03 sint16_05.I_sint16.R03 sint16_06.I_sint16.R03 sint16_07.I_sint16.R03 sint16_08.I_sint16.R03 /end REF_MEASUREMENT
/end GROUP
/begin GROUP I_sint16.R04 ""
 /begin REF_MEASUREMENT sint16_01.I_sint16.R04 sint16_02.I_sint16.R04 sint16_03.I_sint16.R04 sint16_04.I_sint16.R04 sint16_05.I_sint16.R04 sint16_06.I_sint16.R04 sint16_07.I_sint16.R04 sint16_08.I_sint16.R04 /end REF_MEASUREMENT
/end GROUP
/begin GROUP I_sint16_1.R01_16bit ""
 /begin REF_MEASUREMENT sint16_01.I_sint16_1.R01_16bit sint16_02.I_sint16_1.R01_16bit sint16_03.I_sint16_1.R01_16bit sint16_04.I_sint16_1.R01_16bit sint16_05.I_sint16_1.R01_16bit sint16_06.I_sint16_1.R01_16bit sint16_07.I_sint16_1.R01_16bit sint16_08.I_sint16_1.R01_16bit /end REF_MEASUREMENT
/end GROUP
/begin GROUP I_sint16_2.R01_16bit ""
 /begin REF_MEASUREMENT sint16_01.I_sint16_2.R01_16bit sint16_02.I_sint16_2.R01_16bit sint16_03.I_sint16_2.R01_16bit sint16_04.I_sint16_2.R01_16bit sint16_05.I_sint16_2.R01_16bit sint16_06.I_sint16_2.R01_16bit sint16_07.I_sint16_2.R01_16bit sint16_08.I_sint16_2.R01_16bit /end REF_MEASUREMENT
/end GROUP
/begin GROUP I_sint16_3.R01_16bit ""
 /begin REF_MEASUREMENT sint16_01.I_sint16_3.R01_16bit sint16_02.I_sint16_3.R01_16bit sint16_03.I_sint16_3.R01_16bit sint16_04.I_sint16_3.R01_16bit sint16_05.I_sint16_3.R01_16bit sint16_06.I_sint16_3.R01_16bit sint16_07.I_sint16_3.R01_16bit sint16_08.I_sint16_3.R01_16bit /end REF_MEASUREMENT
/end GROUP
/begin GROUP I_sint16_4.R01_16bit ""
 /begin REF_MEASUREMENT sint16_01.I_sint16_4.R01_16bit sint16_02.I_sint16_4.R01_16bit sint16_03.I_sint16_4.R01_16bit sint16_04.I_sint16_4.R01_16bit sint16_05.I_sint16_4.R01_16bit sint16_06.I_sint16_4.R01_16bit sint16_07.I_sint16_4.R01_16bit sint16_08.I_sint16_4.R01_16bit /end REF_MEASUREMENT
/end GROUP
/begin GROUP I_sint32.R01_B ""
 /begin REF_MEASUREMENT sint32_01.I_sint32.R01_B sint32_02.I_sint32.R01_B sint32_03.I_sint32.R01_B sint32_04.I_sint32.R01_B sint32_05.I_sint32.R01_B sint32_06.I_sint32.R01_B sint32_07.I_sint32.R01_B sint32_08.I_sint32.R01_B /end REF_MEASUREMENT
/end GROUP
/begin GROUP I_sint32.R02_B ""
 /begin REF_MEASUREMENT sint32_01.I_sint32.R02_B sint32_02.I_sint32.R02_B sint32_03.I_sint32.R02_B sint32_04.I_sint32.R02_B sint32_05.I_sint32.R02_B sint32_06.I_sint32.R02_B sint32_07.I_sint32.R02_B sint32_08.I_sint32.R02_B /end REF_MEASUREMENT
/end GROUP
/begin GROUP I_sint32.R03_B ""
 /begin REF_MEASUREMENT sint32_01.I_sint32.R03_B sint32_02.I_sint32.R03_B sint32_03.I_sint32.R03_B sint32_04.I_sint32.R03_B sint32_05.I_sint32.R03_B sint32_06.I_sint32.R03_B sint32_07.I_sint32.R03_B sint32_08.I_sint32.R03_B /end REF_MEASUREMENT
/end GROUP
/begin GROUP I_sint32.R04_B ""
 /begin REF_MEASUREMENT sint32_01.I_sint32.R04_B sint32_02.I_sint32.R04_B sint32_03.I_sint32.R04_B sint32_04.I_sint32.R04_B sint32_05.I_sint32.R04_B sint32_06.I_sint32.R04_B sint32_07.I_sint32.R04_B sint32_08.I_sint32.R04_B /end REF_MEASUREMENT
/end GROUP
/begin GROUP I_sint8.R01 ""
 /begin REF_MEASUREMENT sint8_01.I_sint8.R01 sint8_02.I_sint8.R01 sint8_03.I_sint8.R01 sint8_04.I_sint8.R01 sint8_05.I_sint8.R01 sint8_06.I_sint8.R01 sint8_07.I_sint8.R01 sint8_08.I_sint8.R01 /end REF_MEASUREMENT
/end GROUP
/begin GROUP I_sint8.R02 ""
 /begin REF_MEASUREMENT sint8_01.I_sint8.R02 sint8_02.I_sint8.R02 sint8_03.I_sint8.R02 sint8_04.I_sint8.R02 sint8_05.I_sint8.R02 sint8_06.I_sint8.R02 sint8_07.I_sint8.R02 sint8_08.I_sint8.R02 /end REF_MEASUREMENT
/end GROUP
/begin GROUP I_sint8.R03 ""
 /begin REF_MEASUREMENT sint8_01.I_sint8.R03 sint8_02.I_sint8.R03 sint8_03.I_sint8.R03 sint8_04.I_sint8.R03 sint8_05.I_sint8.R03 sint8_06.I_sint8.R03 sint8_07.I_sint8.R03 sint8_08.I_sint8.R03 /end REF_MEASUREMENT
/end GROUP
/begin GROUP I_sint8.R04 ""
 /begin REF_MEASUREMENT sint8_01.I_sint8.R04 sint8_02.I_sint8.R04 sint8_03.I_sint8.R04 sint8_04.I_sint8.R04 sint8_05.I_sint8.R04 sint8_06.I_sint8.R04 sint8_07.I_sint8.R04 sint8_08.I_sint8.R04 /end REF_MEASUREMENT
/end GROUP
/begin GROUP I_sint8_1.R01_8bit ""
 /begin REF_MEASUREMENT sint8_01.I_sint8_1.R01_8bit sint8_02.I_sint8_1.R01_8bit sint8_03.I_sint8_1.R01_8bit sint8_04.I_sint8_1.R01_8bit sint8_05.I_sint8_1.R01_8bit sint8_06.I_sint8_1.R01_8bit sint8_07.I_sint8_1.R01_8bit sint8_08.I_sint8_1.R01_8bit /end REF_MEASUREMENT
/end GROUP
/begin GROUP I_sint8_2.R01_8bit ""
 /begin REF_MEASUREMENT sint8_01.I_sint8_2.R01_8bit sint8_02.I_sint8_2.R01_8bit sint8_03.I_sint8_2.R01_8bit sint8_04.I_sint8_2.R01_8bit sint8_05.I_sint8_2.R01_8bit sint8_06.I_sint8_2.R01_8bit sint8_07.I_sint8_2.R01_8bit sint8_08.I_sint8_2.R01_8bit /end REF_MEASUREMENT
/end GROUP
/begin GROUP I_sint8_3.R01_8bit ""
 /begin REF_MEASUREMENT sint8_01.I_sint8_3.R01_8bit sint8_02.I_sint8_3.R01_8bit sint8_03.I_sint8_3.R01_8bit sint8_04.I_sint8_3.R01_8bit sint8_05.I_sint8_3.R01_8bit sint8_06.I_sint8_3.R01_8bit sint8_07.I_sint8_3.R01_8bit sint8_08.I_sint8_3.R01_8bit /end REF_MEASUREMENT
/end GROUP
/begin GROUP I_sint8_4.R01_8bit ""
 /begin REF_MEASUREMENT sint8_01.I_sint8_4.R01_8bit sint8_02.I_sint8_4.R01_8bit sint8_03.I_sint8_4.R01_8bit sint8_04.I_sint8_4.R01_8bit sint8_05.I_sint8_4.R01_8bit sint8_06.I_sint8_4.R01_8bit sint8_07.I_sint8_4.R01_8bit sint8_08.I_sint8_4.R01_8bit /end REF_MEASUREMENT
/end GROUP
/begin GROUP I_sint8_5.R01_8bit ""
 /begin REF_MEASUREMENT sint8_01.I_sint8_5.R01_8bit sint8_02.I_sint8_5.R01_8bit sint8_03.I_sint8_5.R01_8bit sint8_04.I_sint8_5.R01_8bit sint8_05.I_sint8_5.R01_8bit sint8_06.I_sint8_5.R01_8bit sint8_07.I_sint8_5.R01_8bit sint8_08.I_sint8_5.R01_8bit /end REF_MEASUREMENT
/end GROUP
/begin GROUP I_sint8_6.R01_8bit ""
 /begin REF_MEASUREMENT sint8_01.I_sint8_6.R01_8bit sint8_02.I_sint8_6.R01_8bit sint8_03.I_sint8_6.R01_8bit sint8_04.I_sint8_6.R01_8bit sint8_05.I_sint8_6.R01_8bit sint8_06.I_sint8_6.R01_8bit sint8_07.I_sint8_6.R01_8bit sint8_08.I_sint8_6.R01_8bit /end REF_MEASUREMENT
/end GROUP
/begin GROUP I_sint8_7.R01_8bit ""
 /begin REF_MEASUREMENT sint8_01.I_sint8_7.R01_8bit sint8_02.I_sint8_7.R01_8bit sint8_03.I_sint8_7.R01_8bit sint8_04.I_sint8_7.R01_8bit sint8_05.I_sint8_7.R01_8bit sint8_06.I_sint8_7.R01_8bit sint8_07.I_sint8_7.R01_8bit sint8_08.I_sint8_7.R01_8bit /end REF_MEASUREMENT
/end GROUP
/begin GROUP I_sint8_8.R01_8bit ""
 /begin REF_MEASUREMENT sint8_01.I_sint8_8.R01_8bit sint8_02.I_sint8_8.R01_8bit sint8_03.I_sint8_8.R01_8bit sint8_04.I_sint8_8.R01_8bit sint8_05.I_sint8_8.R01_8bit sint8_06.I_sint8_8.R01_8bit sint8_07.I_sint8_8.R01_8bit sint8_08.I_sint8_8.R01_8bit /end REF_MEASUREMENT
/end GROUP
/begin GROUP I_uint16.R01 ""
 /begin REF_MEASUREMENT uint16_01.I_uint16.R01 uint16_02.I_uint16.R01 uint16_03.I_uint16.R01 uint16_04.I_uint16.R01 uint16_05.I_uint16.R01 uint16_06.I_uint16.R01 uint16_07.I_uint16.R01 uint16_08.I_uint16.R01 /end REF_MEASUREMENT
/end GROUP
/begin GROUP I_uint16.R02 ""
 /begin REF_MEASUREMENT uint16_01.I_uint16.R02 uint16_02.I_uint16.R02 uint16_03.I_uint16.R02 uint16_04.I_uint16.R02 uint16_05.I_uint16.R02 uint16_06.I_uint16.R02 uint16_07.I_uint16.R02 uint16_08.I_uint16.R02 /end REF_MEASUREMENT
/end GROUP
/begin GROUP I_uint16.R03 ""
 /begin REF_MEASUREMENT uint16_01.I_uint16.R03 uint16_02.I_uint16.R03 uint16_03.I_uint16.R03 uint16_04.I_uint16.R03 uint16_05.I_uint16.R03 uint16_06.I_uint16.R03 uint16_07.I_uint16.R03 uint16_08.I_uint16.R03 /end REF_MEASUREMENT
/end GROUP
/begin GROUP I_uint16.R04 ""
 /begin REF_MEASUREMENT uint16_01.I_uint16.R04 uint16_02.I_uint16.R04 uint16_03.I_uint16.R04 uint16_04.I_uint16.R04 uint16_05.I_uint16.R04 uint16_06.I_uint16.R04 uint16_07.I_uint16.R04 uint16_08.I_uint16.R04 /end REF_MEASUREMENT
/end GROUP
/begin GROUP I_uint16_1.R01_16bit ""
 /begin REF_MEASUREMENT uint16_01.I_uint16_1.R01_16bit uint16_02.I_uint16_1.R01_16bit uint16_03.I_uint16_1.R01_16bit uint16_04.I_uint16_1.R01_16bit uint16_05.I_uint16_1.R01_16bit uint16_06.I_uint16_1.R01_16bit uint16_07.I_uint16_1.R01_16bit uint16_08.I_uint16_1.R01_16bit /end REF_MEASUREMENT
/end GROUP
/begin GROUP I_uint16_2.R01_16bit ""
 /begin REF_MEASUREMENT uint16_01.I_uint16_2.R01_16bit uint16_02.I_uint16_2.R01_16bit uint16_03.I_uint16_2.R01_16bit uint16_04.I_uint16_2.R01_16bit uint16_05.I_uint16_2.R01_16bit uint16_06.I_uint16_2.R01_16bit uint16_07.I_uint16_2.R01_16bit uint16_08.I_uint16_2.R01_16bit /end REF_MEASUREMENT
/end GROUP
/begin GROUP I_uint16_3.R01_16bit ""
 /begin REF_MEASUREMENT uint16_01.I_uint16_3.R01_16bit uint16_02.I_uint16_3.R01_16bit uint16_03.I_uint16_3.R01_16bit uint16_04.I_uint16_3.R01_16bit uint16_05.I_uint16_3.R01_16bit uint16_06.I_uint16_3.R01_16bit uint16_07.I_uint16_3.R01_16bit uint16_08.I_uint16_3.R01_16bit /end REF_MEASUREMENT
/end GROUP
/begin GROUP I_uint16_4.R01_16bit ""
 /begin REF_MEASUREMENT uint16_01.I_uint16_4.R01_16bit uint16_02.I_uint16_4.R01_16bit uint16_03.I_uint16_4.R01_16bit uint16_04.I_uint16_4.R01_16bit uint16_05.I_uint16_4.R01_16bit uint16_06.I_uint16_4.R01_16bit uint16_07.I_uint16_4.R01_16bit uint16_08.I_uint16_4.R01_16bit /end REF_MEASUREMENT
/end GROUP
/begin GROUP I_uint32.R01_B ""
 /begin REF_MEASUREMENT uint32_01.I_uint32.R01_B uint32_02.I_uint32.R01_B uint32_03.I_uint32.R01_B uint32_04.I_uint32.R01_B uint32_05.I_uint32.R01_B uint32_06.I_uint32.R01_B uint32_07.I_uint32.R01_B uint32_08.I_uint32.R01_B /end REF_MEASUREMENT
/end GROUP
/begin GROUP I_uint32.R02_B ""
 /begin REF_MEASUREMENT uint32_01.I_uint32.R02_B uint32_02.I_uint32.R02_B uint32_03.I_uint32.R02_B uint32_04.I_uint32.R02_B uint32_05.I_uint32.R02_B uint32_06.I_uint32.R02_B uint32_07.I_uint32.R02_B uint32_08.I_uint32.R02_B /end REF_MEASUREMENT
/end GROUP
/begin GROUP I_uint32.R03_B ""
 /begin REF_MEASUREMENT uint32_01.I_uint32.R03_B uint32_02.I_uint32.R03_B uint32_03.I_uint32.R03_B uint32_04.I_uint32.R03_B uint32_05.I_uint32.R03_B uint32_06.I_uint32.R03_B uint32_07.I_uint32.R03_B uint32_08.I_uint32.R03_B /end REF_MEASUREMENT
/end GROUP
/begin GROUP I_uint32.R04_B ""
 /begin REF_MEASUREMENT uint32_01.I_uint32.R04_B uint32_02.I_uint32.R04_B uint32_03.I_uint32.R04_B uint32_04.I_uint32.R04_B uint32_05.I_uint32.R04_B uint32_06.I_uint32.R04_B uint32_07.I_uint32.R04_B uint32_08.I_uint32.R04_B /end REF_MEASUREMENT
/end GROUP
/begin GROUP I_uint8.R01 ""
 /begin REF_MEASUREMENT uint8_01.I_uint8.R01 uint8_02.I_uint8.R01 uint8_03.I_uint8.R01 uint8_04.I_uint8.R01 uint8_05.I_uint8.R01 uint8_06.I_uint8.R01 uint8_07.I_uint8.R01 uint8_08.I_uint8.R01 /end REF_MEASUREMENT
/end GROUP
/begin GROUP I_uint8.R02 ""
 /begin REF_MEASUREMENT uint8_01.I_uint8.R02 uint8_02.I_uint8.R02 uint8_03.I_uint8.R02 uint8_04.I_uint8.R02 uint8_05.I_uint8.R02 uint8_06.I_uint8.R02 uint8_07.I_uint8.R02 uint8_08.I_uint8.R02 /end REF_MEASUREMENT
/end GROUP
/begin GROUP I_uint8.R03 ""
 /begin REF_MEASUREMENT uint8_01.I_uint8.R03 uint8_02.I_uint8.R03 uint8_03.I_uint8.R03 uint8_04.I_uint8.R03 uint8_05.I_uint8.R03 uint8_06.I_uint8.R03 uint8_07.I_uint8.R03 uint8_08.I_uint8.R03 /end REF_MEASUREMENT
/end GROUP
/begin GROUP I_uint8.R04 ""
 /begin REF_MEASUREMENT uint8_01.I_uint8.R04 uint8_02.I_uint8.R04 uint8_03.I_uint8.R04 uint8_04.I_uint8.R04 uint8_05.I_uint8.R04 uint8_06.I_uint8.R04 uint8_07.I_uint8.R04 uint8_08.I_uint8.R04 /end REF_MEASUREMENT
/end GROUP
/begin GROUP I_uint8_1.R01_8bit ""
 /begin REF_MEASUREMENT uint8_01.I_uint8_1.R01_8bit uint8_02.I_uint8_1.R01_8bit uint8_03.I_uint8_1.R01_8bit uint8_04.I_uint8_1.R01_8bit uint8_05.I_uint8_1.R01_8bit uint8_06.I_uint8_1.R01_8bit uint8_07.I_uint8_1.R01_8bit uint8_08.I_uint8_1.R01_8bit /end REF_MEASUREMENT
/end GROUP
/begin GROUP I_uint8_2.R01_8bit ""
 /begin REF_MEASUREMENT uint8_01.I_uint8_2.R01_8bit uint8_02.I_uint8_2.R01_8bit uint8_03.I_uint8_2.R01_8bit uint8_04.I_uint8_2.R01_8bit uint8_05.I_uint8_2.R01_8bit uint8_06.I_uint8_2.R01_8bit uint8_07.I_uint8_2.R01_8bit uint8_08.I_uint8_2.R01_8bit /end REF_MEASUREMENT
/end GROUP
/begin GROUP I_uint8_3.R01_8bit ""
 /begin REF_MEASUREMENT uint8_01.I_uint8_3.R01_8bit uint8_02.I_uint8_3.R01_8bit uint8_03.I_uint8_3.R01_8bit uint8_04.I_uint8_3.R01_8bit uint8_05.I_uint8_3.R01_8bit uint8_06.I_uint8_3.R01_8bit uint8_07.I_uint8_3.R01_8bit uint8_08.I_uint8_3.R01_8bit /end REF_MEASUREMENT
/end GROUP
/begin GROUP I_uint8_4.R01_8bit ""
 /begin REF_MEASUREMENT uint8_01.I_uint8_4.R01_8bit uint8_02.I_uint8_4.R01_8bit uint8_03.I_uint8_4.R01_8bit uint8_04.I_uint8_4.R01_8bit uint8_05.I_uint8_4.R01_8bit uint8_06.I_uint8_4.R01_8bit uint8_07.I_uint8_4.R01_8bit uint8_08.I_uint8_4.R01_8bit /end REF_MEASUREMENT
/end GROUP
/begin GROUP I_uint8_5.R01_8bit ""
 /begin REF_MEASUREMENT uint8_01.I_uint8_5.R01_8bit uint8_02.I_uint8_5.R01_8bit uint8_03.I_uint8_5.R01_8bit uint8_04.I_uint8_5.R01_8bit uint8_05.I_uint8_5.R01_8bit uint8_06.I_uint8_5.R01_8bit uint8_07.I_uint8_5.R01_8bit uint8_08.I_uint8_5.R01_8bit /end REF_MEASUREMENT
/end GROUP
/begin GROUP I_uint8_6.R01_8bit ""
 /begin REF_MEASUREMENT uint8_01.I_uint8_6.R01_8bit uint8_02.I_uint8_6.R01_8bit uint8_03.I_uint8_6.R01_8bit uint8_04.I_uint8_6.R01_8bit uint8_05.I_uint8_6.R01_8bit uint8_06.I_uint8_6.R01_8bit uint8_07.I_uint8_6.R01_8bit uint8_08.I_uint8_6.R01_8bit /end REF_MEASUREMENT
/end GROUP
/begin GROUP I_uint8_7.R01_8bit ""
 /begin REF_MEASUREMENT uint8_01.I_uint8_7.R01_8bit uint8_02.I_uint8_7.R01_8bit uint8_03.I_uint8_7.R01_8bit uint8_04.I_uint8_7.R01_8bit uint8_05.I_uint8_7.R01_8bit uint8_06.I_uint8_7.R01_8bit uint8_07.I_uint8_7.R01_8bit uint8_08.I_uint8_7.R01_8bit /end REF_MEASUREMENT
/end GROUP
/begin GROUP I_uint8_8.R01_8bit ""
 /begin REF_MEASUREMENT uint8_01.I_uint8_8.R01_8bit uint8_02.I_uint8_8.R01_8bit uint8_03.I_uint8_8.R01_8bit uint8_04.I_uint8_8.R01_8bit uint8_05.I_uint8_8.R01_8bit uint8_06.I_uint8_8.R01_8bit uint8_07.I_uint8_8.R01_8bit uint8_08.I_uint8_8.R01_8bit /end REF_MEASUREMENT
/end GROUP
/begin GROUP M_Ultimate "" ROOT
 /begin REF_MEASUREMENT RM01_Op_u8.M_Ultimate RM01_Par01_u8.M_Ultimate RM01_Par02_u8.M_Ultimate RM01_Res_u8.M_Ultimate SM01_Par01_u8.M_Ultimate SM01_Par02_u8.M_Ultimate SM01_Res_u8.M_Ultimate SM_Err01_log.M_Ultimate SRM01_Res_u8.M_Ultimate SRM02_Res_u8.M_Ultimate SRM_Err01_log.M_Ultimate SRM_Stimu_Count01_u8.M_Ultimate fl32_01.M_Ultimate fl64_01.M_Ultimate s_uint8_01.M_Ultimate sint16_01.M_Ultimate sint32_01.M_Ultimate sint8_01.M_Ultimate uint16_01.M_Ultimate uint32_01.M_Ultimate uint8_01.M_Ultimate /end REF_MEASUREMENT
 /begin REF_CHARACTERISTIC P_F32_1.M_Ultimate P_F64_1.M_Ultimate P_Op_Val_u8.M_Ultimate P_Operation_case.M_Ultimate P_Result_case.M_Ultimate P_S16_1.M_Ultimate P_S32_1.M_Ultimate P_S8_1.M_Ultimate P_Stimu01_u8.M_Ultimate P_Stimu02_u8.M_Ultimate P_Stimu_case.M_Ultimate P_U16_1.M_Ultimate P_U32_1.M_Ultimate P_U8_1.M_Ultimate /end REF_CHARACTERISTIC
/end GROUP
/begin GROUP Map_Mod "" ROOT
 /begin REF_MEASUREMENT M_In_Cuboid_X.Map_Mod M_In_Cuboid_Y.Map_Mod M_In_Cuboid_Z.Map_Mod M_In_Cuboid_Z2.Map_Mod M_In_X_Dist.Map_Mod M_In_X_Two_D.Map_Mod M_In_Y_Dist.Map_Mod M_In_Y_Two_D.Map_Mod M_Out_Cuboid3D_1.Map_Mod M_Out_Cuboid3D_2.Map_Mod M_Out_Cuboid3D_3.Map_Mod M_Out_Group_1.Map_Mod M_Out_Group_2.Map_Mod M_Out_Group_3.Map_Mod M_Out_X_Two_D.Map_Mod /end REF_MEASUREMENT
 /begin REF_CHARACTERISTIC Cuboid3D.Map_Mod Cuboid3D_1.Map_Mod Cuboid3D_2.Map_Mod Cuboid3D_3.Map_Mod Group_Two_D_1.Map_Mod Group_Two_D_2.Map_Mod Group_Two_D_3.Map_Mod P_In_Cuboid_X.Map_Mod P_In_Cuboid_Y.Map_Mod P_In_Cuboid_Z.Map_Mod P_In_Cuboid_Z2.Map_Mod P_In_X_Two_D.Map_Mod P_In_Y_Two_D.Map_Mod TestCuboid_3D_FixAxisPnt_f32.Map_Mod TestCuboid_3D_VarNoAxisPnt.Map_Mod TestCuboid_4D_FixAxisPnt_f32.Map_Mod TestCuboid_4D_VarNoAxisPnt.Map_Mod TestCuboid_4D_WFST.Map_Mod Two_D.Map_Mod /end REF_CHARACTERISTIC
/end GROUP
/begin GROUP Maps_Raster_1 "" ROOT /begin REF_CHARACTERISTIC P_Do_Maps.Maps_Raster_1 /end REF_CHARACTERISTIC
 /begin SUB_GROUP All_Maps_FIX.Maps_Raster_1 All_Maps_GRP.Maps_Raster_1 All_Maps_STD.Maps_Raster_1 /end SUB_GROUP
/end GROUP
/begin GROUP Maps_Raster_2 "" ROOT /begin REF_CHARACTERISTIC P_Do_Maps.Maps_Raster_2 /end REF_CHARACTERISTIC
 /begin SUB_GROUP All_Maps_FIX.Maps_Raster_2 All_Maps_GRP.Maps_Raster_2 All_Maps_STD.Maps_Raster_2 /end SUB_GROUP
/end GROUP
/begin GROUP Maps_Raster_3 "" ROOT /begin REF_CHARACTERISTIC P_Do_Maps.Maps_Raster_3 /end REF_CHARACTERISTIC
 /begin SUB_GROUP All_Maps_FIX.Maps_Raster_3 All_Maps_GRP.Maps_Raster_3 All_Maps_STD.Maps_Raster_3 /end SUB_GROUP
/end GROUP
/begin GROUP Model_Byp_B01 "" ROOT
 /begin REF_MEASUREMENT B_cntr_B01_ok.clsCounter_B01.Model_Byp_B01 bypass_B01_state.Model_Byp_B01 cntrold_B01.clsCounter_B01.Model_Byp_B01 cont_sint16_1_100_B01.Model_Byp_B01 cont_sint16_1_100_offset_cpy_B01.Model_Byp_B01 cont_sint16_B01.Model_Byp_B01 cont_sint16_offset_cpy_B01.Model_Byp_B01 cont_sint8_1_10_B01.Model_Byp_B01 cont_sint8_1_10_offset_cpy_B01.Model_Byp_B01 cont_sint8_B01.Model_Byp_B01 cont_sint8_offset_cpy_B01.Model_Byp_B01 cont_uint16_1_2_B01.Model_Byp_B01 cont_uint16_1_2_offset_cpy_B01.Model_Byp_B01 cont_uint8_10_1_B01.Model_Byp_B01 cont_uint8_10_1_offset_cpy_B01.Model_Byp_B01 errcntr_B01.clsCounter_B01.Model_Byp_B01 log_uint8_0_B01.Model_Byp_B01 log_uint8_0_bitOffset_cpy_B01.Model_Byp_B01 log_uint8_0_offset_cpy_B01.Model_Byp_B01 log_uint8_1_B01.Model_Byp_B01 log_uint8_1_bitOffset_cpy_B01.Model_Byp_B01 log_uint8_1_offset_cpy_B01.Model_Byp_B01 sdisc_sint16_B01.Model_Byp_B01 sdisc_sint16_offset_cpy_B01.Model_Byp_B01 sdisc_sint8_B01.Model_Byp_B01 sdisc_sint8_offset_cpy_B01.Model_Byp_B01 udisc_uint16_B01.Model_Byp_B01 udisc_uint16_offset_cpy_B01.Model_Byp_B01 udisc_uint8_B01.Model_Byp_B01 udisc_uint8_offset_cpy_B01.Model_Byp_B01 /end REF_MEASUREMENT
 /begin REF_CHARACTERISTIC bypass_B01_enable.Model_Byp_B01 cont_sint16_1_100_bypEnable_B01.Model_Byp_B01 cont_sint16_1_100_offset_B01.Model_Byp_B01 cont_sint16_bypEnable_B01.Model_Byp_B01 cont_sint16_offset_B01.Model_Byp_B01 cont_sint8_1_10_bypEnable_B01.Model_Byp_B01 cont_sint8_1_10_offset_B01.Model_Byp_B01 cont_sint8_bypEnable_B01.Model_Byp_B01 cont_sint8_offset_B01.Model_Byp_B01 cont_uint16_1_2_bypEnable_B01.Model_Byp_B01 cont_uint16_1_2_offset_B01.Model_Byp_B01 cont_uint8_10_1_bypEnable_B01.Model_Byp_B01 cont_uint8_10_1_offset_B01.Model_Byp_B01 log_uint8_0_bitOffset_B01.Model_Byp_B01 log_uint8_0_bypEnable_B01.Model_Byp_B01 log_uint8_0_offset_B01.Model_Byp_B01 log_uint8_1_bitOffset_B01.Model_Byp_B01 log_uint8_1_bypEnable_B01.Model_Byp_B01 log_uint8_1_offset_B01.Model_Byp_B01 p_cont_sint16_1_100_B01.Model_Byp_B01 p_cont_sint16_B01.Model_Byp_B01 p_cont_sint8_1_10_B01.Model_Byp_B01 p_cont_sint8_B01.Model_Byp_B01 p_cont_uint16_1_2_B01.Model_Byp_B01 p_cont_uint8_10_1_B01.Model_Byp_B01 p_log_uint8_0_B01.Model_Byp_B01 p_log_uint8_1_B01.Model_Byp_B01 p_sdisc_sint16_B01.Model_Byp_B01 p_sdisc_sint8_B01.Model_Byp_B01 p_udisc_uint16_B01.Model_Byp_B01 p_udisc_uint8_B01.Model_Byp_B01 sdisc_sint16_bypEnable_B01.Model_Byp_B01 sdisc_sint16_offset_B01.Model_Byp_B01 sdisc_sint8_bypEnable_B01.Model_Byp_B01 sdisc_sint8_offset_B01.Model_Byp_B01 udisc_uint16_bypEnable_B01.Model_Byp_B01 udisc_uint16_offset_B01.Model_Byp_B01 udisc_uint8_bypEnable_B01.Model_Byp_B01 udisc_uint8_offset_B01.Model_Byp_B01 /end REF_CHARACTERISTIC
 /begin SUB_GROUP clsCounter_B01.Model_Byp_B01 /end SUB_GROUP
/end GROUP
/begin GROUP Model_Byp_B02 "" ROOT
 /begin REF_MEASUREMENT B_cntr_B02_ok.clsCounter_B02.Model_Byp_B02 bypass_B02_state.Model_Byp_B02 cntrold_B02.clsCounter_B02.Model_Byp_B02 cont_sint16_1_100_B02.Model_Byp_B02 cont_sint16_1_100_offset_cpy_B02.Model_Byp_B02 cont_sint16_B02.Model_Byp_B02 cont_sint16_offset_cpy_B02.Model_Byp_B02 cont_sint8_1_10_B02.Model_Byp_B02 cont_sint8_1_10_offset_cpy_B02.Model_Byp_B02 cont_sint8_B02.Model_Byp_B02 cont_sint8_offset_cpy_B02.Model_Byp_B02 cont_uint16_1_2_B02.Model_Byp_B02 cont_uint16_1_2_offset_cpy_B02.Model_Byp_B02 cont_uint8_10_1_B02.Model_Byp_B02 cont_uint8_10_1_offset_cpy_B02.Model_Byp_B02 errcntr_B02.clsCounter_B02.Model_Byp_B02 log_uint8_0_B02.Model_Byp_B02 log_uint8_0_bitOffset_cpy_B02.Model_Byp_B02 log_uint8_0_offset_cpy_B02.Model_Byp_B02 log_uint8_1_B02.Model_Byp_B02 log_uint8_1_bitOffset_cpy_B02.Model_Byp_B02 log_uint8_1_offset_cpy_B02.Model_Byp_B02 sdisc_sint16_B02.Model_Byp_B02 sdisc_sint16_offset_cpy_B02.Model_Byp_B02 sdisc_sint8_B02.Model_Byp_B02 sdisc_sint8_offset_cpy_B02.Model_Byp_B02 udisc_uint16_B02.Model_Byp_B02 udisc_uint16_offset_cpy_B02.Model_Byp_B02 udisc_uint8_B02.Model_Byp_B02 udisc_uint8_offset_cpy_B02.Model_Byp_B02 /end REF_MEASUREMENT
 /begin REF_CHARACTERISTIC bypass_B02_enable.Model_Byp_B02 cont_sint16_1_100_bypEnable_B02.Model_Byp_B02 cont_sint16_1_100_offset_B02.Model_Byp_B02 cont_sint16_bypEnable_B02.Model_Byp_B02 cont_sint16_offset_B02.Model_Byp_B02 cont_sint8_1_10_bypEnable_B02.Model_Byp_B02 cont_sint8_1_10_offset_B02.Model_Byp_B02 cont_sint8_bypEnable_B02.Model_Byp_B02 cont_sint8_offset_B02.Model_Byp_B02 cont_uint16_1_2_bypEnable_B02.Model_Byp_B02 cont_uint16_1_2_offset_B02.Model_Byp_B02 cont_uint8_10_1_bypEnable_B02.Model_Byp_B02 cont_uint8_10_1_offset_B02.Model_Byp_B02 log_uint8_0_bitOffset_B02.Model_Byp_B02 log_uint8_0_bypEnable_B02.Model_Byp_B02 log_uint8_0_offset_B02.Model_Byp_B02 log_uint8_1_bitOffset_B02.Model_Byp_B02 log_uint8_1_bypEnable_B02.Model_Byp_B02 log_uint8_1_offset_B02.Model_Byp_B02 p_cont_sint16_1_100_B02.Model_Byp_B02 p_cont_sint16_B02.Model_Byp_B02 p_cont_sint8_1_10_B02.Model_Byp_B02 p_cont_sint8_B02.Model_Byp_B02 p_cont_uint16_1_2_B02.Model_Byp_B02 p_cont_uint8_10_1_B02.Model_Byp_B02 p_log_uint8_0_B02.Model_Byp_B02 p_log_uint8_1_B02.Model_Byp_B02 p_sdisc_sint16_B02.Model_Byp_B02 p_sdisc_sint8_B02.Model_Byp_B02 p_udisc_uint16_B02.Model_Byp_B02 p_udisc_uint8_B02.Model_Byp_B02 sdisc_sint16_bypEnable_B02.Model_Byp_B02 sdisc_sint16_offset_B02.Model_Byp_B02 sdisc_sint8_bypEnable_B02.Model_Byp_B02 sdisc_sint8_offset_B02.Model_Byp_B02 udisc_uint16_bypEnable_B02.Model_Byp_B02 udisc_uint16_offset_B02.Model_Byp_B02 udisc_uint8_bypEnable_B02.Model_Byp_B02 udisc_uint8_offset_B02.Model_Byp_B02 /end REF_CHARACTERISTIC
 /begin SUB_GROUP clsCounter_B02.Model_Byp_B02 /end SUB_GROUP
/end GROUP
/begin GROUP Model_XcpByp_B01 "" ROOT
 /begin REF_MEASUREMENT cont_sint16_1_100_Xcp_B01.Model_XcpByp_B01 cont_sint16_Xcp_B01.Model_XcpByp_B01 cont_sint8_1_10_Xcp_B01.Model_XcpByp_B01 cont_sint8_Xcp_B01.Model_XcpByp_B01 cont_uint16_1_2_Xcp_B01.Model_XcpByp_B01 cont_uint8_10_1_Xcp_B01.Model_XcpByp_B01 log_uint8_0_Xcp_B01.Model_XcpByp_B01 log_uint8_1_Xcp_B01.Model_XcpByp_B01 sdisc_sint16_Xcp_B01.Model_XcpByp_B01 sdisc_sint8_Xcp_B01.Model_XcpByp_B01 udisc_uint16_Xcp_B01.Model_XcpByp_B01 udisc_uint8_Xcp_B01.Model_XcpByp_B01 /end REF_MEASUREMENT
 /begin REF_CHARACTERISTIC p_cont_sint16_1_100_Xcp_B01.Model_XcpByp_B01 p_cont_sint16_Xcp_B01.Model_XcpByp_B01 p_cont_sint8_1_10_Xcp_B01.Model_XcpByp_B01 p_cont_sint8_Xcp_B01.Model_XcpByp_B01 p_cont_uint16_1_2_Xcp_B01.Model_XcpByp_B01 p_cont_uint8_10_1_Xcp_B01.Model_XcpByp_B01 p_log_uint8_0_Xcp_B01.Model_XcpByp_B01 p_log_uint8_1_Xcp_B01.Model_XcpByp_B01 p_sdisc_sint16_Xcp_B01.Model_XcpByp_B01 p_sdisc_sint8_Xcp_B01.Model_XcpByp_B01 p_udisc_uint16_Xcp_B01.Model_XcpByp_B01 p_udisc_uint8_Xcp_B01.Model_XcpByp_B01 /end REF_CHARACTERISTIC
/end GROUP
/begin GROUP Model_XcpByp_B02 "" ROOT
 /begin REF_MEASUREMENT cont_sint16_1_100_Xcp_B02.Model_XcpByp_B02 cont_sint16_Xcp_B02.Model_XcpByp_B02 cont_sint8_1_10_Xcp_B02.Model_XcpByp_B02 cont_sint8_Xcp_B02.Model_XcpByp_B02 cont_uint16_1_2_Xcp_B02.Model_XcpByp_B02 cont_uint8_10_1_Xcp_B02.Model_XcpByp_B02 log_uint8_0_Xcp_B02.Model_XcpByp_B02 log_uint8_1_Xcp_B02.Model_XcpByp_B02 sdisc_sint16_Xcp_B02.Model_XcpByp_B02 sdisc_sint8_Xcp_B02.Model_XcpByp_B02 udisc_uint16_Xcp_B02.Model_XcpByp_B02 udisc_uint8_Xcp_B02.Model_XcpByp_B02 /end REF_MEASUREMENT
 /begin REF_CHARACTERISTIC p_cont_sint16_1_100_Xcp_B02.Model_XcpByp_B02 p_cont_sint16_Xcp_B02.Model_XcpByp_B02 p_cont_sint8_1_10_Xcp_B02.Model_XcpByp_B02 p_cont_sint8_Xcp_B02.Model_XcpByp_B02 p_cont_uint16_1_2_Xcp_B02.Model_XcpByp_B02 p_cont_uint8_10_1_Xcp_B02.Model_XcpByp_B02 p_log_uint8_0_Xcp_B02.Model_XcpByp_B02 p_log_uint8_1_Xcp_B02.Model_XcpByp_B02 p_sdisc_sint16_Xcp_B02.Model_XcpByp_B02 p_sdisc_sint8_Xcp_B02.Model_XcpByp_B02 p_udisc_uint16_Xcp_B02.Model_XcpByp_B02 p_udisc_uint8_Xcp_B02.Model_XcpByp_B02 /end REF_CHARACTERISTIC
/end GROUP
/begin GROUP Model_XcpByp_B03 "" ROOT
 /begin REF_MEASUREMENT cont_sint16_1_100_Xcp_B03.Model_XcpByp_B03 cont_sint16_Xcp_B03.Model_XcpByp_B03 cont_sint8_1_10_Xcp_B03.Model_XcpByp_B03 cont_sint8_Xcp_B03.Model_XcpByp_B03 cont_uint16_1_2_Xcp_B03.Model_XcpByp_B03 cont_uint8_10_1_Xcp_B03.Model_XcpByp_B03 log_uint8_0_Xcp_B03.Model_XcpByp_B03 log_uint8_1_Xcp_B03.Model_XcpByp_B03 sdisc_sint16_Xcp_B03.Model_XcpByp_B03 sdisc_sint8_Xcp_B03.Model_XcpByp_B03 udisc_uint16_Xcp_B03.Model_XcpByp_B03 udisc_uint8_Xcp_B03.Model_XcpByp_B03 /end REF_MEASUREMENT
 /begin REF_CHARACTERISTIC p_cont_sint16_1_100_Xcp_B03.Model_XcpByp_B03 p_cont_sint16_Xcp_B03.Model_XcpByp_B03 p_cont_sint8_1_10_Xcp_B03.Model_XcpByp_B03 p_cont_sint8_Xcp_B03.Model_XcpByp_B03 p_cont_uint16_1_2_Xcp_B03.Model_XcpByp_B03 p_cont_uint8_10_1_Xcp_B03.Model_XcpByp_B03 p_log_uint8_0_Xcp_B03.Model_XcpByp_B03 p_log_uint8_1_Xcp_B03.Model_XcpByp_B03 p_sdisc_sint16_Xcp_B03.Model_XcpByp_B03 p_sdisc_sint8_Xcp_B03.Model_XcpByp_B03 p_udisc_uint16_Xcp_B03.Model_XcpByp_B03 p_udisc_uint8_Xcp_B03.Model_XcpByp_B03 /end REF_CHARACTERISTIC
/end GROUP
/begin GROUP R01 "" ROOT
 /begin REF_MEASUREMENT sint16_01.I_sint16.R01 sint16_02.I_sint16.R01 sint16_03.I_sint16.R01 sint16_04.I_sint16.R01 sint16_05.I_sint16.R01 sint16_06.I_sint16.R01 sint16_07.I_sint16.R01 sint16_08.I_sint16.R01 sint8_01.I_sint8.R01 sint8_02.I_sint8.R01 sint8_03.I_sint8.R01 sint8_04.I_sint8.R01 sint8_05.I_sint8.R01 sint8_06.I_sint8.R01 sint8_07.I_sint8.R01 sint8_08.I_sint8.R01 uint16_01.I_uint16.R01 uint16_02.I_uint16.R01 uint16_03.I_uint16.R01 uint16_04.I_uint16.R01 uint16_05.I_uint16.R01 uint16_06.I_uint16.R01 uint16_07.I_uint16.R01 uint16_08.I_uint16.R01 uint8_01.I_uint8.R01 uint8_02.I_uint8.R01 uint8_03.I_uint8.R01 uint8_04.I_uint8.R01 uint8_05.I_uint8.R01 uint8_06.I_uint8.R01 uint8_07.I_uint8.R01 uint8_08.I_uint8.R01 /end REF_MEASUREMENT
/end GROUP
/begin GROUP R01_16bit "" ROOT
 /begin REF_MEASUREMENT sint16_01.I_sint16_1.R01_16bit sint16_01.I_sint16_2.R01_16bit sint16_01.I_sint16_3.R01_16bit sint16_01.I_sint16_4.R01_16bit sint16_02.I_sint16_1.R01_16bit sint16_02.I_sint16_2.R01_16bit sint16_02.I_sint16_3.R01_16bit sint16_02.I_sint16_4.R01_16bit sint16_03.I_sint16_1.R01_16bit sint16_03.I_sint16_2.R01_16bit sint16_03.I_sint16_3.R01_16bit sint16_03.I_sint16_4.R01_16bit sint16_04.I_sint16_1.R01_16bit sint16_04.I_sint16_2.R01_16bit sint16_04.I_sint16_3.R01_16bit sint16_04.I_sint16_4.R01_16bit sint16_05.I_sint16_1.R01_16bit sint16_05.I_sint16_2.R01_16bit sint16_05.I_sint16_3.R01_16bit sint16_05.I_sint16_4.R01_16bit sint16_06.I_sint16_1.R01_16bit sint16_06.I_sint16_2.R01_16bit sint16_06.I_sint16_3.R01_16bit sint16_06.I_sint16_4.R01_16bit sint16_07.I_sint16_1.R01_16bit sint16_07.I_sint16_2.R01_16bit sint16_07.I_sint16_3.R01_16bit sint16_07.I_sint16_4.R01_16bit sint16_08.I_sint16_1.R01_16bit sint16_08.I_sint16_2.R01_16bit sint16_08.I_sint16_3.R01_16bit sint16_08.I_sint16_4.R01_16bit uint16_01.I_uint16_1.R01_16bit uint16_01.I_uint16_2.R01_16bit uint16_01.I_uint16_3.R01_16bit uint16_01.I_uint16_4.R01_16bit uint16_02.I_uint16_1.R01_16bit uint16_02.I_uint16_2.R01_16bit uint16_02.I_uint16_3.R01_16bit uint16_02.I_uint16_4.R01_16bit uint16_03.I_uint16_1.R01_16bit uint16_03.I_uint16_2.R01_16bit uint16_03.I_uint16_3.R01_16bit uint16_03.I_uint16_4.R01_16bit uint16_04.I_uint16_1.R01_16bit uint16_04.I_uint16_2.R01_16bit uint16_04.I_uint16_3.R01_16bit uint16_04.I_uint16_4.R01_16bit uint16_05.I_uint16_1.R01_16bit uint16_05.I_uint16_2.R01_16bit uint16_05.I_uint16_3.R01_16bit uint16_05.I_uint16_4.R01_16bit uint16_06.I_uint16_1.R01_16bit uint16_06.I_uint16_2.R01_16bit uint16_06.I_uint16_3.R01_16bit uint16_06.I_uint16_4.R01_16bit uint16_07.I_uint16_1.R01_16bit uint16_07.I_uint16_2.R01_16bit uint16_07.I_uint16_3.R01_16bit uint16_07.I_uint16_4.R01_16bit uint16_08.I_uint16_1.R01_16bit uint16_08.I_uint16_2.R01_16bit uint16_08.I_uint16_3.R01_16bit uint16_08.I_uint16_4.R01_16bit /end REF_MEASUREMENT
/end GROUP
/begin GROUP R01_8bit "" ROOT
 /begin REF_MEASUREMENT sint8_01.I_sint8_1.R01_8bit sint8_01.I_sint8_2.R01_8bit sint8_01.I_sint8_3.R01_8bit sint8_01.I_sint8_4.R01_8bit sint8_01.I_sint8_5.R01_8bit sint8_01.I_sint8_6.R01_8bit sint8_01.I_sint8_7.R01_8bit sint8_01.I_sint8_8.R01_8bit sint8_02.I_sint8_1.R01_8bit sint8_02.I_sint8_2.R01_8bit sint8_02.I_sint8_3.R01_8bit sint8_02.I_sint8_4.R01_8bit sint8_02.I_sint8_5.R01_8bit sint8_02.I_sint8_6.R01_8bit sint8_02.I_sint8_7.R01_8bit sint8_02.I_sint8_8.R01_8bit sint8_03.I_sint8_1.R01_8bit sint8_03.I_sint8_2.R01_8bit sint8_03.I_sint8_3.R01_8bit sint8_03.I_sint8_4.R01_8bit sint8_03.I_sint8_5.R01_8bit sint8_03.I_sint8_6.R01_8bit sint8_03.I_sint8_7.R01_8bit sint8_03.I_sint8_8.R01_8bit sint8_04.I_sint8_1.R01_8bit sint8_04.I_sint8_2.R01_8bit sint8_04.I_sint8_3.R01_8bit sint8_04.I_sint8_4.R01_8bit sint8_04.I_sint8_5.R01_8bit sint8_04.I_sint8_6.R01_8bit sint8_04.I_sint8_7.R01_8bit sint8_04.I_sint8_8.R01_8bit sint8_05.I_sint8_1.R01_8bit sint8_05.I_sint8_2.R01_8bit sint8_05.I_sint8_3.R01_8bit sint8_05.I_sint8_4.R01_8bit sint8_05.I_sint8_5.R01_8bit sint8_05.I_sint8_6.R01_8bit sint8_05.I_sint8_7.R01_8bit sint8_05.I_sint8_8.R01_8bit sint8_06.I_sint8_1.R01_8bit sint8_06.I_sint8_2.R01_8bit sint8_06.I_sint8_3.R01_8bit sint8_06.I_sint8_4.R01_8bit sint8_06.I_sint8_5.R01_8bit sint8_06.I_sint8_6.R01_8bit sint8_06.I_sint8_7.R01_8bit sint8_06.I_sint8_8.R01_8bit sint8_07.I_sint8_1.R01_8bit sint8_07.I_sint8_2.R01_8bit sint8_07.I_sint8_3.R01_8bit sint8_07.I_sint8_4.R01_8bit sint8_07.I_sint8_5.R01_8bit sint8_07.I_sint8_6.R01_8bit sint8_07.I_sint8_7.R01_8bit sint8_07.I_sint8_8.R01_8bit sint8_08.I_sint8_1.R01_8bit sint8_08.I_sint8_2.R01_8bit sint8_08.I_sint8_3.R01_8bit sint8_08.I_sint8_4.R01_8bit sint8_08.I_sint8_5.R01_8bit sint8_08.I_sint8_6.R01_8bit sint8_08.I_sint8_7.R01_8bit sint8_08.I_sint8_8.R01_8bit uint8_01.I_uint8_1.R01_8bit uint8_01.I_uint8_2.R01_8bit uint8_01.I_uint8_3.R01_8bit uint8_01.I_uint8_4.R01_8bit uint8_01.I_uint8_5.R01_8bit uint8_01.I_uint8_6.R01_8bit uint8_01.I_uint8_7.R01_8bit uint8_01.I_uint8_8.R01_8bit uint8_02.I_uint8_1.R01_8bit uint8_02.I_uint8_2.R01_8bit uint8_02.I_uint8_3.R01_8bit uint8_02.I_uint8_4.R01_8bit uint8_02.I_uint8_5.R01_8bit uint8_02.I_uint8_6.R01_8bit uint8_02.I_uint8_7.R01_8bit uint8_02.I_uint8_8.R01_8bit uint8_03.I_uint8_1.R01_8bit uint8_03.I_uint8_2.R01_8bit uint8_03.I_uint8_3.R01_8bit uint8_03.I_uint8_4.R01_8bit uint8_03.I_uint8_5.R01_8bit uint8_03.I_uint8_6.R01_8bit uint8_03.I_uint8_7.R01_8bit uint8_03.I_uint8_8.R01_8bit uint8_04.I_uint8_1.R01_8bit uint8_04.I_uint8_2.R01_8bit uint8_04.I_uint8_3.R01_8bit uint8_04.I_uint8_4.R01_8bit uint8_04.I_uint8_5.R01_8bit uint8_04.I_uint8_6.R01_8bit uint8_04.I_uint8_7.R01_8bit uint8_04.I_uint8_8.R01_8bit uint8_05.I_uint8_1.R01_8bit uint8_05.I_uint8_2.R01_8bit uint8_05.I_uint8_3.R01_8bit uint8_05.I_uint8_4.R01_8bit uint8_05.I_uint8_5.R01_8bit uint8_05.I_uint8_6.R01_8bit uint8_05.I_uint8_7.R01_8bit uint8_05.I_uint8_8.R01_8bit uint8_06.I_uint8_1.R01_8bit uint8_06.I_uint8_2.R01_8bit uint8_06.I_uint8_3.R01_8bit uint8_06.I_uint8_4.R01_8bit uint8_06.I_uint8_5.R01_8bit uint8_06.I_uint8_6.R01_8bit uint8_06.I_uint8_7.R01_8bit uint8_06.I_uint8_8.R01_8bit uint8_07.I_uint8_1.R01_8bit uint8_07.I_uint8_2.R01_8bit uint8_07.I_uint8_3.R01_8bit uint8_07.I_uint8_4.R01_8bit uint8_07.I_uint8_5.R01_8bit uint8_07.I_uint8_6.R01_8bit uint8_07.I_uint8_7.R01_8bit uint8_07.I_uint8_8.R01_8bit uint8_08.I_uint8_1.R01_8bit uint8_08.I_uint8_2.R01_8bit uint8_08.I_uint8_3.R01_8bit uint8_08.I_uint8_4.R01_8bit uint8_08.I_uint8_5.R01_8bit uint8_08.I_uint8_6.R01_8bit uint8_08.I_uint8_7.R01_8bit uint8_08.I_uint8_8.R01_8bit /end REF_MEASUREMENT
/end GROUP
/begin GROUP R01_B "" ROOT
 /begin REF_MEASUREMENT fl32_01.I_fl32.R01_B fl32_02.I_fl32.R01_B fl32_03.I_fl32.R01_B fl32_04.I_fl32.R01_B fl32_05.I_fl32.R01_B fl32_06.I_fl32.R01_B fl32_07.I_fl32.R01_B fl32_08.I_fl32.R01_B fl64_01.I_fl64.R01_B fl64_02.I_fl64.R01_B fl64_03.I_fl64.R01_B fl64_04.I_fl64.R01_B fl64_05.I_fl64.R01_B fl64_06.I_fl64.R01_B fl64_07.I_fl64.R01_B fl64_08.I_fl64.R01_B sint32_01.I_sint32.R01_B sint32_02.I_sint32.R01_B sint32_03.I_sint32.R01_B sint32_04.I_sint32.R01_B sint32_05.I_sint32.R01_B sint32_06.I_sint32.R01_B sint32_07.I_sint32.R01_B sint32_08.I_sint32.R01_B uint32_01.I_uint32.R01_B uint32_02.I_uint32.R01_B uint32_03.I_uint32.R01_B uint32_04.I_uint32.R01_B uint32_05.I_uint32.R01_B uint32_06.I_uint32.R01_B uint32_07.I_uint32.R01_B uint32_08.I_uint32.R01_B /end REF_MEASUREMENT
/end GROUP
/begin GROUP R02 "" ROOT
 /begin REF_MEASUREMENT sint16_01.I_sint16.R02 sint16_02.I_sint16.R02 sint16_03.I_sint16.R02 sint16_04.I_sint16.R02 sint16_05.I_sint16.R02 sint16_06.I_sint16.R02 sint16_07.I_sint16.R02 sint16_08.I_sint16.R02 sint8_01.I_sint8.R02 sint8_02.I_sint8.R02 sint8_03.I_sint8.R02 sint8_04.I_sint8.R02 sint8_05.I_sint8.R02 sint8_06.I_sint8.R02 sint8_07.I_sint8.R02 sint8_08.I_sint8.R02 uint16_01.I_uint16.R02 uint16_02.I_uint16.R02 uint16_03.I_uint16.R02 uint16_04.I_uint16.R02 uint16_05.I_uint16.R02 uint16_06.I_uint16.R02 uint16_07.I_uint16.R02 uint16_08.I_uint16.R02 uint8_01.I_uint8.R02 uint8_02.I_uint8.R02 uint8_03.I_uint8.R02 uint8_04.I_uint8.R02 uint8_05.I_uint8.R02 uint8_06.I_uint8.R02 uint8_07.I_uint8.R02 uint8_08.I_uint8.R02 /end REF_MEASUREMENT
/end GROUP
/begin GROUP R02_B "" ROOT
 /begin REF_MEASUREMENT fl32_01.I_fl32.R02_B fl32_02.I_fl32.R02_B fl32_03.I_fl32.R02_B fl32_04.I_fl32.R02_B fl32_05.I_fl32.R02_B fl32_06.I_fl32.R02_B fl32_07.I_fl32.R02_B fl32_08.I_fl32.R02_B fl64_01.I_fl64.R02_B fl64_02.I_fl64.R02_B fl64_03.I_fl64.R02_B fl64_04.I_fl64.R02_B fl64_05.I_fl64.R02_B fl64_06.I_fl64.R02_B fl64_07.I_fl64.R02_B fl64_08.I_fl64.R02_B sint32_01.I_sint32.R02_B sint32_02.I_sint32.R02_B sint32_03.I_sint32.R02_B sint32_04.I_sint32.R02_B sint32_05.I_sint32.R02_B sint32_06.I_sint32.R02_B sint32_07.I_sint32.R02_B sint32_08.I_sint32.R02_B uint32_01.I_uint32.R02_B uint32_02.I_uint32.R02_B uint32_03.I_uint32.R02_B uint32_04.I_uint32.R02_B uint32_05.I_uint32.R02_B uint32_06.I_uint32.R02_B uint32_07.I_uint32.R02_B uint32_08.I_uint32.R02_B /end REF_MEASUREMENT
/end GROUP
/begin GROUP R03 "" ROOT
 /begin REF_MEASUREMENT sint16_01.I_sint16.R03 sint16_02.I_sint16.R03 sint16_03.I_sint16.R03 sint16_04.I_sint16.R03 sint16_05.I_sint16.R03 sint16_06.I_sint16.R03 sint16_07.I_sint16.R03 sint16_08.I_sint16.R03 sint8_01.I_sint8.R03 sint8_02.I_sint8.R03 sint8_03.I_sint8.R03 sint8_04.I_sint8.R03 sint8_05.I_sint8.R03 sint8_06.I_sint8.R03 sint8_07.I_sint8.R03 sint8_08.I_sint8.R03 uint16_01.I_uint16.R03 uint16_02.I_uint16.R03 uint16_03.I_uint16.R03 uint16_04.I_uint16.R03 uint16_05.I_uint16.R03 uint16_06.I_uint16.R03 uint16_07.I_uint16.R03 uint16_08.I_uint16.R03 uint8_01.I_uint8.R03 uint8_02.I_uint8.R03 uint8_03.I_uint8.R03 uint8_04.I_uint8.R03 uint8_05.I_uint8.R03 uint8_06.I_uint8.R03 uint8_07.I_uint8.R03 uint8_08.I_uint8.R03 /end REF_MEASUREMENT
/end GROUP
/begin GROUP R03_B "" ROOT
 /begin REF_MEASUREMENT fl32_01.I_fl32.R03_B fl32_02.I_fl32.R03_B fl32_03.I_fl32.R03_B fl32_04.I_fl32.R03_B fl32_05.I_fl32.R03_B fl32_06.I_fl32.R03_B fl32_07.I_fl32.R03_B fl32_08.I_fl32.R03_B fl64_01.I_fl64.R03_B fl64_02.I_fl64.R03_B fl64_03.I_fl64.R03_B fl64_04.I_fl64.R03_B fl64_05.I_fl64.R03_B fl64_06.I_fl64.R03_B fl64_07.I_fl64.R03_B fl64_08.I_fl64.R03_B sint32_01.I_sint32.R03_B sint32_02.I_sint32.R03_B sint32_03.I_sint32.R03_B sint32_04.I_sint32.R03_B sint32_05.I_sint32.R03_B sint32_06.I_sint32.R03_B sint32_07.I_sint32.R03_B sint32_08.I_sint32.R03_B uint32_01.I_uint32.R03_B uint32_02.I_uint32.R03_B uint32_03.I_uint32.R03_B uint32_04.I_uint32.R03_B uint32_05.I_uint32.R03_B uint32_06.I_uint32.R03_B uint32_07.I_uint32.R03_B uint32_08.I_uint32.R03_B /end REF_MEASUREMENT
/end GROUP
/begin GROUP R04 "" ROOT
 /begin REF_MEASUREMENT sint16_01.I_sint16.R04 sint16_02.I_sint16.R04 sint16_03.I_sint16.R04 sint16_04.I_sint16.R04 sint16_05.I_sint16.R04 sint16_06.I_sint16.R04 sint16_07.I_sint16.R04 sint16_08.I_sint16.R04 sint8_01.I_sint8.R04 sint8_02.I_sint8.R04 sint8_03.I_sint8.R04 sint8_04.I_sint8.R04 sint8_05.I_sint8.R04 sint8_06.I_sint8.R04 sint8_07.I_sint8.R04 sint8_08.I_sint8.R04 uint16_01.I_uint16.R04 uint16_02.I_uint16.R04 uint16_03.I_uint16.R04 uint16_04.I_uint16.R04 uint16_05.I_uint16.R04 uint16_06.I_uint16.R04 uint16_07.I_uint16.R04 uint16_08.I_uint16.R04 uint8_01.I_uint8.R04 uint8_02.I_uint8.R04 uint8_03.I_uint8.R04 uint8_04.I_uint8.R04 uint8_05.I_uint8.R04 uint8_06.I_uint8.R04 uint8_07.I_uint8.R04 uint8_08.I_uint8.R04 /end REF_MEASUREMENT
/end GROUP
/begin GROUP R04_B "" ROOT
 /begin REF_MEASUREMENT fl32_01.I_fl32.R04_B fl32_02.I_fl32.R04_B fl32_03.I_fl32.R04_B fl32_04.I_fl32.R04_B fl32_05.I_fl32.R04_B fl32_06.I_fl32.R04_B fl32_07.I_fl32.R04_B fl32_08.I_fl32.R04_B fl64_01.I_fl64.R04_B fl64_02.I_fl64.R04_B fl64_03.I_fl64.R04_B fl64_04.I_fl64.R04_B fl64_05.I_fl64.R04_B fl64_06.I_fl64.R04_B fl64_07.I_fl64.R04_B fl64_08.I_fl64.R04_B sint32_01.I_sint32.R04_B sint32_02.I_sint32.R04_B sint32_03.I_sint32.R04_B sint32_04.I_sint32.R04_B sint32_05.I_sint32.R04_B sint32_06.I_sint32.R04_B sint32_07.I_sint32.R04_B sint32_08.I_sint32.R04_B uint32_01.I_uint32.R04_B uint32_02.I_uint32.R04_B uint32_03.I_uint32.R04_B uint32_04.I_uint32.R04_B uint32_05.I_uint32.R04_B uint32_06.I_uint32.R04_B uint32_07.I_uint32.R04_B uint32_08.I_uint32.R04_B /end REF_MEASUREMENT
/end GROUP
/begin GROUP Reset_Schalter "" ROOT
 /begin REF_MEASUREMENT buffer.EdgeRising.Reset_Schalter oldSignal.EdgeRising.Reset_Schalter /end REF_MEASUREMENT
/end GROUP
/begin GROUP clsCounter_B01.Model_Byp_B01 ""
 /begin REF_MEASUREMENT B_cntr_B01_ok.clsCounter_B01.Model_Byp_B01 cntrold_B01.clsCounter_B01.Model_Byp_B01 errcntr_B01.clsCounter_B01.Model_Byp_B01 /end REF_MEASUREMENT
/end GROUP
/begin GROUP clsCounter_B02.Model_Byp_B02 ""
 /begin REF_MEASUREMENT B_cntr_B02_ok.clsCounter_B02.Model_Byp_B02 cntrold_B02.clsCounter_B02.Model_Byp_B02 errcntr_B02.clsCounter_B02.Model_Byp_B02 /end REF_MEASUREMENT
/end GROUP
/begin RECORD_LAYOUT STANDARD_CURVE_R32R32 FNC_VALUES 3 FLOAT32_IEEE COLUMN_DIR DIRECT AXIS_PTS_X 2 FLOAT32_IEEE INDEX_INCR DIRECT NO_AXIS_PTS_X 1 UWORD /end RECORD_LAYOUT
/begin RECORD_LAYOUT STANDARD_DIST_R32 AXIS_PTS_X 2 FLOAT32_IEEE INDEX_INCR DIRECT NO_AXIS_PTS_X 1 UWORD /end RECORD_LAYOUT
/begin RECORD_LAYOUT STANDARD_GROUP_R32 FNC_VALUES 1 FLOAT32_IEEE COLUMN_DIR DIRECT /end RECORD_LAYOUT
/begin RECORD_LAYOUT STANDARD_MAP_R32R32R32 FNC_VALUES 5 FLOAT32_IEEE COLUMN_DIR DIRECT AXIS_PTS_X 3 FLOAT32_IEEE INDEX_INCR DIRECT AXIS_PTS_Y 4 FLOAT32_IEEE INDEX_INCR DIRECT NO_AXIS_PTS_X 1 UWORD NO_AXIS_PTS_Y 2 UWORD /end RECORD_LAYOUT
/begin RECORD_LAYOUT STANDARD_MAP_R64R64R64 FNC_VALUES 5 FLOAT64_IEEE COLUMN_DIR DIRECT AXIS_PTS_X 3 FLOAT64_IEEE INDEX_INCR DIRECT AXIS_PTS_Y 4 FLOAT64_IEEE INDEX_INCR DIRECT NO_AXIS_PTS_X 1 UWORD NO_AXIS_PTS_Y 2 UWORD /end RECORD_LAYOUT
/begin RECORD_LAYOUT STANDARD_VALUE_R32 FNC_VALUES 1 FLOAT32_IEEE COLUMN_DIR DIRECT /end RECORD_LAYOUT
/begin RECORD_LAYOUT STANDARD_VALUE_R64 FNC_VALUES 1 FLOAT64_IEEE COLUMN_DIR DIRECT /end RECORD_LAYOUT
/begin RECORD_LAYOUT STANDARD_VALUE_S16 FNC_VALUES 1 SWORD COLUMN_DIR DIRECT /end RECORD_LAYOUT
/begin RECORD_LAYOUT STANDARD_VALUE_S32 FNC_VALUES 1 SLONG COLUMN_DIR DIRECT /end RECORD_LAYOUT
/begin RECORD_LAYOUT STANDARD_VALUE_S8 FNC_VALUES 1 SBYTE COLUMN_DIR DIRECT /end RECORD_LAYOUT
/begin RECORD_LAYOUT STANDARD_VALUE_U16 FNC_VALUES 1 UWORD COLUMN_DIR DIRECT /end RECORD_LAYOUT
/begin RECORD_LAYOUT STANDARD_VALUE_U32 FNC_VALUES 1 ULONG COLUMN_DIR DIRECT /end RECORD_LAYOUT
/begin RECORD_LAYOUT STANDARD_VALUE_U8 FNC_VALUES 1 UBYTE COLUMN_DIR DIRECT /end RECORD_LAYOUT
/end MODULE
/end PROJECT
