ASAP2_VERSION 1 61
/begin PROJECT HWA_UDSonCAN_ReferenceSystem "Modified for UDSonCAN Tests with new CalMeasure Mapping"
/begin HEADER "" VERSION "000" PROJECT_NO ASD /end HEADER
/begin MODULE HWA_UDSonCAN_ReferenceSystem "Modified for UDSonCAN Tests with new CalMeasure Mapping"
/begin MOD_COMMON "2013-05-06 09:52:20	create by ETASHexVirtualAddressTableHeaderV2" BYTE_ORDER MSB_FIRST ALIGNMENT_BYTE 1 ALIGNMENT_WORD 2 ALIGNMENT_LONG 4 ALIGNMENT_FLOAT32_IEEE 4 ALIGNMENT_FLOAT64_IEEE 8 /end MOD_COMMON
/begin CHARACTERISTIC One_D.STD_sint16_sint16.All_Curves_STD.Curves_Raster_2 "" CURVE 0x1D1DE8 STANDARD_CURVE_S16S16 0.0 ident -32768.0 32767.0
 /begin AXIS_DESCR STD_AXIS M_In.STD_sint16_sint16.All_Curves_STD.Curves_Raster_2 ident 10 -32768.0 32767.0 /end AXIS_DESCR
/end CHARACTERISTIC
/begin CHARACTERISTIC One_D.STD_sint16_sint16.All_Curves_STD.Curves_Raster_3 "" CURVE 0x1D21C8 STANDARD_CURVE_S16S16 0.0 ident -32768.0 32767.0
 /begin AXIS_DESCR STD_AXIS M_In.STD_sint16_sint16.All_Curves_STD.Curves_Raster_3 ident 10 -32768.0 32767.0 /end AXIS_DESCR
/end CHARACTERISTIC
/begin CHARACTERISTIC One_D.STD_sint32_sint32.All_Curves_STD.Curves_Raster_2 "" CURVE 0x1D1E20 STANDARD_CURVE_S32S32 0.0 ident -2147483648.0 2147483647.0
 /begin AXIS_DESCR STD_AXIS M_In.STD_sint32_sint32.All_Curves_STD.Curves_Raster_2 ident 10 -2147483648.0 2147483647.0 /end AXIS_DESCR
/end CHARACTERISTIC
/begin CHARACTERISTIC One_D.STD_sint32_sint32.All_Curves_STD.Curves_Raster_3 "" CURVE 0x1D2200 STANDARD_CURVE_S32S32 0.0 ident -2147483648.0 2147483647.0
 /begin AXIS_DESCR STD_AXIS M_In.STD_sint32_sint32.All_Curves_STD.Curves_Raster_3 ident 10 -2147483648.0 2147483647.0 /end AXIS_DESCR
/end CHARACTERISTIC
/begin CHARACTERISTIC One_D.STD_sint8_sint8.All_Curves_STD.Curves_Raster_2 "" CURVE 0x1D1E7A STANDARD_CURVE_S8S8 0.0 ident -128.0 127.0
 /begin AXIS_DESCR STD_AXIS M_In.STD_sint8_sint8.All_Curves_STD.Curves_Raster_2 ident 10 -128.0 127.0 /end AXIS_DESCR
/end CHARACTERISTIC
/begin CHARACTERISTIC One_D.STD_sint8_sint8.All_Curves_STD.Curves_Raster_3 "" CURVE 0x1D225A STANDARD_CURVE_S8S8 0.0 ident -128.0 127.0
 /begin AXIS_DESCR STD_AXIS M_In.STD_sint8_sint8.All_Curves_STD.Curves_Raster_3 ident 10 -128.0 127.0 /end AXIS_DESCR
/end CHARACTERISTIC
/begin CHARACTERISTIC One_D.STD_uint16_uint16.All_Curves_STD.Curves_Raster_2 "" CURVE 0x1D1E98 STANDARD_CURVE_U16U16 0.0 ident 0.0 65535.0
 /begin AXIS_DESCR STD_AXIS M_In.STD_uint16_uint16.All_Curves_STD.Curves_Raster_2 ident 10 0.0 65535.0 /end AXIS_DESCR
/end CHARACTERISTIC
/begin CHARACTERISTIC One_D.STD_uint16_uint16.All_Curves_STD.Curves_Raster_3 "" CURVE 0x1D2278 STANDARD_CURVE_U16U16 0.0 ident 0.0 65535.0
 /begin AXIS_DESCR STD_AXIS M_In.STD_uint16_uint16.All_Curves_STD.Curves_Raster_3 ident 10 0.0 65535.0 /end AXIS_DESCR
/end CHARACTERISTIC
/begin CHARACTERISTIC One_D.STD_uint32_uint32.All_Curves_STD.Curves_Raster_2 "" CURVE 0x1D1ED0 STANDARD_CURVE_U32U32 0.0 ident 0.0 4294967295.0
 /begin AXIS_DESCR STD_AXIS M_In.STD_uint32_uint32.All_Curves_STD.Curves_Raster_2 ident 10 0.0 4294967295.0 /end AXIS_DESCR
/end CHARACTERISTIC
/begin CHARACTERISTIC One_D.STD_uint32_uint32.All_Curves_STD.Curves_Raster_3 "" CURVE 0x1D22B0 STANDARD_CURVE_U32U32 0.0 ident 0.0 4294967295.0
 /begin AXIS_DESCR STD_AXIS M_In.STD_uint32_uint32.All_Curves_STD.Curves_Raster_3 ident 10 0.0 4294967295.0 /end AXIS_DESCR
/end CHARACTERISTIC
/begin CHARACTERISTIC One_D.STD_uint8_uint8.All_Curves_STD.Curves_Raster_2 "" CURVE 0x1D1F2A STANDARD_CURVE_U8U8 0.0 ident 0.0 255.0
 /begin AXIS_DESCR STD_AXIS M_In.STD_uint8_uint8.All_Curves_STD.Curves_Raster_2 ident 10 0.0 255.0 /end AXIS_DESCR
/end CHARACTERISTIC
/begin CHARACTERISTIC One_D.STD_uint8_uint8.All_Curves_STD.Curves_Raster_3 "" CURVE 0x1D230A STANDARD_CURVE_U8U8 0.0 ident 0.0 255.0
 /begin AXIS_DESCR STD_AXIS M_In.STD_uint8_uint8.All_Curves_STD.Curves_Raster_3 ident 10 0.0 255.0 /end AXIS_DESCR
/end CHARACTERISTIC
/begin CHARACTERISTIC P_Do_Active_Grp.GRP_float32_float32_float32.All_Maps_GRP.Maps_Raster_1 "" VALUE 0x1D3A04 STANDARD_VALUE_S8 0.0 ident 0 1 BIT_MASK 0x1 /end CHARACTERISTIC
/begin CHARACTERISTIC P_Do_Active_Grp.GRP_float32_float32_float32.All_Maps_GRP.Maps_Raster_2 "" VALUE 0x1D53C8 STANDARD_VALUE_S8 0.0 ident 0 1 BIT_MASK 0x1 /end CHARACTERISTIC
/begin CHARACTERISTIC P_Do_Active_Grp.GRP_sint16_sint16_sint16.All_Maps_GRP.Maps_Raster_1 "" VALUE 0x1D3BFC STANDARD_VALUE_U8 0.0 ident 0 1 BIT_MASK 0x1 /end CHARACTERISTIC
/begin CHARACTERISTIC P_Do_Active_Grp.GRP_sint16_sint16_sint16.All_Maps_GRP.Maps_Raster_2 "" VALUE 0x1D55C0 STANDARD_VALUE_U8 0.0 ident 0 1 BIT_MASK 0x1 /end CHARACTERISTIC
/begin CHARACTERISTIC P_Do_Active_Grp.GRP_sint32_sint32_sint32.All_Maps_GRP.Maps_Raster_1 "" VALUE 0x1D3D04 STANDARD_VALUE_U8 0.0 ident 0 1 BIT_MASK 0x1 /end CHARACTERISTIC
/begin CHARACTERISTIC P_Do_Active_Grp.GRP_sint32_sint32_sint32.All_Maps_GRP.Maps_Raster_2 "" VALUE 0x1D56C8 STANDARD_VALUE_U8 0.0 ident 0 1 BIT_MASK 0x1 /end CHARACTERISTIC
/begin CHARACTERISTIC P_Do_Active_Grp.GRP_sint8_sint8_sint8.All_Maps_GRP.Maps_Raster_1 "" VALUE 0x1D3EF8 STANDARD_VALUE_U8 0.0 ident 0 1 BIT_MASK 0x1 /end CHARACTERISTIC
/begin CHARACTERISTIC P_Do_Active_Grp.GRP_sint8_sint8_sint8.All_Maps_GRP.Maps_Raster_2 "" VALUE 0x1D58BC STANDARD_VALUE_U8 0.0 ident 0 1 BIT_MASK 0x1 /end CHARACTERISTIC
/begin CHARACTERISTIC P_Do_Active_Grp.GRP_uint16_uint16_uint16.All_Maps_GRP.Maps_Raster_1 "" VALUE 0x1D3F84 STANDARD_VALUE_U8 0.0 ident 0 1 BIT_MASK 0x1 /end CHARACTERISTIC
/begin CHARACTERISTIC P_Do_Active_Grp.GRP_uint16_uint16_uint16.All_Maps_GRP.Maps_Raster_2 "" VALUE 0x1D5948 STANDARD_VALUE_U8 0.0 ident 0 1 BIT_MASK 0x1 /end CHARACTERISTIC
/begin CHARACTERISTIC P_Do_Active_Grp.GRP_uint32_uint32_uint32.All_Maps_GRP.Maps_Raster_1 "" VALUE 0x1D408C STANDARD_VALUE_U8 0.0 ident 0 1 BIT_MASK 0x1 /end CHARACTERISTIC
/begin CHARACTERISTIC P_Do_Active_Grp.GRP_uint32_uint32_uint32.All_Maps_GRP.Maps_Raster_2 "" VALUE 0x1D5A50 STANDARD_VALUE_U8 0.0 ident 0 1 BIT_MASK 0x1 /end CHARACTERISTIC
/begin CHARACTERISTIC P_Do_Active_Grp.GRP_uint8_uint8_uint8.All_Maps_GRP.Maps_Raster_1 "" VALUE 0x1D4280 STANDARD_VALUE_U8 0.0 ident 0 1 BIT_MASK 0x1 /end CHARACTERISTIC
/begin CHARACTERISTIC P_Do_Active_Grp.GRP_uint8_uint8_uint8.All_Maps_GRP.Maps_Raster_2 "" VALUE 0x1D5C44 STANDARD_VALUE_U8 0.0 ident 0 1 BIT_MASK 0x1 /end CHARACTERISTIC
/begin CHARACTERISTIC P_Do_Active_Std.FIX_float32_float32_float32.All_Maps_FIX.Maps_Raster_1 "" VALUE 0x1D3238 STANDARD_VALUE_S8 0.0 ident 0 1 BIT_MASK 0x1 /end CHARACTERISTIC
/begin CHARACTERISTIC P_Do_Active_Std.FIX_float32_float32_float32.All_Maps_FIX.Maps_Raster_2 "" VALUE 0x1D4BFC STANDARD_VALUE_S8 0.0 ident 0 1 BIT_MASK 0x1 /end CHARACTERISTIC
/begin CHARACTERISTIC P_Do_Active_Std.FIX_float32_float32_float32.All_Maps_FIX.Maps_Raster_3 "" VALUE 0x1D65C0 STANDARD_VALUE_S8 0.0 ident 0 1 BIT_MASK 0x1 /end CHARACTERISTIC
/begin CHARACTERISTIC P_Do_Active_Std.FIX_sint16_sint16_sint16.All_Maps_FIX.Maps_Raster_1 "" VALUE 0x1D33E8 STANDARD_VALUE_U8 0.0 ident 0 1 BIT_MASK 0x1 /end CHARACTERISTIC
/begin CHARACTERISTIC P_Do_Active_Std.FIX_sint16_sint16_sint16.All_Maps_FIX.Maps_Raster_2 "" VALUE 0x1D4DAC STANDARD_VALUE_U8 0.0 ident 0 1 BIT_MASK 0x1 /end CHARACTERISTIC
/begin CHARACTERISTIC P_Do_Active_Std.FIX_sint16_sint16_sint16.All_Maps_FIX.Maps_Raster_3 "" VALUE 0x1D6770 STANDARD_VALUE_U8 0.0 ident 0 1 BIT_MASK 0x1 /end CHARACTERISTIC
/begin CHARACTERISTIC P_Do_Active_Std.FIX_sint32_sint32_sint32.All_Maps_FIX.Maps_Raster_1 "" VALUE 0x1D34CC STANDARD_VALUE_U8 0.0 ident 0 1 BIT_MASK 0x1 /end CHARACTERISTIC
/begin CHARACTERISTIC P_Do_Active_Std.FIX_sint32_sint32_sint32.All_Maps_FIX.Maps_Raster_2 "" VALUE 0x1D4E90 STANDARD_VALUE_U8 0.0 ident 0 1 BIT_MASK 0x1 /end CHARACTERISTIC
/begin CHARACTERISTIC P_Do_Active_Std.FIX_sint32_sint32_sint32.All_Maps_FIX.Maps_Raster_3 "" VALUE 0x1D6854 STANDARD_VALUE_U8 0.0 ident 0 1 BIT_MASK 0x1 /end CHARACTERISTIC
/begin CHARACTERISTIC P_Do_Active_Std.FIX_sint8_sint8_sint8.All_Maps_FIX.Maps_Raster_1 "" VALUE 0x1D3678 STANDARD_VALUE_U8 0.0 ident 0 1 BIT_MASK 0x1 /end CHARACTERISTIC
/begin CHARACTERISTIC P_Do_Active_Std.FIX_sint8_sint8_sint8.All_Maps_FIX.Maps_Raster_2 "" VALUE 0x1D503C STANDARD_VALUE_U8 0.0 ident 0 1 BIT_MASK 0x1 /end CHARACTERISTIC
/begin CHARACTERISTIC P_Do_Active_Std.FIX_sint8_sint8_sint8.All_Maps_FIX.Maps_Raster_3 "" VALUE 0x1D6A00 STANDARD_VALUE_U8 0.0 ident 0 1 BIT_MASK 0x1 /end CHARACTERISTIC
/begin CHARACTERISTIC P_Do_Active_Std.FIX_uint16_uint16_uint16.All_Maps_FIX.Maps_Raster_1 "" VALUE 0x1D36F0 STANDARD_VALUE_U8 0.0 ident 0 1 BIT_MASK 0x1 /end CHARACTERISTIC
/begin CHARACTERISTIC P_Do_Active_Std.FIX_uint16_uint16_uint16.All_Maps_FIX.Maps_Raster_2 "" VALUE 0x1D50B4 STANDARD_VALUE_U8 0.0 ident 0 1 BIT_MASK 0x1 /end CHARACTERISTIC
/begin CHARACTERISTIC P_Do_Active_Std.FIX_uint16_uint16_uint16.All_Maps_FIX.Maps_Raster_3 "" VALUE 0x1D6A78 STANDARD_VALUE_U8 0.0 ident 0 1 BIT_MASK 0x1 /end CHARACTERISTIC
/begin CHARACTERISTIC P_Do_Active_Std.FIX_uint32_uint32_uint32.All_Maps_FIX.Maps_Raster_1 "" VALUE 0x1D37D4 STANDARD_VALUE_U8 0.0 ident 0 1 BIT_MASK 0x1 /end CHARACTERISTIC
/begin CHARACTERISTIC P_Do_Active_Std.FIX_uint32_uint32_uint32.All_Maps_FIX.Maps_Raster_2 "" VALUE 0x1D5198 STANDARD_VALUE_U8 0.0 ident 0 1 BIT_MASK 0x1 /end CHARACTERISTIC
/begin CHARACTERISTIC P_Do_Active_Std.FIX_uint32_uint32_uint32.All_Maps_FIX.Maps_Raster_3 "" VALUE 0x1D6B5C STANDARD_VALUE_U8 0.0 ident 0 1 BIT_MASK 0x1 /end CHARACTERISTIC
/begin CHARACTERISTIC P_Do_Active_Std.FIX_uint8_uint8_uint8.All_Maps_FIX.Maps_Raster_1 "" VALUE 0x1D3980 STANDARD_VALUE_U8 0.0 ident 0 1 BIT_MASK 0x1 /end CHARACTERISTIC
/begin CHARACTERISTIC P_Do_Active_Std.FIX_uint8_uint8_uint8.All_Maps_FIX.Maps_Raster_2 "" VALUE 0x1D5344 STANDARD_VALUE_U8 0.0 ident 0 1 BIT_MASK 0x1 /end CHARACTERISTIC
/begin CHARACTERISTIC P_Do_Active_Std.FIX_uint8_uint8_uint8.All_Maps_FIX.Maps_Raster_3 "" VALUE 0x1D6D08 STANDARD_VALUE_U8 0.0 ident 0 1 BIT_MASK 0x1 /end CHARACTERISTIC
/begin CHARACTERISTIC P_Do_Active_Std.STD_sint16_sint16.All_Curves_STD.Curves_Raster_2 "" VALUE 0x1D1DE6 STANDARD_VALUE_U8 0.0 ident 0 1 BIT_MASK 0x1 /end CHARACTERISTIC
/begin CHARACTERISTIC P_Do_Active_Std.STD_sint16_sint16.All_Curves_STD.Curves_Raster_3 "" VALUE 0x1D21C6 STANDARD_VALUE_U8 0.0 ident 0 1 BIT_MASK 0x1 /end CHARACTERISTIC
/begin CHARACTERISTIC P_Do_Active_Std.STD_sint32_sint32.All_Curves_STD.Curves_Raster_2 "" VALUE 0x1D1E1C STANDARD_VALUE_U8 0.0 ident 0 1 BIT_MASK 0x1 /end CHARACTERISTIC
/begin CHARACTERISTIC P_Do_Active_Std.STD_sint32_sint32.All_Curves_STD.Curves_Raster_3 "" VALUE 0x1D21FC STANDARD_VALUE_U8 0.0 ident 0 1 BIT_MASK 0x1 /end CHARACTERISTIC
/begin CHARACTERISTIC P_Do_Active_Std.STD_sint8_sint8.All_Curves_STD.Curves_Raster_2 "" VALUE 0x1D1E78 STANDARD_VALUE_U8 0.0 ident 0 1 BIT_MASK 0x1 /end CHARACTERISTIC
/begin CHARACTERISTIC P_Do_Active_Std.STD_sint8_sint8.All_Curves_STD.Curves_Raster_3 "" VALUE 0x1D2258 STANDARD_VALUE_U8 0.0 ident 0 1 BIT_MASK 0x1 /end CHARACTERISTIC
/begin CHARACTERISTIC P_Do_Active_Std.STD_uint16_uint16.All_Curves_STD.Curves_Raster_2 "" VALUE 0x1D1E96 STANDARD_VALUE_U8 0.0 ident 0 1 BIT_MASK 0x1 /end CHARACTERISTIC
/begin CHARACTERISTIC P_Do_Active_Std.STD_uint16_uint16.All_Curves_STD.Curves_Raster_3 "" VALUE 0x1D2276 STANDARD_VALUE_U8 0.0 ident 0 1 BIT_MASK 0x1 /end CHARACTERISTIC
/begin CHARACTERISTIC P_Do_Active_Std.STD_uint32_uint32.All_Curves_STD.Curves_Raster_2 "" VALUE 0x1D1ECC STANDARD_VALUE_U8 0.0 ident 0 1 BIT_MASK 0x1 /end CHARACTERISTIC
/begin CHARACTERISTIC P_Do_Active_Std.STD_uint32_uint32.All_Curves_STD.Curves_Raster_3 "" VALUE 0x1D22AC STANDARD_VALUE_U8 0.0 ident 0 1 BIT_MASK 0x1 /end CHARACTERISTIC
/begin CHARACTERISTIC P_Do_Active_Std.STD_uint8_uint8.All_Curves_STD.Curves_Raster_2 "" VALUE 0x1D1F28 STANDARD_VALUE_U8 0.0 ident 0 1 BIT_MASK 0x1 /end CHARACTERISTIC
/begin CHARACTERISTIC P_Do_Active_Std.STD_uint8_uint8.All_Curves_STD.Curves_Raster_3 "" VALUE 0x1D2308 STANDARD_VALUE_U8 0.0 ident 0 1 BIT_MASK 0x1 /end CHARACTERISTIC
/begin CHARACTERISTIC P_Do_All_FIX_Maps.All_Maps_FIX.Maps_Raster_1 "" VALUE 0x1D3228 STANDARD_VALUE_U8 0.0 ident 0 1 BIT_MASK 0x1 /end CHARACTERISTIC
/begin CHARACTERISTIC P_Do_All_FIX_Maps.All_Maps_FIX.Maps_Raster_2 "" VALUE 0x1D4BEC STANDARD_VALUE_U8 0.0 ident 0 1 BIT_MASK 0x1 /end CHARACTERISTIC
/begin CHARACTERISTIC P_Do_All_FIX_Maps.All_Maps_FIX.Maps_Raster_3 "" VALUE 0x1D65B0 STANDARD_VALUE_U8 0.0 ident 0 1 BIT_MASK 0x1 /end CHARACTERISTIC
/begin CHARACTERISTIC P_Do_All_GRP_Maps.All_Maps_GRP.Maps_Raster_1 "" VALUE 0x1D39F0 STANDARD_VALUE_U8 0.0 ident 0 1 BIT_MASK 0x1 /end CHARACTERISTIC
/begin CHARACTERISTIC P_Do_All_GRP_Maps.All_Maps_GRP.Maps_Raster_2 "" VALUE 0x1D53B4 STANDARD_VALUE_U8 0.0 ident 0 1 BIT_MASK 0x1 /end CHARACTERISTIC
/begin CHARACTERISTIC P_Do_All_STD_Curves.All_Curves_STD.Curves_Raster_2 "" VALUE 0x1D1DDC STANDARD_VALUE_U8 0.0 ident 0 1 BIT_MASK 0x1 /end CHARACTERISTIC
/begin CHARACTERISTIC P_Do_All_STD_Curves.All_Curves_STD.Curves_Raster_3 "" VALUE 0x1D21BC STANDARD_VALUE_U8 0.0 ident 0 1 BIT_MASK 0x1 /end CHARACTERISTIC
/begin CHARACTERISTIC P_Do_GET.GRP_float32_float32_float32.All_Maps_GRP.Maps_Raster_1 "" VALUE 0x1D3A05 STANDARD_VALUE_S8 0.0 ident 0 1 BIT_MASK 0x1 /end CHARACTERISTIC
/begin CHARACTERISTIC P_Do_GET.GRP_float32_float32_float32.All_Maps_GRP.Maps_Raster_2 "" VALUE 0x1D53C9 STANDARD_VALUE_S8 0.0 ident 0 1 BIT_MASK 0x1 /end CHARACTERISTIC
/begin CHARACTERISTIC P_Do_GET.GRP_sint16_sint16_sint16.All_Maps_GRP.Maps_Raster_1 "" VALUE 0x1D3BFD STANDARD_VALUE_S8 0.0 ident 0 1 BIT_MASK 0x1 /end CHARACTERISTIC
/begin CHARACTERISTIC P_Do_GET.GRP_sint16_sint16_sint16.All_Maps_GRP.Maps_Raster_2 "" VALUE 0x1D55C1 STANDARD_VALUE_S8 0.0 ident 0 1 BIT_MASK 0x1 /end CHARACTERISTIC
/begin CHARACTERISTIC P_Do_GET.GRP_sint32_sint32_sint32.All_Maps_GRP.Maps_Raster_1 "" VALUE 0x1D3D05 STANDARD_VALUE_U8 0.0 ident 0 1 BIT_MASK 0x1 /end CHARACTERISTIC
/begin CHARACTERISTIC P_Do_GET.GRP_sint32_sint32_sint32.All_Maps_GRP.Maps_Raster_2 "" VALUE 0x1D56C9 STANDARD_VALUE_U8 0.0 ident 0 1 BIT_MASK 0x1 /end CHARACTERISTIC
/begin CHARACTERISTIC P_Do_GET.GRP_sint8_sint8_sint8.All_Maps_GRP.Maps_Raster_1 "" VALUE 0x1D3EF9 STANDARD_VALUE_S8 0.0 ident 0 1 BIT_MASK 0x1 /end CHARACTERISTIC
/begin CHARACTERISTIC P_Do_GET.GRP_sint8_sint8_sint8.All_Maps_GRP.Maps_Raster_2 "" VALUE 0x1D58BD STANDARD_VALUE_S8 0.0 ident 0 1 BIT_MASK 0x1 /end CHARACTERISTIC
/begin CHARACTERISTIC P_Do_GET.GRP_uint16_uint16_uint16.All_Maps_GRP.Maps_Raster_1 "" VALUE 0x1D3F85 STANDARD_VALUE_S8 0.0 ident 0 1 BIT_MASK 0x1 /end CHARACTERISTIC
/begin CHARACTERISTIC P_Do_GET.GRP_uint16_uint16_uint16.All_Maps_GRP.Maps_Raster_2 "" VALUE 0x1D5949 STANDARD_VALUE_S8 0.0 ident 0 1 BIT_MASK 0x1 /end CHARACTERISTIC
/begin CHARACTERISTIC P_Do_GET.GRP_uint32_uint32_uint32.All_Maps_GRP.Maps_Raster_1 "" VALUE 0x1D408D STANDARD_VALUE_S8 0.0 ident 0 1 BIT_MASK 0x1 /end CHARACTERISTIC
/begin CHARACTERISTIC P_Do_GET.GRP_uint32_uint32_uint32.All_Maps_GRP.Maps_Raster_2 "" VALUE 0x1D5A51 STANDARD_VALUE_S8 0.0 ident 0 1 BIT_MASK 0x1 /end CHARACTERISTIC
/begin CHARACTERISTIC P_Do_GET.GRP_uint8_uint8_uint8.All_Maps_GRP.Maps_Raster_1 "" VALUE 0x1D4281 STANDARD_VALUE_S8 0.0 ident 0 1 BIT_MASK 0x1 /end CHARACTERISTIC
/begin CHARACTERISTIC P_Do_GET.GRP_uint8_uint8_uint8.All_Maps_GRP.Maps_Raster_2 "" VALUE 0x1D5C45 STANDARD_VALUE_S8 0.0 ident 0 1 BIT_MASK 0x1 /end CHARACTERISTIC
/begin CHARACTERISTIC P_Do_X_SET.GRP_float32_float32_float32.All_Maps_GRP.Maps_Raster_1 "" VALUE 0x1D3A06 STANDARD_VALUE_S8 0.0 ident 0 1 BIT_MASK 0x1 /end CHARACTERISTIC
/begin CHARACTERISTIC P_Do_X_SET.GRP_float32_float32_float32.All_Maps_GRP.Maps_Raster_2 "" VALUE 0x1D53CA STANDARD_VALUE_S8 0.0 ident 0 1 BIT_MASK 0x1 /end CHARACTERISTIC
/begin CHARACTERISTIC P_Do_X_SET.GRP_sint16_sint16_sint16.All_Maps_GRP.Maps_Raster_1 "" VALUE 0x1D3BFE STANDARD_VALUE_S8 0.0 ident 0 1 BIT_MASK 0x1 /end CHARACTERISTIC
/begin CHARACTERISTIC P_Do_X_SET.GRP_sint16_sint16_sint16.All_Maps_GRP.Maps_Raster_2 "" VALUE 0x1D55C2 STANDARD_VALUE_S8 0.0 ident 0 1 BIT_MASK 0x1 /end CHARACTERISTIC
/begin CHARACTERISTIC P_Do_X_SET.GRP_sint32_sint32_sint32.All_Maps_GRP.Maps_Raster_1 "" VALUE 0x1D3D06 STANDARD_VALUE_U8 0.0 ident 0 1 BIT_MASK 0x1 /end CHARACTERISTIC
/begin CHARACTERISTIC P_Do_X_SET.GRP_sint32_sint32_sint32.All_Maps_GRP.Maps_Raster_2 "" VALUE 0x1D56CA STANDARD_VALUE_U8 0.0 ident 0 1 BIT_MASK 0x1 /end CHARACTERISTIC
/begin CHARACTERISTIC P_Do_X_SET.GRP_sint8_sint8_sint8.All_Maps_GRP.Maps_Raster_1 "" VALUE 0x1D3EFA STANDARD_VALUE_S8 0.0 ident 0 1 BIT_MASK 0x1 /end CHARACTERISTIC
/begin CHARACTERISTIC P_Do_X_SET.GRP_sint8_sint8_sint8.All_Maps_GRP.Maps_Raster_2 "" VALUE 0x1D58BE STANDARD_VALUE_S8 0.0 ident 0 1 BIT_MASK 0x1 /end CHARACTERISTIC
/begin CHARACTERISTIC P_Do_X_SET.GRP_uint16_uint16_uint16.All_Maps_GRP.Maps_Raster_1 "" VALUE 0x1D3F86 STANDARD_VALUE_S8 0.0 ident 0 1 BIT_MASK 0x1 /end CHARACTERISTIC
/begin CHARACTERISTIC P_Do_X_SET.GRP_uint16_uint16_uint16.All_Maps_GRP.Maps_Raster_2 "" VALUE 0x1D594A STANDARD_VALUE_S8 0.0 ident 0 1 BIT_MASK 0x1 /end CHARACTERISTIC
/begin CHARACTERISTIC P_Do_X_SET.GRP_uint32_uint32_uint32.All_Maps_GRP.Maps_Raster_1 "" VALUE 0x1D408E STANDARD_VALUE_S8 0.0 ident 0 1 BIT_MASK 0x1 /end CHARACTERISTIC
/begin CHARACTERISTIC P_Do_X_SET.GRP_uint32_uint32_uint32.All_Maps_GRP.Maps_Raster_2 "" VALUE 0x1D5A52 STANDARD_VALUE_S8 0.0 ident 0 1 BIT_MASK 0x1 /end CHARACTERISTIC
/begin CHARACTERISTIC P_Do_X_SET.GRP_uint8_uint8_uint8.All_Maps_GRP.Maps_Raster_1 "" VALUE 0x1D4282 STANDARD_VALUE_S8 0.0 ident 0 1 BIT_MASK 0x1 /end CHARACTERISTIC
/begin CHARACTERISTIC P_Do_X_SET.GRP_uint8_uint8_uint8.All_Maps_GRP.Maps_Raster_2 "" VALUE 0x1D5C46 STANDARD_VALUE_S8 0.0 ident 0 1 BIT_MASK 0x1 /end CHARACTERISTIC
/begin CHARACTERISTIC P_Do_Y_SET.GRP_float32_float32_float32.All_Maps_GRP.Maps_Raster_1 "" VALUE 0x1D3A07 STANDARD_VALUE_S8 0.0 ident 0 1 BIT_MASK 0x1 /end CHARACTERISTIC
/begin CHARACTERISTIC P_Do_Y_SET.GRP_float32_float32_float32.All_Maps_GRP.Maps_Raster_2 "" VALUE 0x1D53CB STANDARD_VALUE_S8 0.0 ident 0 1 BIT_MASK 0x1 /end CHARACTERISTIC
/begin CHARACTERISTIC P_Do_Y_SET.GRP_sint16_sint16_sint16.All_Maps_GRP.Maps_Raster_1 "" VALUE 0x1D3BFF STANDARD_VALUE_S8 0.0 ident 0 1 BIT_MASK 0x1 /end CHARACTERISTIC
/begin CHARACTERISTIC P_Do_Y_SET.GRP_sint16_sint16_sint16.All_Maps_GRP.Maps_Raster_2 "" VALUE 0x1D55C3 STANDARD_VALUE_S8 0.0 ident 0 1 BIT_MASK 0x1 /end CHARACTERISTIC
/begin CHARACTERISTIC P_Do_Y_SET.GRP_sint32_sint32_sint32.All_Maps_GRP.Maps_Raster_1 "" VALUE 0x1D3D07 STANDARD_VALUE_U8 0.0 ident 0 1 BIT_MASK 0x1 /end CHARACTERISTIC
/begin CHARACTERISTIC P_Do_Y_SET.GRP_sint32_sint32_sint32.All_Maps_GRP.Maps_Raster_2 "" VALUE 0x1D56CB STANDARD_VALUE_U8 0.0 ident 0 1 BIT_MASK 0x1 /end CHARACTERISTIC
/begin CHARACTERISTIC P_Do_Y_SET.GRP_sint8_sint8_sint8.All_Maps_GRP.Maps_Raster_1 "" VALUE 0x1D3EFB STANDARD_VALUE_S8 0.0 ident 0 1 BIT_MASK 0x1 /end CHARACTERISTIC
/begin CHARACTERISTIC P_Do_Y_SET.GRP_sint8_sint8_sint8.All_Maps_GRP.Maps_Raster_2 "" VALUE 0x1D58BF STANDARD_VALUE_S8 0.0 ident 0 1 BIT_MASK 0x1 /end CHARACTERISTIC
/begin CHARACTERISTIC P_Do_Y_SET.GRP_uint16_uint16_uint16.All_Maps_GRP.Maps_Raster_1 "" VALUE 0x1D3F87 STANDARD_VALUE_S8 0.0 ident 0 1 BIT_MASK 0x1 /end CHARACTERISTIC
/begin CHARACTERISTIC P_Do_Y_SET.GRP_uint16_uint16_uint16.All_Maps_GRP.Maps_Raster_2 "" VALUE 0x1D594B STANDARD_VALUE_S8 0.0 ident 0 1 BIT_MASK 0x1 /end CHARACTERISTIC
/begin CHARACTERISTIC P_Do_Y_SET.GRP_uint32_uint32_uint32.All_Maps_GRP.Maps_Raster_1 "" VALUE 0x1D408F STANDARD_VALUE_S8 0.0 ident 0 1 BIT_MASK 0x1 /end CHARACTERISTIC
/begin CHARACTERISTIC P_Do_Y_SET.GRP_uint32_uint32_uint32.All_Maps_GRP.Maps_Raster_2 "" VALUE 0x1D5A53 STANDARD_VALUE_S8 0.0 ident 0 1 BIT_MASK 0x1 /end CHARACTERISTIC
/begin CHARACTERISTIC P_Do_Y_SET.GRP_uint8_uint8_uint8.All_Maps_GRP.Maps_Raster_1 "" VALUE 0x1D4283 STANDARD_VALUE_S8 0.0 ident 0 1 BIT_MASK 0x1 /end CHARACTERISTIC
/begin CHARACTERISTIC P_Do_Y_SET.GRP_uint8_uint8_uint8.All_Maps_GRP.Maps_Raster_2 "" VALUE 0x1D5C47 STANDARD_VALUE_S8 0.0 ident 0 1 BIT_MASK 0x1 /end CHARACTERISTIC
/begin CHARACTERISTIC P_In.STD_sint16_sint16.All_Curves_STD.Curves_Raster_2 "" VALUE 0x1D1DE4 STANDARD_VALUE_S16 0.0 ident -32768.0 32767.0 /end CHARACTERISTIC
/begin CHARACTERISTIC P_In.STD_sint16_sint16.All_Curves_STD.Curves_Raster_3 "" VALUE 0x1D21C4 STANDARD_VALUE_S16 0.0 ident -32768.0 32767.0 /end CHARACTERISTIC
/begin CHARACTERISTIC P_In.STD_sint32_sint32.All_Curves_STD.Curves_Raster_2 "" VALUE 0x1D1E18 STANDARD_VALUE_S32 0.0 ident -2147483648.0 2147483647.0 /end CHARACTERISTIC
/begin CHARACTERISTIC P_In.STD_sint32_sint32.All_Curves_STD.Curves_Raster_3 "" VALUE 0x1D21F8 STANDARD_VALUE_S32 0.0 ident -2147483648.0 2147483647.0 /end CHARACTERISTIC
/begin CHARACTERISTIC P_In.STD_sint8_sint8.All_Curves_STD.Curves_Raster_2 "" VALUE 0x1D1E79 STANDARD_VALUE_S8 0.0 ident -128.0 127.0 /end CHARACTERISTIC
/begin CHARACTERISTIC P_In.STD_sint8_sint8.All_Curves_STD.Curves_Raster_3 "" VALUE 0x1D2259 STANDARD_VALUE_S8 0.0 ident -128.0 127.0 /end CHARACTERISTIC
/begin CHARACTERISTIC P_In.STD_uint16_uint16.All_Curves_STD.Curves_Raster_2 "" VALUE 0x1D1E94 STANDARD_VALUE_U16 0.0 ident 0.0 65535.0 /end CHARACTERISTIC
/begin CHARACTERISTIC P_In.STD_uint16_uint16.All_Curves_STD.Curves_Raster_3 "" VALUE 0x1D2274 STANDARD_VALUE_U16 0.0 ident 0.0 65535.0 /end CHARACTERISTIC
/begin CHARACTERISTIC P_In.STD_uint32_uint32.All_Curves_STD.Curves_Raster_2 "" VALUE 0x1D1EC8 STANDARD_VALUE_U32 0.0 ident 0.0 4294967295.0 /end CHARACTERISTIC
/begin CHARACTERISTIC P_In.STD_uint32_uint32.All_Curves_STD.Curves_Raster_3 "" VALUE 0x1D22A8 STANDARD_VALUE_U32 0.0 ident 0.0 4294967295.0 /end CHARACTERISTIC
/begin CHARACTERISTIC P_In.STD_uint8_uint8.All_Curves_STD.Curves_Raster_2 "" VALUE 0x1D1F29 STANDARD_VALUE_U8 0.0 ident 0.0 255.0 /end CHARACTERISTIC
/begin CHARACTERISTIC P_In.STD_uint8_uint8.All_Curves_STD.Curves_Raster_3 "" VALUE 0x1D2309 STANDARD_VALUE_U8 0.0 ident 0.0 255.0 /end CHARACTERISTIC
/begin CHARACTERISTIC P_In_X.FIX_float32_float32_float32.All_Maps_FIX.Maps_Raster_1 "" VALUE 0x1D3230 STANDARD_VALUE_R32 0.0 ident -1.e+037 1.e+037 /end CHARACTERISTIC
/begin CHARACTERISTIC P_In_X.FIX_float32_float32_float32.All_Maps_FIX.Maps_Raster_2 "" VALUE 0x1D4BF4 STANDARD_VALUE_R32 0.0 ident -1.e+037 1.e+037 /end CHARACTERISTIC
/begin CHARACTERISTIC P_In_X.FIX_float32_float32_float32.All_Maps_FIX.Maps_Raster_3 "" VALUE 0x1D65B8 STANDARD_VALUE_R32 0.0 ident -1.e+037 1.e+037 /end CHARACTERISTIC
/begin CHARACTERISTIC P_In_X.FIX_sint16_sint16_sint16.All_Maps_FIX.Maps_Raster_1 "" VALUE 0x1D33E4 STANDARD_VALUE_S16 0.0 ident -32768.0 32767.0 /end CHARACTERISTIC
/begin CHARACTERISTIC P_In_X.FIX_sint16_sint16_sint16.All_Maps_FIX.Maps_Raster_2 "" VALUE 0x1D4DA8 STANDARD_VALUE_S16 0.0 ident -32768.0 32767.0 /end CHARACTERISTIC
/begin CHARACTERISTIC P_In_X.FIX_sint16_sint16_sint16.All_Maps_FIX.Maps_Raster_3 "" VALUE 0x1D676C STANDARD_VALUE_S16 0.0 ident -32768.0 32767.0 /end CHARACTERISTIC
/begin CHARACTERISTIC P_In_X.FIX_sint32_sint32_sint32.All_Maps_FIX.Maps_Raster_1 "" VALUE 0x1D34C4 STANDARD_VALUE_S32 0.0 ident -2147483648.0 2147483647.0 /end CHARACTERISTIC
/begin CHARACTERISTIC P_In_X.FIX_sint32_sint32_sint32.All_Maps_FIX.Maps_Raster_2 "" VALUE 0x1D4E88 STANDARD_VALUE_S32 0.0 ident -2147483648.0 2147483647.0 /end CHARACTERISTIC
/begin CHARACTERISTIC P_In_X.FIX_sint32_sint32_sint32.All_Maps_FIX.Maps_Raster_3 "" VALUE 0x1D684C STANDARD_VALUE_S32 0.0 ident -2147483648.0 2147483647.0 /end CHARACTERISTIC
/begin CHARACTERISTIC P_In_X.FIX_sint8_sint8_sint8.All_Maps_FIX.Maps_Raster_1 "" VALUE 0x1D3679 STANDARD_VALUE_S8 0.0 ident -128.0 127.0 /end CHARACTERISTIC
/begin CHARACTERISTIC P_In_X.FIX_sint8_sint8_sint8.All_Maps_FIX.Maps_Raster_2 "" VALUE 0x1D503D STANDARD_VALUE_S8 0.0 ident -128.0 127.0 /end CHARACTERISTIC
/begin CHARACTERISTIC P_In_X.FIX_sint8_sint8_sint8.All_Maps_FIX.Maps_Raster_3 "" VALUE 0x1D6A01 STANDARD_VALUE_S8 0.0 ident -128.0 127.0 /end CHARACTERISTIC
/begin CHARACTERISTIC P_In_X.FIX_uint16_uint16_uint16.All_Maps_FIX.Maps_Raster_1 "" VALUE 0x1D36EC STANDARD_VALUE_U16 0.0 ident 0.0 65535.0 /end CHARACTERISTIC
/begin CHARACTERISTIC P_In_X.FIX_uint16_uint16_uint16.All_Maps_FIX.Maps_Raster_2 "" VALUE 0x1D50B0 STANDARD_VALUE_U16 0.0 ident 0.0 65535.0 /end CHARACTERISTIC
/begin CHARACTERISTIC P_In_X.FIX_uint16_uint16_uint16.All_Maps_FIX.Maps_Raster_3 "" VALUE 0x1D6A74 STANDARD_VALUE_U16 0.0 ident 0.0 65535.0 /end CHARACTERISTIC
/begin CHARACTERISTIC P_In_X.FIX_uint32_uint32_uint32.All_Maps_FIX.Maps_Raster_1 "" VALUE 0x1D37CC STANDARD_VALUE_U32 0.0 ident 0.0 4294967295.0 /end CHARACTERISTIC
/begin CHARACTERISTIC P_In_X.FIX_uint32_uint32_uint32.All_Maps_FIX.Maps_Raster_2 "" VALUE 0x1D5190 STANDARD_VALUE_U32 0.0 ident 0.0 4294967295.0 /end CHARACTERISTIC
/begin CHARACTERISTIC P_In_X.FIX_uint32_uint32_uint32.All_Maps_FIX.Maps_Raster_3 "" VALUE 0x1D6B54 STANDARD_VALUE_U32 0.0 ident 0.0 4294967295.0 /end CHARACTERISTIC
/begin CHARACTERISTIC P_In_X.FIX_uint8_uint8_uint8.All_Maps_FIX.Maps_Raster_1 "" VALUE 0x1D3981 STANDARD_VALUE_U8 0.0 ident 0.0 255.0 /end CHARACTERISTIC
/begin CHARACTERISTIC P_In_X.FIX_uint8_uint8_uint8.All_Maps_FIX.Maps_Raster_2 "" VALUE 0x1D5345 STANDARD_VALUE_U8 0.0 ident 0.0 255.0 /end CHARACTERISTIC
/begin CHARACTERISTIC P_In_X.FIX_uint8_uint8_uint8.All_Maps_FIX.Maps_Raster_3 "" VALUE 0x1D6D09 STANDARD_VALUE_U8 0.0 ident 0.0 255.0 /end CHARACTERISTIC
/begin CHARACTERISTIC P_In_X.GRP_float32_float32_float32.All_Maps_GRP.Maps_Raster_1 "" VALUE 0x1D39FC STANDARD_VALUE_R32 0.0 ident -1.e+037 1.e+037 /end CHARACTERISTIC
/begin CHARACTERISTIC P_In_X.GRP_float32_float32_float32.All_Maps_GRP.Maps_Raster_2 "" VALUE 0x1D53C0 STANDARD_VALUE_R32 0.0 ident -1.e+037 1.e+037 /end CHARACTERISTIC
/begin CHARACTERISTIC P_In_X.GRP_sint16_sint16_sint16.All_Maps_GRP.Maps_Raster_1 "" VALUE 0x1D3BF8 STANDARD_VALUE_S16 0.0 ident -32768.0 32767.0 /end CHARACTERISTIC
/begin CHARACTERISTIC P_In_X.GRP_sint16_sint16_sint16.All_Maps_GRP.Maps_Raster_2 "" VALUE 0x1D55BC STANDARD_VALUE_S16 0.0 ident -32768.0 32767.0 /end CHARACTERISTIC
/begin CHARACTERISTIC P_In_X.GRP_sint32_sint32_sint32.All_Maps_GRP.Maps_Raster_1 "" VALUE 0x1D3CFC STANDARD_VALUE_S32 0.0 ident -2147483648.0 2147483647.0 /end CHARACTERISTIC
/begin CHARACTERISTIC P_In_X.GRP_sint32_sint32_sint32.All_Maps_GRP.Maps_Raster_2 "" VALUE 0x1D56C0 STANDARD_VALUE_S32 0.0 ident -2147483648.0 2147483647.0 /end CHARACTERISTIC
/begin CHARACTERISTIC P_In_X.GRP_sint8_sint8_sint8.All_Maps_GRP.Maps_Raster_1 "" VALUE 0x1D3EFC STANDARD_VALUE_S8 0.0 ident -128.0 127.0 /end CHARACTERISTIC
/begin CHARACTERISTIC P_In_X.GRP_sint8_sint8_sint8.All_Maps_GRP.Maps_Raster_2 "" VALUE 0x1D58C0 STANDARD_VALUE_S8 0.0 ident -128.0 127.0 /end CHARACTERISTIC
/begin CHARACTERISTIC P_In_X.GRP_uint16_uint16_uint16.All_Maps_GRP.Maps_Raster_1 "" VALUE 0x1D3F80 STANDARD_VALUE_U16 0.0 ident 0.0 65535.0 /end CHARACTERISTIC
/begin CHARACTERISTIC P_In_X.GRP_uint16_uint16_uint16.All_Maps_GRP.Maps_Raster_2 "" VALUE 0x1D5944 STANDARD_VALUE_U16 0.0 ident 0.0 65535.0 /end CHARACTERISTIC
/begin CHARACTERISTIC P_In_X.GRP_uint32_uint32_uint32.All_Maps_GRP.Maps_Raster_1 "" VALUE 0x1D4084 STANDARD_VALUE_U32 0.0 ident 0.0 4294967295.0 /end CHARACTERISTIC
/begin CHARACTERISTIC P_In_X.GRP_uint32_uint32_uint32.All_Maps_GRP.Maps_Raster_2 "" VALUE 0x1D5A48 STANDARD_VALUE_U32 0.0 ident 0.0 4294967295.0 /end CHARACTERISTIC
/begin CHARACTERISTIC P_In_X.GRP_uint8_uint8_uint8.All_Maps_GRP.Maps_Raster_1 "" VALUE 0x1D4284 STANDARD_VALUE_U8 0.0 ident 0.0 255.0 /end CHARACTERISTIC
/begin CHARACTERISTIC P_In_X.GRP_uint8_uint8_uint8.All_Maps_GRP.Maps_Raster_2 "" VALUE 0x1D5C48 STANDARD_VALUE_U8 0.0 ident 0.0 255.0 /end CHARACTERISTIC
/begin CHARACTERISTIC P_In_Y.FIX_float32_float32_float32.All_Maps_FIX.Maps_Raster_1 "" VALUE 0x1D3234 STANDARD_VALUE_R32 0.0 ident -1.e+037 1.e+037 /end CHARACTERISTIC
/begin CHARACTERISTIC P_In_Y.FIX_float32_float32_float32.All_Maps_FIX.Maps_Raster_2 "" VALUE 0x1D4BF8 STANDARD_VALUE_R32 0.0 ident -1.e+037 1.e+037 /end CHARACTERISTIC
/begin CHARACTERISTIC P_In_Y.FIX_float32_float32_float32.All_Maps_FIX.Maps_Raster_3 "" VALUE 0x1D65BC STANDARD_VALUE_R32 0.0 ident -1.e+037 1.e+037 /end CHARACTERISTIC
/begin CHARACTERISTIC P_In_Y.FIX_sint16_sint16_sint16.All_Maps_FIX.Maps_Raster_1 "" VALUE 0x1D33E6 STANDARD_VALUE_S16 0.0 ident -32768.0 32767.0 /end CHARACTERISTIC
/begin CHARACTERISTIC P_In_Y.FIX_sint16_sint16_sint16.All_Maps_FIX.Maps_Raster_2 "" VALUE 0x1D4DAA STANDARD_VALUE_S16 0.0 ident -32768.0 32767.0 /end CHARACTERISTIC
/begin CHARACTERISTIC P_In_Y.FIX_sint16_sint16_sint16.All_Maps_FIX.Maps_Raster_3 "" VALUE 0x1D676E STANDARD_VALUE_S16 0.0 ident -32768.0 32767.0 /end CHARACTERISTIC
/begin CHARACTERISTIC P_In_Y.FIX_sint32_sint32_sint32.All_Maps_FIX.Maps_Raster_1 "" VALUE 0x1D34C8 STANDARD_VALUE_S32 0.0 ident -2147483648.0 2147483647.0 /end CHARACTERISTIC
/begin CHARACTERISTIC P_In_Y.FIX_sint32_sint32_sint32.All_Maps_FIX.Maps_Raster_2 "" VALUE 0x1D4E8C STANDARD_VALUE_S32 0.0 ident -2147483648.0 2147483647.0 /end CHARACTERISTIC
/begin CHARACTERISTIC P_In_Y.FIX_sint32_sint32_sint32.All_Maps_FIX.Maps_Raster_3 "" VALUE 0x1D6850 STANDARD_VALUE_S32 0.0 ident -2147483648.0 2147483647.0 /end CHARACTERISTIC
/begin CHARACTERISTIC P_In_Y.FIX_sint8_sint8_sint8.All_Maps_FIX.Maps_Raster_1 "" VALUE 0x1D367A STANDARD_VALUE_S8 0.0 ident -128.0 127.0 /end CHARACTERISTIC
/begin CHARACTERISTIC P_In_Y.FIX_sint8_sint8_sint8.All_Maps_FIX.Maps_Raster_2 "" VALUE 0x1D503E STANDARD_VALUE_S8 0.0 ident -128.0 127.0 /end CHARACTERISTIC
/begin CHARACTERISTIC P_In_Y.FIX_sint8_sint8_sint8.All_Maps_FIX.Maps_Raster_3 "" VALUE 0x1D6A02 STANDARD_VALUE_S8 0.0 ident -128.0 127.0 /end CHARACTERISTIC
/begin CHARACTERISTIC P_In_Y.FIX_uint16_uint16_uint16.All_Maps_FIX.Maps_Raster_1 "" VALUE 0x1D36EE STANDARD_VALUE_U16 0.0 ident 0.0 65535.0 /end CHARACTERISTIC
/begin CHARACTERISTIC P_In_Y.FIX_uint16_uint16_uint16.All_Maps_FIX.Maps_Raster_2 "" VALUE 0x1D50B2 STANDARD_VALUE_U16 0.0 ident 0.0 65535.0 /end CHARACTERISTIC
/begin CHARACTERISTIC P_In_Y.FIX_uint16_uint16_uint16.All_Maps_FIX.Maps_Raster_3 "" VALUE 0x1D6A76 STANDARD_VALUE_U16 0.0 ident 0.0 65535.0 /end CHARACTERISTIC
/begin CHARACTERISTIC P_In_Y.FIX_uint32_uint32_uint32.All_Maps_FIX.Maps_Raster_1 "" VALUE 0x1D37D0 STANDARD_VALUE_U32 0.0 ident 0.0 4294967295.0 /end CHARACTERISTIC
/begin CHARACTERISTIC P_In_Y.FIX_uint32_uint32_uint32.All_Maps_FIX.Maps_Raster_2 "" VALUE 0x1D5194 STANDARD_VALUE_U32 0.0 ident 0.0 4294967295.0 /end CHARACTERISTIC
/begin CHARACTERISTIC P_In_Y.FIX_uint32_uint32_uint32.All_Maps_FIX.Maps_Raster_3 "" VALUE 0x1D6B58 STANDARD_VALUE_U32 0.0 ident 0.0 4294967295.0 /end CHARACTERISTIC
/begin CHARACTERISTIC P_In_Y.FIX_uint8_uint8_uint8.All_Maps_FIX.Maps_Raster_1 "" VALUE 0x1D3982 STANDARD_VALUE_U8 0.0 ident 0.0 255.0 /end CHARACTERISTIC
/begin CHARACTERISTIC P_In_Y.FIX_uint8_uint8_uint8.All_Maps_FIX.Maps_Raster_2 "" VALUE 0x1D5346 STANDARD_VALUE_U8 0.0 ident 0.0 255.0 /end CHARACTERISTIC
/begin CHARACTERISTIC P_In_Y.FIX_uint8_uint8_uint8.All_Maps_FIX.Maps_Raster_3 "" VALUE 0x1D6D0A STANDARD_VALUE_U8 0.0 ident 0.0 255.0 /end CHARACTERISTIC
/begin CHARACTERISTIC P_In_Y.GRP_float32_float32_float32.All_Maps_GRP.Maps_Raster_1 "" VALUE 0x1D3A00 STANDARD_VALUE_R32 0.0 ident -1.e+037 1.e+037 /end CHARACTERISTIC
/begin CHARACTERISTIC P_In_Y.GRP_float32_float32_float32.All_Maps_GRP.Maps_Raster_2 "" VALUE 0x1D53C4 STANDARD_VALUE_R32 0.0 ident -1.e+037 1.e+037 /end CHARACTERISTIC
/begin CHARACTERISTIC P_In_Y.GRP_sint16_sint16_sint16.All_Maps_GRP.Maps_Raster_1 "" VALUE 0x1D3BFA STANDARD_VALUE_S16 0.0 ident -32768.0 32767.0 /end CHARACTERISTIC
/begin CHARACTERISTIC P_In_Y.GRP_sint16_sint16_sint16.All_Maps_GRP.Maps_Raster_2 "" VALUE 0x1D55BE STANDARD_VALUE_S16 0.0 ident -32768.0 32767.0 /end CHARACTERISTIC
/begin CHARACTERISTIC P_In_Y.GRP_sint32_sint32_sint32.All_Maps_GRP.Maps_Raster_1 "" VALUE 0x1D3D00 STANDARD_VALUE_S32 0.0 ident -2147483648.0 2147483647.0 /end CHARACTERISTIC
/begin CHARACTERISTIC P_In_Y.GRP_sint32_sint32_sint32.All_Maps_GRP.Maps_Raster_2 "" VALUE 0x1D56C4 STANDARD_VALUE_S32 0.0 ident -2147483648.0 2147483647.0 /end CHARACTERISTIC
/begin CHARACTERISTIC P_In_Y.GRP_sint8_sint8_sint8.All_Maps_GRP.Maps_Raster_1 "" VALUE 0x1D3EFD STANDARD_VALUE_S8 0.0 ident -128.0 127.0 /end CHARACTERISTIC
/begin CHARACTERISTIC P_In_Y.GRP_sint8_sint8_sint8.All_Maps_GRP.Maps_Raster_2 "" VALUE 0x1D58C1 STANDARD_VALUE_S8 0.0 ident -128.0 127.0 /end CHARACTERISTIC
/begin CHARACTERISTIC P_In_Y.GRP_uint16_uint16_uint16.All_Maps_GRP.Maps_Raster_1 "" VALUE 0x1D3F82 STANDARD_VALUE_U16 0.0 ident 0.0 65535.0 /end CHARACTERISTIC
/begin CHARACTERISTIC P_In_Y.GRP_uint16_uint16_uint16.All_Maps_GRP.Maps_Raster_2 "" VALUE 0x1D5946 STANDARD_VALUE_U16 0.0 ident 0.0 65535.0 /end CHARACTERISTIC
/begin CHARACTERISTIC P_In_Y.GRP_uint32_uint32_uint32.All_Maps_GRP.Maps_Raster_1 "" VALUE 0x1D4088 STANDARD_VALUE_U32 0.0 ident 0.0 4294967295.0 /end CHARACTERISTIC
/begin CHARACTERISTIC P_In_Y.GRP_uint32_uint32_uint32.All_Maps_GRP.Maps_Raster_2 "" VALUE 0x1D5A4C STANDARD_VALUE_U32 0.0 ident 0.0 4294967295.0 /end CHARACTERISTIC
/begin CHARACTERISTIC P_In_Y.GRP_uint8_uint8_uint8.All_Maps_GRP.Maps_Raster_1 "" VALUE 0x1D4285 STANDARD_VALUE_U8 0.0 ident 0.0 255.0 /end CHARACTERISTIC
/begin CHARACTERISTIC P_In_Y.GRP_uint8_uint8_uint8.All_Maps_GRP.Maps_Raster_2 "" VALUE 0x1D5C49 STANDARD_VALUE_U8 0.0 ident 0.0 255.0 /end CHARACTERISTIC
/begin CHARACTERISTIC Two_D.FIX_float32_float32_float32.All_Maps_FIX.Maps_Raster_1 "" MAP 0x1D3250 STANDARD_FIXED_R32 0.0 ident -1.e+037 1.e+037
 /begin AXIS_DESCR FIX_AXIS M_In_X.FIX_float32_float32_float32.All_Maps_FIX.Maps_Raster_1 ident 10 -1.e+037 1.e+037 FIX_AXIS_PAR_DIST 0 1 10 /end AXIS_DESCR
 /begin AXIS_DESCR FIX_AXIS M_In_Y.FIX_float32_float32_float32.All_Maps_FIX.Maps_Raster_1 ident 10 -1.e+037 1.e+037 FIX_AXIS_PAR_DIST 0 1 10 /end AXIS_DESCR
/end CHARACTERISTIC
/begin CHARACTERISTIC Two_D.FIX_float32_float32_float32.All_Maps_FIX.Maps_Raster_2 "" MAP 0x1D4C14 STANDARD_FIXED_R32 0.0 ident -1.e+037 1.e+037
 /begin AXIS_DESCR FIX_AXIS M_In_X.FIX_float32_float32_float32.All_Maps_FIX.Maps_Raster_2 ident 10 -1.e+037 1.e+037 FIX_AXIS_PAR_DIST 0 1 10 /end AXIS_DESCR
 /begin AXIS_DESCR FIX_AXIS M_In_Y.FIX_float32_float32_float32.All_Maps_FIX.Maps_Raster_2 ident 10 -1.e+037 1.e+037 FIX_AXIS_PAR_DIST 0 1 10 /end AXIS_DESCR
/end CHARACTERISTIC
/begin CHARACTERISTIC Two_D.FIX_float32_float32_float32.All_Maps_FIX.Maps_Raster_3 "" MAP 0x1D65D8 STANDARD_FIXED_R32 0.0 ident -1.e+037 1.e+037
 /begin AXIS_DESCR FIX_AXIS M_In_X.FIX_float32_float32_float32.All_Maps_FIX.Maps_Raster_3 ident 10 -1.e+037 1.e+037 FIX_AXIS_PAR_DIST 0 1 10 /end AXIS_DESCR
 /begin AXIS_DESCR FIX_AXIS M_In_Y.FIX_float32_float32_float32.All_Maps_FIX.Maps_Raster_3 ident 10 -1.e+037 1.e+037 FIX_AXIS_PAR_DIST 0 1 10 /end AXIS_DESCR
/end CHARACTERISTIC
/begin CHARACTERISTIC Two_D.FIX_sint16_sint16_sint16.All_Maps_FIX.Maps_Raster_1 "" MAP 0x1D33F6 STANDARD_FIXED_S16 0.0 ident -32768.0 32767.0
 /begin AXIS_DESCR FIX_AXIS M_In_X.FIX_sint16_sint16_sint16.All_Maps_FIX.Maps_Raster_1 ident 10 -32768.0 32767.0 FIX_AXIS_PAR_DIST 0 1 10 /end AXIS_DESCR
 /begin AXIS_DESCR FIX_AXIS M_In_Y.FIX_sint16_sint16_sint16.All_Maps_FIX.Maps_Raster_1 ident 10 -32768.0 32767.0 FIX_AXIS_PAR_DIST 0 1 10 /end AXIS_DESCR
/end CHARACTERISTIC
/begin CHARACTERISTIC Two_D.FIX_sint16_sint16_sint16.All_Maps_FIX.Maps_Raster_2 "" MAP 0x1D4DBA STANDARD_FIXED_S16 0.0 ident -32768.0 32767.0
 /begin AXIS_DESCR FIX_AXIS M_In_X.FIX_sint16_sint16_sint16.All_Maps_FIX.Maps_Raster_2 ident 10 -32768.0 32767.0 FIX_AXIS_PAR_DIST 0 1 10 /end AXIS_DESCR
 /begin AXIS_DESCR FIX_AXIS M_In_Y.FIX_sint16_sint16_sint16.All_Maps_FIX.Maps_Raster_2 ident 10 -32768.0 32767.0 FIX_AXIS_PAR_DIST 0 1 10 /end AXIS_DESCR
/end CHARACTERISTIC
/begin CHARACTERISTIC Two_D.FIX_sint16_sint16_sint16.All_Maps_FIX.Maps_Raster_3 "" MAP 0x1D677E STANDARD_FIXED_S16 0.0 ident -32768.0 32767.0
 /begin AXIS_DESCR FIX_AXIS M_In_X.FIX_sint16_sint16_sint16.All_Maps_FIX.Maps_Raster_3 ident 10 -32768.0 32767.0 FIX_AXIS_PAR_DIST 0 1 10 /end AXIS_DESCR
 /begin AXIS_DESCR FIX_AXIS M_In_Y.FIX_sint16_sint16_sint16.All_Maps_FIX.Maps_Raster_3 ident 10 -32768.0 32767.0 FIX_AXIS_PAR_DIST 0 1 10 /end AXIS_DESCR
/end CHARACTERISTIC
/begin CHARACTERISTIC Two_D.FIX_sint32_sint32_sint32.All_Maps_FIX.Maps_Raster_1 "" MAP 0x1D34E4 STANDARD_FIXED_S32 0.0 ident -2147483648.0 2147483647.0
 /begin AXIS_DESCR FIX_AXIS M_In_X.FIX_sint32_sint32_sint32.All_Maps_FIX.Maps_Raster_1 ident 10 -2147483648.0 2147483647.0 FIX_AXIS_PAR_DIST 0 1 10 /end AXIS_DESCR
 /begin AXIS_DESCR FIX_AXIS M_In_Y.FIX_sint32_sint32_sint32.All_Maps_FIX.Maps_Raster_1 ident 10 -2147483648.0 2147483647.0 FIX_AXIS_PAR_DIST 0 1 10 /end AXIS_DESCR
/end CHARACTERISTIC
/begin CHARACTERISTIC Two_D.FIX_sint32_sint32_sint32.All_Maps_FIX.Maps_Raster_2 "" MAP 0x1D4EA8 STANDARD_FIXED_S32 0.0 ident -2147483648.0 2147483647.0
 /begin AXIS_DESCR FIX_AXIS M_In_X.FIX_sint32_sint32_sint32.All_Maps_FIX.Maps_Raster_2 ident 10 -2147483648.0 2147483647.0 FIX_AXIS_PAR_DIST 0 1 10 /end AXIS_DESCR
 /begin AXIS_DESCR FIX_AXIS M_In_Y.FIX_sint32_sint32_sint32.All_Maps_FIX.Maps_Raster_2 ident 10 -2147483648.0 2147483647.0 FIX_AXIS_PAR_DIST 0 1 10 /end AXIS_DESCR
/end CHARACTERISTIC
/begin CHARACTERISTIC Two_D.FIX_sint32_sint32_sint32.All_Maps_FIX.Maps_Raster_3 "" MAP 0x1D686C STANDARD_FIXED_S32 0.0 ident -2147483648.0 2147483647.0
 /begin AXIS_DESCR FIX_AXIS M_In_X.FIX_sint32_sint32_sint32.All_Maps_FIX.Maps_Raster_3 ident 10 -2147483648.0 2147483647.0 FIX_AXIS_PAR_DIST 0 1 10 /end AXIS_DESCR
 /begin AXIS_DESCR FIX_AXIS M_In_Y.FIX_sint32_sint32_sint32.All_Maps_FIX.Maps_Raster_3 ident 10 -2147483648.0 2147483647.0 FIX_AXIS_PAR_DIST 0 1 10 /end AXIS_DESCR
/end CHARACTERISTIC
/begin CHARACTERISTIC Two_D.FIX_sint8_sint8_sint8.All_Maps_FIX.Maps_Raster_1 "" MAP 0x1D3681 STANDARD_FIXED_S8 0.0 ident -128.0 127.0
 /begin AXIS_DESCR FIX_AXIS M_In_X.FIX_sint8_sint8_sint8.All_Maps_FIX.Maps_Raster_1 ident 10 -128.0 127.0 FIX_AXIS_PAR_DIST 0 1 10 /end AXIS_DESCR
 /begin AXIS_DESCR FIX_AXIS M_In_Y.FIX_sint8_sint8_sint8.All_Maps_FIX.Maps_Raster_1 ident 10 -128.0 127.0 FIX_AXIS_PAR_DIST 0 1 10 /end AXIS_DESCR
/end CHARACTERISTIC
/begin CHARACTERISTIC Two_D.FIX_sint8_sint8_sint8.All_Maps_FIX.Maps_Raster_2 "" MAP 0x1D5045 STANDARD_FIXED_S8 0.0 ident -128.0 127.0
 /begin AXIS_DESCR FIX_AXIS M_In_X.FIX_sint8_sint8_sint8.All_Maps_FIX.Maps_Raster_2 ident 10 -128.0 127.0 FIX_AXIS_PAR_DIST 0 1 10 /end AXIS_DESCR
 /begin AXIS_DESCR FIX_AXIS M_In_Y.FIX_sint8_sint8_sint8.All_Maps_FIX.Maps_Raster_2 ident 10 -128.0 127.0 FIX_AXIS_PAR_DIST 0 1 10 /end AXIS_DESCR
/end CHARACTERISTIC
/begin CHARACTERISTIC Two_D.FIX_sint8_sint8_sint8.All_Maps_FIX.Maps_Raster_3 "" MAP 0x1D6A09 STANDARD_FIXED_S8 0.0 ident -128.0 127.0
 /begin AXIS_DESCR FIX_AXIS M_In_X.FIX_sint8_sint8_sint8.All_Maps_FIX.Maps_Raster_3 ident 10 -128.0 127.0 FIX_AXIS_PAR_DIST 0 1 10 /end AXIS_DESCR
 /begin AXIS_DESCR FIX_AXIS M_In_Y.FIX_sint8_sint8_sint8.All_Maps_FIX.Maps_Raster_3 ident 10 -128.0 127.0 FIX_AXIS_PAR_DIST 0 1 10 /end AXIS_DESCR
/end CHARACTERISTIC
/begin CHARACTERISTIC Two_D.FIX_uint16_uint16_uint16.All_Maps_FIX.Maps_Raster_1 "" MAP 0x1D36FE STANDARD_FIXED_U16 0.0 ident 0.0 65535.0
 /begin AXIS_DESCR FIX_AXIS M_In_X.FIX_uint16_uint16_uint16.All_Maps_FIX.Maps_Raster_1 ident 10 0.0 65535.0 FIX_AXIS_PAR_DIST 0 1 10 /end AXIS_DESCR
 /begin AXIS_DESCR FIX_AXIS M_In_Y.FIX_uint16_uint16_uint16.All_Maps_FIX.Maps_Raster_1 ident 10 0.0 65535.0 FIX_AXIS_PAR_DIST 0 1 10 /end AXIS_DESCR
/end CHARACTERISTIC
/begin CHARACTERISTIC Two_D.FIX_uint16_uint16_uint16.All_Maps_FIX.Maps_Raster_2 "" MAP 0x1D50C2 STANDARD_FIXED_U16 0.0 ident 0.0 65535.0
 /begin AXIS_DESCR FIX_AXIS M_In_X.FIX_uint16_uint16_uint16.All_Maps_FIX.Maps_Raster_2 ident 10 0.0 65535.0 FIX_AXIS_PAR_DIST 0 1 10 /end AXIS_DESCR
 /begin AXIS_DESCR FIX_AXIS M_In_Y.FIX_uint16_uint16_uint16.All_Maps_FIX.Maps_Raster_2 ident 10 0.0 65535.0 FIX_AXIS_PAR_DIST 0 1 10 /end AXIS_DESCR
/end CHARACTERISTIC
/begin CHARACTERISTIC Two_D.FIX_uint16_uint16_uint16.All_Maps_FIX.Maps_Raster_3 "" MAP 0x1D6A86 STANDARD_FIXED_U16 0.0 ident 0.0 65535.0
 /begin AXIS_DESCR FIX_AXIS M_In_X.FIX_uint16_uint16_uint16.All_Maps_FIX.Maps_Raster_3 ident 10 0.0 65535.0 FIX_AXIS_PAR_DIST 0 1 10 /end AXIS_DESCR
 /begin AXIS_DESCR FIX_AXIS M_In_Y.FIX_uint16_uint16_uint16.All_Maps_FIX.Maps_Raster_3 ident 10 0.0 65535.0 FIX_AXIS_PAR_DIST 0 1 10 /end AXIS_DESCR
/end CHARACTERISTIC
/begin CHARACTERISTIC Two_D.FIX_uint32_uint32_uint32.All_Maps_FIX.Maps_Raster_1 "" MAP 0x1D37EC STANDARD_FIXED_U32 0.0 ident 0.0 4294967295.0
 /begin AXIS_DESCR FIX_AXIS M_In_X.FIX_uint32_uint32_uint32.All_Maps_FIX.Maps_Raster_1 ident 10 0.0 4294967295.0 FIX_AXIS_PAR_DIST 0 1 10 /end AXIS_DESCR
 /begin AXIS_DESCR FIX_AXIS M_In_Y.FIX_uint32_uint32_uint32.All_Maps_FIX.Maps_Raster_1 ident 10 0.0 4294967295.0 FIX_AXIS_PAR_DIST 0 1 10 /end AXIS_DESCR
/end CHARACTERISTIC
/begin CHARACTERISTIC Two_D.FIX_uint32_uint32_uint32.All_Maps_FIX.Maps_Raster_2 "" MAP 0x1D51B0 STANDARD_FIXED_U32 0.0 ident 0.0 4294967295.0
 /begin AXIS_DESCR FIX_AXIS M_In_X.FIX_uint32_uint32_uint32.All_Maps_FIX.Maps_Raster_2 ident 10 0.0 4294967295.0 FIX_AXIS_PAR_DIST 0 1 10 /end AXIS_DESCR
 /begin AXIS_DESCR FIX_AXIS M_In_Y.FIX_uint32_uint32_uint32.All_Maps_FIX.Maps_Raster_2 ident 10 0.0 4294967295.0 FIX_AXIS_PAR_DIST 0 1 10 /end AXIS_DESCR
/end CHARACTERISTIC
/begin CHARACTERISTIC Two_D.FIX_uint32_uint32_uint32.All_Maps_FIX.Maps_Raster_3 "" MAP 0x1D6B74 STANDARD_FIXED_U32 0.0 ident 0.0 4294967295.0
 /begin AXIS_DESCR FIX_AXIS M_In_X.FIX_uint32_uint32_uint32.All_Maps_FIX.Maps_Raster_3 ident 10 0.0 4294967295.0 FIX_AXIS_PAR_DIST 0 1 10 /end AXIS_DESCR
 /begin AXIS_DESCR FIX_AXIS M_In_Y.FIX_uint32_uint32_uint32.All_Maps_FIX.Maps_Raster_3 ident 10 0.0 4294967295.0 FIX_AXIS_PAR_DIST 0 1 10 /end AXIS_DESCR
/end CHARACTERISTIC
/begin CHARACTERISTIC Two_D.FIX_uint8_uint8_uint8.All_Maps_FIX.Maps_Raster_1 "" MAP 0x1D3989 STANDARD_FIXED_U8 0.0 ident 0.0 255.0
 /begin AXIS_DESCR FIX_AXIS M_In_X.FIX_uint8_uint8_uint8.All_Maps_FIX.Maps_Raster_1 ident 10 0.0 255.0 FIX_AXIS_PAR_DIST 0 1 10 /end AXIS_DESCR
 /begin AXIS_DESCR FIX_AXIS M_In_Y.FIX_uint8_uint8_uint8.All_Maps_FIX.Maps_Raster_1 ident 10 0.0 255.0 FIX_AXIS_PAR_DIST 0 1 10 /end AXIS_DESCR
/end CHARACTERISTIC
/begin CHARACTERISTIC Two_D.FIX_uint8_uint8_uint8.All_Maps_FIX.Maps_Raster_2 "" MAP 0x1D534D STANDARD_FIXED_U8 0.0 ident 0.0 255.0
 /begin AXIS_DESCR FIX_AXIS M_In_X.FIX_uint8_uint8_uint8.All_Maps_FIX.Maps_Raster_2 ident 10 0.0 255.0 FIX_AXIS_PAR_DIST 0 1 10 /end AXIS_DESCR
 /begin AXIS_DESCR FIX_AXIS M_In_Y.FIX_uint8_uint8_uint8.All_Maps_FIX.Maps_Raster_2 ident 10 0.0 255.0 FIX_AXIS_PAR_DIST 0 1 10 /end AXIS_DESCR
/end CHARACTERISTIC
/begin CHARACTERISTIC Two_D.FIX_uint8_uint8_uint8.All_Maps_FIX.Maps_Raster_3 "" MAP 0x1D6D11 STANDARD_FIXED_U8 0.0 ident 0.0 255.0
 /begin AXIS_DESCR FIX_AXIS M_In_X.FIX_uint8_uint8_uint8.All_Maps_FIX.Maps_Raster_3 ident 10 0.0 255.0 FIX_AXIS_PAR_DIST 0 1 10 /end AXIS_DESCR
 /begin AXIS_DESCR FIX_AXIS M_In_Y.FIX_uint8_uint8_uint8.All_Maps_FIX.Maps_Raster_3 ident 10 0.0 255.0 FIX_AXIS_PAR_DIST 0 1 10 /end AXIS_DESCR
/end CHARACTERISTIC
/begin CHARACTERISTIC Two_D.GRP_float32_float32_float32.All_Maps_GRP.Maps_Raster_1 "" MAP 0x1D3A08 STANDARD_GROUP_R32 0.0 ident -1.e+037 1.e+037
 /begin AXIS_DESCR COM_AXIS M_In_X.GRP_float32_float32_float32.All_Maps_GRP.Maps_Raster_1 ident 10 -1.e+037 1.e+037 AXIS_PTS_REF distrib_X.GRP_float32_float32_float32.All_Maps_GRP.Maps_Raster_1 /end AXIS_DESCR
 /begin AXIS_DESCR COM_AXIS M_In_Y.GRP_float32_float32_float32.All_Maps_GRP.Maps_Raster_1 ident 10 -1.e+037 1.e+037 AXIS_PTS_REF distrib_Y.GRP_float32_float32_float32.All_Maps_GRP.Maps_Raster_1 /end AXIS_DESCR
/end CHARACTERISTIC
/begin CHARACTERISTIC Two_D.GRP_float32_float32_float32.All_Maps_GRP.Maps_Raster_2 "" MAP 0x1D53CC STANDARD_GROUP_R32 0.0 ident -1.e+037 1.e+037
 /begin AXIS_DESCR COM_AXIS M_In_X.GRP_float32_float32_float32.All_Maps_GRP.Maps_Raster_2 ident 10 -1.e+037 1.e+037 AXIS_PTS_REF distrib_X.GRP_float32_float32_float32.All_Maps_GRP.Maps_Raster_2 /end AXIS_DESCR
 /begin AXIS_DESCR COM_AXIS M_In_Y.GRP_float32_float32_float32.All_Maps_GRP.Maps_Raster_2 ident 10 -1.e+037 1.e+037 AXIS_PTS_REF distrib_Y.GRP_float32_float32_float32.All_Maps_GRP.Maps_Raster_2 /end AXIS_DESCR
/end CHARACTERISTIC
/begin CHARACTERISTIC Two_D.GRP_sint16_sint16_sint16.All_Maps_GRP.Maps_Raster_1 "" MAP 0x1D3C00 STANDARD_GROUP_S16 0.0 ident -32768.0 32767.0
 /begin AXIS_DESCR COM_AXIS M_In_X.GRP_sint16_sint16_sint16.All_Maps_GRP.Maps_Raster_1 ident 10 -32768.0 32767.0 AXIS_PTS_REF distrib_X.GRP_sint16_sint16_sint16.All_Maps_GRP.Maps_Raster_1 /end AXIS_DESCR
 /begin AXIS_DESCR COM_AXIS M_In_Y.GRP_sint16_sint16_sint16.All_Maps_GRP.Maps_Raster_1 ident 10 -32768.0 32767.0 AXIS_PTS_REF distrib_Y.GRP_sint16_sint16_sint16.All_Maps_GRP.Maps_Raster_1 /end AXIS_DESCR
/end CHARACTERISTIC
/begin CHARACTERISTIC Two_D.GRP_sint16_sint16_sint16.All_Maps_GRP.Maps_Raster_2 "" MAP 0x1D55C4 STANDARD_GROUP_S16 0.0 ident -32768.0 32767.0
 /begin AXIS_DESCR COM_AXIS M_In_X.GRP_sint16_sint16_sint16.All_Maps_GRP.Maps_Raster_2 ident 10 -32768.0 32767.0 AXIS_PTS_REF distrib_X.GRP_sint16_sint16_sint16.All_Maps_GRP.Maps_Raster_2 /end AXIS_DESCR
 /begin AXIS_DESCR COM_AXIS M_In_Y.GRP_sint16_sint16_sint16.All_Maps_GRP.Maps_Raster_2 ident 10 -32768.0 32767.0 AXIS_PTS_REF distrib_Y.GRP_sint16_sint16_sint16.All_Maps_GRP.Maps_Raster_2 /end AXIS_DESCR
/end CHARACTERISTIC
/begin CHARACTERISTIC Two_D.GRP_sint32_sint32_sint32.All_Maps_GRP.Maps_Raster_1 "" MAP 0x1D3D08 STANDARD_GROUP_S32 0.0 ident -2147483648.0 2147483647.0
 /begin AXIS_DESCR COM_AXIS M_In_X.GRP_sint32_sint32_sint32.All_Maps_GRP.Maps_Raster_1 ident 10 -2147483648.0 2147483647.0 AXIS_PTS_REF distrib_X.GRP_sint32_sint32_sint32.All_Maps_GRP.Maps_Raster_1 /end AXIS_DESCR
 /begin AXIS_DESCR COM_AXIS M_In_Y.GRP_sint32_sint32_sint32.All_Maps_GRP.Maps_Raster_1 ident 10 -2147483648.0 2147483647.0 AXIS_PTS_REF distrib_Y.GRP_sint32_sint32_sint32.All_Maps_GRP.Maps_Raster_1 /end AXIS_DESCR
/end CHARACTERISTIC
/begin CHARACTERISTIC Two_D.GRP_sint32_sint32_sint32.All_Maps_GRP.Maps_Raster_2 "" MAP 0x1D56CC STANDARD_GROUP_S32 0.0 ident -2147483648.0 2147483647.0
 /begin AXIS_DESCR COM_AXIS M_In_X.GRP_sint32_sint32_sint32.All_Maps_GRP.Maps_Raster_2 ident 10 -2147483648.0 2147483647.0 AXIS_PTS_REF distrib_X.GRP_sint32_sint32_sint32.All_Maps_GRP.Maps_Raster_2 /end AXIS_DESCR
 /begin AXIS_DESCR COM_AXIS M_In_Y.GRP_sint32_sint32_sint32.All_Maps_GRP.Maps_Raster_2 ident 10 -2147483648.0 2147483647.0 AXIS_PTS_REF distrib_Y.GRP_sint32_sint32_sint32.All_Maps_GRP.Maps_Raster_2 /end AXIS_DESCR
/end CHARACTERISTIC
/begin CHARACTERISTIC Two_D.GRP_sint8_sint8_sint8.All_Maps_GRP.Maps_Raster_1 "" MAP 0x1D3EFE STANDARD_GROUP_S8 0.0 ident -128.0 127.0
 /begin AXIS_DESCR COM_AXIS M_In_X.GRP_sint8_sint8_sint8.All_Maps_GRP.Maps_Raster_1 ident 10 -128.0 127.0 AXIS_PTS_REF distrib_X.GRP_sint8_sint8_sint8.All_Maps_GRP.Maps_Raster_1 /end AXIS_DESCR
 /begin AXIS_DESCR COM_AXIS M_In_Y.GRP_sint8_sint8_sint8.All_Maps_GRP.Maps_Raster_1 ident 10 -128.0 127.0 AXIS_PTS_REF distrib_Y.GRP_sint8_sint8_sint8.All_Maps_GRP.Maps_Raster_1 /end AXIS_DESCR
/end CHARACTERISTIC
/begin CHARACTERISTIC Two_D.GRP_sint8_sint8_sint8.All_Maps_GRP.Maps_Raster_2 "" MAP 0x1D58C2 STANDARD_GROUP_S8 0.0 ident -128.0 127.0
 /begin AXIS_DESCR COM_AXIS M_In_X.GRP_sint8_sint8_sint8.All_Maps_GRP.Maps_Raster_2 ident 10 -128.0 127.0 AXIS_PTS_REF distrib_X.GRP_sint8_sint8_sint8.All_Maps_GRP.Maps_Raster_2 /end AXIS_DESCR
 /begin AXIS_DESCR COM_AXIS M_In_Y.GRP_sint8_sint8_sint8.All_Maps_GRP.Maps_Raster_2 ident 10 -128.0 127.0 AXIS_PTS_REF distrib_Y.GRP_sint8_sint8_sint8.All_Maps_GRP.Maps_Raster_2 /end AXIS_DESCR
/end CHARACTERISTIC
/begin CHARACTERISTIC Two_D.GRP_uint16_uint16_uint16.All_Maps_GRP.Maps_Raster_1 "" MAP 0x1D3F88 STANDARD_GROUP_U16 0.0 ident 0.0 65535.0
 /begin AXIS_DESCR COM_AXIS M_In_X.GRP_uint16_uint16_uint16.All_Maps_GRP.Maps_Raster_1 ident 10 0.0 65535.0 AXIS_PTS_REF distrib_X.GRP_uint16_uint16_uint16.All_Maps_GRP.Maps_Raster_1 /end AXIS_DESCR
 /begin AXIS_DESCR COM_AXIS M_In_Y.GRP_uint16_uint16_uint16.All_Maps_GRP.Maps_Raster_1 ident 10 0.0 65535.0 AXIS_PTS_REF distrib_Y.GRP_uint16_uint16_uint16.All_Maps_GRP.Maps_Raster_1 /end AXIS_DESCR
/end CHARACTERISTIC
/begin CHARACTERISTIC Two_D.GRP_uint16_uint16_uint16.All_Maps_GRP.Maps_Raster_2 "" MAP 0x1D594C STANDARD_GROUP_U16 0.0 ident 0.0 65535.0
 /begin AXIS_DESCR COM_AXIS M_In_X.GRP_uint16_uint16_uint16.All_Maps_GRP.Maps_Raster_2 ident 10 0.0 65535.0 AXIS_PTS_REF distrib_X.GRP_uint16_uint16_uint16.All_Maps_GRP.Maps_Raster_2 /end AXIS_DESCR
 /begin AXIS_DESCR COM_AXIS M_In_Y.GRP_uint16_uint16_uint16.All_Maps_GRP.Maps_Raster_2 ident 10 0.0 65535.0 AXIS_PTS_REF distrib_Y.GRP_uint16_uint16_uint16.All_Maps_GRP.Maps_Raster_2 /end AXIS_DESCR
/end CHARACTERISTIC
/begin CHARACTERISTIC Two_D.GRP_uint32_uint32_uint32.All_Maps_GRP.Maps_Raster_1 "" MAP 0x1D4090 STANDARD_GROUP_U32 0.0 ident 0.0 4294967295.0
 /begin AXIS_DESCR COM_AXIS M_In_X.GRP_uint32_uint32_uint32.All_Maps_GRP.Maps_Raster_1 ident 10 0.0 4294967295.0 AXIS_PTS_REF distrib_X.GRP_uint32_uint32_uint32.All_Maps_GRP.Maps_Raster_1 /end AXIS_DESCR
 /begin AXIS_DESCR COM_AXIS M_In_Y.GRP_uint32_uint32_uint32.All_Maps_GRP.Maps_Raster_1 ident 10 0.0 4294967295.0 AXIS_PTS_REF distrib_Y.GRP_uint32_uint32_uint32.All_Maps_GRP.Maps_Raster_1 /end AXIS_DESCR
/end CHARACTERISTIC
/begin CHARACTERISTIC Two_D.GRP_uint32_uint32_uint32.All_Maps_GRP.Maps_Raster_2 "" MAP 0x1D5A54 STANDARD_GROUP_U32 0.0 ident 0.0 4294967295.0
 /begin AXIS_DESCR COM_AXIS M_In_X.GRP_uint32_uint32_uint32.All_Maps_GRP.Maps_Raster_2 ident 10 0.0 4294967295.0 AXIS_PTS_REF distrib_X.GRP_uint32_uint32_uint32.All_Maps_GRP.Maps_Raster_2 /end AXIS_DESCR
 /begin AXIS_DESCR COM_AXIS M_In_Y.GRP_uint32_uint32_uint32.All_Maps_GRP.Maps_Raster_2 ident 10 0.0 4294967295.0 AXIS_PTS_REF distrib_Y.GRP_uint32_uint32_uint32.All_Maps_GRP.Maps_Raster_2 /end AXIS_DESCR
/end CHARACTERISTIC
/begin CHARACTERISTIC Two_D.GRP_uint8_uint8_uint8.All_Maps_GRP.Maps_Raster_1 "" MAP 0x1D4286 STANDARD_GROUP_U8 0.0 ident 0.0 255.0
 /begin AXIS_DESCR COM_AXIS M_In_X.GRP_uint8_uint8_uint8.All_Maps_GRP.Maps_Raster_1 ident 10 0.0 255.0 AXIS_PTS_REF distrib_X.GRP_uint8_uint8_uint8.All_Maps_GRP.Maps_Raster_1 /end AXIS_DESCR
 /begin AXIS_DESCR COM_AXIS M_In_Y.GRP_uint8_uint8_uint8.All_Maps_GRP.Maps_Raster_1 ident 10 0.0 255.0 AXIS_PTS_REF distrib_Y.GRP_uint8_uint8_uint8.All_Maps_GRP.Maps_Raster_1 /end AXIS_DESCR
/end CHARACTERISTIC
/begin CHARACTERISTIC Two_D.GRP_uint8_uint8_uint8.All_Maps_GRP.Maps_Raster_2 "" MAP 0x1D5C4A STANDARD_GROUP_U8 0.0 ident 0.0 255.0
 /begin AXIS_DESCR COM_AXIS M_In_X.GRP_uint8_uint8_uint8.All_Maps_GRP.Maps_Raster_2 ident 10 0.0 255.0 AXIS_PTS_REF distrib_X.GRP_uint8_uint8_uint8.All_Maps_GRP.Maps_Raster_2 /end AXIS_DESCR
 /begin AXIS_DESCR COM_AXIS M_In_Y.GRP_uint8_uint8_uint8.All_Maps_GRP.Maps_Raster_2 ident 10 0.0 255.0 AXIS_PTS_REF distrib_Y.GRP_uint8_uint8_uint8.All_Maps_GRP.Maps_Raster_2 /end AXIS_DESCR
/end CHARACTERISTIC
/begin AXIS_PTS distrib_X.GRP_float32_float32_float32.All_Maps_GRP.Maps_Raster_1 "" 0x1D3B98 M_In_X.GRP_float32_float32_float32.All_Maps_GRP.Maps_Raster_1 STANDARD_DIST_R32 0.0 ident 10 -1.e+037 1.e+037 /end AXIS_PTS
/begin AXIS_PTS distrib_X.GRP_float32_float32_float32.All_Maps_GRP.Maps_Raster_2 "" 0x1D555C M_In_X.GRP_float32_float32_float32.All_Maps_GRP.Maps_Raster_2 STANDARD_DIST_R32 0.0 ident 10 -1.e+037 1.e+037 /end AXIS_PTS
/begin AXIS_PTS distrib_X.GRP_sint16_sint16_sint16.All_Maps_GRP.Maps_Raster_1 "" 0x1D3CC8 M_In_X.GRP_sint16_sint16_sint16.All_Maps_GRP.Maps_Raster_1 STANDARD_DIST_S16 0.0 ident 10 -32768.0 32767.0 /end AXIS_PTS
/begin AXIS_PTS distrib_X.GRP_sint16_sint16_sint16.All_Maps_GRP.Maps_Raster_2 "" 0x1D568C M_In_X.GRP_sint16_sint16_sint16.All_Maps_GRP.Maps_Raster_2 STANDARD_DIST_S16 0.0 ident 10 -32768.0 32767.0 /end AXIS_PTS
/begin AXIS_PTS distrib_X.GRP_sint32_sint32_sint32.All_Maps_GRP.Maps_Raster_1 "" 0x1D3E98 M_In_X.GRP_sint32_sint32_sint32.All_Maps_GRP.Maps_Raster_1 STANDARD_DIST_S32 0.0 ident 10 -2147483648.0 2147483647.0 /end AXIS_PTS
/begin AXIS_PTS distrib_X.GRP_sint32_sint32_sint32.All_Maps_GRP.Maps_Raster_2 "" 0x1D585C M_In_X.GRP_sint32_sint32_sint32.All_Maps_GRP.Maps_Raster_2 STANDARD_DIST_S32 0.0 ident 10 -2147483648.0 2147483647.0 /end AXIS_PTS
/begin AXIS_PTS distrib_X.GRP_sint8_sint8_sint8.All_Maps_GRP.Maps_Raster_1 "" 0x1D3F62 M_In_X.GRP_sint8_sint8_sint8.All_Maps_GRP.Maps_Raster_1 STANDARD_DIST_S8 0.0 ident 10 -128.0 127.0 /end AXIS_PTS
/begin AXIS_PTS distrib_X.GRP_sint8_sint8_sint8.All_Maps_GRP.Maps_Raster_2 "" 0x1D5926 M_In_X.GRP_sint8_sint8_sint8.All_Maps_GRP.Maps_Raster_2 STANDARD_DIST_S8 0.0 ident 10 -128.0 127.0 /end AXIS_PTS
/begin AXIS_PTS distrib_X.GRP_uint16_uint16_uint16.All_Maps_GRP.Maps_Raster_1 "" 0x1D4050 M_In_X.GRP_uint16_uint16_uint16.All_Maps_GRP.Maps_Raster_1 STANDARD_DIST_U16 0.0 ident 10 0.0 65535.0 /end AXIS_PTS
/begin AXIS_PTS distrib_X.GRP_uint16_uint16_uint16.All_Maps_GRP.Maps_Raster_2 "" 0x1D5A14 M_In_X.GRP_uint16_uint16_uint16.All_Maps_GRP.Maps_Raster_2 STANDARD_DIST_U16 0.0 ident 10 0.0 65535.0 /end AXIS_PTS
/begin AXIS_PTS distrib_X.GRP_uint32_uint32_uint32.All_Maps_GRP.Maps_Raster_1 "" 0x1D4220 M_In_X.GRP_uint32_uint32_uint32.All_Maps_GRP.Maps_Raster_1 STANDARD_DIST_U32 0.0 ident 10 0.0 4294967295.0 /end AXIS_PTS
/begin AXIS_PTS distrib_X.GRP_uint32_uint32_uint32.All_Maps_GRP.Maps_Raster_2 "" 0x1D5BE4 M_In_X.GRP_uint32_uint32_uint32.All_Maps_GRP.Maps_Raster_2 STANDARD_DIST_U32 0.0 ident 10 0.0 4294967295.0 /end AXIS_PTS
/begin AXIS_PTS distrib_X.GRP_uint8_uint8_uint8.All_Maps_GRP.Maps_Raster_1 "" 0x1D42EA M_In_X.GRP_uint8_uint8_uint8.All_Maps_GRP.Maps_Raster_1 STANDARD_DIST_U8 0.0 ident 10 0.0 255.0 /end AXIS_PTS
/begin AXIS_PTS distrib_X.GRP_uint8_uint8_uint8.All_Maps_GRP.Maps_Raster_2 "" 0x1D5CAE M_In_X.GRP_uint8_uint8_uint8.All_Maps_GRP.Maps_Raster_2 STANDARD_DIST_U8 0.0 ident 10 0.0 255.0 /end AXIS_PTS
/begin AXIS_PTS distrib_Y.GRP_float32_float32_float32.All_Maps_GRP.Maps_Raster_1 "" 0x1D3BC4 M_In_Y.GRP_float32_float32_float32.All_Maps_GRP.Maps_Raster_1 STANDARD_DIST_R32 0.0 ident 10 -1.e+037 1.e+037 /end AXIS_PTS
/begin AXIS_PTS distrib_Y.GRP_float32_float32_float32.All_Maps_GRP.Maps_Raster_2 "" 0x1D5588 M_In_Y.GRP_float32_float32_float32.All_Maps_GRP.Maps_Raster_2 STANDARD_DIST_R32 0.0 ident 10 -1.e+037 1.e+037 /end AXIS_PTS
/begin AXIS_PTS distrib_Y.GRP_sint16_sint16_sint16.All_Maps_GRP.Maps_Raster_1 "" 0x1D3CDE M_In_Y.GRP_sint16_sint16_sint16.All_Maps_GRP.Maps_Raster_1 STANDARD_DIST_S16 0.0 ident 10 -32768.0 32767.0 /end AXIS_PTS
/begin AXIS_PTS distrib_Y.GRP_sint16_sint16_sint16.All_Maps_GRP.Maps_Raster_2 "" 0x1D56A2 M_In_Y.GRP_sint16_sint16_sint16.All_Maps_GRP.Maps_Raster_2 STANDARD_DIST_S16 0.0 ident 10 -32768.0 32767.0 /end AXIS_PTS
/begin AXIS_PTS distrib_Y.GRP_sint32_sint32_sint32.All_Maps_GRP.Maps_Raster_1 "" 0x1D3EC4 M_In_Y.GRP_sint32_sint32_sint32.All_Maps_GRP.Maps_Raster_1 STANDARD_DIST_S32 0.0 ident 10 -2147483648.0 2147483647.0 /end AXIS_PTS
/begin AXIS_PTS distrib_Y.GRP_sint32_sint32_sint32.All_Maps_GRP.Maps_Raster_2 "" 0x1D5888 M_In_Y.GRP_sint32_sint32_sint32.All_Maps_GRP.Maps_Raster_2 STANDARD_DIST_S32 0.0 ident 10 -2147483648.0 2147483647.0 /end AXIS_PTS
/begin AXIS_PTS distrib_Y.GRP_sint8_sint8_sint8.All_Maps_GRP.Maps_Raster_1 "" 0x1D3F6D M_In_Y.GRP_sint8_sint8_sint8.All_Maps_GRP.Maps_Raster_1 STANDARD_DIST_S8 0.0 ident 10 -128.0 127.0 /end AXIS_PTS
/begin AXIS_PTS distrib_Y.GRP_sint8_sint8_sint8.All_Maps_GRP.Maps_Raster_2 "" 0x1D5931 M_In_Y.GRP_sint8_sint8_sint8.All_Maps_GRP.Maps_Raster_2 STANDARD_DIST_S8 0.0 ident 10 -128.0 127.0 /end AXIS_PTS
/begin AXIS_PTS distrib_Y.GRP_uint16_uint16_uint16.All_Maps_GRP.Maps_Raster_1 "" 0x1D4066 M_In_Y.GRP_uint16_uint16_uint16.All_Maps_GRP.Maps_Raster_1 STANDARD_DIST_U16 0.0 ident 10 0.0 65535.0 /end AXIS_PTS
/begin AXIS_PTS distrib_Y.GRP_uint16_uint16_uint16.All_Maps_GRP.Maps_Raster_2 "" 0x1D5A2A M_In_Y.GRP_uint16_uint16_uint16.All_Maps_GRP.Maps_Raster_2 STANDARD_DIST_U16 0.0 ident 10 0.0 65535.0 /end AXIS_PTS
/begin AXIS_PTS distrib_Y.GRP_uint32_uint32_uint32.All_Maps_GRP.Maps_Raster_1 "" 0x1D424C M_In_Y.GRP_uint32_uint32_uint32.All_Maps_GRP.Maps_Raster_1 STANDARD_DIST_U32 0.0 ident 10 0.0 4294967295.0 /end AXIS_PTS
/begin AXIS_PTS distrib_Y.GRP_uint32_uint32_uint32.All_Maps_GRP.Maps_Raster_2 "" 0x1D5C10 M_In_Y.GRP_uint32_uint32_uint32.All_Maps_GRP.Maps_Raster_2 STANDARD_DIST_U32 0.0 ident 10 0.0 4294967295.0 /end AXIS_PTS
/begin AXIS_PTS distrib_Y.GRP_uint8_uint8_uint8.All_Maps_GRP.Maps_Raster_1 "" 0x1D42F5 M_In_Y.GRP_uint8_uint8_uint8.All_Maps_GRP.Maps_Raster_1 STANDARD_DIST_U8 0.0 ident 10 0.0 255.0 /end AXIS_PTS
/begin AXIS_PTS distrib_Y.GRP_uint8_uint8_uint8.All_Maps_GRP.Maps_Raster_2 "" 0x1D5CB9 M_In_Y.GRP_uint8_uint8_uint8.All_Maps_GRP.Maps_Raster_2 STANDARD_DIST_U8 0.0 ident 10 0.0 255.0 /end AXIS_PTS
/begin MEASUREMENT Calculated.FIX_float32_float32_float32.All_Maps_FIX.Maps_Raster_1 "" SBYTE ident 1 100 0 1 BIT_MASK 0x1 ECU_ADDRESS 0x7F89D8 /end MEASUREMENT
/begin MEASUREMENT Calculated.FIX_float32_float32_float32.All_Maps_FIX.Maps_Raster_2 "" SBYTE ident 1 100 0 1 BIT_MASK 0x1 ECU_ADDRESS 0x7F8AB0 /end MEASUREMENT
/begin MEASUREMENT Calculated.FIX_float32_float32_float32.All_Maps_FIX.Maps_Raster_3 "" SBYTE ident 1 100 0 1 BIT_MASK 0x1 ECU_ADDRESS 0x7F8B88 /end MEASUREMENT
/begin MEASUREMENT Calculated.FIX_sint16_sint16_sint16.All_Maps_FIX.Maps_Raster_1 "" UBYTE ident 1 100 0 1 BIT_MASK 0x1 ECU_ADDRESS 0x7F89E2 /end MEASUREMENT
/begin MEASUREMENT Calculated.FIX_sint16_sint16_sint16.All_Maps_FIX.Maps_Raster_2 "" UBYTE ident 1 100 0 1 BIT_MASK 0x1 ECU_ADDRESS 0x7F8ABA /end MEASUREMENT
/begin MEASUREMENT Calculated.FIX_sint16_sint16_sint16.All_Maps_FIX.Maps_Raster_3 "" UBYTE ident 1 100 0 1 BIT_MASK 0x1 ECU_ADDRESS 0x7F8B92 /end MEASUREMENT
/begin MEASUREMENT Calculated.FIX_sint32_sint32_sint32.All_Maps_FIX.Maps_Raster_1 "" UBYTE ident 1 100 0 1 BIT_MASK 0x1 ECU_ADDRESS 0x7F89F0 /end MEASUREMENT
/begin MEASUREMENT Calculated.FIX_sint32_sint32_sint32.All_Maps_FIX.Maps_Raster_2 "" UBYTE ident 1 100 0 1 BIT_MASK 0x1 ECU_ADDRESS 0x7F8AC8 /end MEASUREMENT
/begin MEASUREMENT Calculated.FIX_sint32_sint32_sint32.All_Maps_FIX.Maps_Raster_3 "" UBYTE ident 1 100 0 1 BIT_MASK 0x1 ECU_ADDRESS 0x7F8BA0 /end MEASUREMENT
/begin MEASUREMENT Calculated.FIX_sint8_sint8_sint8.All_Maps_FIX.Maps_Raster_1 "" UBYTE ident 1 100 0 1 BIT_MASK 0x1 ECU_ADDRESS 0x7F89F4 /end MEASUREMENT
/begin MEASUREMENT Calculated.FIX_sint8_sint8_sint8.All_Maps_FIX.Maps_Raster_2 "" UBYTE ident 1 100 0 1 BIT_MASK 0x1 ECU_ADDRESS 0x7F8ACC /end MEASUREMENT
/begin MEASUREMENT Calculated.FIX_sint8_sint8_sint8.All_Maps_FIX.Maps_Raster_3 "" UBYTE ident 1 100 0 1 BIT_MASK 0x1 ECU_ADDRESS 0x7F8BA4 /end MEASUREMENT
/begin MEASUREMENT Calculated.FIX_uint16_uint16_uint16.All_Maps_FIX.Maps_Raster_1 "" UBYTE ident 1 100 0 1 BIT_MASK 0x1 ECU_ADDRESS 0x7F89FE /end MEASUREMENT
/begin MEASUREMENT Calculated.FIX_uint16_uint16_uint16.All_Maps_FIX.Maps_Raster_2 "" UBYTE ident 1 100 0 1 BIT_MASK 0x1 ECU_ADDRESS 0x7F8AD6 /end MEASUREMENT
/begin MEASUREMENT Calculated.FIX_uint16_uint16_uint16.All_Maps_FIX.Maps_Raster_3 "" UBYTE ident 1 100 0 1 BIT_MASK 0x1 ECU_ADDRESS 0x7F8BAE /end MEASUREMENT
/begin MEASUREMENT Calculated.FIX_uint32_uint32_uint32.All_Maps_FIX.Maps_Raster_1 "" UBYTE ident 1 100 0 1 BIT_MASK 0x1 ECU_ADDRESS 0x7F8A0C /end MEASUREMENT
/begin MEASUREMENT Calculated.FIX_uint32_uint32_uint32.All_Maps_FIX.Maps_Raster_2 "" UBYTE ident 1 100 0 1 BIT_MASK 0x1 ECU_ADDRESS 0x7F8AE4 /end MEASUREMENT
/begin MEASUREMENT Calculated.FIX_uint32_uint32_uint32.All_Maps_FIX.Maps_Raster_3 "" UBYTE ident 1 100 0 1 BIT_MASK 0x1 ECU_ADDRESS 0x7F8BBC /end MEASUREMENT
/begin MEASUREMENT Calculated.FIX_uint8_uint8_uint8.All_Maps_FIX.Maps_Raster_1 "" UBYTE ident 1 100 0 1 BIT_MASK 0x1 ECU_ADDRESS 0x7F8A10 /end MEASUREMENT
/begin MEASUREMENT Calculated.FIX_uint8_uint8_uint8.All_Maps_FIX.Maps_Raster_2 "" UBYTE ident 1 100 0 1 BIT_MASK 0x1 ECU_ADDRESS 0x7F8AE8 /end MEASUREMENT
/begin MEASUREMENT Calculated.FIX_uint8_uint8_uint8.All_Maps_FIX.Maps_Raster_3 "" UBYTE ident 1 100 0 1 BIT_MASK 0x1 ECU_ADDRESS 0x7F8BC0 /end MEASUREMENT
/begin MEASUREMENT Calculated.GRP_float32_float32_float32.All_Maps_GRP.Maps_Raster_1 "" SBYTE ident 1 100 0 1 BIT_MASK 0x1 ECU_ADDRESS 0x7F8A20 /end MEASUREMENT
/begin MEASUREMENT Calculated.GRP_float32_float32_float32.All_Maps_GRP.Maps_Raster_2 "" SBYTE ident 1 100 0 1 BIT_MASK 0x1 ECU_ADDRESS 0x7F8AF8 /end MEASUREMENT
/begin MEASUREMENT Calculated.GRP_sint16_sint16_sint16.All_Maps_GRP.Maps_Raster_1 "" UBYTE ident 1 100 0 1 BIT_MASK 0x1 ECU_ADDRESS 0x7F8A2A /end MEASUREMENT
/begin MEASUREMENT Calculated.GRP_sint16_sint16_sint16.All_Maps_GRP.Maps_Raster_2 "" UBYTE ident 1 100 0 1 BIT_MASK 0x1 ECU_ADDRESS 0x7F8B02 /end MEASUREMENT
/begin MEASUREMENT Calculated.GRP_sint32_sint32_sint32.All_Maps_GRP.Maps_Raster_1 "" UBYTE ident 1 100 0 1 BIT_MASK 0x1 ECU_ADDRESS 0x7F8A38 /end MEASUREMENT
/begin MEASUREMENT Calculated.GRP_sint32_sint32_sint32.All_Maps_GRP.Maps_Raster_2 "" UBYTE ident 1 100 0 1 BIT_MASK 0x1 ECU_ADDRESS 0x7F8B10 /end MEASUREMENT
/begin MEASUREMENT Calculated.GRP_sint8_sint8_sint8.All_Maps_GRP.Maps_Raster_1 "" UBYTE ident 1 100 0 1 BIT_MASK 0x1 ECU_ADDRESS 0x7F8A3C /end MEASUREMENT
/begin MEASUREMENT Calculated.GRP_sint8_sint8_sint8.All_Maps_GRP.Maps_Raster_2 "" UBYTE ident 1 100 0 1 BIT_MASK 0x1 ECU_ADDRESS 0x7F8B14 /end MEASUREMENT
/begin MEASUREMENT Calculated.GRP_uint16_uint16_uint16.All_Maps_GRP.Maps_Raster_1 "" UBYTE ident 1 100 0 1 BIT_MASK 0x1 ECU_ADDRESS 0x7F8A46 /end MEASUREMENT
/begin MEASUREMENT Calculated.GRP_uint16_uint16_uint16.All_Maps_GRP.Maps_Raster_2 "" UBYTE ident 1 100 0 1 BIT_MASK 0x1 ECU_ADDRESS 0x7F8B1E /end MEASUREMENT
/begin MEASUREMENT Calculated.GRP_uint32_uint32_uint32.All_Maps_GRP.Maps_Raster_1 "" UBYTE ident 1 100 0 1 BIT_MASK 0x1 ECU_ADDRESS 0x7F8A54 /end MEASUREMENT
/begin MEASUREMENT Calculated.GRP_uint32_uint32_uint32.All_Maps_GRP.Maps_Raster_2 "" UBYTE ident 1 100 0 1 BIT_MASK 0x1 ECU_ADDRESS 0x7F8B2C /end MEASUREMENT
/begin MEASUREMENT Calculated.GRP_uint8_uint8_uint8.All_Maps_GRP.Maps_Raster_1 "" UBYTE ident 1 100 0 1 BIT_MASK 0x1 ECU_ADDRESS 0x7F8A58 /end MEASUREMENT
/begin MEASUREMENT Calculated.GRP_uint8_uint8_uint8.All_Maps_GRP.Maps_Raster_2 "" UBYTE ident 1 100 0 1 BIT_MASK 0x1 ECU_ADDRESS 0x7F8B30 /end MEASUREMENT
/begin MEASUREMENT Calculated.STD_sint16_sint16.All_Curves_STD.Curves_Raster_2 "" UBYTE ident 1 100 0 1 BIT_MASK 0x1 ECU_ADDRESS 0x7F8714 /end MEASUREMENT
/begin MEASUREMENT Calculated.STD_sint16_sint16.All_Curves_STD.Curves_Raster_3 "" UBYTE ident 1 100 0 1 BIT_MASK 0x1 ECU_ADDRESS 0x7F87A4 /end MEASUREMENT
/begin MEASUREMENT Calculated.STD_sint32_sint32.All_Curves_STD.Curves_Raster_2 "" UBYTE ident 1 100 0 1 BIT_MASK 0x1 ECU_ADDRESS 0x7F8720 /end MEASUREMENT
/begin MEASUREMENT Calculated.STD_sint32_sint32.All_Curves_STD.Curves_Raster_3 "" UBYTE ident 1 100 0 1 BIT_MASK 0x1 ECU_ADDRESS 0x7F87B0 /end MEASUREMENT
/begin MEASUREMENT Calculated.STD_sint8_sint8.All_Curves_STD.Curves_Raster_2 "" UBYTE ident 1 100 0 1 BIT_MASK 0x1 ECU_ADDRESS 0x7F8724 /end MEASUREMENT
/begin MEASUREMENT Calculated.STD_sint8_sint8.All_Curves_STD.Curves_Raster_3 "" UBYTE ident 1 100 0 1 BIT_MASK 0x1 ECU_ADDRESS 0x7F87B4 /end MEASUREMENT
/begin MEASUREMENT Calculated.STD_uint16_uint16.All_Curves_STD.Curves_Raster_2 "" UBYTE ident 1 100 0 1 BIT_MASK 0x1 ECU_ADDRESS 0x7F872C /end MEASUREMENT
/begin MEASUREMENT Calculated.STD_uint16_uint16.All_Curves_STD.Curves_Raster_3 "" UBYTE ident 1 100 0 1 BIT_MASK 0x1 ECU_ADDRESS 0x7F87BC /end MEASUREMENT
/begin MEASUREMENT Calculated.STD_uint32_uint32.All_Curves_STD.Curves_Raster_2 "" UBYTE ident 1 100 0 1 BIT_MASK 0x1 ECU_ADDRESS 0x7F8738 /end MEASUREMENT
/begin MEASUREMENT Calculated.STD_uint32_uint32.All_Curves_STD.Curves_Raster_3 "" UBYTE ident 1 100 0 1 BIT_MASK 0x1 ECU_ADDRESS 0x7F87C8 /end MEASUREMENT
/begin MEASUREMENT Calculated.STD_uint8_uint8.All_Curves_STD.Curves_Raster_2 "" UBYTE ident 1 100 0 1 BIT_MASK 0x1 ECU_ADDRESS 0x7F873C /end MEASUREMENT
/begin MEASUREMENT Calculated.STD_uint8_uint8.All_Curves_STD.Curves_Raster_3 "" UBYTE ident 1 100 0 1 BIT_MASK 0x1 ECU_ADDRESS 0x7F87CC /end MEASUREMENT
/begin MEASUREMENT M_In.STD_sint16_sint16.All_Curves_STD.Curves_Raster_2 "" SWORD ident 1 100 -32768.0 32767.0 ECU_ADDRESS 0x7F8710 /end MEASUREMENT
/begin MEASUREMENT M_In.STD_sint16_sint16.All_Curves_STD.Curves_Raster_3 "" SWORD ident 1 100 -32768.0 32767.0 ECU_ADDRESS 0x7F87A0 /end MEASUREMENT
/begin MEASUREMENT M_In.STD_sint32_sint32.All_Curves_STD.Curves_Raster_2 "" SLONG ident 1 100 -2147483648.0 2147483647.0 ECU_ADDRESS 0x7F8718 /end MEASUREMENT
/begin MEASUREMENT M_In.STD_sint32_sint32.All_Curves_STD.Curves_Raster_3 "" SLONG ident 1 100 -2147483648.0 2147483647.0 ECU_ADDRESS 0x7F87A8 /end MEASUREMENT
/begin MEASUREMENT M_In.STD_sint8_sint8.All_Curves_STD.Curves_Raster_2 "" SBYTE ident 1 100 -128.0 127.0 ECU_ADDRESS 0x7F8725 /end MEASUREMENT
/begin MEASUREMENT M_In.STD_sint8_sint8.All_Curves_STD.Curves_Raster_3 "" SBYTE ident 1 100 -128.0 127.0 ECU_ADDRESS 0x7F87B5 /end MEASUREMENT
/begin MEASUREMENT M_In.STD_uint16_uint16.All_Curves_STD.Curves_Raster_2 "" UWORD ident 1 100 0.0 65535.0 ECU_ADDRESS 0x7F8728 /end MEASUREMENT
/begin MEASUREMENT M_In.STD_uint16_uint16.All_Curves_STD.Curves_Raster_3 "" UWORD ident 1 100 0.0 65535.0 ECU_ADDRESS 0x7F87B8 /end MEASUREMENT
/begin MEASUREMENT M_In.STD_uint32_uint32.All_Curves_STD.Curves_Raster_2 "" ULONG ident 1 100 0.0 4294967295.0 ECU_ADDRESS 0x7F8730 /end MEASUREMENT
/begin MEASUREMENT M_In.STD_uint32_uint32.All_Curves_STD.Curves_Raster_3 "" ULONG ident 1 100 0.0 4294967295.0 ECU_ADDRESS 0x7F87C0 /end MEASUREMENT
/begin MEASUREMENT M_In.STD_uint8_uint8.All_Curves_STD.Curves_Raster_2 "" UBYTE ident 1 100 0.0 255.0 ECU_ADDRESS 0x7F873D /end MEASUREMENT
/begin MEASUREMENT M_In.STD_uint8_uint8.All_Curves_STD.Curves_Raster_3 "" UBYTE ident 1 100 0.0 255.0 ECU_ADDRESS 0x7F87CD /end MEASUREMENT
/begin MEASUREMENT M_In_X.FIX_float32_float32_float32.All_Maps_FIX.Maps_Raster_1 "" FLOAT32_IEEE ident 1 100 -1.e+037 1.e+037 ECU_ADDRESS 0x7F89CC /end MEASUREMENT
/begin MEASUREMENT M_In_X.FIX_float32_float32_float32.All_Maps_FIX.Maps_Raster_2 "" FLOAT32_IEEE ident 1 100 -1.e+037 1.e+037 ECU_ADDRESS 0x7F8AA4 /end MEASUREMENT
/begin MEASUREMENT M_In_X.FIX_float32_float32_float32.All_Maps_FIX.Maps_Raster_3 "" FLOAT32_IEEE ident 1 100 -1.e+037 1.e+037 ECU_ADDRESS 0x7F8B7C /end MEASUREMENT
/begin MEASUREMENT M_In_X.FIX_sint16_sint16_sint16.All_Maps_FIX.Maps_Raster_1 "" SWORD ident 1 100 -32768.0 32767.0 ECU_ADDRESS 0x7F89DC /end MEASUREMENT
/begin MEASUREMENT M_In_X.FIX_sint16_sint16_sint16.All_Maps_FIX.Maps_Raster_2 "" SWORD ident 1 100 -32768.0 32767.0 ECU_ADDRESS 0x7F8AB4 /end MEASUREMENT
/begin MEASUREMENT M_In_X.FIX_sint16_sint16_sint16.All_Maps_FIX.Maps_Raster_3 "" SWORD ident 1 100 -32768.0 32767.0 ECU_ADDRESS 0x7F8B8C /end MEASUREMENT
/begin MEASUREMENT M_In_X.FIX_sint32_sint32_sint32.All_Maps_FIX.Maps_Raster_1 "" SLONG ident 1 100 -2147483648.0 2147483647.0 ECU_ADDRESS 0x7F89E4 /end MEASUREMENT
/begin MEASUREMENT M_In_X.FIX_sint32_sint32_sint32.All_Maps_FIX.Maps_Raster_2 "" SLONG ident 1 100 -2147483648.0 2147483647.0 ECU_ADDRESS 0x7F8ABC /end MEASUREMENT
/begin MEASUREMENT M_In_X.FIX_sint32_sint32_sint32.All_Maps_FIX.Maps_Raster_3 "" SLONG ident 1 100 -2147483648.0 2147483647.0 ECU_ADDRESS 0x7F8B94 /end MEASUREMENT
/begin MEASUREMENT M_In_X.FIX_sint8_sint8_sint8.All_Maps_FIX.Maps_Raster_1 "" SBYTE ident 1 100 -128.0 127.0 ECU_ADDRESS 0x7F89F5 /end MEASUREMENT
/begin MEASUREMENT M_In_X.FIX_sint8_sint8_sint8.All_Maps_FIX.Maps_Raster_2 "" SBYTE ident 1 100 -128.0 127.0 ECU_ADDRESS 0x7F8ACD /end MEASUREMENT
/begin MEASUREMENT M_In_X.FIX_sint8_sint8_sint8.All_Maps_FIX.Maps_Raster_3 "" SBYTE ident 1 100 -128.0 127.0 ECU_ADDRESS 0x7F8BA5 /end MEASUREMENT
/begin MEASUREMENT M_In_X.FIX_uint16_uint16_uint16.All_Maps_FIX.Maps_Raster_1 "" UWORD ident 1 100 0.0 65535.0 ECU_ADDRESS 0x7F89F8 /end MEASUREMENT
/begin MEASUREMENT M_In_X.FIX_uint16_uint16_uint16.All_Maps_FIX.Maps_Raster_2 "" UWORD ident 1 100 0.0 65535.0 ECU_ADDRESS 0x7F8AD0 /end MEASUREMENT
/begin MEASUREMENT M_In_X.FIX_uint16_uint16_uint16.All_Maps_FIX.Maps_Raster_3 "" UWORD ident 1 100 0.0 65535.0 ECU_ADDRESS 0x7F8BA8 /end MEASUREMENT
/begin MEASUREMENT M_In_X.FIX_uint32_uint32_uint32.All_Maps_FIX.Maps_Raster_1 "" ULONG ident 1 100 0.0 4294967295.0 ECU_ADDRESS 0x7F8A00 /end MEASUREMENT
/begin MEASUREMENT M_In_X.FIX_uint32_uint32_uint32.All_Maps_FIX.Maps_Raster_2 "" ULONG ident 1 100 0.0 4294967295.0 ECU_ADDRESS 0x7F8AD8 /end MEASUREMENT
/begin MEASUREMENT M_In_X.FIX_uint32_uint32_uint32.All_Maps_FIX.Maps_Raster_3 "" ULONG ident 1 100 0.0 4294967295.0 ECU_ADDRESS 0x7F8BB0 /end MEASUREMENT
/begin MEASUREMENT M_In_X.FIX_uint8_uint8_uint8.All_Maps_FIX.Maps_Raster_1 "" UBYTE ident 1 100 0.0 255.0 ECU_ADDRESS 0x7F8A11 /end MEASUREMENT
/begin MEASUREMENT M_In_X.FIX_uint8_uint8_uint8.All_Maps_FIX.Maps_Raster_2 "" UBYTE ident 1 100 0.0 255.0 ECU_ADDRESS 0x7F8AE9 /end MEASUREMENT
/begin MEASUREMENT M_In_X.FIX_uint8_uint8_uint8.All_Maps_FIX.Maps_Raster_3 "" UBYTE ident 1 100 0.0 255.0 ECU_ADDRESS 0x7F8BC1 /end MEASUREMENT
/begin MEASUREMENT M_In_X.GRP_float32_float32_float32.All_Maps_GRP.Maps_Raster_1 "" FLOAT32_IEEE ident 1 100 -1.e+037 1.e+037 ECU_ADDRESS 0x7F8A14 /end MEASUREMENT
/begin MEASUREMENT M_In_X.GRP_float32_float32_float32.All_Maps_GRP.Maps_Raster_2 "" FLOAT32_IEEE ident 1 100 -1.e+037 1.e+037 ECU_ADDRESS 0x7F8AEC /end MEASUREMENT
/begin MEASUREMENT M_In_X.GRP_sint16_sint16_sint16.All_Maps_GRP.Maps_Raster_1 "" SWORD ident 1 100 -32768.0 32767.0 ECU_ADDRESS 0x7F8A24 /end MEASUREMENT
/begin MEASUREMENT M_In_X.GRP_sint16_sint16_sint16.All_Maps_GRP.Maps_Raster_2 "" SWORD ident 1 100 -32768.0 32767.0 ECU_ADDRESS 0x7F8AFC /end MEASUREMENT
/begin MEASUREMENT M_In_X.GRP_sint32_sint32_sint32.All_Maps_GRP.Maps_Raster_1 "" SLONG ident 1 100 -2147483648.0 2147483647.0 ECU_ADDRESS 0x7F8A2C /end MEASUREMENT
/begin MEASUREMENT M_In_X.GRP_sint32_sint32_sint32.All_Maps_GRP.Maps_Raster_2 "" SLONG ident 1 100 -2147483648.0 2147483647.0 ECU_ADDRESS 0x7F8B04 /end MEASUREMENT
/begin MEASUREMENT M_In_X.GRP_sint8_sint8_sint8.All_Maps_GRP.Maps_Raster_1 "" SBYTE ident 1 100 -128.0 127.0 ECU_ADDRESS 0x7F8A3D /end MEASUREMENT
/begin MEASUREMENT M_In_X.GRP_sint8_sint8_sint8.All_Maps_GRP.Maps_Raster_2 "" SBYTE ident 1 100 -128.0 127.0 ECU_ADDRESS 0x7F8B15 /end MEASUREMENT
/begin MEASUREMENT M_In_X.GRP_uint16_uint16_uint16.All_Maps_GRP.Maps_Raster_1 "" UWORD ident 1 100 0.0 65535.0 ECU_ADDRESS 0x7F8A40 /end MEASUREMENT
/begin MEASUREMENT M_In_X.GRP_uint16_uint16_uint16.All_Maps_GRP.Maps_Raster_2 "" UWORD ident 1 100 0.0 65535.0 ECU_ADDRESS 0x7F8B18 /end MEASUREMENT
/begin MEASUREMENT M_In_X.GRP_uint32_uint32_uint32.All_Maps_GRP.Maps_Raster_1 "" ULONG ident 1 100 0.0 4294967295.0 ECU_ADDRESS 0x7F8A48 /end MEASUREMENT
/begin MEASUREMENT M_In_X.GRP_uint32_uint32_uint32.All_Maps_GRP.Maps_Raster_2 "" ULONG ident 1 100 0.0 4294967295.0 ECU_ADDRESS 0x7F8B20 /end MEASUREMENT
/begin MEASUREMENT M_In_X.GRP_uint8_uint8_uint8.All_Maps_GRP.Maps_Raster_1 "" UBYTE ident 1 100 0.0 255.0 ECU_ADDRESS 0x7F8A59 /end MEASUREMENT
/begin MEASUREMENT M_In_X.GRP_uint8_uint8_uint8.All_Maps_GRP.Maps_Raster_2 "" UBYTE ident 1 100 0.0 255.0 ECU_ADDRESS 0x7F8B31 /end MEASUREMENT
/begin MEASUREMENT M_In_Y.FIX_float32_float32_float32.All_Maps_FIX.Maps_Raster_1 "" FLOAT32_IEEE ident 1 100 -1.e+037 1.e+037 ECU_ADDRESS 0x7F89D0 /end MEASUREMENT
/begin MEASUREMENT M_In_Y.FIX_float32_float32_float32.All_Maps_FIX.Maps_Raster_2 "" FLOAT32_IEEE ident 1 100 -1.e+037 1.e+037 ECU_ADDRESS 0x7F8AA8 /end MEASUREMENT
/begin MEASUREMENT M_In_Y.FIX_float32_float32_float32.All_Maps_FIX.Maps_Raster_3 "" FLOAT32_IEEE ident 1 100 -1.e+037 1.e+037 ECU_ADDRESS 0x7F8B80 /end MEASUREMENT
/begin MEASUREMENT M_In_Y.FIX_sint16_sint16_sint16.All_Maps_FIX.Maps_Raster_1 "" SWORD ident 1 100 -32768.0 32767.0 ECU_ADDRESS 0x7F89DE /end MEASUREMENT
/begin MEASUREMENT M_In_Y.FIX_sint16_sint16_sint16.All_Maps_FIX.Maps_Raster_2 "" SWORD ident 1 100 -32768.0 32767.0 ECU_ADDRESS 0x7F8AB6 /end MEASUREMENT
/begin MEASUREMENT M_In_Y.FIX_sint16_sint16_sint16.All_Maps_FIX.Maps_Raster_3 "" SWORD ident 1 100 -32768.0 32767.0 ECU_ADDRESS 0x7F8B8E /end MEASUREMENT
/begin MEASUREMENT M_In_Y.FIX_sint32_sint32_sint32.All_Maps_FIX.Maps_Raster_1 "" SLONG ident 1 100 -2147483648.0 2147483647.0 ECU_ADDRESS 0x7F89E8 /end MEASUREMENT
/begin MEASUREMENT M_In_Y.FIX_sint32_sint32_sint32.All_Maps_FIX.Maps_Raster_2 "" SLONG ident 1 100 -2147483648.0 2147483647.0 ECU_ADDRESS 0x7F8AC0 /end MEASUREMENT
/begin MEASUREMENT M_In_Y.FIX_sint32_sint32_sint32.All_Maps_FIX.Maps_Raster_3 "" SLONG ident 1 100 -2147483648.0 2147483647.0 ECU_ADDRESS 0x7F8B98 /end MEASUREMENT
/begin MEASUREMENT M_In_Y.FIX_sint8_sint8_sint8.All_Maps_FIX.Maps_Raster_1 "" SBYTE ident 1 100 -128.0 127.0 ECU_ADDRESS 0x7F89F6 /end MEASUREMENT
/begin MEASUREMENT M_In_Y.FIX_sint8_sint8_sint8.All_Maps_FIX.Maps_Raster_2 "" SBYTE ident 1 100 -128.0 127.0 ECU_ADDRESS 0x7F8ACE /end MEASUREMENT
/begin MEASUREMENT M_In_Y.FIX_sint8_sint8_sint8.All_Maps_FIX.Maps_Raster_3 "" SBYTE ident 1 100 -128.0 127.0 ECU_ADDRESS 0x7F8BA6 /end MEASUREMENT
/begin MEASUREMENT M_In_Y.FIX_uint16_uint16_uint16.All_Maps_FIX.Maps_Raster_1 "" UWORD ident 1 100 0.0 65535.0 ECU_ADDRESS 0x7F89FA /end MEASUREMENT
/begin MEASUREMENT M_In_Y.FIX_uint16_uint16_uint16.All_Maps_FIX.Maps_Raster_2 "" UWORD ident 1 100 0.0 65535.0 ECU_ADDRESS 0x7F8AD2 /end MEASUREMENT
/begin MEASUREMENT M_In_Y.FIX_uint16_uint16_uint16.All_Maps_FIX.Maps_Raster_3 "" UWORD ident 1 100 0.0 65535.0 ECU_ADDRESS 0x7F8BAA /end MEASUREMENT
/begin MEASUREMENT M_In_Y.FIX_uint32_uint32_uint32.All_Maps_FIX.Maps_Raster_1 "" ULONG ident 1 100 0.0 4294967295.0 ECU_ADDRESS 0x7F8A04 /end MEASUREMENT
/begin MEASUREMENT M_In_Y.FIX_uint32_uint32_uint32.All_Maps_FIX.Maps_Raster_2 "" ULONG ident 1 100 0.0 4294967295.0 ECU_ADDRESS 0x7F8ADC /end MEASUREMENT
/begin MEASUREMENT M_In_Y.FIX_uint32_uint32_uint32.All_Maps_FIX.Maps_Raster_3 "" ULONG ident 1 100 0.0 4294967295.0 ECU_ADDRESS 0x7F8BB4 /end MEASUREMENT
/begin MEASUREMENT M_In_Y.FIX_uint8_uint8_uint8.All_Maps_FIX.Maps_Raster_1 "" UBYTE ident 1 100 0.0 255.0 ECU_ADDRESS 0x7F8A12 /end MEASUREMENT
/begin MEASUREMENT M_In_Y.FIX_uint8_uint8_uint8.All_Maps_FIX.Maps_Raster_2 "" UBYTE ident 1 100 0.0 255.0 ECU_ADDRESS 0x7F8AEA /end MEASUREMENT
/begin MEASUREMENT M_In_Y.FIX_uint8_uint8_uint8.All_Maps_FIX.Maps_Raster_3 "" UBYTE ident 1 100 0.0 255.0 ECU_ADDRESS 0x7F8BC2 /end MEASUREMENT
/begin MEASUREMENT M_In_Y.GRP_float32_float32_float32.All_Maps_GRP.Maps_Raster_1 "" FLOAT32_IEEE ident 1 100 -1.e+037 1.e+037 ECU_ADDRESS 0x7F8A18 /end MEASUREMENT
/begin MEASUREMENT M_In_Y.GRP_float32_float32_float32.All_Maps_GRP.Maps_Raster_2 "" FLOAT32_IEEE ident 1 100 -1.e+037 1.e+037 ECU_ADDRESS 0x7F8AF0 /end MEASUREMENT
/begin MEASUREMENT M_In_Y.GRP_sint16_sint16_sint16.All_Maps_GRP.Maps_Raster_1 "" SWORD ident 1 100 -32768.0 32767.0 ECU_ADDRESS 0x7F8A26 /end MEASUREMENT
/begin MEASUREMENT M_In_Y.GRP_sint16_sint16_sint16.All_Maps_GRP.Maps_Raster_2 "" SWORD ident 1 100 -32768.0 32767.0 ECU_ADDRESS 0x7F8AFE /end MEASUREMENT
/begin MEASUREMENT M_In_Y.GRP_sint32_sint32_sint32.All_Maps_GRP.Maps_Raster_1 "" SLONG ident 1 100 -2147483648.0 2147483647.0 ECU_ADDRESS 0x7F8A30 /end MEASUREMENT
/begin MEASUREMENT M_In_Y.GRP_sint32_sint32_sint32.All_Maps_GRP.Maps_Raster_2 "" SLONG ident 1 100 -2147483648.0 2147483647.0 ECU_ADDRESS 0x7F8B08 /end MEASUREMENT
/begin MEASUREMENT M_In_Y.GRP_sint8_sint8_sint8.All_Maps_GRP.Maps_Raster_1 "" SBYTE ident 1 100 -128.0 127.0 ECU_ADDRESS 0x7F8A3E /end MEASUREMENT
/begin MEASUREMENT M_In_Y.GRP_sint8_sint8_sint8.All_Maps_GRP.Maps_Raster_2 "" SBYTE ident 1 100 -128.0 127.0 ECU_ADDRESS 0x7F8B16 /end MEASUREMENT
/begin MEASUREMENT M_In_Y.GRP_uint16_uint16_uint16.All_Maps_GRP.Maps_Raster_1 "" UWORD ident 1 100 0.0 65535.0 ECU_ADDRESS 0x7F8A42 /end MEASUREMENT
/begin MEASUREMENT M_In_Y.GRP_uint16_uint16_uint16.All_Maps_GRP.Maps_Raster_2 "" UWORD ident 1 100 0.0 65535.0 ECU_ADDRESS 0x7F8B1A /end MEASUREMENT
/begin MEASUREMENT M_In_Y.GRP_uint32_uint32_uint32.All_Maps_GRP.Maps_Raster_1 "" ULONG ident 1 100 0.0 4294967295.0 ECU_ADDRESS 0x7F8A4C /end MEASUREMENT
/begin MEASUREMENT M_In_Y.GRP_uint32_uint32_uint32.All_Maps_GRP.Maps_Raster_2 "" ULONG ident 1 100 0.0 4294967295.0 ECU_ADDRESS 0x7F8B24 /end MEASUREMENT
/begin MEASUREMENT M_In_Y.GRP_uint8_uint8_uint8.All_Maps_GRP.Maps_Raster_1 "" UBYTE ident 1 100 0.0 255.0 ECU_ADDRESS 0x7F8A5A /end MEASUREMENT
/begin MEASUREMENT M_In_Y.GRP_uint8_uint8_uint8.All_Maps_GRP.Maps_Raster_2 "" UBYTE ident 1 100 0.0 255.0 ECU_ADDRESS 0x7F8B32 /end MEASUREMENT
/begin MEASUREMENT M_out.FIX_float32_float32_float32.All_Maps_FIX.Maps_Raster_1 "" FLOAT32_IEEE ident 1 100 -1.e+037 1.e+037 ECU_ADDRESS 0x7F89D4 /end MEASUREMENT
/begin MEASUREMENT M_out.FIX_float32_float32_float32.All_Maps_FIX.Maps_Raster_2 "" FLOAT32_IEEE ident 1 100 -1.e+037 1.e+037 ECU_ADDRESS 0x7F8AAC /end MEASUREMENT
/begin MEASUREMENT M_out.FIX_float32_float32_float32.All_Maps_FIX.Maps_Raster_3 "" FLOAT32_IEEE ident 1 100 -1.e+037 1.e+037 ECU_ADDRESS 0x7F8B84 /end MEASUREMENT
/begin MEASUREMENT M_out.FIX_sint16_sint16_sint16.All_Maps_FIX.Maps_Raster_1 "" SWORD ident 1 100 -32768.0 32767.0 ECU_ADDRESS 0x7F89E0 /end MEASUREMENT
/begin MEASUREMENT M_out.FIX_sint16_sint16_sint16.All_Maps_FIX.Maps_Raster_2 "" SWORD ident 1 100 -32768.0 32767.0 ECU_ADDRESS 0x7F8AB8 /end MEASUREMENT
/begin MEASUREMENT M_out.FIX_sint16_sint16_sint16.All_Maps_FIX.Maps_Raster_3 "" SWORD ident 1 100 -32768.0 32767.0 ECU_ADDRESS 0x7F8B90 /end MEASUREMENT
/begin MEASUREMENT M_out.FIX_sint32_sint32_sint32.All_Maps_FIX.Maps_Raster_1 "" SLONG ident 1 100 -2147483648.0 2147483647.0 ECU_ADDRESS 0x7F89EC /end MEASUREMENT
/begin MEASUREMENT M_out.FIX_sint32_sint32_sint32.All_Maps_FIX.Maps_Raster_2 "" SLONG ident 1 100 -2147483648.0 2147483647.0 ECU_ADDRESS 0x7F8AC4 /end MEASUREMENT
/begin MEASUREMENT M_out.FIX_sint32_sint32_sint32.All_Maps_FIX.Maps_Raster_3 "" SLONG ident 1 100 -2147483648.0 2147483647.0 ECU_ADDRESS 0x7F8B9C /end MEASUREMENT
/begin MEASUREMENT M_out.FIX_sint8_sint8_sint8.All_Maps_FIX.Maps_Raster_1 "" SBYTE ident 1 100 -128.0 127.0 ECU_ADDRESS 0x7F89F7 /end MEASUREMENT
/begin MEASUREMENT M_out.FIX_sint8_sint8_sint8.All_Maps_FIX.Maps_Raster_2 "" SBYTE ident 1 100 -128.0 127.0 ECU_ADDRESS 0x7F8ACF /end MEASUREMENT
/begin MEASUREMENT M_out.FIX_sint8_sint8_sint8.All_Maps_FIX.Maps_Raster_3 "" SBYTE ident 1 100 -128.0 127.0 ECU_ADDRESS 0x7F8BA7 /end MEASUREMENT
/begin MEASUREMENT M_out.FIX_uint16_uint16_uint16.All_Maps_FIX.Maps_Raster_1 "" UWORD ident 1 100 0.0 65535.0 ECU_ADDRESS 0x7F89FC /end MEASUREMENT
/begin MEASUREMENT M_out.FIX_uint16_uint16_uint16.All_Maps_FIX.Maps_Raster_2 "" UWORD ident 1 100 0.0 65535.0 ECU_ADDRESS 0x7F8AD4 /end MEASUREMENT
/begin MEASUREMENT M_out.FIX_uint16_uint16_uint16.All_Maps_FIX.Maps_Raster_3 "" UWORD ident 1 100 0.0 65535.0 ECU_ADDRESS 0x7F8BAC /end MEASUREMENT
/begin MEASUREMENT M_out.FIX_uint32_uint32_uint32.All_Maps_FIX.Maps_Raster_1 "" ULONG ident 1 100 0.0 4294967295.0 ECU_ADDRESS 0x7F8A08 /end MEASUREMENT
/begin MEASUREMENT M_out.FIX_uint32_uint32_uint32.All_Maps_FIX.Maps_Raster_2 "" ULONG ident 1 100 0.0 4294967295.0 ECU_ADDRESS 0x7F8AE0 /end MEASUREMENT
/begin MEASUREMENT M_out.FIX_uint32_uint32_uint32.All_Maps_FIX.Maps_Raster_3 "" ULONG ident 1 100 0.0 4294967295.0 ECU_ADDRESS 0x7F8BB8 /end MEASUREMENT
/begin MEASUREMENT M_out.FIX_uint8_uint8_uint8.All_Maps_FIX.Maps_Raster_1 "" UBYTE ident 1 100 0.0 255.0 ECU_ADDRESS 0x7F8A13 /end MEASUREMENT
/begin MEASUREMENT M_out.FIX_uint8_uint8_uint8.All_Maps_FIX.Maps_Raster_2 "" UBYTE ident 1 100 0.0 255.0 ECU_ADDRESS 0x7F8AEB /end MEASUREMENT
/begin MEASUREMENT M_out.FIX_uint8_uint8_uint8.All_Maps_FIX.Maps_Raster_3 "" UBYTE ident 1 100 0.0 255.0 ECU_ADDRESS 0x7F8BC3 /end MEASUREMENT
/begin MEASUREMENT M_out.GRP_float32_float32_float32.All_Maps_GRP.Maps_Raster_1 "" FLOAT32_IEEE ident 1 100 -1.e+037 1.e+037 ECU_ADDRESS 0x7F8A1C /end MEASUREMENT
/begin MEASUREMENT M_out.GRP_float32_float32_float32.All_Maps_GRP.Maps_Raster_2 "" FLOAT32_IEEE ident 1 100 -1.e+037 1.e+037 ECU_ADDRESS 0x7F8AF4 /end MEASUREMENT
/begin MEASUREMENT M_out.GRP_sint16_sint16_sint16.All_Maps_GRP.Maps_Raster_1 "" SWORD ident 1 100 -32768.0 32767.0 ECU_ADDRESS 0x7F8A28 /end MEASUREMENT
/begin MEASUREMENT M_out.GRP_sint16_sint16_sint16.All_Maps_GRP.Maps_Raster_2 "" SWORD ident 1 100 -32768.0 32767.0 ECU_ADDRESS 0x7F8B00 /end MEASUREMENT
/begin MEASUREMENT M_out.GRP_sint32_sint32_sint32.All_Maps_GRP.Maps_Raster_1 "" SLONG ident 1 100 -2147483648.0 2147483647.0 ECU_ADDRESS 0x7F8A34 /end MEASUREMENT
/begin MEASUREMENT M_out.GRP_sint32_sint32_sint32.All_Maps_GRP.Maps_Raster_2 "" SLONG ident 1 100 -2147483648.0 2147483647.0 ECU_ADDRESS 0x7F8B0C /end MEASUREMENT
/begin MEASUREMENT M_out.GRP_sint8_sint8_sint8.All_Maps_GRP.Maps_Raster_1 "" SBYTE ident 1 100 -128.0 127.0 ECU_ADDRESS 0x7F8A3F /end MEASUREMENT
/begin MEASUREMENT M_out.GRP_sint8_sint8_sint8.All_Maps_GRP.Maps_Raster_2 "" SBYTE ident 1 100 -128.0 127.0 ECU_ADDRESS 0x7F8B17 /end MEASUREMENT
/begin MEASUREMENT M_out.GRP_uint16_uint16_uint16.All_Maps_GRP.Maps_Raster_1 "" UWORD ident 1 100 0.0 65535.0 ECU_ADDRESS 0x7F8A44 /end MEASUREMENT
/begin MEASUREMENT M_out.GRP_uint16_uint16_uint16.All_Maps_GRP.Maps_Raster_2 "" UWORD ident 1 100 0.0 65535.0 ECU_ADDRESS 0x7F8B1C /end MEASUREMENT
/begin MEASUREMENT M_out.GRP_uint32_uint32_uint32.All_Maps_GRP.Maps_Raster_1 "" ULONG ident 1 100 0.0 4294967295.0 ECU_ADDRESS 0x7F8A50 /end MEASUREMENT
/begin MEASUREMENT M_out.GRP_uint32_uint32_uint32.All_Maps_GRP.Maps_Raster_2 "" ULONG ident 1 100 0.0 4294967295.0 ECU_ADDRESS 0x7F8B28 /end MEASUREMENT
/begin MEASUREMENT M_out.GRP_uint8_uint8_uint8.All_Maps_GRP.Maps_Raster_1 "" UBYTE ident 1 100 0.0 255.0 ECU_ADDRESS 0x7F8A5B /end MEASUREMENT
/begin MEASUREMENT M_out.GRP_uint8_uint8_uint8.All_Maps_GRP.Maps_Raster_2 "" UBYTE ident 1 100 0.0 255.0 ECU_ADDRESS 0x7F8B33 /end MEASUREMENT
/begin MEASUREMENT M_out.STD_sint16_sint16.All_Curves_STD.Curves_Raster_2 "" SWORD ident 1 100 -32768.0 32767.0 ECU_ADDRESS 0x7F8712 /end MEASUREMENT
/begin MEASUREMENT M_out.STD_sint16_sint16.All_Curves_STD.Curves_Raster_3 "" SWORD ident 1 100 -32768.0 32767.0 ECU_ADDRESS 0x7F87A2 /end MEASUREMENT
/begin MEASUREMENT M_out.STD_sint32_sint32.All_Curves_STD.Curves_Raster_2 "" SLONG ident 1 100 -2147483648.0 2147483647.0 ECU_ADDRESS 0x7F871C /end MEASUREMENT
/begin MEASUREMENT M_out.STD_sint32_sint32.All_Curves_STD.Curves_Raster_3 "" SLONG ident 1 100 -2147483648.0 2147483647.0 ECU_ADDRESS 0x7F87AC /end MEASUREMENT
/begin MEASUREMENT M_out.STD_sint8_sint8.All_Curves_STD.Curves_Raster_2 "" SBYTE ident 1 100 -128.0 127.0 ECU_ADDRESS 0x7F8726 /end MEASUREMENT
/begin MEASUREMENT M_out.STD_sint8_sint8.All_Curves_STD.Curves_Raster_3 "" SBYTE ident 1 100 -128.0 127.0 ECU_ADDRESS 0x7F87B6 /end MEASUREMENT
/begin MEASUREMENT M_out.STD_uint16_uint16.All_Curves_STD.Curves_Raster_2 "" UWORD ident 1 100 0.0 65535.0 ECU_ADDRESS 0x7F872A /end MEASUREMENT
/begin MEASUREMENT M_out.STD_uint16_uint16.All_Curves_STD.Curves_Raster_3 "" UWORD ident 1 100 0.0 65535.0 ECU_ADDRESS 0x7F87BA /end MEASUREMENT
/begin MEASUREMENT M_out.STD_uint32_uint32.All_Curves_STD.Curves_Raster_2 "" ULONG ident 1 100 0.0 4294967295.0 ECU_ADDRESS 0x7F8734 /end MEASUREMENT
/begin MEASUREMENT M_out.STD_uint32_uint32.All_Curves_STD.Curves_Raster_3 "" ULONG ident 1 100 0.0 4294967295.0 ECU_ADDRESS 0x7F87C4 /end MEASUREMENT
/begin MEASUREMENT M_out.STD_uint8_uint8.All_Curves_STD.Curves_Raster_2 "" UBYTE ident 1 100 0.0 255.0 ECU_ADDRESS 0x7F873E /end MEASUREMENT
/begin MEASUREMENT M_out.STD_uint8_uint8.All_Curves_STD.Curves_Raster_3 "" UBYTE ident 1 100 0.0 255.0 ECU_ADDRESS 0x7F87CE /end MEASUREMENT
/begin COMPU_METHOD ident "" RAT_FUNC "%12.4" "" COEFFS 0 1 0 0 0 1 /end COMPU_METHOD
/begin GROUP All_Curves_STD.Curves_Raster_2 ""
 /begin REF_MEASUREMENT Calculated.STD_sint16_sint16.All_Curves_STD.Curves_Raster_2 Calculated.STD_sint32_sint32.All_Curves_STD.Curves_Raster_2 Calculated.STD_sint8_sint8.All_Curves_STD.Curves_Raster_2 Calculated.STD_uint16_uint16.All_Curves_STD.Curves_Raster_2 Calculated.STD_uint32_uint32.All_Curves_STD.Curves_Raster_2 Calculated.STD_uint8_uint8.All_Curves_STD.Curves_Raster_2 M_In.STD_sint16_sint16.All_Curves_STD.Curves_Raster_2 M_In.STD_sint32_sint32.All_Curves_STD.Curves_Raster_2 M_In.STD_sint8_sint8.All_Curves_STD.Curves_Raster_2 M_In.STD_uint16_uint16.All_Curves_STD.Curves_Raster_2 M_In.STD_uint32_uint32.All_Curves_STD.Curves_Raster_2 M_In.STD_uint8_uint8.All_Curves_STD.Curves_Raster_2 M_out.STD_sint16_sint16.All_Curves_STD.Curves_Raster_2 M_out.STD_sint32_sint32.All_Curves_STD.Curves_Raster_2 M_out.STD_sint8_sint8.All_Curves_STD.Curves_Raster_2 M_out.STD_uint16_uint16.All_Curves_STD.Curves_Raster_2 M_out.STD_uint32_uint32.All_Curves_STD.Curves_Raster_2 M_out.STD_uint8_uint8.All_Curves_STD.Curves_Raster_2 /end REF_MEASUREMENT
 /begin REF_CHARACTERISTIC One_D.STD_sint16_sint16.All_Curves_STD.Curves_Raster_2 One_D.STD_sint32_sint32.All_Curves_STD.Curves_Raster_2 One_D.STD_sint8_sint8.All_Curves_STD.Curves_Raster_2 One_D.STD_uint16_uint16.All_Curves_STD.Curves_Raster_2 One_D.STD_uint32_uint32.All_Curves_STD.Curves_Raster_2 One_D.STD_uint8_uint8.All_Curves_STD.Curves_Raster_2 P_Do_Active_Std.STD_sint16_sint16.All_Curves_STD.Curves_Raster_2 P_Do_Active_Std.STD_sint32_sint32.All_Curves_STD.Curves_Raster_2 P_Do_Active_Std.STD_sint8_sint8.All_Curves_STD.Curves_Raster_2 P_Do_Active_Std.STD_uint16_uint16.All_Curves_STD.Curves_Raster_2 P_Do_Active_Std.STD_uint32_uint32.All_Curves_STD.Curves_Raster_2 P_Do_Active_Std.STD_uint8_uint8.All_Curves_STD.Curves_Raster_2 P_Do_All_STD_Curves.All_Curves_STD.Curves_Raster_2 P_In.STD_sint16_sint16.All_Curves_STD.Curves_Raster_2 P_In.STD_sint32_sint32.All_Curves_STD.Curves_Raster_2 P_In.STD_sint8_sint8.All_Curves_STD.Curves_Raster_2 P_In.STD_uint16_uint16.All_Curves_STD.Curves_Raster_2 P_In.STD_uint32_uint32.All_Curves_STD.Curves_Raster_2 P_In.STD_uint8_uint8.All_Curves_STD.Curves_Raster_2 /end REF_CHARACTERISTIC
 /begin SUB_GROUP STD_sint16_sint16.All_Curves_STD.Curves_Raster_2 STD_sint32_sint32.All_Curves_STD.Curves_Raster_2 STD_sint8_sint8.All_Curves_STD.Curves_Raster_2 STD_uint16_uint16.All_Curves_STD.Curves_Raster_2 STD_uint32_uint32.All_Curves_STD.Curves_Raster_2 STD_uint8_uint8.All_Curves_STD.Curves_Raster_2 /end SUB_GROUP
/end GROUP
/begin GROUP All_Curves_STD.Curves_Raster_3 ""
 /begin REF_MEASUREMENT Calculated.STD_sint16_sint16.All_Curves_STD.Curves_Raster_3 Calculated.STD_sint32_sint32.All_Curves_STD.Curves_Raster_3 Calculated.STD_sint8_sint8.All_Curves_STD.Curves_Raster_3 Calculated.STD_uint16_uint16.All_Curves_STD.Curves_Raster_3 Calculated.STD_uint32_uint32.All_Curves_STD.Curves_Raster_3 Calculated.STD_uint8_uint8.All_Curves_STD.Curves_Raster_3 M_In.STD_sint16_sint16.All_Curves_STD.Curves_Raster_3 M_In.STD_sint32_sint32.All_Curves_STD.Curves_Raster_3 M_In.STD_sint8_sint8.All_Curves_STD.Curves_Raster_3 M_In.STD_uint16_uint16.All_Curves_STD.Curves_Raster_3 M_In.STD_uint32_uint32.All_Curves_STD.Curves_Raster_3 M_In.STD_uint8_uint8.All_Curves_STD.Curves_Raster_3 M_out.STD_sint16_sint16.All_Curves_STD.Curves_Raster_3 M_out.STD_sint32_sint32.All_Curves_STD.Curves_Raster_3 M_out.STD_sint8_sint8.All_Curves_STD.Curves_Raster_3 M_out.STD_uint16_uint16.All_Curves_STD.Curves_Raster_3 M_out.STD_uint32_uint32.All_Curves_STD.Curves_Raster_3 M_out.STD_uint8_uint8.All_Curves_STD.Curves_Raster_3 /end REF_MEASUREMENT
 /begin REF_CHARACTERISTIC One_D.STD_sint16_sint16.All_Curves_STD.Curves_Raster_3 One_D.STD_sint32_sint32.All_Curves_STD.Curves_Raster_3 One_D.STD_sint8_sint8.All_Curves_STD.Curves_Raster_3 One_D.STD_uint16_uint16.All_Curves_STD.Curves_Raster_3 One_D.STD_uint32_uint32.All_Curves_STD.Curves_Raster_3 One_D.STD_uint8_uint8.All_Curves_STD.Curves_Raster_3 P_Do_Active_Std.STD_sint16_sint16.All_Curves_STD.Curves_Raster_3 P_Do_Active_Std.STD_sint32_sint32.All_Curves_STD.Curves_Raster_3 P_Do_Active_Std.STD_sint8_sint8.All_Curves_STD.Curves_Raster_3 P_Do_Active_Std.STD_uint16_uint16.All_Curves_STD.Curves_Raster_3 P_Do_Active_Std.STD_uint32_uint32.All_Curves_STD.Curves_Raster_3 P_Do_Active_Std.STD_uint8_uint8.All_Curves_STD.Curves_Raster_3 P_Do_All_STD_Curves.All_Curves_STD.Curves_Raster_3 P_In.STD_sint16_sint16.All_Curves_STD.Curves_Raster_3 P_In.STD_sint32_sint32.All_Curves_STD.Curves_Raster_3 P_In.STD_sint8_sint8.All_Curves_STD.Curves_Raster_3 P_In.STD_uint16_uint16.All_Curves_STD.Curves_Raster_3 P_In.STD_uint32_uint32.All_Curves_STD.Curves_Raster_3 P_In.STD_uint8_uint8.All_Curves_STD.Curves_Raster_3 /end REF_CHARACTERISTIC
 /begin SUB_GROUP STD_sint16_sint16.All_Curves_STD.Curves_Raster_3 STD_sint32_sint32.All_Curves_STD.Curves_Raster_3 STD_sint8_sint8.All_Curves_STD.Curves_Raster_3 STD_uint16_uint16.All_Curves_STD.Curves_Raster_3 STD_uint32_uint32.All_Curves_STD.Curves_Raster_3 STD_uint8_uint8.All_Curves_STD.Curves_Raster_3 /end SUB_GROUP
/end GROUP
/begin GROUP All_Maps_FIX.Maps_Raster_1 ""
 /begin REF_MEASUREMENT Calculated.FIX_float32_float32_float32.All_Maps_FIX.Maps_Raster_1 Calculated.FIX_sint16_sint16_sint16.All_Maps_FIX.Maps_Raster_1 Calculated.FIX_sint32_sint32_sint32.All_Maps_FIX.Maps_Raster_1 Calculated.FIX_sint8_sint8_sint8.All_Maps_FIX.Maps_Raster_1 Calculated.FIX_uint16_uint16_uint16.All_Maps_FIX.Maps_Raster_1 Calculated.FIX_uint32_uint32_uint32.All_Maps_FIX.Maps_Raster_1 Calculated.FIX_uint8_uint8_uint8.All_Maps_FIX.Maps_Raster_1 M_In_X.FIX_float32_float32_float32.All_Maps_FIX.Maps_Raster_1 M_In_X.FIX_sint16_sint16_sint16.All_Maps_FIX.Maps_Raster_1 M_In_X.FIX_sint32_sint32_sint32.All_Maps_FIX.Maps_Raster_1 M_In_X.FIX_sint8_sint8_sint8.All_Maps_FIX.Maps_Raster_1 M_In_X.FIX_uint16_uint16_uint16.All_Maps_FIX.Maps_Raster_1 M_In_X.FIX_uint32_uint32_uint32.All_Maps_FIX.Maps_Raster_1 M_In_X.FIX_uint8_uint8_uint8.All_Maps_FIX.Maps_Raster_1 M_In_Y.FIX_float32_float32_float32.All_Maps_FIX.Maps_Raster_1 M_In_Y.FIX_sint16_sint16_sint16.All_Maps_FIX.Maps_Raster_1 M_In_Y.FIX_sint32_sint32_sint32.All_Maps_FIX.Maps_Raster_1 M_In_Y.FIX_sint8_sint8_sint8.All_Maps_FIX.Maps_Raster_1 M_In_Y.FIX_uint16_uint16_uint16.All_Maps_FIX.Maps_Raster_1 M_In_Y.FIX_uint32_uint32_uint32.All_Maps_FIX.Maps_Raster_1 M_In_Y.FIX_uint8_uint8_uint8.All_Maps_FIX.Maps_Raster_1 M_out.FIX_float32_float32_float32.All_Maps_FIX.Maps_Raster_1 M_out.FIX_sint16_sint16_sint16.All_Maps_FIX.Maps_Raster_1 M_out.FIX_sint32_sint32_sint32.All_Maps_FIX.Maps_Raster_1 M_out.FIX_sint8_sint8_sint8.All_Maps_FIX.Maps_Raster_1 M_out.FIX_uint16_uint16_uint16.All_Maps_FIX.Maps_Raster_1 M_out.FIX_uint32_uint32_uint32.All_Maps_FIX.Maps_Raster_1 M_out.FIX_uint8_uint8_uint8.All_Maps_FIX.Maps_Raster_1 /end REF_MEASUREMENT
 /begin REF_CHARACTERISTIC P_Do_Active_Std.FIX_float32_float32_float32.All_Maps_FIX.Maps_Raster_1 P_Do_Active_Std.FIX_sint16_sint16_sint16.All_Maps_FIX.Maps_Raster_1 P_Do_Active_Std.FIX_sint32_sint32_sint32.All_Maps_FIX.Maps_Raster_1 P_Do_Active_Std.FIX_sint8_sint8_sint8.All_Maps_FIX.Maps_Raster_1 P_Do_Active_Std.FIX_uint16_uint16_uint16.All_Maps_FIX.Maps_Raster_1 P_Do_Active_Std.FIX_uint32_uint32_uint32.All_Maps_FIX.Maps_Raster_1 P_Do_Active_Std.FIX_uint8_uint8_uint8.All_Maps_FIX.Maps_Raster_1 P_Do_All_FIX_Maps.All_Maps_FIX.Maps_Raster_1 P_In_X.FIX_float32_float32_float32.All_Maps_FIX.Maps_Raster_1 P_In_X.FIX_sint16_sint16_sint16.All_Maps_FIX.Maps_Raster_1 P_In_X.FIX_sint32_sint32_sint32.All_Maps_FIX.Maps_Raster_1 P_In_X.FIX_sint8_sint8_sint8.All_Maps_FIX.Maps_Raster_1 P_In_X.FIX_uint16_uint16_uint16.All_Maps_FIX.Maps_Raster_1 P_In_X.FIX_uint32_uint32_uint32.All_Maps_FIX.Maps_Raster_1 P_In_X.FIX_uint8_uint8_uint8.All_Maps_FIX.Maps_Raster_1 P_In_Y.FIX_float32_float32_float32.All_Maps_FIX.Maps_Raster_1 P_In_Y.FIX_sint16_sint16_sint16.All_Maps_FIX.Maps_Raster_1 P_In_Y.FIX_sint32_sint32_sint32.All_Maps_FIX.Maps_Raster_1 P_In_Y.FIX_sint8_sint8_sint8.All_Maps_FIX.Maps_Raster_1 P_In_Y.FIX_uint16_uint16_uint16.All_Maps_FIX.Maps_Raster_1 P_In_Y.FIX_uint32_uint32_uint32.All_Maps_FIX.Maps_Raster_1 P_In_Y.FIX_uint8_uint8_uint8.All_Maps_FIX.Maps_Raster_1 Two_D.FIX_float32_float32_float32.All_Maps_FIX.Maps_Raster_1 Two_D.FIX_sint16_sint16_sint16.All_Maps_FIX.Maps_Raster_1 Two_D.FIX_sint32_sint32_sint32.All_Maps_FIX.Maps_Raster_1 Two_D.FIX_sint8_sint8_sint8.All_Maps_FIX.Maps_Raster_1 Two_D.FIX_uint16_uint16_uint16.All_Maps_FIX.Maps_Raster_1 Two_D.FIX_uint32_uint32_uint32.All_Maps_FIX.Maps_Raster_1 Two_D.FIX_uint8_uint8_uint8.All_Maps_FIX.Maps_Raster_1 /end REF_CHARACTERISTIC
 /begin SUB_GROUP FIX_float32_float32_float32.All_Maps_FIX.Maps_Raster_1 FIX_sint16_sint16_sint16.All_Maps_FIX.Maps_Raster_1 FIX_sint32_sint32_sint32.All_Maps_FIX.Maps_Raster_1 FIX_sint8_sint8_sint8.All_Maps_FIX.Maps_Raster_1 FIX_uint16_uint16_uint16.All_Maps_FIX.Maps_Raster_1 FIX_uint32_uint32_uint32.All_Maps_FIX.Maps_Raster_1 FIX_uint8_uint8_uint8.All_Maps_FIX.Maps_Raster_1 /end SUB_GROUP
/end GROUP
/begin GROUP All_Maps_FIX.Maps_Raster_2 ""
 /begin REF_MEASUREMENT Calculated.FIX_float32_float32_float32.All_Maps_FIX.Maps_Raster_2 Calculated.FIX_sint16_sint16_sint16.All_Maps_FIX.Maps_Raster_2 Calculated.FIX_sint32_sint32_sint32.All_Maps_FIX.Maps_Raster_2 Calculated.FIX_sint8_sint8_sint8.All_Maps_FIX.Maps_Raster_2 Calculated.FIX_uint16_uint16_uint16.All_Maps_FIX.Maps_Raster_2 Calculated.FIX_uint32_uint32_uint32.All_Maps_FIX.Maps_Raster_2 Calculated.FIX_uint8_uint8_uint8.All_Maps_FIX.Maps_Raster_2 M_In_X.FIX_float32_float32_float32.All_Maps_FIX.Maps_Raster_2 M_In_X.FIX_sint16_sint16_sint16.All_Maps_FIX.Maps_Raster_2 M_In_X.FIX_sint32_sint32_sint32.All_Maps_FIX.Maps_Raster_2 M_In_X.FIX_sint8_sint8_sint8.All_Maps_FIX.Maps_Raster_2 M_In_X.FIX_uint16_uint16_uint16.All_Maps_FIX.Maps_Raster_2 M_In_X.FIX_uint32_uint32_uint32.All_Maps_FIX.Maps_Raster_2 M_In_X.FIX_uint8_uint8_uint8.All_Maps_FIX.Maps_Raster_2 M_In_Y.FIX_float32_float32_float32.All_Maps_FIX.Maps_Raster_2 M_In_Y.FIX_sint16_sint16_sint16.All_Maps_FIX.Maps_Raster_2 M_In_Y.FIX_sint32_sint32_sint32.All_Maps_FIX.Maps_Raster_2 M_In_Y.FIX_sint8_sint8_sint8.All_Maps_FIX.Maps_Raster_2 M_In_Y.FIX_uint16_uint16_uint16.All_Maps_FIX.Maps_Raster_2 M_In_Y.FIX_uint32_uint32_uint32.All_Maps_FIX.Maps_Raster_2 M_In_Y.FIX_uint8_uint8_uint8.All_Maps_FIX.Maps_Raster_2 M_out.FIX_float32_float32_float32.All_Maps_FIX.Maps_Raster_2 M_out.FIX_sint16_sint16_sint16.All_Maps_FIX.Maps_Raster_2 M_out.FIX_sint32_sint32_sint32.All_Maps_FIX.Maps_Raster_2 M_out.FIX_sint8_sint8_sint8.All_Maps_FIX.Maps_Raster_2 M_out.FIX_uint16_uint16_uint16.All_Maps_FIX.Maps_Raster_2 M_out.FIX_uint32_uint32_uint32.All_Maps_FIX.Maps_Raster_2 M_out.FIX_uint8_uint8_uint8.All_Maps_FIX.Maps_Raster_2 /end REF_MEASUREMENT
 /begin REF_CHARACTERISTIC P_Do_Active_Std.FIX_float32_float32_float32.All_Maps_FIX.Maps_Raster_2 P_Do_Active_Std.FIX_sint16_sint16_sint16.All_Maps_FIX.Maps_Raster_2 P_Do_Active_Std.FIX_sint32_sint32_sint32.All_Maps_FIX.Maps_Raster_2 P_Do_Active_Std.FIX_sint8_sint8_sint8.All_Maps_FIX.Maps_Raster_2 P_Do_Active_Std.FIX_uint16_uint16_uint16.All_Maps_FIX.Maps_Raster_2 P_Do_Active_Std.FIX_uint32_uint32_uint32.All_Maps_FIX.Maps_Raster_2 P_Do_Active_Std.FIX_uint8_uint8_uint8.All_Maps_FIX.Maps_Raster_2 P_Do_All_FIX_Maps.All_Maps_FIX.Maps_Raster_2 P_In_X.FIX_float32_float32_float32.All_Maps_FIX.Maps_Raster_2 P_In_X.FIX_sint16_sint16_sint16.All_Maps_FIX.Maps_Raster_2 P_In_X.FIX_sint32_sint32_sint32.All_Maps_FIX.Maps_Raster_2 P_In_X.FIX_sint8_sint8_sint8.All_Maps_FIX.Maps_Raster_2 P_In_X.FIX_uint16_uint16_uint16.All_Maps_FIX.Maps_Raster_2 P_In_X.FIX_uint32_uint32_uint32.All_Maps_FIX.Maps_Raster_2 P_In_X.FIX_uint8_uint8_uint8.All_Maps_FIX.Maps_Raster_2 P_In_Y.FIX_float32_float32_float32.All_Maps_FIX.Maps_Raster_2 P_In_Y.FIX_sint16_sint16_sint16.All_Maps_FIX.Maps_Raster_2 P_In_Y.FIX_sint32_sint32_sint32.All_Maps_FIX.Maps_Raster_2 P_In_Y.FIX_sint8_sint8_sint8.All_Maps_FIX.Maps_Raster_2 P_In_Y.FIX_uint16_uint16_uint16.All_Maps_FIX.Maps_Raster_2 P_In_Y.FIX_uint32_uint32_uint32.All_Maps_FIX.Maps_Raster_2 P_In_Y.FIX_uint8_uint8_uint8.All_Maps_FIX.Maps_Raster_2 Two_D.FIX_float32_float32_float32.All_Maps_FIX.Maps_Raster_2 Two_D.FIX_sint16_sint16_sint16.All_Maps_FIX.Maps_Raster_2 Two_D.FIX_sint32_sint32_sint32.All_Maps_FIX.Maps_Raster_2 Two_D.FIX_sint8_sint8_sint8.All_Maps_FIX.Maps_Raster_2 Two_D.FIX_uint16_uint16_uint16.All_Maps_FIX.Maps_Raster_2 Two_D.FIX_uint32_uint32_uint32.All_Maps_FIX.Maps_Raster_2 Two_D.FIX_uint8_uint8_uint8.All_Maps_FIX.Maps_Raster_2 /end REF_CHARACTERISTIC
 /begin SUB_GROUP FIX_float32_float32_float32.All_Maps_FIX.Maps_Raster_2 FIX_sint16_sint16_sint16.All_Maps_FIX.Maps_Raster_2 FIX_sint32_sint32_sint32.All_Maps_FIX.Maps_Raster_2 FIX_sint8_sint8_sint8.All_Maps_FIX.Maps_Raster_2 FIX_uint16_uint16_uint16.All_Maps_FIX.Maps_Raster_2 FIX_uint32_uint32_uint32.All_Maps_FIX.Maps_Raster_2 FIX_uint8_uint8_uint8.All_Maps_FIX.Maps_Raster_2 /end SUB_GROUP
/end GROUP
/begin GROUP All_Maps_FIX.Maps_Raster_3 ""
 /begin REF_MEASUREMENT Calculated.FIX_float32_float32_float32.All_Maps_FIX.Maps_Raster_3 Calculated.FIX_sint16_sint16_sint16.All_Maps_FIX.Maps_Raster_3 Calculated.FIX_sint32_sint32_sint32.All_Maps_FIX.Maps_Raster_3 Calculated.FIX_sint8_sint8_sint8.All_Maps_FIX.Maps_Raster_3 Calculated.FIX_uint16_uint16_uint16.All_Maps_FIX.Maps_Raster_3 Calculated.FIX_uint32_uint32_uint32.All_Maps_FIX.Maps_Raster_3 Calculated.FIX_uint8_uint8_uint8.All_Maps_FIX.Maps_Raster_3 M_In_X.FIX_float32_float32_float32.All_Maps_FIX.Maps_Raster_3 M_In_X.FIX_sint16_sint16_sint16.All_Maps_FIX.Maps_Raster_3 M_In_X.FIX_sint32_sint32_sint32.All_Maps_FIX.Maps_Raster_3 M_In_X.FIX_sint8_sint8_sint8.All_Maps_FIX.Maps_Raster_3 M_In_X.FIX_uint16_uint16_uint16.All_Maps_FIX.Maps_Raster_3 M_In_X.FIX_uint32_uint32_uint32.All_Maps_FIX.Maps_Raster_3 M_In_X.FIX_uint8_uint8_uint8.All_Maps_FIX.Maps_Raster_3 M_In_Y.FIX_float32_float32_float32.All_Maps_FIX.Maps_Raster_3 M_In_Y.FIX_sint16_sint16_sint16.All_Maps_FIX.Maps_Raster_3 M_In_Y.FIX_sint32_sint32_sint32.All_Maps_FIX.Maps_Raster_3 M_In_Y.FIX_sint8_sint8_sint8.All_Maps_FIX.Maps_Raster_3 M_In_Y.FIX_uint16_uint16_uint16.All_Maps_FIX.Maps_Raster_3 M_In_Y.FIX_uint32_uint32_uint32.All_Maps_FIX.Maps_Raster_3 M_In_Y.FIX_uint8_uint8_uint8.All_Maps_FIX.Maps_Raster_3 M_out.FIX_float32_float32_float32.All_Maps_FIX.Maps_Raster_3 M_out.FIX_sint16_sint16_sint16.All_Maps_FIX.Maps_Raster_3 M_out.FIX_sint32_sint32_sint32.All_Maps_FIX.Maps_Raster_3 M_out.FIX_sint8_sint8_sint8.All_Maps_FIX.Maps_Raster_3 M_out.FIX_uint16_uint16_uint16.All_Maps_FIX.Maps_Raster_3 M_out.FIX_uint32_uint32_uint32.All_Maps_FIX.Maps_Raster_3 M_out.FIX_uint8_uint8_uint8.All_Maps_FIX.Maps_Raster_3 /end REF_MEASUREMENT
 /begin REF_CHARACTERISTIC P_Do_Active_Std.FIX_float32_float32_float32.All_Maps_FIX.Maps_Raster_3 P_Do_Active_Std.FIX_sint16_sint16_sint16.All_Maps_FIX.Maps_Raster_3 P_Do_Active_Std.FIX_sint32_sint32_sint32.All_Maps_FIX.Maps_Raster_3 P_Do_Active_Std.FIX_sint8_sint8_sint8.All_Maps_FIX.Maps_Raster_3 P_Do_Active_Std.FIX_uint16_uint16_uint16.All_Maps_FIX.Maps_Raster_3 P_Do_Active_Std.FIX_uint32_uint32_uint32.All_Maps_FIX.Maps_Raster_3 P_Do_Active_Std.FIX_uint8_uint8_uint8.All_Maps_FIX.Maps_Raster_3 P_Do_All_FIX_Maps.All_Maps_FIX.Maps_Raster_3 P_In_X.FIX_float32_float32_float32.All_Maps_FIX.Maps_Raster_3 P_In_X.FIX_sint16_sint16_sint16.All_Maps_FIX.Maps_Raster_3 P_In_X.FIX_sint32_sint32_sint32.All_Maps_FIX.Maps_Raster_3 P_In_X.FIX_sint8_sint8_sint8.All_Maps_FIX.Maps_Raster_3 P_In_X.FIX_uint16_uint16_uint16.All_Maps_FIX.Maps_Raster_3 P_In_X.FIX_uint32_uint32_uint32.All_Maps_FIX.Maps_Raster_3 P_In_X.FIX_uint8_uint8_uint8.All_Maps_FIX.Maps_Raster_3 P_In_Y.FIX_float32_float32_float32.All_Maps_FIX.Maps_Raster_3 P_In_Y.FIX_sint16_sint16_sint16.All_Maps_FIX.Maps_Raster_3 P_In_Y.FIX_sint32_sint32_sint32.All_Maps_FIX.Maps_Raster_3 P_In_Y.FIX_sint8_sint8_sint8.All_Maps_FIX.Maps_Raster_3 P_In_Y.FIX_uint16_uint16_uint16.All_Maps_FIX.Maps_Raster_3 P_In_Y.FIX_uint32_uint32_uint32.All_Maps_FIX.Maps_Raster_3 P_In_Y.FIX_uint8_uint8_uint8.All_Maps_FIX.Maps_Raster_3 Two_D.FIX_float32_float32_float32.All_Maps_FIX.Maps_Raster_3 Two_D.FIX_sint16_sint16_sint16.All_Maps_FIX.Maps_Raster_3 Two_D.FIX_sint32_sint32_sint32.All_Maps_FIX.Maps_Raster_3 Two_D.FIX_sint8_sint8_sint8.All_Maps_FIX.Maps_Raster_3 Two_D.FIX_uint16_uint16_uint16.All_Maps_FIX.Maps_Raster_3 Two_D.FIX_uint32_uint32_uint32.All_Maps_FIX.Maps_Raster_3 Two_D.FIX_uint8_uint8_uint8.All_Maps_FIX.Maps_Raster_3 /end REF_CHARACTERISTIC
 /begin SUB_GROUP FIX_float32_float32_float32.All_Maps_FIX.Maps_Raster_3 FIX_sint16_sint16_sint16.All_Maps_FIX.Maps_Raster_3 FIX_sint32_sint32_sint32.All_Maps_FIX.Maps_Raster_3 FIX_sint8_sint8_sint8.All_Maps_FIX.Maps_Raster_3 FIX_uint16_uint16_uint16.All_Maps_FIX.Maps_Raster_3 FIX_uint32_uint32_uint32.All_Maps_FIX.Maps_Raster_3 FIX_uint8_uint8_uint8.All_Maps_FIX.Maps_Raster_3 /end SUB_GROUP
/end GROUP
/begin GROUP All_Maps_GRP.Maps_Raster_1 ""
 /begin REF_MEASUREMENT Calculated.GRP_float32_float32_float32.All_Maps_GRP.Maps_Raster_1 Calculated.GRP_sint16_sint16_sint16.All_Maps_GRP.Maps_Raster_1 Calculated.GRP_sint32_sint32_sint32.All_Maps_GRP.Maps_Raster_1 Calculated.GRP_sint8_sint8_sint8.All_Maps_GRP.Maps_Raster_1 Calculated.GRP_uint16_uint16_uint16.All_Maps_GRP.Maps_Raster_1 Calculated.GRP_uint32_uint32_uint32.All_Maps_GRP.Maps_Raster_1 Calculated.GRP_uint8_uint8_uint8.All_Maps_GRP.Maps_Raster_1 M_In_X.GRP_float32_float32_float32.All_Maps_GRP.Maps_Raster_1 M_In_X.GRP_sint16_sint16_sint16.All_Maps_GRP.Maps_Raster_1 M_In_X.GRP_sint32_sint32_sint32.All_Maps_GRP.Maps_Raster_1 M_In_X.GRP_sint8_sint8_sint8.All_Maps_GRP.Maps_Raster_1 M_In_X.GRP_uint16_uint16_uint16.All_Maps_GRP.Maps_Raster_1 M_In_X.GRP_uint32_uint32_uint32.All_Maps_GRP.Maps_Raster_1 M_In_X.GRP_uint8_uint8_uint8.All_Maps_GRP.Maps_Raster_1 M_In_Y.GRP_float32_float32_float32.All_Maps_GRP.Maps_Raster_1 M_In_Y.GRP_sint16_sint16_sint16.All_Maps_GRP.Maps_Raster_1 M_In_Y.GRP_sint32_sint32_sint32.All_Maps_GRP.Maps_Raster_1 M_In_Y.GRP_sint8_sint8_sint8.All_Maps_GRP.Maps_Raster_1 M_In_Y.GRP_uint16_uint16_uint16.All_Maps_GRP.Maps_Raster_1 M_In_Y.GRP_uint32_uint32_uint32.All_Maps_GRP.Maps_Raster_1 M_In_Y.GRP_uint8_uint8_uint8.All_Maps_GRP.Maps_Raster_1 M_out.GRP_float32_float32_float32.All_Maps_GRP.Maps_Raster_1 M_out.GRP_sint16_sint16_sint16.All_Maps_GRP.Maps_Raster_1 M_out.GRP_sint32_sint32_sint32.All_Maps_GRP.Maps_Raster_1 M_out.GRP_sint8_sint8_sint8.All_Maps_GRP.Maps_Raster_1 M_out.GRP_uint16_uint16_uint16.All_Maps_GRP.Maps_Raster_1 M_out.GRP_uint32_uint32_uint32.All_Maps_GRP.Maps_Raster_1 M_out.GRP_uint8_uint8_uint8.All_Maps_GRP.Maps_Raster_1 /end REF_MEASUREMENT
 /begin REF_CHARACTERISTIC P_Do_Active_Grp.GRP_float32_float32_float32.All_Maps_GRP.Maps_Raster_1 P_Do_Active_Grp.GRP_sint16_sint16_sint16.All_Maps_GRP.Maps_Raster_1 P_Do_Active_Grp.GRP_sint32_sint32_sint32.All_Maps_GRP.Maps_Raster_1 P_Do_Active_Grp.GRP_sint8_sint8_sint8.All_Maps_GRP.Maps_Raster_1 P_Do_Active_Grp.GRP_uint16_uint16_uint16.All_Maps_GRP.Maps_Raster_1 P_Do_Active_Grp.GRP_uint32_uint32_uint32.All_Maps_GRP.Maps_Raster_1 P_Do_Active_Grp.GRP_uint8_uint8_uint8.All_Maps_GRP.Maps_Raster_1 P_Do_All_GRP_Maps.All_Maps_GRP.Maps_Raster_1 P_Do_GET.GRP_float32_float32_float32.All_Maps_GRP.Maps_Raster_1 P_Do_GET.GRP_sint16_sint16_sint16.All_Maps_GRP.Maps_Raster_1 P_Do_GET.GRP_sint32_sint32_sint32.All_Maps_GRP.Maps_Raster_1 P_Do_GET.GRP_sint8_sint8_sint8.All_Maps_GRP.Maps_Raster_1 P_Do_GET.GRP_uint16_uint16_uint16.All_Maps_GRP.Maps_Raster_1 P_Do_GET.GRP_uint32_uint32_uint32.All_Maps_GRP.Maps_Raster_1 P_Do_GET.GRP_uint8_uint8_uint8.All_Maps_GRP.Maps_Raster_1 P_Do_X_SET.GRP_float32_float32_float32.All_Maps_GRP.Maps_Raster_1 P_Do_X_SET.GRP_sint16_sint16_sint16.All_Maps_GRP.Maps_Raster_1 P_Do_X_SET.GRP_sint32_sint32_sint32.All_Maps_GRP.Maps_Raster_1 P_Do_X_SET.GRP_sint8_sint8_sint8.All_Maps_GRP.Maps_Raster_1 P_Do_X_SET.GRP_uint16_uint16_uint16.All_Maps_GRP.Maps_Raster_1 P_Do_X_SET.GRP_uint32_uint32_uint32.All_Maps_GRP.Maps_Raster_1 P_Do_X_SET.GRP_uint8_uint8_uint8.All_Maps_GRP.Maps_Raster_1 P_Do_Y_SET.GRP_float32_float32_float32.All_Maps_GRP.Maps_Raster_1 P_Do_Y_SET.GRP_sint16_sint16_sint16.All_Maps_GRP.Maps_Raster_1 P_Do_Y_SET.GRP_sint32_sint32_sint32.All_Maps_GRP.Maps_Raster_1 P_Do_Y_SET.GRP_sint8_sint8_sint8.All_Maps_GRP.Maps_Raster_1 P_Do_Y_SET.GRP_uint16_uint16_uint16.All_Maps_GRP.Maps_Raster_1 P_Do_Y_SET.GRP_uint32_uint32_uint32.All_Maps_GRP.Maps_Raster_1 P_Do_Y_SET.GRP_uint8_uint8_uint8.All_Maps_GRP.Maps_Raster_1 P_In_X.GRP_float32_float32_float32.All_Maps_GRP.Maps_Raster_1 P_In_X.GRP_sint16_sint16_sint16.All_Maps_GRP.Maps_Raster_1 P_In_X.GRP_sint32_sint32_sint32.All_Maps_GRP.Maps_Raster_1 P_In_X.GRP_sint8_sint8_sint8.All_Maps_GRP.Maps_Raster_1 P_In_X.GRP_uint16_uint16_uint16.All_Maps_GRP.Maps_Raster_1 P_In_X.GRP_uint32_uint32_uint32.All_Maps_GRP.Maps_Raster_1 P_In_X.GRP_uint8_uint8_uint8.All_Maps_GRP.Maps_Raster_1 P_In_Y.GRP_float32_float32_float32.All_Maps_GRP.Maps_Raster_1 P_In_Y.GRP_sint16_sint16_sint16.All_Maps_GRP.Maps_Raster_1 P_In_Y.GRP_sint32_sint32_sint32.All_Maps_GRP.Maps_Raster_1 P_In_Y.GRP_sint8_sint8_sint8.All_Maps_GRP.Maps_Raster_1 P_In_Y.GRP_uint16_uint16_uint16.All_Maps_GRP.Maps_Raster_1 P_In_Y.GRP_uint32_uint32_uint32.All_Maps_GRP.Maps_Raster_1 P_In_Y.GRP_uint8_uint8_uint8.All_Maps_GRP.Maps_Raster_1 Two_D.GRP_float32_float32_float32.All_Maps_GRP.Maps_Raster_1 Two_D.GRP_sint16_sint16_sint16.All_Maps_GRP.Maps_Raster_1 Two_D.GRP_sint32_sint32_sint32.All_Maps_GRP.Maps_Raster_1 Two_D.GRP_sint8_sint8_sint8.All_Maps_GRP.Maps_Raster_1 Two_D.GRP_uint16_uint16_uint16.All_Maps_GRP.Maps_Raster_1 Two_D.GRP_uint32_uint32_uint32.All_Maps_GRP.Maps_Raster_1 Two_D.GRP_uint8_uint8_uint8.All_Maps_GRP.Maps_Raster_1 /end REF_CHARACTERISTIC
 /begin SUB_GROUP GRP_float32_float32_float32.All_Maps_GRP.Maps_Raster_1 GRP_sint16_sint16_sint16.All_Maps_GRP.Maps_Raster_1 GRP_sint32_sint32_sint32.All_Maps_GRP.Maps_Raster_1 GRP_sint8_sint8_sint8.All_Maps_GRP.Maps_Raster_1 GRP_uint16_uint16_uint16.All_Maps_GRP.Maps_Raster_1 GRP_uint32_uint32_uint32.All_Maps_GRP.Maps_Raster_1 GRP_uint8_uint8_uint8.All_Maps_GRP.Maps_Raster_1 /end SUB_GROUP
/end GROUP
/begin GROUP All_Maps_GRP.Maps_Raster_2 ""
 /begin REF_MEASUREMENT Calculated.GRP_float32_float32_float32.All_Maps_GRP.Maps_Raster_2 Calculated.GRP_sint16_sint16_sint16.All_Maps_GRP.Maps_Raster_2 Calculated.GRP_sint32_sint32_sint32.All_Maps_GRP.Maps_Raster_2 Calculated.GRP_sint8_sint8_sint8.All_Maps_GRP.Maps_Raster_2 Calculated.GRP_uint16_uint16_uint16.All_Maps_GRP.Maps_Raster_2 Calculated.GRP_uint32_uint32_uint32.All_Maps_GRP.Maps_Raster_2 Calculated.GRP_uint8_uint8_uint8.All_Maps_GRP.Maps_Raster_2 M_In_X.GRP_float32_float32_float32.All_Maps_GRP.Maps_Raster_2 M_In_X.GRP_sint16_sint16_sint16.All_Maps_GRP.Maps_Raster_2 M_In_X.GRP_sint32_sint32_sint32.All_Maps_GRP.Maps_Raster_2 M_In_X.GRP_sint8_sint8_sint8.All_Maps_GRP.Maps_Raster_2 M_In_X.GRP_uint16_uint16_uint16.All_Maps_GRP.Maps_Raster_2 M_In_X.GRP_uint32_uint32_uint32.All_Maps_GRP.Maps_Raster_2 M_In_X.GRP_uint8_uint8_uint8.All_Maps_GRP.Maps_Raster_2 M_In_Y.GRP_float32_float32_float32.All_Maps_GRP.Maps_Raster_2 M_In_Y.GRP_sint16_sint16_sint16.All_Maps_GRP.Maps_Raster_2 M_In_Y.GRP_sint32_sint32_sint32.All_Maps_GRP.Maps_Raster_2 M_In_Y.GRP_sint8_sint8_sint8.All_Maps_GRP.Maps_Raster_2 M_In_Y.GRP_uint16_uint16_uint16.All_Maps_GRP.Maps_Raster_2 M_In_Y.GRP_uint32_uint32_uint32.All_Maps_GRP.Maps_Raster_2 M_In_Y.GRP_uint8_uint8_uint8.All_Maps_GRP.Maps_Raster_2 M_out.GRP_float32_float32_float32.All_Maps_GRP.Maps_Raster_2 M_out.GRP_sint16_sint16_sint16.All_Maps_GRP.Maps_Raster_2 M_out.GRP_sint32_sint32_sint32.All_Maps_GRP.Maps_Raster_2 M_out.GRP_sint8_sint8_sint8.All_Maps_GRP.Maps_Raster_2 M_out.GRP_uint16_uint16_uint16.All_Maps_GRP.Maps_Raster_2 M_out.GRP_uint32_uint32_uint32.All_Maps_GRP.Maps_Raster_2 M_out.GRP_uint8_uint8_uint8.All_Maps_GRP.Maps_Raster_2 /end REF_MEASUREMENT
 /begin REF_CHARACTERISTIC P_Do_Active_Grp.GRP_float32_float32_float32.All_Maps_GRP.Maps_Raster_2 P_Do_Active_Grp.GRP_sint16_sint16_sint16.All_Maps_GRP.Maps_Raster_2 P_Do_Active_Grp.GRP_sint32_sint32_sint32.All_Maps_GRP.Maps_Raster_2 P_Do_Active_Grp.GRP_sint8_sint8_sint8.All_Maps_GRP.Maps_Raster_2 P_Do_Active_Grp.GRP_uint16_uint16_uint16.All_Maps_GRP.Maps_Raster_2 P_Do_Active_Grp.GRP_uint32_uint32_uint32.All_Maps_GRP.Maps_Raster_2 P_Do_Active_Grp.GRP_uint8_uint8_uint8.All_Maps_GRP.Maps_Raster_2 P_Do_All_GRP_Maps.All_Maps_GRP.Maps_Raster_2 P_Do_GET.GRP_float32_float32_float32.All_Maps_GRP.Maps_Raster_2 P_Do_GET.GRP_sint16_sint16_sint16.All_Maps_GRP.Maps_Raster_2 P_Do_GET.GRP_sint32_sint32_sint32.All_Maps_GRP.Maps_Raster_2 P_Do_GET.GRP_sint8_sint8_sint8.All_Maps_GRP.Maps_Raster_2 P_Do_GET.GRP_uint16_uint16_uint16.All_Maps_GRP.Maps_Raster_2 P_Do_GET.GRP_uint32_uint32_uint32.All_Maps_GRP.Maps_Raster_2 P_Do_GET.GRP_uint8_uint8_uint8.All_Maps_GRP.Maps_Raster_2 P_Do_X_SET.GRP_float32_float32_float32.All_Maps_GRP.Maps_Raster_2 P_Do_X_SET.GRP_sint16_sint16_sint16.All_Maps_GRP.Maps_Raster_2 P_Do_X_SET.GRP_sint32_sint32_sint32.All_Maps_GRP.Maps_Raster_2 P_Do_X_SET.GRP_sint8_sint8_sint8.All_Maps_GRP.Maps_Raster_2 P_Do_X_SET.GRP_uint16_uint16_uint16.All_Maps_GRP.Maps_Raster_2 P_Do_X_SET.GRP_uint32_uint32_uint32.All_Maps_GRP.Maps_Raster_2 P_Do_X_SET.GRP_uint8_uint8_uint8.All_Maps_GRP.Maps_Raster_2 P_Do_Y_SET.GRP_float32_float32_float32.All_Maps_GRP.Maps_Raster_2 P_Do_Y_SET.GRP_sint16_sint16_sint16.All_Maps_GRP.Maps_Raster_2 P_Do_Y_SET.GRP_sint32_sint32_sint32.All_Maps_GRP.Maps_Raster_2 P_Do_Y_SET.GRP_sint8_sint8_sint8.All_Maps_GRP.Maps_Raster_2 P_Do_Y_SET.GRP_uint16_uint16_uint16.All_Maps_GRP.Maps_Raster_2 P_Do_Y_SET.GRP_uint32_uint32_uint32.All_Maps_GRP.Maps_Raster_2 P_Do_Y_SET.GRP_uint8_uint8_uint8.All_Maps_GRP.Maps_Raster_2 P_In_X.GRP_float32_float32_float32.All_Maps_GRP.Maps_Raster_2 P_In_X.GRP_sint16_sint16_sint16.All_Maps_GRP.Maps_Raster_2 P_In_X.GRP_sint32_sint32_sint32.All_Maps_GRP.Maps_Raster_2 P_In_X.GRP_sint8_sint8_sint8.All_Maps_GRP.Maps_Raster_2 P_In_X.GRP_uint16_uint16_uint16.All_Maps_GRP.Maps_Raster_2 P_In_X.GRP_uint32_uint32_uint32.All_Maps_GRP.Maps_Raster_2 P_In_X.GRP_uint8_uint8_uint8.All_Maps_GRP.Maps_Raster_2 P_In_Y.GRP_float32_float32_float32.All_Maps_GRP.Maps_Raster_2 P_In_Y.GRP_sint16_sint16_sint16.All_Maps_GRP.Maps_Raster_2 P_In_Y.GRP_sint32_sint32_sint32.All_Maps_GRP.Maps_Raster_2 P_In_Y.GRP_sint8_sint8_sint8.All_Maps_GRP.Maps_Raster_2 P_In_Y.GRP_uint16_uint16_uint16.All_Maps_GRP.Maps_Raster_2 P_In_Y.GRP_uint32_uint32_uint32.All_Maps_GRP.Maps_Raster_2 P_In_Y.GRP_uint8_uint8_uint8.All_Maps_GRP.Maps_Raster_2 Two_D.GRP_float32_float32_float32.All_Maps_GRP.Maps_Raster_2 Two_D.GRP_sint16_sint16_sint16.All_Maps_GRP.Maps_Raster_2 Two_D.GRP_sint32_sint32_sint32.All_Maps_GRP.Maps_Raster_2 Two_D.GRP_sint8_sint8_sint8.All_Maps_GRP.Maps_Raster_2 Two_D.GRP_uint16_uint16_uint16.All_Maps_GRP.Maps_Raster_2 Two_D.GRP_uint32_uint32_uint32.All_Maps_GRP.Maps_Raster_2 Two_D.GRP_uint8_uint8_uint8.All_Maps_GRP.Maps_Raster_2 /end REF_CHARACTERISTIC
 /begin SUB_GROUP GRP_float32_float32_float32.All_Maps_GRP.Maps_Raster_2 GRP_sint16_sint16_sint16.All_Maps_GRP.Maps_Raster_2 GRP_sint32_sint32_sint32.All_Maps_GRP.Maps_Raster_2 GRP_sint8_sint8_sint8.All_Maps_GRP.Maps_Raster_2 GRP_uint16_uint16_uint16.All_Maps_GRP.Maps_Raster_2 GRP_uint32_uint32_uint32.All_Maps_GRP.Maps_Raster_2 GRP_uint8_uint8_uint8.All_Maps_GRP.Maps_Raster_2 /end SUB_GROUP
/end GROUP
/begin GROUP Curves_Raster_2 "" ROOT
 /begin REF_MEASUREMENT Calculated.STD_sint16_sint16.All_Curves_STD.Curves_Raster_2 Calculated.STD_sint32_sint32.All_Curves_STD.Curves_Raster_2 Calculated.STD_sint8_sint8.All_Curves_STD.Curves_Raster_2 Calculated.STD_uint16_uint16.All_Curves_STD.Curves_Raster_2 Calculated.STD_uint32_uint32.All_Curves_STD.Curves_Raster_2 Calculated.STD_uint8_uint8.All_Curves_STD.Curves_Raster_2 M_In.STD_sint16_sint16.All_Curves_STD.Curves_Raster_2 M_In.STD_sint32_sint32.All_Curves_STD.Curves_Raster_2 M_In.STD_sint8_sint8.All_Curves_STD.Curves_Raster_2 M_In.STD_uint16_uint16.All_Curves_STD.Curves_Raster_2 M_In.STD_uint32_uint32.All_Curves_STD.Curves_Raster_2 M_In.STD_uint8_uint8.All_Curves_STD.Curves_Raster_2 M_out.STD_sint16_sint16.All_Curves_STD.Curves_Raster_2 M_out.STD_sint32_sint32.All_Curves_STD.Curves_Raster_2 M_out.STD_sint8_sint8.All_Curves_STD.Curves_Raster_2 M_out.STD_uint16_uint16.All_Curves_STD.Curves_Raster_2 M_out.STD_uint32_uint32.All_Curves_STD.Curves_Raster_2 M_out.STD_uint8_uint8.All_Curves_STD.Curves_Raster_2 /end REF_MEASUREMENT
 /begin REF_CHARACTERISTIC One_D.STD_sint16_sint16.All_Curves_STD.Curves_Raster_2 One_D.STD_sint32_sint32.All_Curves_STD.Curves_Raster_2 One_D.STD_sint8_sint8.All_Curves_STD.Curves_Raster_2 One_D.STD_uint16_uint16.All_Curves_STD.Curves_Raster_2 One_D.STD_uint32_uint32.All_Curves_STD.Curves_Raster_2 One_D.STD_uint8_uint8.All_Curves_STD.Curves_Raster_2 P_Do_Active_Std.STD_sint16_sint16.All_Curves_STD.Curves_Raster_2 P_Do_Active_Std.STD_sint32_sint32.All_Curves_STD.Curves_Raster_2 P_Do_Active_Std.STD_sint8_sint8.All_Curves_STD.Curves_Raster_2 P_Do_Active_Std.STD_uint16_uint16.All_Curves_STD.Curves_Raster_2 P_Do_Active_Std.STD_uint32_uint32.All_Curves_STD.Curves_Raster_2 P_Do_Active_Std.STD_uint8_uint8.All_Curves_STD.Curves_Raster_2 P_Do_All_STD_Curves.All_Curves_STD.Curves_Raster_2 P_In.STD_sint16_sint16.All_Curves_STD.Curves_Raster_2 P_In.STD_sint32_sint32.All_Curves_STD.Curves_Raster_2 P_In.STD_sint8_sint8.All_Curves_STD.Curves_Raster_2 P_In.STD_uint16_uint16.All_Curves_STD.Curves_Raster_2 P_In.STD_uint32_uint32.All_Curves_STD.Curves_Raster_2 P_In.STD_uint8_uint8.All_Curves_STD.Curves_Raster_2 /end REF_CHARACTERISTIC
/end GROUP
/begin GROUP Curves_Raster_3 "" ROOT
 /begin REF_MEASUREMENT Calculated.STD_sint16_sint16.All_Curves_STD.Curves_Raster_3 Calculated.STD_sint32_sint32.All_Curves_STD.Curves_Raster_3 Calculated.STD_sint8_sint8.All_Curves_STD.Curves_Raster_3 Calculated.STD_uint16_uint16.All_Curves_STD.Curves_Raster_3 Calculated.STD_uint32_uint32.All_Curves_STD.Curves_Raster_3 Calculated.STD_uint8_uint8.All_Curves_STD.Curves_Raster_3 M_In.STD_sint16_sint16.All_Curves_STD.Curves_Raster_3 M_In.STD_sint32_sint32.All_Curves_STD.Curves_Raster_3 M_In.STD_sint8_sint8.All_Curves_STD.Curves_Raster_3 M_In.STD_uint16_uint16.All_Curves_STD.Curves_Raster_3 M_In.STD_uint32_uint32.All_Curves_STD.Curves_Raster_3 M_In.STD_uint8_uint8.All_Curves_STD.Curves_Raster_3 M_out.STD_sint16_sint16.All_Curves_STD.Curves_Raster_3 M_out.STD_sint32_sint32.All_Curves_STD.Curves_Raster_3 M_out.STD_sint8_sint8.All_Curves_STD.Curves_Raster_3 M_out.STD_uint16_uint16.All_Curves_STD.Curves_Raster_3 M_out.STD_uint32_uint32.All_Curves_STD.Curves_Raster_3 M_out.STD_uint8_uint8.All_Curves_STD.Curves_Raster_3 /end REF_MEASUREMENT
 /begin REF_CHARACTERISTIC One_D.STD_sint16_sint16.All_Curves_STD.Curves_Raster_3 One_D.STD_sint32_sint32.All_Curves_STD.Curves_Raster_3 One_D.STD_sint8_sint8.All_Curves_STD.Curves_Raster_3 One_D.STD_uint16_uint16.All_Curves_STD.Curves_Raster_3 One_D.STD_uint32_uint32.All_Curves_STD.Curves_Raster_3 One_D.STD_uint8_uint8.All_Curves_STD.Curves_Raster_3 P_Do_Active_Std.STD_sint16_sint16.All_Curves_STD.Curves_Raster_3 P_Do_Active_Std.STD_sint32_sint32.All_Curves_STD.Curves_Raster_3 P_Do_Active_Std.STD_sint8_sint8.All_Curves_STD.Curves_Raster_3 P_Do_Active_Std.STD_uint16_uint16.All_Curves_STD.Curves_Raster_3 P_Do_Active_Std.STD_uint32_uint32.All_Curves_STD.Curves_Raster_3 P_Do_Active_Std.STD_uint8_uint8.All_Curves_STD.Curves_Raster_3 P_Do_All_STD_Curves.All_Curves_STD.Curves_Raster_3 P_In.STD_sint16_sint16.All_Curves_STD.Curves_Raster_3 P_In.STD_sint32_sint32.All_Curves_STD.Curves_Raster_3 P_In.STD_sint8_sint8.All_Curves_STD.Curves_Raster_3 P_In.STD_uint16_uint16.All_Curves_STD.Curves_Raster_3 P_In.STD_uint32_uint32.All_Curves_STD.Curves_Raster_3 P_In.STD_uint8_uint8.All_Curves_STD.Curves_Raster_3 /end REF_CHARACTERISTIC
/end GROUP
/begin GROUP FIX_float32_float32_float32.All_Maps_FIX.Maps_Raster_1 ""
 /begin REF_MEASUREMENT Calculated.FIX_float32_float32_float32.All_Maps_FIX.Maps_Raster_1 M_In_X.FIX_float32_float32_float32.All_Maps_FIX.Maps_Raster_1 M_In_Y.FIX_float32_float32_float32.All_Maps_FIX.Maps_Raster_1 M_out.FIX_float32_float32_float32.All_Maps_FIX.Maps_Raster_1 /end REF_MEASUREMENT
 /begin REF_CHARACTERISTIC P_Do_Active_Std.FIX_float32_float32_float32.All_Maps_FIX.Maps_Raster_1 P_In_X.FIX_float32_float32_float32.All_Maps_FIX.Maps_Raster_1 P_In_Y.FIX_float32_float32_float32.All_Maps_FIX.Maps_Raster_1 Two_D.FIX_float32_float32_float32.All_Maps_FIX.Maps_Raster_1 /end REF_CHARACTERISTIC
/end GROUP
/begin GROUP FIX_float32_float32_float32.All_Maps_FIX.Maps_Raster_2 ""
 /begin REF_MEASUREMENT Calculated.FIX_float32_float32_float32.All_Maps_FIX.Maps_Raster_2 M_In_X.FIX_float32_float32_float32.All_Maps_FIX.Maps_Raster_2 M_In_Y.FIX_float32_float32_float32.All_Maps_FIX.Maps_Raster_2 M_out.FIX_float32_float32_float32.All_Maps_FIX.Maps_Raster_2 /end REF_MEASUREMENT
 /begin REF_CHARACTERISTIC P_Do_Active_Std.FIX_float32_float32_float32.All_Maps_FIX.Maps_Raster_2 P_In_X.FIX_float32_float32_float32.All_Maps_FIX.Maps_Raster_2 P_In_Y.FIX_float32_float32_float32.All_Maps_FIX.Maps_Raster_2 Two_D.FIX_float32_float32_float32.All_Maps_FIX.Maps_Raster_2 /end REF_CHARACTERISTIC
/end GROUP
/begin GROUP FIX_float32_float32_float32.All_Maps_FIX.Maps_Raster_3 ""
 /begin REF_MEASUREMENT Calculated.FIX_float32_float32_float32.All_Maps_FIX.Maps_Raster_3 M_In_X.FIX_float32_float32_float32.All_Maps_FIX.Maps_Raster_3 M_In_Y.FIX_float32_float32_float32.All_Maps_FIX.Maps_Raster_3 M_out.FIX_float32_float32_float32.All_Maps_FIX.Maps_Raster_3 /end REF_MEASUREMENT
 /begin REF_CHARACTERISTIC P_Do_Active_Std.FIX_float32_float32_float32.All_Maps_FIX.Maps_Raster_3 P_In_X.FIX_float32_float32_float32.All_Maps_FIX.Maps_Raster_3 P_In_Y.FIX_float32_float32_float32.All_Maps_FIX.Maps_Raster_3 Two_D.FIX_float32_float32_float32.All_Maps_FIX.Maps_Raster_3 /end REF_CHARACTERISTIC
/end GROUP
/begin GROUP FIX_sint16_sint16_sint16.All_Maps_FIX.Maps_Raster_1 ""
 /begin REF_MEASUREMENT Calculated.FIX_sint16_sint16_sint16.All_Maps_FIX.Maps_Raster_1 M_In_X.FIX_sint16_sint16_sint16.All_Maps_FIX.Maps_Raster_1 M_In_Y.FIX_sint16_sint16_sint16.All_Maps_FIX.Maps_Raster_1 M_out.FIX_sint16_sint16_sint16.All_Maps_FIX.Maps_Raster_1 /end REF_MEASUREMENT
 /begin REF_CHARACTERISTIC P_Do_Active_Std.FIX_sint16_sint16_sint16.All_Maps_FIX.Maps_Raster_1 P_In_X.FIX_sint16_sint16_sint16.All_Maps_FIX.Maps_Raster_1 P_In_Y.FIX_sint16_sint16_sint16.All_Maps_FIX.Maps_Raster_1 Two_D.FIX_sint16_sint16_sint16.All_Maps_FIX.Maps_Raster_1 /end REF_CHARACTERISTIC
/end GROUP
/begin GROUP FIX_sint16_sint16_sint16.All_Maps_FIX.Maps_Raster_2 ""
 /begin REF_MEASUREMENT Calculated.FIX_sint16_sint16_sint16.All_Maps_FIX.Maps_Raster_2 M_In_X.FIX_sint16_sint16_sint16.All_Maps_FIX.Maps_Raster_2 M_In_Y.FIX_sint16_sint16_sint16.All_Maps_FIX.Maps_Raster_2 M_out.FIX_sint16_sint16_sint16.All_Maps_FIX.Maps_Raster_2 /end REF_MEASUREMENT
 /begin REF_CHARACTERISTIC P_Do_Active_Std.FIX_sint16_sint16_sint16.All_Maps_FIX.Maps_Raster_2 P_In_X.FIX_sint16_sint16_sint16.All_Maps_FIX.Maps_Raster_2 P_In_Y.FIX_sint16_sint16_sint16.All_Maps_FIX.Maps_Raster_2 Two_D.FIX_sint16_sint16_sint16.All_Maps_FIX.Maps_Raster_2 /end REF_CHARACTERISTIC
/end GROUP
/begin GROUP FIX_sint16_sint16_sint16.All_Maps_FIX.Maps_Raster_3 ""
 /begin REF_MEASUREMENT Calculated.FIX_sint16_sint16_sint16.All_Maps_FIX.Maps_Raster_3 M_In_X.FIX_sint16_sint16_sint16.All_Maps_FIX.Maps_Raster_3 M_In_Y.FIX_sint16_sint16_sint16.All_Maps_FIX.Maps_Raster_3 M_out.FIX_sint16_sint16_sint16.All_Maps_FIX.Maps_Raster_3 /end REF_MEASUREMENT
 /begin REF_CHARACTERISTIC P_Do_Active_Std.FIX_sint16_sint16_sint16.All_Maps_FIX.Maps_Raster_3 P_In_X.FIX_sint16_sint16_sint16.All_Maps_FIX.Maps_Raster_3 P_In_Y.FIX_sint16_sint16_sint16.All_Maps_FIX.Maps_Raster_3 Two_D.FIX_sint16_sint16_sint16.All_Maps_FIX.Maps_Raster_3 /end REF_CHARACTERISTIC
/end GROUP
/begin GROUP FIX_sint32_sint32_sint32.All_Maps_FIX.Maps_Raster_1 ""
 /begin REF_MEASUREMENT Calculated.FIX_sint32_sint32_sint32.All_Maps_FIX.Maps_Raster_1 M_In_X.FIX_sint32_sint32_sint32.All_Maps_FIX.Maps_Raster_1 M_In_Y.FIX_sint32_sint32_sint32.All_Maps_FIX.Maps_Raster_1 M_out.FIX_sint32_sint32_sint32.All_Maps_FIX.Maps_Raster_1 /end REF_MEASUREMENT
 /begin REF_CHARACTERISTIC P_Do_Active_Std.FIX_sint32_sint32_sint32.All_Maps_FIX.Maps_Raster_1 P_In_X.FIX_sint32_sint32_sint32.All_Maps_FIX.Maps_Raster_1 P_In_Y.FIX_sint32_sint32_sint32.All_Maps_FIX.Maps_Raster_1 Two_D.FIX_sint32_sint32_sint32.All_Maps_FIX.Maps_Raster_1 /end REF_CHARACTERISTIC
/end GROUP
/begin GROUP FIX_sint32_sint32_sint32.All_Maps_FIX.Maps_Raster_2 ""
 /begin REF_MEASUREMENT Calculated.FIX_sint32_sint32_sint32.All_Maps_FIX.Maps_Raster_2 M_In_X.FIX_sint32_sint32_sint32.All_Maps_FIX.Maps_Raster_2 M_In_Y.FIX_sint32_sint32_sint32.All_Maps_FIX.Maps_Raster_2 M_out.FIX_sint32_sint32_sint32.All_Maps_FIX.Maps_Raster_2 /end REF_MEASUREMENT
 /begin REF_CHARACTERISTIC P_Do_Active_Std.FIX_sint32_sint32_sint32.All_Maps_FIX.Maps_Raster_2 P_In_X.FIX_sint32_sint32_sint32.All_Maps_FIX.Maps_Raster_2 P_In_Y.FIX_sint32_sint32_sint32.All_Maps_FIX.Maps_Raster_2 Two_D.FIX_sint32_sint32_sint32.All_Maps_FIX.Maps_Raster_2 /end REF_CHARACTERISTIC
/end GROUP
/begin GROUP FIX_sint32_sint32_sint32.All_Maps_FIX.Maps_Raster_3 ""
 /begin REF_MEASUREMENT Calculated.FIX_sint32_sint32_sint32.All_Maps_FIX.Maps_Raster_3 M_In_X.FIX_sint32_sint32_sint32.All_Maps_FIX.Maps_Raster_3 M_In_Y.FIX_sint32_sint32_sint32.All_Maps_FIX.Maps_Raster_3 M_out.FIX_sint32_sint32_sint32.All_Maps_FIX.Maps_Raster_3 /end REF_MEASUREMENT
 /begin REF_CHARACTERISTIC P_Do_Active_Std.FIX_sint32_sint32_sint32.All_Maps_FIX.Maps_Raster_3 P_In_X.FIX_sint32_sint32_sint32.All_Maps_FIX.Maps_Raster_3 P_In_Y.FIX_sint32_sint32_sint32.All_Maps_FIX.Maps_Raster_3 Two_D.FIX_sint32_sint32_sint32.All_Maps_FIX.Maps_Raster_3 /end REF_CHARACTERISTIC
/end GROUP
/begin GROUP FIX_sint8_sint8_sint8.All_Maps_FIX.Maps_Raster_1 ""
 /begin REF_MEASUREMENT Calculated.FIX_sint8_sint8_sint8.All_Maps_FIX.Maps_Raster_1 M_In_X.FIX_sint8_sint8_sint8.All_Maps_FIX.Maps_Raster_1 M_In_Y.FIX_sint8_sint8_sint8.All_Maps_FIX.Maps_Raster_1 M_out.FIX_sint8_sint8_sint8.All_Maps_FIX.Maps_Raster_1 /end REF_MEASUREMENT
 /begin REF_CHARACTERISTIC P_Do_Active_Std.FIX_sint8_sint8_sint8.All_Maps_FIX.Maps_Raster_1 P_In_X.FIX_sint8_sint8_sint8.All_Maps_FIX.Maps_Raster_1 P_In_Y.FIX_sint8_sint8_sint8.All_Maps_FIX.Maps_Raster_1 Two_D.FIX_sint8_sint8_sint8.All_Maps_FIX.Maps_Raster_1 /end REF_CHARACTERISTIC
/end GROUP
/begin GROUP FIX_sint8_sint8_sint8.All_Maps_FIX.Maps_Raster_2 ""
 /begin REF_MEASUREMENT Calculated.FIX_sint8_sint8_sint8.All_Maps_FIX.Maps_Raster_2 M_In_X.FIX_sint8_sint8_sint8.All_Maps_FIX.Maps_Raster_2 M_In_Y.FIX_sint8_sint8_sint8.All_Maps_FIX.Maps_Raster_2 M_out.FIX_sint8_sint8_sint8.All_Maps_FIX.Maps_Raster_2 /end REF_MEASUREMENT
 /begin REF_CHARACTERISTIC P_Do_Active_Std.FIX_sint8_sint8_sint8.All_Maps_FIX.Maps_Raster_2 P_In_X.FIX_sint8_sint8_sint8.All_Maps_FIX.Maps_Raster_2 P_In_Y.FIX_sint8_sint8_sint8.All_Maps_FIX.Maps_Raster_2 Two_D.FIX_sint8_sint8_sint8.All_Maps_FIX.Maps_Raster_2 /end REF_CHARACTERISTIC
/end GROUP
/begin GROUP FIX_sint8_sint8_sint8.All_Maps_FIX.Maps_Raster_3 ""
 /begin REF_MEASUREMENT Calculated.FIX_sint8_sint8_sint8.All_Maps_FIX.Maps_Raster_3 M_In_X.FIX_sint8_sint8_sint8.All_Maps_FIX.Maps_Raster_3 M_In_Y.FIX_sint8_sint8_sint8.All_Maps_FIX.Maps_Raster_3 M_out.FIX_sint8_sint8_sint8.All_Maps_FIX.Maps_Raster_3 /end REF_MEASUREMENT
 /begin REF_CHARACTERISTIC P_Do_Active_Std.FIX_sint8_sint8_sint8.All_Maps_FIX.Maps_Raster_3 P_In_X.FIX_sint8_sint8_sint8.All_Maps_FIX.Maps_Raster_3 P_In_Y.FIX_sint8_sint8_sint8.All_Maps_FIX.Maps_Raster_3 Two_D.FIX_sint8_sint8_sint8.All_Maps_FIX.Maps_Raster_3 /end REF_CHARACTERISTIC
/end GROUP
/begin GROUP FIX_uint16_uint16_uint16.All_Maps_FIX.Maps_Raster_1 ""
 /begin REF_MEASUREMENT Calculated.FIX_uint16_uint16_uint16.All_Maps_FIX.Maps_Raster_1 M_In_X.FIX_uint16_uint16_uint16.All_Maps_FIX.Maps_Raster_1 M_In_Y.FIX_uint16_uint16_uint16.All_Maps_FIX.Maps_Raster_1 M_out.FIX_uint16_uint16_uint16.All_Maps_FIX.Maps_Raster_1 /end REF_MEASUREMENT
 /begin REF_CHARACTERISTIC P_Do_Active_Std.FIX_uint16_uint16_uint16.All_Maps_FIX.Maps_Raster_1 P_In_X.FIX_uint16_uint16_uint16.All_Maps_FIX.Maps_Raster_1 P_In_Y.FIX_uint16_uint16_uint16.All_Maps_FIX.Maps_Raster_1 Two_D.FIX_uint16_uint16_uint16.All_Maps_FIX.Maps_Raster_1 /end REF_CHARACTERISTIC
/end GROUP
/begin GROUP FIX_uint16_uint16_uint16.All_Maps_FIX.Maps_Raster_2 ""
 /begin REF_MEASUREMENT Calculated.FIX_uint16_uint16_uint16.All_Maps_FIX.Maps_Raster_2 M_In_X.FIX_uint16_uint16_uint16.All_Maps_FIX.Maps_Raster_2 M_In_Y.FIX_uint16_uint16_uint16.All_Maps_FIX.Maps_Raster_2 M_out.FIX_uint16_uint16_uint16.All_Maps_FIX.Maps_Raster_2 /end REF_MEASUREMENT
 /begin REF_CHARACTERISTIC P_Do_Active_Std.FIX_uint16_uint16_uint16.All_Maps_FIX.Maps_Raster_2 P_In_X.FIX_uint16_uint16_uint16.All_Maps_FIX.Maps_Raster_2 P_In_Y.FIX_uint16_uint16_uint16.All_Maps_FIX.Maps_Raster_2 Two_D.FIX_uint16_uint16_uint16.All_Maps_FIX.Maps_Raster_2 /end REF_CHARACTERISTIC
/end GROUP
/begin GROUP FIX_uint16_uint16_uint16.All_Maps_FIX.Maps_Raster_3 ""
 /begin REF_MEASUREMENT Calculated.FIX_uint16_uint16_uint16.All_Maps_FIX.Maps_Raster_3 M_In_X.FIX_uint16_uint16_uint16.All_Maps_FIX.Maps_Raster_3 M_In_Y.FIX_uint16_uint16_uint16.All_Maps_FIX.Maps_Raster_3 M_out.FIX_uint16_uint16_uint16.All_Maps_FIX.Maps_Raster_3 /end REF_MEASUREMENT
 /begin REF_CHARACTERISTIC P_Do_Active_Std.FIX_uint16_uint16_uint16.All_Maps_FIX.Maps_Raster_3 P_In_X.FIX_uint16_uint16_uint16.All_Maps_FIX.Maps_Raster_3 P_In_Y.FIX_uint16_uint16_uint16.All_Maps_FIX.Maps_Raster_3 Two_D.FIX_uint16_uint16_uint16.All_Maps_FIX.Maps_Raster_3 /end REF_CHARACTERISTIC
/end GROUP
/begin GROUP FIX_uint32_uint32_uint32.All_Maps_FIX.Maps_Raster_1 ""
 /begin REF_MEASUREMENT Calculated.FIX_uint32_uint32_uint32.All_Maps_FIX.Maps_Raster_1 M_In_X.FIX_uint32_uint32_uint32.All_Maps_FIX.Maps_Raster_1 M_In_Y.FIX_uint32_uint32_uint32.All_Maps_FIX.Maps_Raster_1 M_out.FIX_uint32_uint32_uint32.All_Maps_FIX.Maps_Raster_1 /end REF_MEASUREMENT
 /begin REF_CHARACTERISTIC P_Do_Active_Std.FIX_uint32_uint32_uint32.All_Maps_FIX.Maps_Raster_1 P_In_X.FIX_uint32_uint32_uint32.All_Maps_FIX.Maps_Raster_1 P_In_Y.FIX_uint32_uint32_uint32.All_Maps_FIX.Maps_Raster_1 Two_D.FIX_uint32_uint32_uint32.All_Maps_FIX.Maps_Raster_1 /end REF_CHARACTERISTIC
/end GROUP
/begin GROUP FIX_uint32_uint32_uint32.All_Maps_FIX.Maps_Raster_2 ""
 /begin REF_MEASUREMENT Calculated.FIX_uint32_uint32_uint32.All_Maps_FIX.Maps_Raster_2 M_In_X.FIX_uint32_uint32_uint32.All_Maps_FIX.Maps_Raster_2 M_In_Y.FIX_uint32_uint32_uint32.All_Maps_FIX.Maps_Raster_2 M_out.FIX_uint32_uint32_uint32.All_Maps_FIX.Maps_Raster_2 /end REF_MEASUREMENT
 /begin REF_CHARACTERISTIC P_Do_Active_Std.FIX_uint32_uint32_uint32.All_Maps_FIX.Maps_Raster_2 P_In_X.FIX_uint32_uint32_uint32.All_Maps_FIX.Maps_Raster_2 P_In_Y.FIX_uint32_uint32_uint32.All_Maps_FIX.Maps_Raster_2 Two_D.FIX_uint32_uint32_uint32.All_Maps_FIX.Maps_Raster_2 /end REF_CHARACTERISTIC
/end GROUP
/begin GROUP FIX_uint32_uint32_uint32.All_Maps_FIX.Maps_Raster_3 ""
 /begin REF_MEASUREMENT Calculated.FIX_uint32_uint32_uint32.All_Maps_FIX.Maps_Raster_3 M_In_X.FIX_uint32_uint32_uint32.All_Maps_FIX.Maps_Raster_3 M_In_Y.FIX_uint32_uint32_uint32.All_Maps_FIX.Maps_Raster_3 M_out.FIX_uint32_uint32_uint32.All_Maps_FIX.Maps_Raster_3 /end REF_MEASUREMENT
 /begin REF_CHARACTERISTIC P_Do_Active_Std.FIX_uint32_uint32_uint32.All_Maps_FIX.Maps_Raster_3 P_In_X.FIX_uint32_uint32_uint32.All_Maps_FIX.Maps_Raster_3 P_In_Y.FIX_uint32_uint32_uint32.All_Maps_FIX.Maps_Raster_3 Two_D.FIX_uint32_uint32_uint32.All_Maps_FIX.Maps_Raster_3 /end REF_CHARACTERISTIC
/end GROUP
/begin GROUP FIX_uint8_uint8_uint8.All_Maps_FIX.Maps_Raster_1 ""
 /begin REF_MEASUREMENT Calculated.FIX_uint8_uint8_uint8.All_Maps_FIX.Maps_Raster_1 M_In_X.FIX_uint8_uint8_uint8.All_Maps_FIX.Maps_Raster_1 M_In_Y.FIX_uint8_uint8_uint8.All_Maps_FIX.Maps_Raster_1 M_out.FIX_uint8_uint8_uint8.All_Maps_FIX.Maps_Raster_1 /end REF_MEASUREMENT
 /begin REF_CHARACTERISTIC P_Do_Active_Std.FIX_uint8_uint8_uint8.All_Maps_FIX.Maps_Raster_1 P_In_X.FIX_uint8_uint8_uint8.All_Maps_FIX.Maps_Raster_1 P_In_Y.FIX_uint8_uint8_uint8.All_Maps_FIX.Maps_Raster_1 Two_D.FIX_uint8_uint8_uint8.All_Maps_FIX.Maps_Raster_1 /end REF_CHARACTERISTIC
/end GROUP
/begin GROUP FIX_uint8_uint8_uint8.All_Maps_FIX.Maps_Raster_2 ""
 /begin REF_MEASUREMENT Calculated.FIX_uint8_uint8_uint8.All_Maps_FIX.Maps_Raster_2 M_In_X.FIX_uint8_uint8_uint8.All_Maps_FIX.Maps_Raster_2 M_In_Y.FIX_uint8_uint8_uint8.All_Maps_FIX.Maps_Raster_2 M_out.FIX_uint8_uint8_uint8.All_Maps_FIX.Maps_Raster_2 /end REF_MEASUREMENT
 /begin REF_CHARACTERISTIC P_Do_Active_Std.FIX_uint8_uint8_uint8.All_Maps_FIX.Maps_Raster_2 P_In_X.FIX_uint8_uint8_uint8.All_Maps_FIX.Maps_Raster_2 P_In_Y.FIX_uint8_uint8_uint8.All_Maps_FIX.Maps_Raster_2 Two_D.FIX_uint8_uint8_uint8.All_Maps_FIX.Maps_Raster_2 /end REF_CHARACTERISTIC
/end GROUP
/begin GROUP FIX_uint8_uint8_uint8.All_Maps_FIX.Maps_Raster_3 ""
 /begin REF_MEASUREMENT Calculated.FIX_uint8_uint8_uint8.All_Maps_FIX.Maps_Raster_3 M_In_X.FIX_uint8_uint8_uint8.All_Maps_FIX.Maps_Raster_3 M_In_Y.FIX_uint8_uint8_uint8.All_Maps_FIX.Maps_Raster_3 M_out.FIX_uint8_uint8_uint8.All_Maps_FIX.Maps_Raster_3 /end REF_MEASUREMENT
 /begin REF_CHARACTERISTIC P_Do_Active_Std.FIX_uint8_uint8_uint8.All_Maps_FIX.Maps_Raster_3 P_In_X.FIX_uint8_uint8_uint8.All_Maps_FIX.Maps_Raster_3 P_In_Y.FIX_uint8_uint8_uint8.All_Maps_FIX.Maps_Raster_3 Two_D.FIX_uint8_uint8_uint8.All_Maps_FIX.Maps_Raster_3 /end REF_CHARACTERISTIC
/end GROUP
/begin GROUP GRP_float32_float32_float32.All_Maps_GRP.Maps_Raster_1 ""
 /begin REF_MEASUREMENT Calculated.GRP_float32_float32_float32.All_Maps_GRP.Maps_Raster_1 M_In_X.GRP_float32_float32_float32.All_Maps_GRP.Maps_Raster_1 M_In_Y.GRP_float32_float32_float32.All_Maps_GRP.Maps_Raster_1 M_out.GRP_float32_float32_float32.All_Maps_GRP.Maps_Raster_1 /end REF_MEASUREMENT
 /begin REF_CHARACTERISTIC P_Do_Active_Grp.GRP_float32_float32_float32.All_Maps_GRP.Maps_Raster_1 P_Do_GET.GRP_float32_float32_float32.All_Maps_GRP.Maps_Raster_1 P_Do_X_SET.GRP_float32_float32_float32.All_Maps_GRP.Maps_Raster_1 P_Do_Y_SET.GRP_float32_float32_float32.All_Maps_GRP.Maps_Raster_1 P_In_X.GRP_float32_float32_float32.All_Maps_GRP.Maps_Raster_1 P_In_Y.GRP_float32_float32_float32.All_Maps_GRP.Maps_Raster_1 Two_D.GRP_float32_float32_float32.All_Maps_GRP.Maps_Raster_1 /end REF_CHARACTERISTIC
/end GROUP
/begin GROUP GRP_float32_float32_float32.All_Maps_GRP.Maps_Raster_2 ""
 /begin REF_MEASUREMENT Calculated.GRP_float32_float32_float32.All_Maps_GRP.Maps_Raster_2 M_In_X.GRP_float32_float32_float32.All_Maps_GRP.Maps_Raster_2 M_In_Y.GRP_float32_float32_float32.All_Maps_GRP.Maps_Raster_2 M_out.GRP_float32_float32_float32.All_Maps_GRP.Maps_Raster_2 /end REF_MEASUREMENT
 /begin REF_CHARACTERISTIC P_Do_Active_Grp.GRP_float32_float32_float32.All_Maps_GRP.Maps_Raster_2 P_Do_GET.GRP_float32_float32_float32.All_Maps_GRP.Maps_Raster_2 P_Do_X_SET.GRP_float32_float32_float32.All_Maps_GRP.Maps_Raster_2 P_Do_Y_SET.GRP_float32_float32_float32.All_Maps_GRP.Maps_Raster_2 P_In_X.GRP_float32_float32_float32.All_Maps_GRP.Maps_Raster_2 P_In_Y.GRP_float32_float32_float32.All_Maps_GRP.Maps_Raster_2 Two_D.GRP_float32_float32_float32.All_Maps_GRP.Maps_Raster_2 /end REF_CHARACTERISTIC
/end GROUP
/begin GROUP GRP_sint16_sint16_sint16.All_Maps_GRP.Maps_Raster_1 ""
 /begin REF_MEASUREMENT Calculated.GRP_sint16_sint16_sint16.All_Maps_GRP.Maps_Raster_1 M_In_X.GRP_sint16_sint16_sint16.All_Maps_GRP.Maps_Raster_1 M_In_Y.GRP_sint16_sint16_sint16.All_Maps_GRP.Maps_Raster_1 M_out.GRP_sint16_sint16_sint16.All_Maps_GRP.Maps_Raster_1 /end REF_MEASUREMENT
 /begin REF_CHARACTERISTIC P_Do_Active_Grp.GRP_sint16_sint16_sint16.All_Maps_GRP.Maps_Raster_1 P_Do_GET.GRP_sint16_sint16_sint16.All_Maps_GRP.Maps_Raster_1 P_Do_X_SET.GRP_sint16_sint16_sint16.All_Maps_GRP.Maps_Raster_1 P_Do_Y_SET.GRP_sint16_sint16_sint16.All_Maps_GRP.Maps_Raster_1 P_In_X.GRP_sint16_sint16_sint16.All_Maps_GRP.Maps_Raster_1 P_In_Y.GRP_sint16_sint16_sint16.All_Maps_GRP.Maps_Raster_1 Two_D.GRP_sint16_sint16_sint16.All_Maps_GRP.Maps_Raster_1 /end REF_CHARACTERISTIC
/end GROUP
/begin GROUP GRP_sint16_sint16_sint16.All_Maps_GRP.Maps_Raster_2 ""
 /begin REF_MEASUREMENT Calculated.GRP_sint16_sint16_sint16.All_Maps_GRP.Maps_Raster_2 M_In_X.GRP_sint16_sint16_sint16.All_Maps_GRP.Maps_Raster_2 M_In_Y.GRP_sint16_sint16_sint16.All_Maps_GRP.Maps_Raster_2 M_out.GRP_sint16_sint16_sint16.All_Maps_GRP.Maps_Raster_2 /end REF_MEASUREMENT
 /begin REF_CHARACTERISTIC P_Do_Active_Grp.GRP_sint16_sint16_sint16.All_Maps_GRP.Maps_Raster_2 P_Do_GET.GRP_sint16_sint16_sint16.All_Maps_GRP.Maps_Raster_2 P_Do_X_SET.GRP_sint16_sint16_sint16.All_Maps_GRP.Maps_Raster_2 P_Do_Y_SET.GRP_sint16_sint16_sint16.All_Maps_GRP.Maps_Raster_2 P_In_X.GRP_sint16_sint16_sint16.All_Maps_GRP.Maps_Raster_2 P_In_Y.GRP_sint16_sint16_sint16.All_Maps_GRP.Maps_Raster_2 Two_D.GRP_sint16_sint16_sint16.All_Maps_GRP.Maps_Raster_2 /end REF_CHARACTERISTIC
/end GROUP
/begin GROUP GRP_sint32_sint32_sint32.All_Maps_GRP.Maps_Raster_1 ""
 /begin REF_MEASUREMENT Calculated.GRP_sint32_sint32_sint32.All_Maps_GRP.Maps_Raster_1 M_In_X.GRP_sint32_sint32_sint32.All_Maps_GRP.Maps_Raster_1 M_In_Y.GRP_sint32_sint32_sint32.All_Maps_GRP.Maps_Raster_1 M_out.GRP_sint32_sint32_sint32.All_Maps_GRP.Maps_Raster_1 /end REF_MEASUREMENT
 /begin REF_CHARACTERISTIC P_Do_Active_Grp.GRP_sint32_sint32_sint32.All_Maps_GRP.Maps_Raster_1 P_Do_GET.GRP_sint32_sint32_sint32.All_Maps_GRP.Maps_Raster_1 P_Do_X_SET.GRP_sint32_sint32_sint32.All_Maps_GRP.Maps_Raster_1 P_Do_Y_SET.GRP_sint32_sint32_sint32.All_Maps_GRP.Maps_Raster_1 P_In_X.GRP_sint32_sint32_sint32.All_Maps_GRP.Maps_Raster_1 P_In_Y.GRP_sint32_sint32_sint32.All_Maps_GRP.Maps_Raster_1 Two_D.GRP_sint32_sint32_sint32.All_Maps_GRP.Maps_Raster_1 /end REF_CHARACTERISTIC
/end GROUP
/begin GROUP GRP_sint32_sint32_sint32.All_Maps_GRP.Maps_Raster_2 ""
 /begin REF_MEASUREMENT Calculated.GRP_sint32_sint32_sint32.All_Maps_GRP.Maps_Raster_2 M_In_X.GRP_sint32_sint32_sint32.All_Maps_GRP.Maps_Raster_2 M_In_Y.GRP_sint32_sint32_sint32.All_Maps_GRP.Maps_Raster_2 M_out.GRP_sint32_sint32_sint32.All_Maps_GRP.Maps_Raster_2 /end REF_MEASUREMENT
 /begin REF_CHARACTERISTIC P_Do_Active_Grp.GRP_sint32_sint32_sint32.All_Maps_GRP.Maps_Raster_2 P_Do_GET.GRP_sint32_sint32_sint32.All_Maps_GRP.Maps_Raster_2 P_Do_X_SET.GRP_sint32_sint32_sint32.All_Maps_GRP.Maps_Raster_2 P_Do_Y_SET.GRP_sint32_sint32_sint32.All_Maps_GRP.Maps_Raster_2 P_In_X.GRP_sint32_sint32_sint32.All_Maps_GRP.Maps_Raster_2 P_In_Y.GRP_sint32_sint32_sint32.All_Maps_GRP.Maps_Raster_2 Two_D.GRP_sint32_sint32_sint32.All_Maps_GRP.Maps_Raster_2 /end REF_CHARACTERISTIC
/end GROUP
/begin GROUP GRP_sint8_sint8_sint8.All_Maps_GRP.Maps_Raster_1 ""
 /begin REF_MEASUREMENT Calculated.GRP_sint8_sint8_sint8.All_Maps_GRP.Maps_Raster_1 M_In_X.GRP_sint8_sint8_sint8.All_Maps_GRP.Maps_Raster_1 M_In_Y.GRP_sint8_sint8_sint8.All_Maps_GRP.Maps_Raster_1 M_out.GRP_sint8_sint8_sint8.All_Maps_GRP.Maps_Raster_1 /end REF_MEASUREMENT
 /begin REF_CHARACTERISTIC P_Do_Active_Grp.GRP_sint8_sint8_sint8.All_Maps_GRP.Maps_Raster_1 P_Do_GET.GRP_sint8_sint8_sint8.All_Maps_GRP.Maps_Raster_1 P_Do_X_SET.GRP_sint8_sint8_sint8.All_Maps_GRP.Maps_Raster_1 P_Do_Y_SET.GRP_sint8_sint8_sint8.All_Maps_GRP.Maps_Raster_1 P_In_X.GRP_sint8_sint8_sint8.All_Maps_GRP.Maps_Raster_1 P_In_Y.GRP_sint8_sint8_sint8.All_Maps_GRP.Maps_Raster_1 Two_D.GRP_sint8_sint8_sint8.All_Maps_GRP.Maps_Raster_1 /end REF_CHARACTERISTIC
/end GROUP
/begin GROUP GRP_sint8_sint8_sint8.All_Maps_GRP.Maps_Raster_2 ""
 /begin REF_MEASUREMENT Calculated.GRP_sint8_sint8_sint8.All_Maps_GRP.Maps_Raster_2 M_In_X.GRP_sint8_sint8_sint8.All_Maps_GRP.Maps_Raster_2 M_In_Y.GRP_sint8_sint8_sint8.All_Maps_GRP.Maps_Raster_2 M_out.GRP_sint8_sint8_sint8.All_Maps_GRP.Maps_Raster_2 /end REF_MEASUREMENT
 /begin REF_CHARACTERISTIC P_Do_Active_Grp.GRP_sint8_sint8_sint8.All_Maps_GRP.Maps_Raster_2 P_Do_GET.GRP_sint8_sint8_sint8.All_Maps_GRP.Maps_Raster_2 P_Do_X_SET.GRP_sint8_sint8_sint8.All_Maps_GRP.Maps_Raster_2 P_Do_Y_SET.GRP_sint8_sint8_sint8.All_Maps_GRP.Maps_Raster_2 P_In_X.GRP_sint8_sint8_sint8.All_Maps_GRP.Maps_Raster_2 P_In_Y.GRP_sint8_sint8_sint8.All_Maps_GRP.Maps_Raster_2 Two_D.GRP_sint8_sint8_sint8.All_Maps_GRP.Maps_Raster_2 /end REF_CHARACTERISTIC
/end GROUP
/begin GROUP GRP_uint16_uint16_uint16.All_Maps_GRP.Maps_Raster_1 ""
 /begin REF_MEASUREMENT Calculated.GRP_uint16_uint16_uint16.All_Maps_GRP.Maps_Raster_1 M_In_X.GRP_uint16_uint16_uint16.All_Maps_GRP.Maps_Raster_1 M_In_Y.GRP_uint16_uint16_uint16.All_Maps_GRP.Maps_Raster_1 M_out.GRP_uint16_uint16_uint16.All_Maps_GRP.Maps_Raster_1 /end REF_MEASUREMENT
 /begin REF_CHARACTERISTIC P_Do_Active_Grp.GRP_uint16_uint16_uint16.All_Maps_GRP.Maps_Raster_1 P_Do_GET.GRP_uint16_uint16_uint16.All_Maps_GRP.Maps_Raster_1 P_Do_X_SET.GRP_uint16_uint16_uint16.All_Maps_GRP.Maps_Raster_1 P_Do_Y_SET.GRP_uint16_uint16_uint16.All_Maps_GRP.Maps_Raster_1 P_In_X.GRP_uint16_uint16_uint16.All_Maps_GRP.Maps_Raster_1 P_In_Y.GRP_uint16_uint16_uint16.All_Maps_GRP.Maps_Raster_1 Two_D.GRP_uint16_uint16_uint16.All_Maps_GRP.Maps_Raster_1 /end REF_CHARACTERISTIC
/end GROUP
/begin GROUP GRP_uint16_uint16_uint16.All_Maps_GRP.Maps_Raster_2 ""
 /begin REF_MEASUREMENT Calculated.GRP_uint16_uint16_uint16.All_Maps_GRP.Maps_Raster_2 M_In_X.GRP_uint16_uint16_uint16.All_Maps_GRP.Maps_Raster_2 M_In_Y.GRP_uint16_uint16_uint16.All_Maps_GRP.Maps_Raster_2 M_out.GRP_uint16_uint16_uint16.All_Maps_GRP.Maps_Raster_2 /end REF_MEASUREMENT
 /begin REF_CHARACTERISTIC P_Do_Active_Grp.GRP_uint16_uint16_uint16.All_Maps_GRP.Maps_Raster_2 P_Do_GET.GRP_uint16_uint16_uint16.All_Maps_GRP.Maps_Raster_2 P_Do_X_SET.GRP_uint16_uint16_uint16.All_Maps_GRP.Maps_Raster_2 P_Do_Y_SET.GRP_uint16_uint16_uint16.All_Maps_GRP.Maps_Raster_2 P_In_X.GRP_uint16_uint16_uint16.All_Maps_GRP.Maps_Raster_2 P_In_Y.GRP_uint16_uint16_uint16.All_Maps_GRP.Maps_Raster_2 Two_D.GRP_uint16_uint16_uint16.All_Maps_GRP.Maps_Raster_2 /end REF_CHARACTERISTIC
/end GROUP
/begin GROUP GRP_uint32_uint32_uint32.All_Maps_GRP.Maps_Raster_1 ""
 /begin REF_MEASUREMENT Calculated.GRP_uint32_uint32_uint32.All_Maps_GRP.Maps_Raster_1 M_In_X.GRP_uint32_uint32_uint32.All_Maps_GRP.Maps_Raster_1 M_In_Y.GRP_uint32_uint32_uint32.All_Maps_GRP.Maps_Raster_1 M_out.GRP_uint32_uint32_uint32.All_Maps_GRP.Maps_Raster_1 /end REF_MEASUREMENT
 /begin REF_CHARACTERISTIC P_Do_Active_Grp.GRP_uint32_uint32_uint32.All_Maps_GRP.Maps_Raster_1 P_Do_GET.GRP_uint32_uint32_uint32.All_Maps_GRP.Maps_Raster_1 P_Do_X_SET.GRP_uint32_uint32_uint32.All_Maps_GRP.Maps_Raster_1 P_Do_Y_SET.GRP_uint32_uint32_uint32.All_Maps_GRP.Maps_Raster_1 P_In_X.GRP_uint32_uint32_uint32.All_Maps_GRP.Maps_Raster_1 P_In_Y.GRP_uint32_uint32_uint32.All_Maps_GRP.Maps_Raster_1 Two_D.GRP_uint32_uint32_uint32.All_Maps_GRP.Maps_Raster_1 /end REF_CHARACTERISTIC
/end GROUP
/begin GROUP GRP_uint32_uint32_uint32.All_Maps_GRP.Maps_Raster_2 ""
 /begin REF_MEASUREMENT Calculated.GRP_uint32_uint32_uint32.All_Maps_GRP.Maps_Raster_2 M_In_X.GRP_uint32_uint32_uint32.All_Maps_GRP.Maps_Raster_2 M_In_Y.GRP_uint32_uint32_uint32.All_Maps_GRP.Maps_Raster_2 M_out.GRP_uint32_uint32_uint32.All_Maps_GRP.Maps_Raster_2 /end REF_MEASUREMENT
 /begin REF_CHARACTERISTIC P_Do_Active_Grp.GRP_uint32_uint32_uint32.All_Maps_GRP.Maps_Raster_2 P_Do_GET.GRP_uint32_uint32_uint32.All_Maps_GRP.Maps_Raster_2 P_Do_X_SET.GRP_uint32_uint32_uint32.All_Maps_GRP.Maps_Raster_2 P_Do_Y_SET.GRP_uint32_uint32_uint32.All_Maps_GRP.Maps_Raster_2 P_In_X.GRP_uint32_uint32_uint32.All_Maps_GRP.Maps_Raster_2 P_In_Y.GRP_uint32_uint32_uint32.All_Maps_GRP.Maps_Raster_2 Two_D.GRP_uint32_uint32_uint32.All_Maps_GRP.Maps_Raster_2 /end REF_CHARACTERISTIC
/end GROUP
/begin GROUP GRP_uint8_uint8_uint8.All_Maps_GRP.Maps_Raster_1 ""
 /begin REF_MEASUREMENT Calculated.GRP_uint8_uint8_uint8.All_Maps_GRP.Maps_Raster_1 M_In_X.GRP_uint8_uint8_uint8.All_Maps_GRP.Maps_Raster_1 M_In_Y.GRP_uint8_uint8_uint8.All_Maps_GRP.Maps_Raster_1 M_out.GRP_uint8_uint8_uint8.All_Maps_GRP.Maps_Raster_1 /end REF_MEASUREMENT
 /begin REF_CHARACTERISTIC P_Do_Active_Grp.GRP_uint8_uint8_uint8.All_Maps_GRP.Maps_Raster_1 P_Do_GET.GRP_uint8_uint8_uint8.All_Maps_GRP.Maps_Raster_1 P_Do_X_SET.GRP_uint8_uint8_uint8.All_Maps_GRP.Maps_Raster_1 P_Do_Y_SET.GRP_uint8_uint8_uint8.All_Maps_GRP.Maps_Raster_1 P_In_X.GRP_uint8_uint8_uint8.All_Maps_GRP.Maps_Raster_1 P_In_Y.GRP_uint8_uint8_uint8.All_Maps_GRP.Maps_Raster_1 Two_D.GRP_uint8_uint8_uint8.All_Maps_GRP.Maps_Raster_1 /end REF_CHARACTERISTIC
/end GROUP
/begin GROUP GRP_uint8_uint8_uint8.All_Maps_GRP.Maps_Raster_2 ""
 /begin REF_MEASUREMENT Calculated.GRP_uint8_uint8_uint8.All_Maps_GRP.Maps_Raster_2 M_In_X.GRP_uint8_uint8_uint8.All_Maps_GRP.Maps_Raster_2 M_In_Y.GRP_uint8_uint8_uint8.All_Maps_GRP.Maps_Raster_2 M_out.GRP_uint8_uint8_uint8.All_Maps_GRP.Maps_Raster_2 /end REF_MEASUREMENT
 /begin REF_CHARACTERISTIC P_Do_Active_Grp.GRP_uint8_uint8_uint8.All_Maps_GRP.Maps_Raster_2 P_Do_GET.GRP_uint8_uint8_uint8.All_Maps_GRP.Maps_Raster_2 P_Do_X_SET.GRP_uint8_uint8_uint8.All_Maps_GRP.Maps_Raster_2 P_Do_Y_SET.GRP_uint8_uint8_uint8.All_Maps_GRP.Maps_Raster_2 P_In_X.GRP_uint8_uint8_uint8.All_Maps_GRP.Maps_Raster_2 P_In_Y.GRP_uint8_uint8_uint8.All_Maps_GRP.Maps_Raster_2 Two_D.GRP_uint8_uint8_uint8.All_Maps_GRP.Maps_Raster_2 /end REF_CHARACTERISTIC
/end GROUP
/begin GROUP Maps_Raster_1 "" ROOT
 /begin REF_MEASUREMENT Calculated.FIX_float32_float32_float32.All_Maps_FIX.Maps_Raster_1 Calculated.FIX_sint16_sint16_sint16.All_Maps_FIX.Maps_Raster_1 Calculated.FIX_sint32_sint32_sint32.All_Maps_FIX.Maps_Raster_1 Calculated.FIX_sint8_sint8_sint8.All_Maps_FIX.Maps_Raster_1 Calculated.FIX_uint16_uint16_uint16.All_Maps_FIX.Maps_Raster_1 Calculated.FIX_uint32_uint32_uint32.All_Maps_FIX.Maps_Raster_1 Calculated.FIX_uint8_uint8_uint8.All_Maps_FIX.Maps_Raster_1 Calculated.GRP_float32_float32_float32.All_Maps_GRP.Maps_Raster_1 Calculated.GRP_sint16_sint16_sint16.All_Maps_GRP.Maps_Raster_1 Calculated.GRP_sint32_sint32_sint32.All_Maps_GRP.Maps_Raster_1 Calculated.GRP_sint8_sint8_sint8.All_Maps_GRP.Maps_Raster_1 Calculated.GRP_uint16_uint16_uint16.All_Maps_GRP.Maps_Raster_1 Calculated.GRP_uint32_uint32_uint32.All_Maps_GRP.Maps_Raster_1 Calculated.GRP_uint8_uint8_uint8.All_Maps_GRP.Maps_Raster_1 M_In_X.FIX_float32_float32_float32.All_Maps_FIX.Maps_Raster_1 M_In_X.FIX_sint16_sint16_sint16.All_Maps_FIX.Maps_Raster_1 M_In_X.FIX_sint32_sint32_sint32.All_Maps_FIX.Maps_Raster_1 M_In_X.FIX_sint8_sint8_sint8.All_Maps_FIX.Maps_Raster_1 M_In_X.FIX_uint16_uint16_uint16.All_Maps_FIX.Maps_Raster_1 M_In_X.FIX_uint32_uint32_uint32.All_Maps_FIX.Maps_Raster_1 M_In_X.FIX_uint8_uint8_uint8.All_Maps_FIX.Maps_Raster_1 M_In_X.GRP_float32_float32_float32.All_Maps_GRP.Maps_Raster_1 M_In_X.GRP_sint16_sint16_sint16.All_Maps_GRP.Maps_Raster_1 M_In_X.GRP_sint32_sint32_sint32.All_Maps_GRP.Maps_Raster_1 M_In_X.GRP_sint8_sint8_sint8.All_Maps_GRP.Maps_Raster_1 M_In_X.GRP_uint16_uint16_uint16.All_Maps_GRP.Maps_Raster_1 M_In_X.GRP_uint32_uint32_uint32.All_Maps_GRP.Maps_Raster_1 M_In_X.GRP_uint8_uint8_uint8.All_Maps_GRP.Maps_Raster_1 M_In_Y.FIX_float32_float32_float32.All_Maps_FIX.Maps_Raster_1 M_In_Y.FIX_sint16_sint16_sint16.All_Maps_FIX.Maps_Raster_1 M_In_Y.FIX_sint32_sint32_sint32.All_Maps_FIX.Maps_Raster_1 M_In_Y.FIX_sint8_sint8_sint8.All_Maps_FIX.Maps_Raster_1 M_In_Y.FIX_uint16_uint16_uint16.All_Maps_FIX.Maps_Raster_1 M_In_Y.FIX_uint32_uint32_uint32.All_Maps_FIX.Maps_Raster_1 M_In_Y.FIX_uint8_uint8_uint8.All_Maps_FIX.Maps_Raster_1 M_In_Y.GRP_float32_float32_float32.All_Maps_GRP.Maps_Raster_1 M_In_Y.GRP_sint16_sint16_sint16.All_Maps_GRP.Maps_Raster_1 M_In_Y.GRP_sint32_sint32_sint32.All_Maps_GRP.Maps_Raster_1 M_In_Y.GRP_sint8_sint8_sint8.All_Maps_GRP.Maps_Raster_1 M_In_Y.GRP_uint16_uint16_uint16.All_Maps_GRP.Maps_Raster_1 M_In_Y.GRP_uint32_uint32_uint32.All_Maps_GRP.Maps_Raster_1 M_In_Y.GRP_uint8_uint8_uint8.All_Maps_GRP.Maps_Raster_1 M_out.FIX_float32_float32_float32.All_Maps_FIX.Maps_Raster_1 M_out.FIX_sint16_sint16_sint16.All_Maps_FIX.Maps_Raster_1 M_out.FIX_sint32_sint32_sint32.All_Maps_FIX.Maps_Raster_1 M_out.FIX_sint8_sint8_sint8.All_Maps_FIX.Maps_Raster_1 M_out.FIX_uint16_uint16_uint16.All_Maps_FIX.Maps_Raster_1 M_out.FIX_uint32_uint32_uint32.All_Maps_FIX.Maps_Raster_1 M_out.FIX_uint8_uint8_uint8.All_Maps_FIX.Maps_Raster_1 M_out.GRP_float32_float32_float32.All_Maps_GRP.Maps_Raster_1 M_out.GRP_sint16_sint16_sint16.All_Maps_GRP.Maps_Raster_1 M_out.GRP_sint32_sint32_sint32.All_Maps_GRP.Maps_Raster_1 M_out.GRP_sint8_sint8_sint8.All_Maps_GRP.Maps_Raster_1 M_out.GRP_uint16_uint16_uint16.All_Maps_GRP.Maps_Raster_1 M_out.GRP_uint32_uint32_uint32.All_Maps_GRP.Maps_Raster_1 M_out.GRP_uint8_uint8_uint8.All_Maps_GRP.Maps_Raster_1 /end REF_MEASUREMENT
 /begin REF_CHARACTERISTIC P_Do_Active_Grp.GRP_float32_float32_float32.All_Maps_GRP.Maps_Raster_1 P_Do_Active_Grp.GRP_sint16_sint16_sint16.All_Maps_GRP.Maps_Raster_1 P_Do_Active_Grp.GRP_sint32_sint32_sint32.All_Maps_GRP.Maps_Raster_1 P_Do_Active_Grp.GRP_sint8_sint8_sint8.All_Maps_GRP.Maps_Raster_1 P_Do_Active_Grp.GRP_uint16_uint16_uint16.All_Maps_GRP.Maps_Raster_1 P_Do_Active_Grp.GRP_uint32_uint32_uint32.All_Maps_GRP.Maps_Raster_1 P_Do_Active_Grp.GRP_uint8_uint8_uint8.All_Maps_GRP.Maps_Raster_1 P_Do_Active_Std.FIX_float32_float32_float32.All_Maps_FIX.Maps_Raster_1 P_Do_Active_Std.FIX_sint16_sint16_sint16.All_Maps_FIX.Maps_Raster_1 P_Do_Active_Std.FIX_sint32_sint32_sint32.All_Maps_FIX.Maps_Raster_1 P_Do_Active_Std.FIX_sint8_sint8_sint8.All_Maps_FIX.Maps_Raster_1 P_Do_Active_Std.FIX_uint16_uint16_uint16.All_Maps_FIX.Maps_Raster_1 P_Do_Active_Std.FIX_uint32_uint32_uint32.All_Maps_FIX.Maps_Raster_1 P_Do_Active_Std.FIX_uint8_uint8_uint8.All_Maps_FIX.Maps_Raster_1 P_Do_All_FIX_Maps.All_Maps_FIX.Maps_Raster_1 P_Do_All_GRP_Maps.All_Maps_GRP.Maps_Raster_1 P_Do_GET.GRP_float32_float32_float32.All_Maps_GRP.Maps_Raster_1 P_Do_GET.GRP_sint16_sint16_sint16.All_Maps_GRP.Maps_Raster_1 P_Do_GET.GRP_sint32_sint32_sint32.All_Maps_GRP.Maps_Raster_1 P_Do_GET.GRP_sint8_sint8_sint8.All_Maps_GRP.Maps_Raster_1 P_Do_GET.GRP_uint16_uint16_uint16.All_Maps_GRP.Maps_Raster_1 P_Do_GET.GRP_uint32_uint32_uint32.All_Maps_GRP.Maps_Raster_1 P_Do_GET.GRP_uint8_uint8_uint8.All_Maps_GRP.Maps_Raster_1 P_Do_X_SET.GRP_float32_float32_float32.All_Maps_GRP.Maps_Raster_1 P_Do_X_SET.GRP_sint16_sint16_sint16.All_Maps_GRP.Maps_Raster_1 P_Do_X_SET.GRP_sint32_sint32_sint32.All_Maps_GRP.Maps_Raster_1 P_Do_X_SET.GRP_sint8_sint8_sint8.All_Maps_GRP.Maps_Raster_1 P_Do_X_SET.GRP_uint16_uint16_uint16.All_Maps_GRP.Maps_Raster_1 P_Do_X_SET.GRP_uint32_uint32_uint32.All_Maps_GRP.Maps_Raster_1 P_Do_X_SET.GRP_uint8_uint8_uint8.All_Maps_GRP.Maps_Raster_1 P_Do_Y_SET.GRP_float32_float32_float32.All_Maps_GRP.Maps_Raster_1 P_Do_Y_SET.GRP_sint16_sint16_sint16.All_Maps_GRP.Maps_Raster_1 P_Do_Y_SET.GRP_sint32_sint32_sint32.All_Maps_GRP.Maps_Raster_1 P_Do_Y_SET.GRP_sint8_sint8_sint8.All_Maps_GRP.Maps_Raster_1 P_Do_Y_SET.GRP_uint16_uint16_uint16.All_Maps_GRP.Maps_Raster_1 P_Do_Y_SET.GRP_uint32_uint32_uint32.All_Maps_GRP.Maps_Raster_1 P_Do_Y_SET.GRP_uint8_uint8_uint8.All_Maps_GRP.Maps_Raster_1 P_In_X.FIX_float32_float32_float32.All_Maps_FIX.Maps_Raster_1 P_In_X.FIX_sint16_sint16_sint16.All_Maps_FIX.Maps_Raster_1 P_In_X.FIX_sint32_sint32_sint32.All_Maps_FIX.Maps_Raster_1 P_In_X.FIX_sint8_sint8_sint8.All_Maps_FIX.Maps_Raster_1 P_In_X.FIX_uint16_uint16_uint16.All_Maps_FIX.Maps_Raster_1 P_In_X.FIX_uint32_uint32_uint32.All_Maps_FIX.Maps_Raster_1 P_In_X.FIX_uint8_uint8_uint8.All_Maps_FIX.Maps_Raster_1 P_In_X.GRP_float32_float32_float32.All_Maps_GRP.Maps_Raster_1 P_In_X.GRP_sint16_sint16_sint16.All_Maps_GRP.Maps_Raster_1 P_In_X.GRP_sint32_sint32_sint32.All_Maps_GRP.Maps_Raster_1 P_In_X.GRP_sint8_sint8_sint8.All_Maps_GRP.Maps_Raster_1 P_In_X.GRP_uint16_uint16_uint16.All_Maps_GRP.Maps_Raster_1 P_In_X.GRP_uint32_uint32_uint32.All_Maps_GRP.Maps_Raster_1 P_In_X.GRP_uint8_uint8_uint8.All_Maps_GRP.Maps_Raster_1 P_In_Y.FIX_float32_float32_float32.All_Maps_FIX.Maps_Raster_1 P_In_Y.FIX_sint16_sint16_sint16.All_Maps_FIX.Maps_Raster_1 P_In_Y.FIX_sint32_sint32_sint32.All_Maps_FIX.Maps_Raster_1 P_In_Y.FIX_sint8_sint8_sint8.All_Maps_FIX.Maps_Raster_1 P_In_Y.FIX_uint16_uint16_uint16.All_Maps_FIX.Maps_Raster_1 P_In_Y.FIX_uint32_uint32_uint32.All_Maps_FIX.Maps_Raster_1 P_In_Y.FIX_uint8_uint8_uint8.All_Maps_FIX.Maps_Raster_1 P_In_Y.GRP_float32_float32_float32.All_Maps_GRP.Maps_Raster_1 P_In_Y.GRP_sint16_sint16_sint16.All_Maps_GRP.Maps_Raster_1 P_In_Y.GRP_sint32_sint32_sint32.All_Maps_GRP.Maps_Raster_1 P_In_Y.GRP_sint8_sint8_sint8.All_Maps_GRP.Maps_Raster_1 P_In_Y.GRP_uint16_uint16_uint16.All_Maps_GRP.Maps_Raster_1 P_In_Y.GRP_uint32_uint32_uint32.All_Maps_GRP.Maps_Raster_1 P_In_Y.GRP_uint8_uint8_uint8.All_Maps_GRP.Maps_Raster_1 Two_D.FIX_float32_float32_float32.All_Maps_FIX.Maps_Raster_1 Two_D.FIX_sint16_sint16_sint16.All_Maps_FIX.Maps_Raster_1 Two_D.FIX_sint32_sint32_sint32.All_Maps_FIX.Maps_Raster_1 Two_D.FIX_sint8_sint8_sint8.All_Maps_FIX.Maps_Raster_1 Two_D.FIX_uint16_uint16_uint16.All_Maps_FIX.Maps_Raster_1 Two_D.FIX_uint32_uint32_uint32.All_Maps_FIX.Maps_Raster_1 Two_D.FIX_uint8_uint8_uint8.All_Maps_FIX.Maps_Raster_1 Two_D.GRP_float32_float32_float32.All_Maps_GRP.Maps_Raster_1 Two_D.GRP_sint16_sint16_sint16.All_Maps_GRP.Maps_Raster_1 Two_D.GRP_sint32_sint32_sint32.All_Maps_GRP.Maps_Raster_1 Two_D.GRP_sint8_sint8_sint8.All_Maps_GRP.Maps_Raster_1 Two_D.GRP_uint16_uint16_uint16.All_Maps_GRP.Maps_Raster_1 Two_D.GRP_uint32_uint32_uint32.All_Maps_GRP.Maps_Raster_1 Two_D.GRP_uint8_uint8_uint8.All_Maps_GRP.Maps_Raster_1 /end REF_CHARACTERISTIC
/end GROUP
/begin GROUP Maps_Raster_2 "" ROOT
 /begin REF_MEASUREMENT Calculated.FIX_float32_float32_float32.All_Maps_FIX.Maps_Raster_2 Calculated.FIX_sint16_sint16_sint16.All_Maps_FIX.Maps_Raster_2 Calculated.FIX_sint32_sint32_sint32.All_Maps_FIX.Maps_Raster_2 Calculated.FIX_sint8_sint8_sint8.All_Maps_FIX.Maps_Raster_2 Calculated.FIX_uint16_uint16_uint16.All_Maps_FIX.Maps_Raster_2 Calculated.FIX_uint32_uint32_uint32.All_Maps_FIX.Maps_Raster_2 Calculated.FIX_uint8_uint8_uint8.All_Maps_FIX.Maps_Raster_2 Calculated.GRP_float32_float32_float32.All_Maps_GRP.Maps_Raster_2 Calculated.GRP_sint16_sint16_sint16.All_Maps_GRP.Maps_Raster_2 Calculated.GRP_sint32_sint32_sint32.All_Maps_GRP.Maps_Raster_2 Calculated.GRP_sint8_sint8_sint8.All_Maps_GRP.Maps_Raster_2 Calculated.GRP_uint16_uint16_uint16.All_Maps_GRP.Maps_Raster_2 Calculated.GRP_uint32_uint32_uint32.All_Maps_GRP.Maps_Raster_2 Calculated.GRP_uint8_uint8_uint8.All_Maps_GRP.Maps_Raster_2 M_In_X.FIX_float32_float32_float32.All_Maps_FIX.Maps_Raster_2 M_In_X.FIX_sint16_sint16_sint16.All_Maps_FIX.Maps_Raster_2 M_In_X.FIX_sint32_sint32_sint32.All_Maps_FIX.Maps_Raster_2 M_In_X.FIX_sint8_sint8_sint8.All_Maps_FIX.Maps_Raster_2 M_In_X.FIX_uint16_uint16_uint16.All_Maps_FIX.Maps_Raster_2 M_In_X.FIX_uint32_uint32_uint32.All_Maps_FIX.Maps_Raster_2 M_In_X.FIX_uint8_uint8_uint8.All_Maps_FIX.Maps_Raster_2 M_In_X.GRP_float32_float32_float32.All_Maps_GRP.Maps_Raster_2 M_In_X.GRP_sint16_sint16_sint16.All_Maps_GRP.Maps_Raster_2 M_In_X.GRP_sint32_sint32_sint32.All_Maps_GRP.Maps_Raster_2 M_In_X.GRP_sint8_sint8_sint8.All_Maps_GRP.Maps_Raster_2 M_In_X.GRP_uint16_uint16_uint16.All_Maps_GRP.Maps_Raster_2 M_In_X.GRP_uint32_uint32_uint32.All_Maps_GRP.Maps_Raster_2 M_In_X.GRP_uint8_uint8_uint8.All_Maps_GRP.Maps_Raster_2 M_In_Y.FIX_float32_float32_float32.All_Maps_FIX.Maps_Raster_2 M_In_Y.FIX_sint16_sint16_sint16.All_Maps_FIX.Maps_Raster_2 M_In_Y.FIX_sint32_sint32_sint32.All_Maps_FIX.Maps_Raster_2 M_In_Y.FIX_sint8_sint8_sint8.All_Maps_FIX.Maps_Raster_2 M_In_Y.FIX_uint16_uint16_uint16.All_Maps_FIX.Maps_Raster_2 M_In_Y.FIX_uint32_uint32_uint32.All_Maps_FIX.Maps_Raster_2 M_In_Y.FIX_uint8_uint8_uint8.All_Maps_FIX.Maps_Raster_2 M_In_Y.GRP_float32_float32_float32.All_Maps_GRP.Maps_Raster_2 M_In_Y.GRP_sint16_sint16_sint16.All_Maps_GRP.Maps_Raster_2 M_In_Y.GRP_sint32_sint32_sint32.All_Maps_GRP.Maps_Raster_2 M_In_Y.GRP_sint8_sint8_sint8.All_Maps_GRP.Maps_Raster_2 M_In_Y.GRP_uint16_uint16_uint16.All_Maps_GRP.Maps_Raster_2 M_In_Y.GRP_uint32_uint32_uint32.All_Maps_GRP.Maps_Raster_2 M_In_Y.GRP_uint8_uint8_uint8.All_Maps_GRP.Maps_Raster_2 M_out.FIX_float32_float32_float32.All_Maps_FIX.Maps_Raster_2 M_out.FIX_sint16_sint16_sint16.All_Maps_FIX.Maps_Raster_2 M_out.FIX_sint32_sint32_sint32.All_Maps_FIX.Maps_Raster_2 M_out.FIX_sint8_sint8_sint8.All_Maps_FIX.Maps_Raster_2 M_out.FIX_uint16_uint16_uint16.All_Maps_FIX.Maps_Raster_2 M_out.FIX_uint32_uint32_uint32.All_Maps_FIX.Maps_Raster_2 M_out.FIX_uint8_uint8_uint8.All_Maps_FIX.Maps_Raster_2 M_out.GRP_float32_float32_float32.All_Maps_GRP.Maps_Raster_2 M_out.GRP_sint16_sint16_sint16.All_Maps_GRP.Maps_Raster_2 M_out.GRP_sint32_sint32_sint32.All_Maps_GRP.Maps_Raster_2 M_out.GRP_sint8_sint8_sint8.All_Maps_GRP.Maps_Raster_2 M_out.GRP_uint16_uint16_uint16.All_Maps_GRP.Maps_Raster_2 M_out.GRP_uint32_uint32_uint32.All_Maps_GRP.Maps_Raster_2 M_out.GRP_uint8_uint8_uint8.All_Maps_GRP.Maps_Raster_2 /end REF_MEASUREMENT
 /begin REF_CHARACTERISTIC P_Do_Active_Grp.GRP_float32_float32_float32.All_Maps_GRP.Maps_Raster_2 P_Do_Active_Grp.GRP_sint16_sint16_sint16.All_Maps_GRP.Maps_Raster_2 P_Do_Active_Grp.GRP_sint32_sint32_sint32.All_Maps_GRP.Maps_Raster_2 P_Do_Active_Grp.GRP_sint8_sint8_sint8.All_Maps_GRP.Maps_Raster_2 P_Do_Active_Grp.GRP_uint16_uint16_uint16.All_Maps_GRP.Maps_Raster_2 P_Do_Active_Grp.GRP_uint32_uint32_uint32.All_Maps_GRP.Maps_Raster_2 P_Do_Active_Grp.GRP_uint8_uint8_uint8.All_Maps_GRP.Maps_Raster_2 P_Do_Active_Std.FIX_float32_float32_float32.All_Maps_FIX.Maps_Raster_2 P_Do_Active_Std.FIX_sint16_sint16_sint16.All_Maps_FIX.Maps_Raster_2 P_Do_Active_Std.FIX_sint32_sint32_sint32.All_Maps_FIX.Maps_Raster_2 P_Do_Active_Std.FIX_sint8_sint8_sint8.All_Maps_FIX.Maps_Raster_2 P_Do_Active_Std.FIX_uint16_uint16_uint16.All_Maps_FIX.Maps_Raster_2 P_Do_Active_Std.FIX_uint32_uint32_uint32.All_Maps_FIX.Maps_Raster_2 P_Do_Active_Std.FIX_uint8_uint8_uint8.All_Maps_FIX.Maps_Raster_2 P_Do_All_FIX_Maps.All_Maps_FIX.Maps_Raster_2 P_Do_All_GRP_Maps.All_Maps_GRP.Maps_Raster_2 P_Do_GET.GRP_float32_float32_float32.All_Maps_GRP.Maps_Raster_2 P_Do_GET.GRP_sint16_sint16_sint16.All_Maps_GRP.Maps_Raster_2 P_Do_GET.GRP_sint32_sint32_sint32.All_Maps_GRP.Maps_Raster_2 P_Do_GET.GRP_sint8_sint8_sint8.All_Maps_GRP.Maps_Raster_2 P_Do_GET.GRP_uint16_uint16_uint16.All_Maps_GRP.Maps_Raster_2 P_Do_GET.GRP_uint32_uint32_uint32.All_Maps_GRP.Maps_Raster_2 P_Do_GET.GRP_uint8_uint8_uint8.All_Maps_GRP.Maps_Raster_2 P_Do_X_SET.GRP_float32_float32_float32.All_Maps_GRP.Maps_Raster_2 P_Do_X_SET.GRP_sint16_sint16_sint16.All_Maps_GRP.Maps_Raster_2 P_Do_X_SET.GRP_sint32_sint32_sint32.All_Maps_GRP.Maps_Raster_2 P_Do_X_SET.GRP_sint8_sint8_sint8.All_Maps_GRP.Maps_Raster_2 P_Do_X_SET.GRP_uint16_uint16_uint16.All_Maps_GRP.Maps_Raster_2 P_Do_X_SET.GRP_uint32_uint32_uint32.All_Maps_GRP.Maps_Raster_2 P_Do_X_SET.GRP_uint8_uint8_uint8.All_Maps_GRP.Maps_Raster_2 P_Do_Y_SET.GRP_float32_float32_float32.All_Maps_GRP.Maps_Raster_2 P_Do_Y_SET.GRP_sint16_sint16_sint16.All_Maps_GRP.Maps_Raster_2 P_Do_Y_SET.GRP_sint32_sint32_sint32.All_Maps_GRP.Maps_Raster_2 P_Do_Y_SET.GRP_sint8_sint8_sint8.All_Maps_GRP.Maps_Raster_2 P_Do_Y_SET.GRP_uint16_uint16_uint16.All_Maps_GRP.Maps_Raster_2 P_Do_Y_SET.GRP_uint32_uint32_uint32.All_Maps_GRP.Maps_Raster_2 P_Do_Y_SET.GRP_uint8_uint8_uint8.All_Maps_GRP.Maps_Raster_2 P_In_X.FIX_float32_float32_float32.All_Maps_FIX.Maps_Raster_2 P_In_X.FIX_sint16_sint16_sint16.All_Maps_FIX.Maps_Raster_2 P_In_X.FIX_sint32_sint32_sint32.All_Maps_FIX.Maps_Raster_2 P_In_X.FIX_sint8_sint8_sint8.All_Maps_FIX.Maps_Raster_2 P_In_X.FIX_uint16_uint16_uint16.All_Maps_FIX.Maps_Raster_2 P_In_X.FIX_uint32_uint32_uint32.All_Maps_FIX.Maps_Raster_2 P_In_X.FIX_uint8_uint8_uint8.All_Maps_FIX.Maps_Raster_2 P_In_X.GRP_float32_float32_float32.All_Maps_GRP.Maps_Raster_2 P_In_X.GRP_sint16_sint16_sint16.All_Maps_GRP.Maps_Raster_2 P_In_X.GRP_sint32_sint32_sint32.All_Maps_GRP.Maps_Raster_2 P_In_X.GRP_sint8_sint8_sint8.All_Maps_GRP.Maps_Raster_2 P_In_X.GRP_uint16_uint16_uint16.All_Maps_GRP.Maps_Raster_2 P_In_X.GRP_uint32_uint32_uint32.All_Maps_GRP.Maps_Raster_2 P_In_X.GRP_uint8_uint8_uint8.All_Maps_GRP.Maps_Raster_2 P_In_Y.FIX_float32_float32_float32.All_Maps_FIX.Maps_Raster_2 P_In_Y.FIX_sint16_sint16_sint16.All_Maps_FIX.Maps_Raster_2 P_In_Y.FIX_sint32_sint32_sint32.All_Maps_FIX.Maps_Raster_2 P_In_Y.FIX_sint8_sint8_sint8.All_Maps_FIX.Maps_Raster_2 P_In_Y.FIX_uint16_uint16_uint16.All_Maps_FIX.Maps_Raster_2 P_In_Y.FIX_uint32_uint32_uint32.All_Maps_FIX.Maps_Raster_2 P_In_Y.FIX_uint8_uint8_uint8.All_Maps_FIX.Maps_Raster_2 P_In_Y.GRP_float32_float32_float32.All_Maps_GRP.Maps_Raster_2 P_In_Y.GRP_sint16_sint16_sint16.All_Maps_GRP.Maps_Raster_2 P_In_Y.GRP_sint32_sint32_sint32.All_Maps_GRP.Maps_Raster_2 P_In_Y.GRP_sint8_sint8_sint8.All_Maps_GRP.Maps_Raster_2 P_In_Y.GRP_uint16_uint16_uint16.All_Maps_GRP.Maps_Raster_2 P_In_Y.GRP_uint32_uint32_uint32.All_Maps_GRP.Maps_Raster_2 P_In_Y.GRP_uint8_uint8_uint8.All_Maps_GRP.Maps_Raster_2 Two_D.FIX_float32_float32_float32.All_Maps_FIX.Maps_Raster_2 Two_D.FIX_sint16_sint16_sint16.All_Maps_FIX.Maps_Raster_2 Two_D.FIX_sint32_sint32_sint32.All_Maps_FIX.Maps_Raster_2 Two_D.FIX_sint8_sint8_sint8.All_Maps_FIX.Maps_Raster_2 Two_D.FIX_uint16_uint16_uint16.All_Maps_FIX.Maps_Raster_2 Two_D.FIX_uint32_uint32_uint32.All_Maps_FIX.Maps_Raster_2 Two_D.FIX_uint8_uint8_uint8.All_Maps_FIX.Maps_Raster_2 Two_D.GRP_float32_float32_float32.All_Maps_GRP.Maps_Raster_2 Two_D.GRP_sint16_sint16_sint16.All_Maps_GRP.Maps_Raster_2 Two_D.GRP_sint32_sint32_sint32.All_Maps_GRP.Maps_Raster_2 Two_D.GRP_sint8_sint8_sint8.All_Maps_GRP.Maps_Raster_2 Two_D.GRP_uint16_uint16_uint16.All_Maps_GRP.Maps_Raster_2 Two_D.GRP_uint32_uint32_uint32.All_Maps_GRP.Maps_Raster_2 Two_D.GRP_uint8_uint8_uint8.All_Maps_GRP.Maps_Raster_2 /end REF_CHARACTERISTIC
/end GROUP
/begin GROUP Maps_Raster_3 "" ROOT
 /begin REF_MEASUREMENT Calculated.FIX_float32_float32_float32.All_Maps_FIX.Maps_Raster_3 Calculated.FIX_sint16_sint16_sint16.All_Maps_FIX.Maps_Raster_3 Calculated.FIX_sint32_sint32_sint32.All_Maps_FIX.Maps_Raster_3 Calculated.FIX_sint8_sint8_sint8.All_Maps_FIX.Maps_Raster_3 Calculated.FIX_uint16_uint16_uint16.All_Maps_FIX.Maps_Raster_3 Calculated.FIX_uint32_uint32_uint32.All_Maps_FIX.Maps_Raster_3 Calculated.FIX_uint8_uint8_uint8.All_Maps_FIX.Maps_Raster_3 M_In_X.FIX_float32_float32_float32.All_Maps_FIX.Maps_Raster_3 M_In_X.FIX_sint16_sint16_sint16.All_Maps_FIX.Maps_Raster_3 M_In_X.FIX_sint32_sint32_sint32.All_Maps_FIX.Maps_Raster_3 M_In_X.FIX_sint8_sint8_sint8.All_Maps_FIX.Maps_Raster_3 M_In_X.FIX_uint16_uint16_uint16.All_Maps_FIX.Maps_Raster_3 M_In_X.FIX_uint32_uint32_uint32.All_Maps_FIX.Maps_Raster_3 M_In_X.FIX_uint8_uint8_uint8.All_Maps_FIX.Maps_Raster_3 M_In_Y.FIX_float32_float32_float32.All_Maps_FIX.Maps_Raster_3 M_In_Y.FIX_sint16_sint16_sint16.All_Maps_FIX.Maps_Raster_3 M_In_Y.FIX_sint32_sint32_sint32.All_Maps_FIX.Maps_Raster_3 M_In_Y.FIX_sint8_sint8_sint8.All_Maps_FIX.Maps_Raster_3 M_In_Y.FIX_uint16_uint16_uint16.All_Maps_FIX.Maps_Raster_3 M_In_Y.FIX_uint32_uint32_uint32.All_Maps_FIX.Maps_Raster_3 M_In_Y.FIX_uint8_uint8_uint8.All_Maps_FIX.Maps_Raster_3 M_out.FIX_float32_float32_float32.All_Maps_FIX.Maps_Raster_3 M_out.FIX_sint16_sint16_sint16.All_Maps_FIX.Maps_Raster_3 M_out.FIX_sint32_sint32_sint32.All_Maps_FIX.Maps_Raster_3 M_out.FIX_sint8_sint8_sint8.All_Maps_FIX.Maps_Raster_3 M_out.FIX_uint16_uint16_uint16.All_Maps_FIX.Maps_Raster_3 M_out.FIX_uint32_uint32_uint32.All_Maps_FIX.Maps_Raster_3 M_out.FIX_uint8_uint8_uint8.All_Maps_FIX.Maps_Raster_3 /end REF_MEASUREMENT
 /begin REF_CHARACTERISTIC P_Do_Active_Std.FIX_float32_float32_float32.All_Maps_FIX.Maps_Raster_3 P_Do_Active_Std.FIX_sint16_sint16_sint16.All_Maps_FIX.Maps_Raster_3 P_Do_Active_Std.FIX_sint32_sint32_sint32.All_Maps_FIX.Maps_Raster_3 P_Do_Active_Std.FIX_sint8_sint8_sint8.All_Maps_FIX.Maps_Raster_3 P_Do_Active_Std.FIX_uint16_uint16_uint16.All_Maps_FIX.Maps_Raster_3 P_Do_Active_Std.FIX_uint32_uint32_uint32.All_Maps_FIX.Maps_Raster_3 P_Do_Active_Std.FIX_uint8_uint8_uint8.All_Maps_FIX.Maps_Raster_3 P_Do_All_FIX_Maps.All_Maps_FIX.Maps_Raster_3 P_In_X.FIX_float32_float32_float32.All_Maps_FIX.Maps_Raster_3 P_In_X.FIX_sint16_sint16_sint16.All_Maps_FIX.Maps_Raster_3 P_In_X.FIX_sint32_sint32_sint32.All_Maps_FIX.Maps_Raster_3 P_In_X.FIX_sint8_sint8_sint8.All_Maps_FIX.Maps_Raster_3 P_In_X.FIX_uint16_uint16_uint16.All_Maps_FIX.Maps_Raster_3 P_In_X.FIX_uint32_uint32_uint32.All_Maps_FIX.Maps_Raster_3 P_In_X.FIX_uint8_uint8_uint8.All_Maps_FIX.Maps_Raster_3 P_In_Y.FIX_float32_float32_float32.All_Maps_FIX.Maps_Raster_3 P_In_Y.FIX_sint16_sint16_sint16.All_Maps_FIX.Maps_Raster_3 P_In_Y.FIX_sint32_sint32_sint32.All_Maps_FIX.Maps_Raster_3 P_In_Y.FIX_sint8_sint8_sint8.All_Maps_FIX.Maps_Raster_3 P_In_Y.FIX_uint16_uint16_uint16.All_Maps_FIX.Maps_Raster_3 P_In_Y.FIX_uint32_uint32_uint32.All_Maps_FIX.Maps_Raster_3 P_In_Y.FIX_uint8_uint8_uint8.All_Maps_FIX.Maps_Raster_3 Two_D.FIX_float32_float32_float32.All_Maps_FIX.Maps_Raster_3 Two_D.FIX_sint16_sint16_sint16.All_Maps_FIX.Maps_Raster_3 Two_D.FIX_sint32_sint32_sint32.All_Maps_FIX.Maps_Raster_3 Two_D.FIX_sint8_sint8_sint8.All_Maps_FIX.Maps_Raster_3 Two_D.FIX_uint16_uint16_uint16.All_Maps_FIX.Maps_Raster_3 Two_D.FIX_uint32_uint32_uint32.All_Maps_FIX.Maps_Raster_3 Two_D.FIX_uint8_uint8_uint8.All_Maps_FIX.Maps_Raster_3 /end REF_CHARACTERISTIC
/end GROUP
/begin GROUP STD_sint16_sint16.All_Curves_STD.Curves_Raster_2 ""
 /begin REF_MEASUREMENT Calculated.STD_sint16_sint16.All_Curves_STD.Curves_Raster_2 M_In.STD_sint16_sint16.All_Curves_STD.Curves_Raster_2 M_out.STD_sint16_sint16.All_Curves_STD.Curves_Raster_2 /end REF_MEASUREMENT
 /begin REF_CHARACTERISTIC One_D.STD_sint16_sint16.All_Curves_STD.Curves_Raster_2 P_Do_Active_Std.STD_sint16_sint16.All_Curves_STD.Curves_Raster_2 P_In.STD_sint16_sint16.All_Curves_STD.Curves_Raster_2 /end REF_CHARACTERISTIC
/end GROUP
/begin GROUP STD_sint16_sint16.All_Curves_STD.Curves_Raster_3 ""
 /begin REF_MEASUREMENT Calculated.STD_sint16_sint16.All_Curves_STD.Curves_Raster_3 M_In.STD_sint16_sint16.All_Curves_STD.Curves_Raster_3 M_out.STD_sint16_sint16.All_Curves_STD.Curves_Raster_3 /end REF_MEASUREMENT
 /begin REF_CHARACTERISTIC One_D.STD_sint16_sint16.All_Curves_STD.Curves_Raster_3 P_Do_Active_Std.STD_sint16_sint16.All_Curves_STD.Curves_Raster_3 P_In.STD_sint16_sint16.All_Curves_STD.Curves_Raster_3 /end REF_CHARACTERISTIC
/end GROUP
/begin GROUP STD_sint32_sint32.All_Curves_STD.Curves_Raster_2 ""
 /begin REF_MEASUREMENT Calculated.STD_sint32_sint32.All_Curves_STD.Curves_Raster_2 M_In.STD_sint32_sint32.All_Curves_STD.Curves_Raster_2 M_out.STD_sint32_sint32.All_Curves_STD.Curves_Raster_2 /end REF_MEASUREMENT
 /begin REF_CHARACTERISTIC One_D.STD_sint32_sint32.All_Curves_STD.Curves_Raster_2 P_Do_Active_Std.STD_sint32_sint32.All_Curves_STD.Curves_Raster_2 P_In.STD_sint32_sint32.All_Curves_STD.Curves_Raster_2 /end REF_CHARACTERISTIC
/end GROUP
/begin GROUP STD_sint32_sint32.All_Curves_STD.Curves_Raster_3 ""
 /begin REF_MEASUREMENT Calculated.STD_sint32_sint32.All_Curves_STD.Curves_Raster_3 M_In.STD_sint32_sint32.All_Curves_STD.Curves_Raster_3 M_out.STD_sint32_sint32.All_Curves_STD.Curves_Raster_3 /end REF_MEASUREMENT
 /begin REF_CHARACTERISTIC One_D.STD_sint32_sint32.All_Curves_STD.Curves_Raster_3 P_Do_Active_Std.STD_sint32_sint32.All_Curves_STD.Curves_Raster_3 P_In.STD_sint32_sint32.All_Curves_STD.Curves_Raster_3 /end REF_CHARACTERISTIC
/end GROUP
/begin GROUP STD_sint8_sint8.All_Curves_STD.Curves_Raster_2 ""
 /begin REF_MEASUREMENT Calculated.STD_sint8_sint8.All_Curves_STD.Curves_Raster_2 M_In.STD_sint8_sint8.All_Curves_STD.Curves_Raster_2 M_out.STD_sint8_sint8.All_Curves_STD.Curves_Raster_2 /end REF_MEASUREMENT
 /begin REF_CHARACTERISTIC One_D.STD_sint8_sint8.All_Curves_STD.Curves_Raster_2 P_Do_Active_Std.STD_sint8_sint8.All_Curves_STD.Curves_Raster_2 P_In.STD_sint8_sint8.All_Curves_STD.Curves_Raster_2 /end REF_CHARACTERISTIC
/end GROUP
/begin GROUP STD_sint8_sint8.All_Curves_STD.Curves_Raster_3 ""
 /begin REF_MEASUREMENT Calculated.STD_sint8_sint8.All_Curves_STD.Curves_Raster_3 M_In.STD_sint8_sint8.All_Curves_STD.Curves_Raster_3 M_out.STD_sint8_sint8.All_Curves_STD.Curves_Raster_3 /end REF_MEASUREMENT
 /begin REF_CHARACTERISTIC One_D.STD_sint8_sint8.All_Curves_STD.Curves_Raster_3 P_Do_Active_Std.STD_sint8_sint8.All_Curves_STD.Curves_Raster_3 P_In.STD_sint8_sint8.All_Curves_STD.Curves_Raster_3 /end REF_CHARACTERISTIC
/end GROUP
/begin GROUP STD_uint16_uint16.All_Curves_STD.Curves_Raster_2 ""
 /begin REF_MEASUREMENT Calculated.STD_uint16_uint16.All_Curves_STD.Curves_Raster_2 M_In.STD_uint16_uint16.All_Curves_STD.Curves_Raster_2 M_out.STD_uint16_uint16.All_Curves_STD.Curves_Raster_2 /end REF_MEASUREMENT
 /begin REF_CHARACTERISTIC One_D.STD_uint16_uint16.All_Curves_STD.Curves_Raster_2 P_Do_Active_Std.STD_uint16_uint16.All_Curves_STD.Curves_Raster_2 P_In.STD_uint16_uint16.All_Curves_STD.Curves_Raster_2 /end REF_CHARACTERISTIC
/end GROUP
/begin GROUP STD_uint16_uint16.All_Curves_STD.Curves_Raster_3 ""
 /begin REF_MEASUREMENT Calculated.STD_uint16_uint16.All_Curves_STD.Curves_Raster_3 M_In.STD_uint16_uint16.All_Curves_STD.Curves_Raster_3 M_out.STD_uint16_uint16.All_Curves_STD.Curves_Raster_3 /end REF_MEASUREMENT
 /begin REF_CHARACTERISTIC One_D.STD_uint16_uint16.All_Curves_STD.Curves_Raster_3 P_Do_Active_Std.STD_uint16_uint16.All_Curves_STD.Curves_Raster_3 P_In.STD_uint16_uint16.All_Curves_STD.Curves_Raster_3 /end REF_CHARACTERISTIC
/end GROUP
/begin GROUP STD_uint32_uint32.All_Curves_STD.Curves_Raster_2 ""
 /begin REF_MEASUREMENT Calculated.STD_uint32_uint32.All_Curves_STD.Curves_Raster_2 M_In.STD_uint32_uint32.All_Curves_STD.Curves_Raster_2 M_out.STD_uint32_uint32.All_Curves_STD.Curves_Raster_2 /end REF_MEASUREMENT
 /begin REF_CHARACTERISTIC One_D.STD_uint32_uint32.All_Curves_STD.Curves_Raster_2 P_Do_Active_Std.STD_uint32_uint32.All_Curves_STD.Curves_Raster_2 P_In.STD_uint32_uint32.All_Curves_STD.Curves_Raster_2 /end REF_CHARACTERISTIC
/end GROUP
/begin GROUP STD_uint32_uint32.All_Curves_STD.Curves_Raster_3 ""
 /begin REF_MEASUREMENT Calculated.STD_uint32_uint32.All_Curves_STD.Curves_Raster_3 M_In.STD_uint32_uint32.All_Curves_STD.Curves_Raster_3 M_out.STD_uint32_uint32.All_Curves_STD.Curves_Raster_3 /end REF_MEASUREMENT
 /begin REF_CHARACTERISTIC One_D.STD_uint32_uint32.All_Curves_STD.Curves_Raster_3 P_Do_Active_Std.STD_uint32_uint32.All_Curves_STD.Curves_Raster_3 P_In.STD_uint32_uint32.All_Curves_STD.Curves_Raster_3 /end REF_CHARACTERISTIC
/end GROUP
/begin GROUP STD_uint8_uint8.All_Curves_STD.Curves_Raster_2 ""
 /begin REF_MEASUREMENT Calculated.STD_uint8_uint8.All_Curves_STD.Curves_Raster_2 M_In.STD_uint8_uint8.All_Curves_STD.Curves_Raster_2 M_out.STD_uint8_uint8.All_Curves_STD.Curves_Raster_2 /end REF_MEASUREMENT
 /begin REF_CHARACTERISTIC One_D.STD_uint8_uint8.All_Curves_STD.Curves_Raster_2 P_Do_Active_Std.STD_uint8_uint8.All_Curves_STD.Curves_Raster_2 P_In.STD_uint8_uint8.All_Curves_STD.Curves_Raster_2 /end REF_CHARACTERISTIC
/end GROUP
/begin GROUP STD_uint8_uint8.All_Curves_STD.Curves_Raster_3 ""
 /begin REF_MEASUREMENT Calculated.STD_uint8_uint8.All_Curves_STD.Curves_Raster_3 M_In.STD_uint8_uint8.All_Curves_STD.Curves_Raster_3 M_out.STD_uint8_uint8.All_Curves_STD.Curves_Raster_3 /end REF_MEASUREMENT
 /begin REF_CHARACTERISTIC One_D.STD_uint8_uint8.All_Curves_STD.Curves_Raster_3 P_Do_Active_Std.STD_uint8_uint8.All_Curves_STD.Curves_Raster_3 P_In.STD_uint8_uint8.All_Curves_STD.Curves_Raster_3 /end REF_CHARACTERISTIC
/end GROUP
/begin RECORD_LAYOUT STANDARD_CURVE_S16S16 FNC_VALUES 3 SWORD COLUMN_DIR DIRECT AXIS_PTS_X 2 SWORD INDEX_INCR DIRECT NO_AXIS_PTS_X 1 UWORD /end RECORD_LAYOUT
/begin RECORD_LAYOUT STANDARD_CURVE_S32S32 FNC_VALUES 3 SLONG COLUMN_DIR DIRECT AXIS_PTS_X 2 SLONG INDEX_INCR DIRECT NO_AXIS_PTS_X 1 UWORD /end RECORD_LAYOUT
/begin RECORD_LAYOUT STANDARD_CURVE_S8S8 FNC_VALUES 3 SBYTE COLUMN_DIR DIRECT AXIS_PTS_X 2 SBYTE INDEX_INCR DIRECT NO_AXIS_PTS_X 1 UBYTE /end RECORD_LAYOUT
/begin RECORD_LAYOUT STANDARD_CURVE_U16U16 FNC_VALUES 3 UWORD COLUMN_DIR DIRECT AXIS_PTS_X 2 UWORD INDEX_INCR DIRECT NO_AXIS_PTS_X 1 UWORD /end RECORD_LAYOUT
/begin RECORD_LAYOUT STANDARD_CURVE_U32U32 FNC_VALUES 3 ULONG COLUMN_DIR DIRECT AXIS_PTS_X 2 ULONG INDEX_INCR DIRECT NO_AXIS_PTS_X 1 UWORD /end RECORD_LAYOUT
/begin RECORD_LAYOUT STANDARD_CURVE_U8U8 FNC_VALUES 3 UBYTE COLUMN_DIR DIRECT AXIS_PTS_X 2 UBYTE INDEX_INCR DIRECT NO_AXIS_PTS_X 1 UBYTE /end RECORD_LAYOUT
/begin RECORD_LAYOUT STANDARD_DIST_R32 AXIS_PTS_X 2 FLOAT32_IEEE INDEX_INCR DIRECT NO_AXIS_PTS_X 1 UWORD /end RECORD_LAYOUT
/begin RECORD_LAYOUT STANDARD_DIST_S16 AXIS_PTS_X 2 SWORD INDEX_INCR DIRECT NO_AXIS_PTS_X 1 UWORD /end RECORD_LAYOUT
/begin RECORD_LAYOUT STANDARD_DIST_S32 AXIS_PTS_X 2 SLONG INDEX_INCR DIRECT NO_AXIS_PTS_X 1 UWORD /end RECORD_LAYOUT
/begin RECORD_LAYOUT STANDARD_DIST_S8 AXIS_PTS_X 2 SBYTE INDEX_INCR DIRECT NO_AXIS_PTS_X 1 UBYTE /end RECORD_LAYOUT
/begin RECORD_LAYOUT STANDARD_DIST_U16 AXIS_PTS_X 2 UWORD INDEX_INCR DIRECT NO_AXIS_PTS_X 1 UWORD /end RECORD_LAYOUT
/begin RECORD_LAYOUT STANDARD_DIST_U32 AXIS_PTS_X 2 ULONG INDEX_INCR DIRECT NO_AXIS_PTS_X 1 UWORD /end RECORD_LAYOUT
/begin RECORD_LAYOUT STANDARD_DIST_U8 AXIS_PTS_X 2 UBYTE INDEX_INCR DIRECT NO_AXIS_PTS_X 1 UBYTE /end RECORD_LAYOUT
/begin RECORD_LAYOUT STANDARD_FIXED_R32 FNC_VALUES 1 FLOAT32_IEEE COLUMN_DIR DIRECT /end RECORD_LAYOUT
/begin RECORD_LAYOUT STANDARD_FIXED_S16 FNC_VALUES 1 SWORD COLUMN_DIR DIRECT /end RECORD_LAYOUT
/begin RECORD_LAYOUT STANDARD_FIXED_S32 FNC_VALUES 1 SLONG COLUMN_DIR DIRECT /end RECORD_LAYOUT
/begin RECORD_LAYOUT STANDARD_FIXED_S8 FNC_VALUES 1 SBYTE COLUMN_DIR DIRECT /end RECORD_LAYOUT
/begin RECORD_LAYOUT STANDARD_FIXED_U16 FNC_VALUES 1 UWORD COLUMN_DIR DIRECT /end RECORD_LAYOUT
/begin RECORD_LAYOUT STANDARD_FIXED_U32 FNC_VALUES 1 ULONG COLUMN_DIR DIRECT /end RECORD_LAYOUT
/begin RECORD_LAYOUT STANDARD_FIXED_U8 FNC_VALUES 1 UBYTE COLUMN_DIR DIRECT /end RECORD_LAYOUT
/begin RECORD_LAYOUT STANDARD_GROUP_R32 FNC_VALUES 1 FLOAT32_IEEE COLUMN_DIR DIRECT /end RECORD_LAYOUT
/begin RECORD_LAYOUT STANDARD_GROUP_S16 FNC_VALUES 1 SWORD COLUMN_DIR DIRECT /end RECORD_LAYOUT
/begin RECORD_LAYOUT STANDARD_GROUP_S32 FNC_VALUES 1 SLONG COLUMN_DIR DIRECT /end RECORD_LAYOUT
/begin RECORD_LAYOUT STANDARD_GROUP_S8 FNC_VALUES 1 SBYTE COLUMN_DIR DIRECT /end RECORD_LAYOUT
/begin RECORD_LAYOUT STANDARD_GROUP_U16 FNC_VALUES 1 UWORD COLUMN_DIR DIRECT /end RECORD_LAYOUT
/begin RECORD_LAYOUT STANDARD_GROUP_U32 FNC_VALUES 1 ULONG COLUMN_DIR DIRECT /end RECORD_LAYOUT
/begin RECORD_LAYOUT STANDARD_GROUP_U8 FNC_VALUES 1 UBYTE COLUMN_DIR DIRECT /end RECORD_LAYOUT
/begin RECORD_LAYOUT STANDARD_VALUE_R32 FNC_VALUES 1 FLOAT32_IEEE COLUMN_DIR DIRECT /end RECORD_LAYOUT
/begin RECORD_LAYOUT STANDARD_VALUE_S16 FNC_VALUES 1 SWORD COLUMN_DIR DIRECT /end RECORD_LAYOUT
/begin RECORD_LAYOUT STANDARD_VALUE_S32 FNC_VALUES 1 SLONG COLUMN_DIR DIRECT /end RECORD_LAYOUT
/begin RECORD_LAYOUT STANDARD_VALUE_S8 FNC_VALUES 1 SBYTE COLUMN_DIR DIRECT /end RECORD_LAYOUT
/begin RECORD_LAYOUT STANDARD_VALUE_U16 FNC_VALUES 1 UWORD COLUMN_DIR DIRECT /end RECORD_LAYOUT
/begin RECORD_LAYOUT STANDARD_VALUE_U32 FNC_VALUES 1 ULONG COLUMN_DIR DIRECT /end RECORD_LAYOUT
/begin RECORD_LAYOUT STANDARD_VALUE_U8 FNC_VALUES 1 UBYTE COLUMN_DIR DIRECT /end RECORD_LAYOUT
/end MODULE
/end PROJECT
