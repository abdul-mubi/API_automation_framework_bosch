ASAP2_VERSION 1 61
/begin PROJECT HWA_UDSonCAN_ReferenceSystem "Modified for UDSonCAN Tests with new CalMeasure Mapping"
/begin HEADER "" VERSION "000" PROJECT_NO ASD /end HEADER
/begin MODULE HWA_UDSonCAN_ReferenceSystem "Modified for UDSonCAN Tests with new CalMeasure Mapping"
/begin MOD_COMMON "2013-05-06 09:52:20	create by ETASHexVirtualAddressTableHeaderV2" BYTE_ORDER MSB_FIRST ALIGNMENT_BYTE 1 ALIGNMENT_WORD 2 ALIGNMENT_LONG 4 ALIGNMENT_FLOAT32_IEEE 4 ALIGNMENT_FLOAT64_IEEE 8 /end MOD_COMMON
/begin CHARACTERISTIC _element_of_base_folder_will_be_removed.Cal_Measure "" VALUE 0x1D0134 STANDARD_VALUE_U8 0.0 ident 0 1 BIT_MASK 0x1 /end CHARACTERISTIC
/begin CHARACTERISTIC calc_loops_16.Curve_Module "" VALUE 0x1D1774 STANDARD_VALUE_U16 0.0 ident 0 65535 /end CHARACTERISTIC
/begin CHARACTERISTIC calc_loops_32.Curve_Module "" VALUE 0x1D1776 STANDARD_VALUE_U16 0.0 ident 0 65535 /end CHARACTERISTIC
/begin CHARACTERISTIC curve_table.Curve_Calc_16.Curve_Module "" CURVE 0x1D14A6 STANDARD_CURVE_U16U16 0.0 ident 0.0 65535.0
 /begin AXIS_DESCR STD_AXIS input_array.Curve_Calc_16.Curve_Module ident 10 0.0 65535.0 /end AXIS_DESCR
/end CHARACTERISTIC
/begin CHARACTERISTIC curve_table.Curve_Calc_32.Curve_Module "" CURVE 0x1D1534 STANDARD_CURVE_U32U16 0.0 ident 0.0 65535.0
 /begin AXIS_DESCR STD_AXIS input_array.Curve_Calc_32.Curve_Module ident 10 0.0 4294967295.0 /end AXIS_DESCR
/end CHARACTERISTIC
/begin CHARACTERISTIC curve_table.Curve_Calc_real32.Curve_Module "" CURVE 0x1D14D8 STANDARD_CURVE_R32R32 0.0 ident -1.e+037 1.e+037
 /begin AXIS_DESCR STD_AXIS input_array.Curve_Calc_real32.Curve_Module ident 10 -1.e+037 1.e+037 /end AXIS_DESCR
/end CHARACTERISTIC
/begin CHARACTERISTIC ip_NumEntries_u8.C_ClassUdsVIN.UdsLocIDs "" VALUE 0x1DAA5C STANDARD_VALUE_U8 0.0 ident 0 255 /end CHARACTERISTIC
/begin CHARACTERISTIC ip_NumEntries_u8.C_ClassUdsVIN2.UdsLocIDs "" VALUE 0x1DAA5D STANDARD_VALUE_U8 0.0 ident 0 255 /end CHARACTERISTIC
/begin CHARACTERISTIC KL_Direct_fl32.Curve_Mod "" CURVE 0x1D1658 STANDARD_CURVE_R64R64 0.0 ident -1.e+037 1.e+037
 /begin AXIS_DESCR STD_AXIS M_In_KL_Direct_fl32.Curve_Mod ident 8 -1.e+037 1.e+037 /end AXIS_DESCR
/end CHARACTERISTIC
/begin CHARACTERISTIC KL1_Distr_fl32_Distrib1.Curve_Mod "" CURVE 0x1D1598 STANDARD_GROUP_R64 0.0 ident -1.e+037 1.e+037
 /begin AXIS_DESCR COM_AXIS M_In_fl32_Distrib1.Curve_Mod ident 8 -1.e+037 1.e+037 AXIS_PTS_REF Distrib1.Curve_Mod /end AXIS_DESCR
/end CHARACTERISTIC
/begin CHARACTERISTIC KL2_Distr_fl32_Distrib1.Curve_Mod "" CURVE 0x1D15D8 STANDARD_GROUP_R64 0.0 ident -1.e+037 1.e+037
 /begin AXIS_DESCR COM_AXIS M_In_fl32_Distrib1.Curve_Mod ident 8 -1.e+037 1.e+037 AXIS_PTS_REF Distrib1.Curve_Mod /end AXIS_DESCR
/end CHARACTERISTIC
/begin CHARACTERISTIC KL3_Distr_fl32_Distrib2.Curve_Mod "" CURVE 0x1D1618 STANDARD_GROUP_R64 0.0 ident -1.e+037 1.e+037
 /begin AXIS_DESCR COM_AXIS M_In_fl32_Distrib2.Curve_Mod ident 8 -1.e+037 1.e+037 AXIS_PTS_REF Distrib2.Curve_Mod /end AXIS_DESCR
/end CHARACTERISTIC
/begin CHARACTERISTIC nr_of_cells.Curve_Calc_16.Curve_Module "" VALUE 0x1D14A4 STANDARD_VALUE_U8 0.0 ident 0 255 /end CHARACTERISTIC
/begin CHARACTERISTIC nr_of_cells.Curve_Calc_32.Curve_Module "" VALUE 0x1D1530 STANDARD_VALUE_U8 0.0 ident 0 255 /end CHARACTERISTIC
/begin CHARACTERISTIC nr_of_cells.Curve_Calc_real32.Curve_Module "" VALUE 0x1D14D4 STANDARD_VALUE_U8 0.0 ident 0 255 /end CHARACTERISTIC
/begin CHARACTERISTIC P_CAN_C_Buf.CanDriver "" VAL_BLK 0x1D0FE8 STANDARD_VALUE_U32 0.0 ident 0 4294967295 MATRIX_DIM 64 1 1 /end CHARACTERISTIC
/begin CHARACTERISTIC P_CAN_C_IdTyp.CanDriver "" VAL_BLK 0x1D10E8 STANDARD_VALUE_U32 0.0 ident 0 4294967295 MATRIX_DIM 64 1 1 /end CHARACTERISTIC
/begin CHARACTERISTIC P_CAN_DataSwitch.CanDriver "" VALUE 0x1D1300 STANDARD_VALUE_U8 0.0 ident 0 1 BIT_MASK 0x1 /end CHARACTERISTIC
/begin CHARACTERISTIC P_CAN_IDs.CanDriver "" VAL_BLK 0x1D11E8 STANDARD_VALUE_U32 0.0 ident 0 4294967295 MATRIX_DIM 65 1 1 /end CHARACTERISTIC
/begin CHARACTERISTIC P_CAN_IDs_fast.CanDriver "" VAL_BLK 0x1D12EC STANDARD_VALUE_U32 0.0 ident 0 4294967295 MATRIX_DIM 5 1 1 /end CHARACTERISTIC
/begin CHARACTERISTIC P_CAN_Length.CanDriver "" VAL_BLK 0x1D1301 STANDARD_VALUE_U8 0.0 ident 1 8 MATRIX_DIM 64 1 1 /end CHARACTERISTIC
/begin CHARACTERISTIC P_CAN_Length_fast.CanDriver "" VAL_BLK 0x1D1341 STANDARD_VALUE_U8 0.0 ident 1 8 MATRIX_DIM 5 1 1 /end CHARACTERISTIC
/begin CHARACTERISTIC P_can_on_off.CanDriver "" VALUE 0x1D1356 STANDARD_VALUE_U8 0.0 ident 0 1 BIT_MASK 0x1 /end CHARACTERISTIC
/begin CHARACTERISTIC P_CAN_R01_Enable.CanDriver "" VALUE 0x1D1346 STANDARD_VALUE_U8 0.0 ident 0 1 BIT_MASK 0x1 /end CHARACTERISTIC
/begin CHARACTERISTIC P_CAN_R02_Enable.CanDriver "" VALUE 0x1D1347 STANDARD_VALUE_U8 0.0 ident 0 1 BIT_MASK 0x1 /end CHARACTERISTIC
/begin CHARACTERISTIC P_CAN_R03_Enable.CanDriver "" VALUE 0x1D1348 STANDARD_VALUE_U8 0.0 ident 0 1 BIT_MASK 0x1 /end CHARACTERISTIC
/begin CHARACTERISTIC P_CAN_R04_Enable.CanDriver "" VALUE 0x1D1349 STANDARD_VALUE_U8 0.0 ident 0 1 BIT_MASK 0x1 /end CHARACTERISTIC
/begin CHARACTERISTIC P_CAN_R05_Enable.CanDriver "" VALUE 0x1D134A STANDARD_VALUE_U8 0.0 ident 0 1 BIT_MASK 0x1 /end CHARACTERISTIC
/begin CHARACTERISTIC P_CAN_R06_Enable.CanDriver "" VALUE 0x1D134B STANDARD_VALUE_U8 0.0 ident 0 1 BIT_MASK 0x1 /end CHARACTERISTIC
/begin CHARACTERISTIC P_CAN_R07_Enable.CanDriver "" VALUE 0x1D134C STANDARD_VALUE_U8 0.0 ident 0 1 BIT_MASK 0x1 /end CHARACTERISTIC
/begin CHARACTERISTIC P_CAN_R08_Enable.CanDriver "" VALUE 0x1D134D STANDARD_VALUE_U8 0.0 ident 0 1 BIT_MASK 0x1 /end CHARACTERISTIC
/begin CHARACTERISTIC P_CAN_R09_Enable.CanDriver "" VALUE 0x1D134E STANDARD_VALUE_U8 0.0 ident 0 1 BIT_MASK 0x1 /end CHARACTERISTIC
/begin CHARACTERISTIC P_CAN_R10_Enable.CanDriver "" VALUE 0x1D134F STANDARD_VALUE_U8 0.0 ident 0 1 BIT_MASK 0x1 /end CHARACTERISTIC
/begin CHARACTERISTIC P_CAN_R11_Enable.CanDriver "" VALUE 0x1D1350 STANDARD_VALUE_U8 0.0 ident 0 1 BIT_MASK 0x1 /end CHARACTERISTIC
/begin CHARACTERISTIC P_CAN_R12_Enable.CanDriver "" VALUE 0x1D1351 STANDARD_VALUE_U8 0.0 ident 0 1 BIT_MASK 0x1 /end CHARACTERISTIC
/begin CHARACTERISTIC P_CAN_R13_Enable.CanDriver "" VALUE 0x1D1352 STANDARD_VALUE_U8 0.0 ident 0 1 BIT_MASK 0x1 /end CHARACTERISTIC
/begin CHARACTERISTIC P_CAN_R14_Enable.CanDriver "" VALUE 0x1D1353 STANDARD_VALUE_U8 0.0 ident 0 1 BIT_MASK 0x1 /end CHARACTERISTIC
/begin CHARACTERISTIC P_CAN_R15_Enable.CanDriver "" VALUE 0x1D1354 STANDARD_VALUE_U8 0.0 ident 0 1 BIT_MASK 0x1 /end CHARACTERISTIC
/begin CHARACTERISTIC P_CAN_R16_Enable.CanDriver "" VALUE 0x1D1355 STANDARD_VALUE_U8 0.0 ident 0 1 BIT_MASK 0x1 /end CHARACTERISTIC
/begin CHARACTERISTIC p_CarbPID05_deltaEnCoTemp40_u8.CRB_OBD "" VALUE 0x1D13A0 STANDARD_VALUE_S8 0.0 ident 0 127 /end CHARACTERISTIC
/begin CHARACTERISTIC p_CarbPID0C_deltaEngineRPM_u8.CRB_OBD "" VALUE 0x1D139D STANDARD_VALUE_S8 0.0 ident 0 127 /end CHARACTERISTIC
/begin CHARACTERISTIC P_Card01PID01_MIL_b.CRB_OBD "" VALUE 0x1D139E STANDARD_VALUE_U8 0.0 ident 0 1 BIT_MASK 0x1 /end CHARACTERISTIC
/begin CHARACTERISTIC P_counter_1_delta.Counter_module_Mle "" VALUE 0x1D1390 STANDARD_VALUE_U8 0.0 ident 0 255 /end CHARACTERISTIC
/begin CHARACTERISTIC P_counter_1_updown.Counter_module_Mle "" VALUE 0x1D1391 STANDARD_VALUE_U8 0.0 enum_UPDOWN_ENUM 0 1 /end CHARACTERISTIC
/begin CHARACTERISTIC p_DefaultDiagProtocol_u8.DiagKwpUds "" VALUE 0x1D2355 STANDARD_VALUE_U8 0.0 enum_ACTIVE_DIAG_PROTOCOL_E 0 3 /end CHARACTERISTIC
/begin CHARACTERISTIC P_DetectDTCDuringDriveCycle_b.CRB_OBD "" VALUE 0x1D139C STANDARD_VALUE_U8 0.0 ident 0 1 BIT_MASK 0x1 /end CHARACTERISTIC
/begin CHARACTERISTIC p_DiagBSmax_u8.DiagKwpUds "" VALUE 0x1D2356 STANDARD_VALUE_U8 0.0 ident 0 255 /end CHARACTERISTIC
/begin CHARACTERISTIC p_DiagErrorPrescaler_u8.DiagKwpUds "" VALUE 0x1D2358 STANDARD_VALUE_U8 0.0 ident 0 255 /end CHARACTERISTIC
/begin CHARACTERISTIC p_DiagErrorSID_u8.DiagKwpUds "" VALUE 0x1D2351 STANDARD_VALUE_U8 0.0 ident 0 255 /end CHARACTERISTIC
/begin CHARACTERISTIC p_DiagGenNumByteRespError_u8.DiagKwpUds "" VALUE 0x1D2354 STANDARD_VALUE_U8 0.0 ident 0 255 /end CHARACTERISTIC
/begin CHARACTERISTIC p_DiagInfoSetGet_u8.DiagKwpUds "" VALUE 0x1D2359 STANDARD_VALUE_U8 0.0 enum_DIAGINFO_e 0 15 /end CHARACTERISTIC
/begin CHARACTERISTIC p_DiagNumError_u8.DiagKwpUds "" VALUE 0x1D2353 STANDARD_VALUE_U8 0.0 ident 0 255 /end CHARACTERISTIC
/begin CHARACTERISTIC p_DiagRespCode_u8.DiagKwpUds "" VALUE 0x1D2350 STANDARD_VALUE_U8 0.0 enum_DIAG_RESP_CODE_E 0 9 /end CHARACTERISTIC
/begin CHARACTERISTIC p_DiagResponce_u8.DiagKwpUds "" VAL_BLK 0x1D235C STANDARD_VALUE_U8 0.0 ident 0 255 MATRIX_DIM 10 1 1 /end CHARACTERISTIC
/begin CHARACTERISTIC p_DiagSTmin_u8.DiagKwpUds "" VALUE 0x1D2352 STANDARD_VALUE_U8 0.0 ident 0 255 /end CHARACTERISTIC
/begin CHARACTERISTIC p_DiagTriggerError_u8.DiagKwpUds "" VALUE 0x1D2357 STANDARD_VALUE_U8 0.0 enum_DIAG_ERROR_TRIGGER_E 0 2 /end CHARACTERISTIC
/begin CHARACTERISTIC P_Do_Curves.Curves_Raster_1 "" VALUE 0x1D1780 STANDARD_VALUE_U8 0.0 ident 0 1 BIT_MASK 0x1 /end CHARACTERISTIC
/begin CHARACTERISTIC P_Do_Curves.Curves_Raster_2 "" VALUE 0x1D1B60 STANDARD_VALUE_U8 0.0 ident 0 1 BIT_MASK 0x1 /end CHARACTERISTIC
/begin CHARACTERISTIC P_Do_Curves.Curves_Raster_3 "" VALUE 0x1D1F40 STANDARD_VALUE_U8 0.0 ident 0 1 BIT_MASK 0x1 /end CHARACTERISTIC
/begin CHARACTERISTIC P_EmissionRelatedDTCStored_b.CRB_OBD "" VALUE 0x1D139B STANDARD_VALUE_U8 0.0 ident 0 1 BIT_MASK 0x1 /end CHARACTERISTIC
/begin CHARACTERISTIC P_Enable.Dist_B01.Distab13_12T "" VALUE 0x1D23C4 STANDARD_VALUE_U8 0.0 ident 0 1 BIT_MASK 0x1 /end CHARACTERISTIC
/begin CHARACTERISTIC P_Enable.Dist_B02.Distab13_12T "" VALUE 0x1D23DC STANDARD_VALUE_U8 0.0 ident 0 1 BIT_MASK 0x1 /end CHARACTERISTIC
/begin CHARACTERISTIC P_Enable.Dist_B03.Distab13_12T "" VALUE 0x1D23F4 STANDARD_VALUE_U8 0.0 ident 0 1 BIT_MASK 0x1 /end CHARACTERISTIC
/begin CHARACTERISTIC P_Enable.Dist_B04.Distab13_12T "" VALUE 0x1D240C STANDARD_VALUE_U8 0.0 ident 0 1 BIT_MASK 0x1 /end CHARACTERISTIC
/begin CHARACTERISTIC P_Enable.Dist_R01.Distab13_12T "" VALUE 0x1D2424 STANDARD_VALUE_U8 0.0 ident 0 1 BIT_MASK 0x1 /end CHARACTERISTIC
/begin CHARACTERISTIC P_Enable.Dist_R02.Distab13_12T "" VALUE 0x1D2434 STANDARD_VALUE_U8 0.0 ident 0 1 BIT_MASK 0x1 /end CHARACTERISTIC
/begin CHARACTERISTIC P_Enable.Dist_R03.Distab13_12T "" VALUE 0x1D2444 STANDARD_VALUE_U8 0.0 ident 0 1 BIT_MASK 0x1 /end CHARACTERISTIC
/begin CHARACTERISTIC P_Enable.Dist_R04.Distab13_12T "" VALUE 0x1D2454 STANDARD_VALUE_U8 0.0 ident 0 1 BIT_MASK 0x1 /end CHARACTERISTIC
/begin CHARACTERISTIC P_Enable.Dist_R05.Distab13_12T "" VALUE 0x1D2464 STANDARD_VALUE_U8 0.0 ident 0 1 BIT_MASK 0x1 /end CHARACTERISTIC
/begin CHARACTERISTIC P_Enable.Dist_R06.Distab13_12T "" VALUE 0x1D2474 STANDARD_VALUE_U8 0.0 ident 0 1 BIT_MASK 0x1 /end CHARACTERISTIC
/begin CHARACTERISTIC P_Enable.Dist_R07.Distab13_12T "" VALUE 0x1D2484 STANDARD_VALUE_U8 0.0 ident 0 1 BIT_MASK 0x1 /end CHARACTERISTIC
/begin CHARACTERISTIC P_Enable.Dist_R08.Distab13_12T "" VALUE 0x1D2494 STANDARD_VALUE_U8 0.0 ident 0 1 BIT_MASK 0x1 /end CHARACTERISTIC
/begin CHARACTERISTIC P_Enable.Dist_R09.Distab13_12T "" VALUE 0x1D24A4 STANDARD_VALUE_U8 0.0 ident 0 1 BIT_MASK 0x1 /end CHARACTERISTIC
/begin CHARACTERISTIC P_Enable.Dist_R10.Distab13_12T "" VALUE 0x1D24B4 STANDARD_VALUE_U8 0.0 ident 0 1 BIT_MASK 0x1 /end CHARACTERISTIC
/begin CHARACTERISTIC P_Enable.Dist_R11.Distab13_12T "" VALUE 0x1D24C4 STANDARD_VALUE_U8 0.0 ident 0 1 BIT_MASK 0x1 /end CHARACTERISTIC
/begin CHARACTERISTIC P_Enable.Dist_R12.Distab13_12T "" VALUE 0x1D24D4 STANDARD_VALUE_U8 0.0 ident 0 1 BIT_MASK 0x1 /end CHARACTERISTIC
/begin CHARACTERISTIC P_extended_on_off.CanDriver "" VALUE 0x1D1357 STANDARD_VALUE_U8 0.0 ident 0 1 BIT_MASK 0x1 /end CHARACTERISTIC
/begin CHARACTERISTIC P_F32_1.Cal_Measure "" VALUE 0x1D0108 STANDARD_VALUE_R32 0.0 ident -1.e+037 1.e+037 /end CHARACTERISTIC
/begin CHARACTERISTIC P_F32_1.Shared.Cal_Measure "" VALUE 0x1D0598 STANDARD_VALUE_R32 0.0 ident -1.e+037 1.e+037 /end CHARACTERISTIC
/begin CHARACTERISTIC P_F32_2.Cal_Measure "" VALUE 0x1D010C STANDARD_VALUE_R32 0.0 ident -1.e+037 1.e+037 /end CHARACTERISTIC
/begin CHARACTERISTIC P_F32_2.Shared.Cal_Measure "" VALUE 0x1D059C STANDARD_VALUE_R32 0.0 ident -1.e+037 1.e+037 /end CHARACTERISTIC
/* /end C:/ETAS/ASCET513/target/mpc555/Add_ToolChain/ASAP_Templates\P_F32_FORMULA.a2l inserted by script merge_Tab.pl */
/begin CHARACTERISTIC P_F64_1.Cal_Measure "" VALUE 0x1D00F8 STANDARD_VALUE_R64 0.0 ident -1.e+037 1.e+037 /end CHARACTERISTIC
/begin CHARACTERISTIC P_F64_1.Shared.Cal_Measure "" VALUE 0x1D0588 STANDARD_VALUE_R64 0.0 ident -1.e+037 1.e+037 /end CHARACTERISTIC
/begin CHARACTERISTIC P_F64_2.Cal_Measure "" VALUE 0x1D0100 STANDARD_VALUE_R64 0.0 ident -1.e+037 1.e+037 /end CHARACTERISTIC
/begin CHARACTERISTIC P_F64_2.Shared.Cal_Measure "" VALUE 0x1D0590 STANDARD_VALUE_R64 0.0 ident -1.e+037 1.e+037 /end CHARACTERISTIC
/* /end C:/ETAS/ASCET513/target/mpc555/Add_ToolChain/ASAP_Templates\P_F64_FORMULA.a2l inserted by script merge_Tab.pl */
/begin CHARACTERISTIC P_fast_on_off.CanDriver "" VALUE 0x1D1358 STANDARD_VALUE_U8 0.0 ident 0 1 BIT_MASK 0x1 /end CHARACTERISTIC
/begin CHARACTERISTIC P_Fl32_array.Cal_Measure_Blocks "" VAL_BLK 0x1D0140 STANDARD_VALUE_R64 0.0 ident -1.e+037 1.e+037 MATRIX_DIM 6 1 1 DISPLAY_IDENTIFIER P_Fl32_array.Cal_Measure_Blocks_DISP_ID /end CHARACTERISTIC
/begin CHARACTERISTIC P_Fl32_matrix.Cal_Measure_Blocks "" VAL_BLK 0x1D0170 STANDARD_VALUE_R64 0.0 ident -1.e+037 1.e+037 MATRIX_DIM 5 6 1 DISPLAY_IDENTIFIER P_Fl32_matrix.Cal_Measure_Blocks_DISP_ID /end CHARACTERISTIC
/begin CHARACTERISTIC P_Fl64_array.Cal_Measure_Blocks "" VAL_BLK 0x1D0260 STANDARD_VALUE_R64 0.0 ident -1.e+037 1.e+037 MATRIX_DIM 6 1 1 DISPLAY_IDENTIFIER P_Fl64_array.Cal_Measure_Blocks_DISP_ID /end CHARACTERISTIC
/begin CHARACTERISTIC P_Fl64_matrix.Cal_Measure_Blocks "" VAL_BLK 0x1D0290 STANDARD_VALUE_R64 0.0 ident -1.e+037 1.e+037 MATRIX_DIM 5 6 1 DISPLAY_IDENTIFIER P_Fl64_matrix.Cal_Measure_Blocks_DISP_ID /end CHARACTERISTIC
/begin CHARACTERISTIC P_FreezeFrameDataStored_b.CRB_OBD "" VALUE 0x1D139F STANDARD_VALUE_U8 0.0 ident 0 1 BIT_MASK 0x1 /end CHARACTERISTIC
/begin CHARACTERISTIC P_In_fl32_Distrib1.Curve_Mod "" VALUE 0x1D1588 STANDARD_VALUE_R64 0.0 ident -1.e+037 1.e+037 /end CHARACTERISTIC
/begin CHARACTERISTIC P_In_fl32_Distrib2.Curve_Mod "" VALUE 0x1D1590 STANDARD_VALUE_R64 0.0 ident -1.e+037 1.e+037 /end CHARACTERISTIC
/begin CHARACTERISTIC P_In_KL_Direct_fl32.Curve_Mod "" VALUE 0x1D1580 STANDARD_VALUE_R64 0.0 ident -1.e+037 1.e+037 /end CHARACTERISTIC
/begin CHARACTERISTIC p_Index_x.Shared.Cal_Measure_Block16 "" VALUE 0x1D0FDC STANDARD_VALUE_U8 0.0 ident 0 15 /end CHARACTERISTIC
/begin CHARACTERISTIC p_Index_y.Shared.Cal_Measure_Block16 "" VALUE 0x1D0FDD STANDARD_VALUE_U8 0.0 ident 0 15 /end CHARACTERISTIC
/begin CHARACTERISTIC p_MaxTxDTCinBlock_u8.CRB_OBD "" VALUE 0x1D139A STANDARD_VALUE_U8 0.0 ident 0 255 /end CHARACTERISTIC
/begin CHARACTERISTIC p_NumDTC_u16.CRB_OBD "" VALUE 0x1D1398 STANDARD_VALUE_U16 0.0 ident 0 65535 /end CHARACTERISTIC
/begin CHARACTERISTIC P_Reset_CAN_Err_Counter.CanDriver "" VALUE 0x1D135A STANDARD_VALUE_BIT 0.0 ident 0 1 BIT_MASK 0x80 /end CHARACTERISTIC
/begin CHARACTERISTIC P_reset_counter.Counter_module_Mle "" VALUE 0x1D1392 STANDARD_VALUE_U8 0.0 ident 0 1 BIT_MASK 0x1 /end CHARACTERISTIC
/begin CHARACTERISTIC p_ResetCounter_u8.C_ClassDiagCounter.DiagKwpUds "" VALUE 0x1D00B4 STANDARD_VALUE_U8 0.0 enum_RESET_COUNTER_E 0 1 /end CHARACTERISTIC
/begin CHARACTERISTIC p_ResetTimer_b.DiagP3MasterDownload.DiagKwpUds "" VALUE 0x1D2324 STANDARD_VALUE_U8 0.0 ident 0 1 BIT_MASK 0x1 /end CHARACTERISTIC
/begin CHARACTERISTIC p_ResetTimer_b.DiagSTminDownloadCF1CF2.DiagKwpUds "" VALUE 0x1D2334 STANDARD_VALUE_U8 0.0 ident 0 1 BIT_MASK 0x1 /end CHARACTERISTIC
/begin CHARACTERISTIC p_ResetTimer_b.DiagSTminDownloadCF2CF3.DiagKwpUds "" VALUE 0x1D2344 STANDARD_VALUE_U8 0.0 ident 0 1 BIT_MASK 0x1 /end CHARACTERISTIC
/begin CHARACTERISTIC P_S16_1.Cal_Measure "" VALUE 0x1D0120 STANDARD_VALUE_S16 0.0 ident -32768.0 32767.0 /end CHARACTERISTIC
/begin CHARACTERISTIC P_S16_1.Shared.Cal_Measure "" VALUE 0x1D05B0 STANDARD_VALUE_S16 0.0 ident -32768.0 32767.0 /end CHARACTERISTIC
/begin CHARACTERISTIC P_S16_2.Cal_Measure "" VALUE 0x1D0122 STANDARD_VALUE_S16 0.0 ident -32768.0 32767.0 /end CHARACTERISTIC
/begin CHARACTERISTIC P_S16_2.Shared.Cal_Measure "" VALUE 0x1D05B2 STANDARD_VALUE_S16 0.0 ident -32768.0 32767.0 /end CHARACTERISTIC
/begin CHARACTERISTIC P_S16_3.Cal_Measure "" VALUE 0x1D0124 STANDARD_VALUE_S16 0.0 ident -32768.0 32767.0 /end CHARACTERISTIC
/begin CHARACTERISTIC P_S16_3.Shared.Cal_Measure "" VALUE 0x1D05B4 STANDARD_VALUE_S16 0.0 ident -32768.0 32767.0 /end CHARACTERISTIC
/* /end C:/ETAS/ASCET513/target/mpc555/Add_ToolChain/ASAP_Templates\P_S16_FORMULA.a2l inserted by script merge_Tab.pl */
/begin CHARACTERISTIC P_S32_1.Cal_Measure "" VALUE 0x1D0110 STANDARD_VALUE_S32 0.0 ident -2147483648.0 2147483647.0 /end CHARACTERISTIC
/begin CHARACTERISTIC P_S32_1.Shared.Cal_Measure "" VALUE 0x1D05A0 STANDARD_VALUE_S32 0.0 ident -2147483648.0 2147483647.0 /end CHARACTERISTIC
/begin CHARACTERISTIC P_S32_2.Cal_Measure "" VALUE 0x1D0114 STANDARD_VALUE_S32 0.0 ident -2147483648.0 2147483647.0 /end CHARACTERISTIC
/begin CHARACTERISTIC P_S32_2.Shared.Cal_Measure "" VALUE 0x1D05A4 STANDARD_VALUE_S32 0.0 ident -2147483648.0 2147483647.0 /end CHARACTERISTIC
/* /end C:/ETAS/ASCET513/target/mpc555/Add_ToolChain/ASAP_Templates\P_S32_FORMULA.a2l inserted by script merge_Tab.pl */
/begin CHARACTERISTIC P_S8_1.Cal_Measure "" VALUE 0x1D012C STANDARD_VALUE_S8 0.0 ident -128.0 127.0 /end CHARACTERISTIC
/begin CHARACTERISTIC P_S8_1.Shared.Cal_Measure "" VALUE 0x1D05BC STANDARD_VALUE_S8 0.0 ident -128.0 127.0 /end CHARACTERISTIC
/begin CHARACTERISTIC P_S8_2.Cal_Measure "" VALUE 0x1D012D STANDARD_VALUE_S8 0.0 ident -128.0 127.0 /end CHARACTERISTIC
/begin CHARACTERISTIC P_S8_2.Shared.Cal_Measure "" VALUE 0x1D05BD STANDARD_VALUE_S8 0.0 ident -128.0 127.0 /end CHARACTERISTIC
/begin CHARACTERISTIC P_S8_3.Cal_Measure "" VALUE 0x1D012E STANDARD_VALUE_S8 0.0 ident -128.0 127.0 /end CHARACTERISTIC
/begin CHARACTERISTIC P_S8_3.Shared.Cal_Measure "" VALUE 0x1D05BE STANDARD_VALUE_S8 0.0 ident -128.0 127.0 /end CHARACTERISTIC
/begin CHARACTERISTIC P_S8_4.Cal_Measure "" VALUE 0x1D012F STANDARD_VALUE_S8 0.0 ident -128.0 127.0 /end CHARACTERISTIC
/begin CHARACTERISTIC P_S8_4.Shared.Cal_Measure "" VALUE 0x1D05BF STANDARD_VALUE_S8 0.0 ident -128.0 127.0 /end CHARACTERISTIC
/begin CHARACTERISTIC P_Sint16_array.Cal_Measure_Blocks "" VAL_BLK 0x1D04A0 STANDARD_VALUE_S16 0.0 ident -32768.0 32767.0 MATRIX_DIM 6 1 1 DISPLAY_IDENTIFIER P_Sint16_array.Cal_Measure_Blocks_DISP_ID /end CHARACTERISTIC
/begin CHARACTERISTIC P_Sint16_matrix.Cal_Measure_Blocks "" VAL_BLK 0x1D04AC STANDARD_VALUE_S16 0.0 ident -32768.0 32767.0 MATRIX_DIM 5 6 1 DISPLAY_IDENTIFIER P_Sint16_matrix.Cal_Measure_Blocks_DISP_ID /end CHARACTERISTIC
/begin CHARACTERISTIC P_Sint32_array.Cal_Measure_Blocks "" VAL_BLK 0x1D0380 STANDARD_VALUE_S32 0.0 ident -2147483648.0 2147483647.0 MATRIX_DIM 6 1 1 DISPLAY_IDENTIFIER P_Sint32_array.Cal_Measure_Blocks_DISP_ID /end CHARACTERISTIC
/begin CHARACTERISTIC P_Sint32_matrix.Cal_Measure_Blocks "" VAL_BLK 0x1D0398 STANDARD_VALUE_S32 0.0 ident -2147483648.0 2147483647.0 MATRIX_DIM 5 6 1 DISPLAY_IDENTIFIER P_Sint32_matrix.Cal_Measure_Blocks_DISP_ID /end CHARACTERISTIC
/begin CHARACTERISTIC P_Sint8_array.Cal_Measure_Blocks "" VAL_BLK 0x1D0530 STANDARD_VALUE_S8 0.0 ident -128.0 127.0 MATRIX_DIM 6 1 1 DISPLAY_IDENTIFIER P_Sint8_array.Cal_Measure_Blocks_DISP_ID /end CHARACTERISTIC
/begin CHARACTERISTIC P_Sint8_matrix.Cal_Measure_Blocks "" VAL_BLK 0x1D0536 STANDARD_VALUE_S8 0.0 ident -128.0 127.0 MATRIX_DIM 5 6 1 DISPLAY_IDENTIFIER P_Sint8_matrix.Cal_Measure_Blocks_DISP_ID /end CHARACTERISTIC
/begin CHARACTERISTIC P_standard_on_off.CanDriver "" VALUE 0x1D1359 STANDARD_VALUE_U8 0.0 ident 0 1 BIT_MASK 0x1 /end CHARACTERISTIC
/begin CHARACTERISTIC p_TableDTC_u16.CRB_OBD "" VAL_BLK 0x1D13A2 STANDARD_VALUE_U16 0.0 ident 0 65535 MATRIX_DIM 127 1 1 /end CHARACTERISTIC
/begin CHARACTERISTIC p_TestVarMsbFirstMotorolaByteOrder_0x87654321_u32.DifferentByteOrder "" VALUE 0x1D236C STANDARD_VALUE_U32 0.0 ident 0 4294967295 READ_ONLY /end CHARACTERISTIC
/begin CHARACTERISTIC p_TestVarMsbFirstMswLastByteOrder_0x43218765_u32.DifferentByteOrder "" VALUE 0x1D2374 STANDARD_VALUE_U32 0.0 ident 0 4294967295 READ_ONLY /end CHARACTERISTIC
/begin CHARACTERISTIC p_TestVarMsbLastIntelByteOrder_0x21436587_u32.DifferentByteOrder "" VALUE 0x1D2370 STANDARD_VALUE_U32 0.0 ident 0 4294967295 READ_ONLY /end CHARACTERISTIC
/begin CHARACTERISTIC p_TestVarMsbLastMswFirstByteOrder_0x65872143_u32.DifferentByteOrder "" VALUE 0x1D2378 STANDARD_VALUE_U32 0.0 ident 0 4294967295 READ_ONLY /end CHARACTERISTIC
/begin CHARACTERISTIC P_TRG_Direct.Dist_B01.Distab13_12T "" VALUE 0x1D23C6 STANDARD_VALUE_U8 0.0 ident 0 1 BIT_MASK 0x1 /end CHARACTERISTIC
/begin CHARACTERISTIC P_TRG_Direct.Dist_B02.Distab13_12T "" VALUE 0x1D23DE STANDARD_VALUE_U8 0.0 ident 0 1 BIT_MASK 0x1 /end CHARACTERISTIC
/begin CHARACTERISTIC P_TRG_Direct.Dist_B03.Distab13_12T "" VALUE 0x1D23F6 STANDARD_VALUE_U8 0.0 ident 0 1 BIT_MASK 0x1 /end CHARACTERISTIC
/begin CHARACTERISTIC P_TRG_Direct.Dist_B04.Distab13_12T "" VALUE 0x1D240E STANDARD_VALUE_U8 0.0 ident 0 1 BIT_MASK 0x1 /end CHARACTERISTIC
/begin CHARACTERISTIC P_TRG_Direct.Dist_R01.Distab13_12T "" VALUE 0x1D2426 STANDARD_VALUE_U8 0.0 ident 0 1 BIT_MASK 0x1 /end CHARACTERISTIC
/begin CHARACTERISTIC P_TRG_Direct.Dist_R02.Distab13_12T "" VALUE 0x1D2436 STANDARD_VALUE_U8 0.0 ident 0 1 BIT_MASK 0x1 /end CHARACTERISTIC
/begin CHARACTERISTIC P_TRG_Direct.Dist_R03.Distab13_12T "" VALUE 0x1D2446 STANDARD_VALUE_U8 0.0 ident 0 1 BIT_MASK 0x1 /end CHARACTERISTIC
/begin CHARACTERISTIC P_TRG_Direct.Dist_R04.Distab13_12T "" VALUE 0x1D2456 STANDARD_VALUE_U8 0.0 ident 0 1 BIT_MASK 0x1 /end CHARACTERISTIC
/begin CHARACTERISTIC P_TRG_Direct.Dist_R05.Distab13_12T "" VALUE 0x1D2466 STANDARD_VALUE_U8 0.0 ident 0 1 BIT_MASK 0x1 /end CHARACTERISTIC
/begin CHARACTERISTIC P_TRG_Direct.Dist_R06.Distab13_12T "" VALUE 0x1D2476 STANDARD_VALUE_U8 0.0 ident 0 1 BIT_MASK 0x1 /end CHARACTERISTIC
/begin CHARACTERISTIC P_TRG_Direct.Dist_R07.Distab13_12T "" VALUE 0x1D2486 STANDARD_VALUE_U8 0.0 ident 0 1 BIT_MASK 0x1 /end CHARACTERISTIC
/begin CHARACTERISTIC P_TRG_Direct.Dist_R08.Distab13_12T "" VALUE 0x1D2496 STANDARD_VALUE_U8 0.0 ident 0 1 BIT_MASK 0x1 /end CHARACTERISTIC
/begin CHARACTERISTIC P_TRG_Direct.Dist_R09.Distab13_12T "" VALUE 0x1D24A6 STANDARD_VALUE_U8 0.0 ident 0 1 BIT_MASK 0x1 /end CHARACTERISTIC
/begin CHARACTERISTIC P_TRG_Direct.Dist_R10.Distab13_12T "" VALUE 0x1D24B6 STANDARD_VALUE_U8 0.0 ident 0 1 BIT_MASK 0x1 /end CHARACTERISTIC
/begin CHARACTERISTIC P_TRG_Direct.Dist_R11.Distab13_12T "" VALUE 0x1D24C6 STANDARD_VALUE_U8 0.0 ident 0 1 BIT_MASK 0x1 /end CHARACTERISTIC
/begin CHARACTERISTIC P_TRG_Direct.Dist_R12.Distab13_12T "" VALUE 0x1D24D6 STANDARD_VALUE_U8 0.0 ident 0 1 BIT_MASK 0x1 /end CHARACTERISTIC
/begin CHARACTERISTIC P_TRG_Nr.Dist_B01.Distab13_12T "" VALUE 0x1D23C7 STANDARD_VALUE_U8 0.0 ident 0 15 /end CHARACTERISTIC
/begin CHARACTERISTIC P_TRG_Nr.Dist_B02.Distab13_12T "" VALUE 0x1D23DF STANDARD_VALUE_U8 0.0 ident 0 15 /end CHARACTERISTIC
/begin CHARACTERISTIC P_TRG_Nr.Dist_B03.Distab13_12T "" VALUE 0x1D23F7 STANDARD_VALUE_U8 0.0 ident 0 15 /end CHARACTERISTIC
/begin CHARACTERISTIC P_TRG_Nr.Dist_B04.Distab13_12T "" VALUE 0x1D240F STANDARD_VALUE_U8 0.0 ident 0 15 /end CHARACTERISTIC
/begin CHARACTERISTIC P_TRG_Nr.Dist_R01.Distab13_12T "" VALUE 0x1D2427 STANDARD_VALUE_U8 0.0 ident 0 15 /end CHARACTERISTIC
/begin CHARACTERISTIC P_TRG_Nr.Dist_R02.Distab13_12T "" VALUE 0x1D2437 STANDARD_VALUE_U8 0.0 ident 0 15 /end CHARACTERISTIC
/begin CHARACTERISTIC P_TRG_Nr.Dist_R03.Distab13_12T "" VALUE 0x1D2447 STANDARD_VALUE_U8 0.0 ident 0 15 /end CHARACTERISTIC
/begin CHARACTERISTIC P_TRG_Nr.Dist_R04.Distab13_12T "" VALUE 0x1D2457 STANDARD_VALUE_U8 0.0 ident 0 15 /end CHARACTERISTIC
/begin CHARACTERISTIC P_TRG_Nr.Dist_R05.Distab13_12T "" VALUE 0x1D2467 STANDARD_VALUE_U8 0.0 ident 0 15 /end CHARACTERISTIC
/begin CHARACTERISTIC P_TRG_Nr.Dist_R06.Distab13_12T "" VALUE 0x1D2477 STANDARD_VALUE_U8 0.0 ident 0 15 /end CHARACTERISTIC
/begin CHARACTERISTIC P_TRG_Nr.Dist_R07.Distab13_12T "" VALUE 0x1D2487 STANDARD_VALUE_U8 0.0 ident 0 15 /end CHARACTERISTIC
/begin CHARACTERISTIC P_TRG_Nr.Dist_R08.Distab13_12T "" VALUE 0x1D2497 STANDARD_VALUE_U8 0.0 ident 0 15 /end CHARACTERISTIC
/begin CHARACTERISTIC P_TRG_Nr.Dist_R09.Distab13_12T "" VALUE 0x1D24A7 STANDARD_VALUE_U8 0.0 ident 0 15 /end CHARACTERISTIC
/begin CHARACTERISTIC P_TRG_Nr.Dist_R10.Distab13_12T "" VALUE 0x1D24B7 STANDARD_VALUE_U8 0.0 ident 0 15 /end CHARACTERISTIC
/begin CHARACTERISTIC P_TRG_Nr.Dist_R11.Distab13_12T "" VALUE 0x1D24C7 STANDARD_VALUE_U8 0.0 ident 0 15 /end CHARACTERISTIC
/begin CHARACTERISTIC P_TRG_Nr.Dist_R12.Distab13_12T "" VALUE 0x1D24D7 STANDARD_VALUE_U8 0.0 ident 0 15 /end CHARACTERISTIC
/begin CHARACTERISTIC P_TRG_Val.Dist_B01.Distab13_12T "" VALUE 0x1D23C0 STANDARD_VALUE_U32 0.0 ident 0 4294967295 /end CHARACTERISTIC
/begin CHARACTERISTIC P_TRG_Val.Dist_B02.Distab13_12T "" VALUE 0x1D23D8 STANDARD_VALUE_U32 0.0 ident 0 4294967295 /end CHARACTERISTIC
/begin CHARACTERISTIC P_TRG_Val.Dist_B03.Distab13_12T "" VALUE 0x1D23F0 STANDARD_VALUE_U32 0.0 ident 0 4294967295 /end CHARACTERISTIC
/begin CHARACTERISTIC P_TRG_Val.Dist_B04.Distab13_12T "" VALUE 0x1D2408 STANDARD_VALUE_U32 0.0 ident 0 4294967295 /end CHARACTERISTIC
/begin CHARACTERISTIC P_TRG_Val.Dist_R01.Distab13_12T "" VALUE 0x1D2420 STANDARD_VALUE_U32 0.0 ident 0 4294967295 /end CHARACTERISTIC
/begin CHARACTERISTIC P_TRG_Val.Dist_R02.Distab13_12T "" VALUE 0x1D2430 STANDARD_VALUE_U32 0.0 ident 0 4294967295 /end CHARACTERISTIC
/begin CHARACTERISTIC P_TRG_Val.Dist_R03.Distab13_12T "" VALUE 0x1D2440 STANDARD_VALUE_U32 0.0 ident 0 4294967295 /end CHARACTERISTIC
/begin CHARACTERISTIC P_TRG_Val.Dist_R04.Distab13_12T "" VALUE 0x1D2450 STANDARD_VALUE_U32 0.0 ident 0 4294967295 /end CHARACTERISTIC
/begin CHARACTERISTIC P_TRG_Val.Dist_R05.Distab13_12T "" VALUE 0x1D2460 STANDARD_VALUE_U32 0.0 ident 0 4294967295 /end CHARACTERISTIC
/begin CHARACTERISTIC P_TRG_Val.Dist_R06.Distab13_12T "" VALUE 0x1D2470 STANDARD_VALUE_U32 0.0 ident 0 4294967295 /end CHARACTERISTIC
/begin CHARACTERISTIC P_TRG_Val.Dist_R07.Distab13_12T "" VALUE 0x1D2480 STANDARD_VALUE_U32 0.0 ident 0 4294967295 /end CHARACTERISTIC
/begin CHARACTERISTIC P_TRG_Val.Dist_R08.Distab13_12T "" VALUE 0x1D2490 STANDARD_VALUE_U32 0.0 ident 0 4294967295 /end CHARACTERISTIC
/begin CHARACTERISTIC P_TRG_Val.Dist_R09.Distab13_12T "" VALUE 0x1D24A0 STANDARD_VALUE_U32 0.0 ident 0 4294967295 /end CHARACTERISTIC
/begin CHARACTERISTIC P_TRG_Val.Dist_R10.Distab13_12T "" VALUE 0x1D24B0 STANDARD_VALUE_U32 0.0 ident 0 4294967295 /end CHARACTERISTIC
/begin CHARACTERISTIC P_TRG_Val.Dist_R11.Distab13_12T "" VALUE 0x1D24C0 STANDARD_VALUE_U32 0.0 ident 0 4294967295 /end CHARACTERISTIC
/begin CHARACTERISTIC P_TRG_Val.Dist_R12.Distab13_12T "" VALUE 0x1D24D0 STANDARD_VALUE_U32 0.0 ident 0 4294967295 /end CHARACTERISTIC
/begin CHARACTERISTIC P_TRGID_Nr.Dist_B01.Distab13_12T "" VALUE 0x1D23C5 STANDARD_VALUE_U8 0.0 ident 0 31 /end CHARACTERISTIC
/begin CHARACTERISTIC P_TRGID_Nr.Dist_B02.Distab13_12T "" VALUE 0x1D23DD STANDARD_VALUE_U8 0.0 ident 0 31 /end CHARACTERISTIC
/begin CHARACTERISTIC P_TRGID_Nr.Dist_B03.Distab13_12T "" VALUE 0x1D23F5 STANDARD_VALUE_U8 0.0 ident 0 31 /end CHARACTERISTIC
/begin CHARACTERISTIC P_TRGID_Nr.Dist_B04.Distab13_12T "" VALUE 0x1D240D STANDARD_VALUE_U8 0.0 ident 0 31 /end CHARACTERISTIC
/begin CHARACTERISTIC P_TRGID_Nr.Dist_R01.Distab13_12T "" VALUE 0x1D2425 STANDARD_VALUE_U8 0.0 ident 0 31 /end CHARACTERISTIC
/begin CHARACTERISTIC P_TRGID_Nr.Dist_R02.Distab13_12T "" VALUE 0x1D2435 STANDARD_VALUE_U8 0.0 ident 0 31 /end CHARACTERISTIC
/begin CHARACTERISTIC P_TRGID_Nr.Dist_R03.Distab13_12T "" VALUE 0x1D2445 STANDARD_VALUE_U8 0.0 ident 0 31 /end CHARACTERISTIC
/begin CHARACTERISTIC P_TRGID_Nr.Dist_R04.Distab13_12T "" VALUE 0x1D2455 STANDARD_VALUE_U8 0.0 ident 0 31 /end CHARACTERISTIC
/begin CHARACTERISTIC P_TRGID_Nr.Dist_R05.Distab13_12T "" VALUE 0x1D2465 STANDARD_VALUE_U8 0.0 ident 0 31 /end CHARACTERISTIC
/begin CHARACTERISTIC P_TRGID_Nr.Dist_R06.Distab13_12T "" VALUE 0x1D2475 STANDARD_VALUE_U8 0.0 ident 0 31 /end CHARACTERISTIC
/begin CHARACTERISTIC P_TRGID_Nr.Dist_R07.Distab13_12T "" VALUE 0x1D2485 STANDARD_VALUE_U8 0.0 ident 0 31 /end CHARACTERISTIC
/begin CHARACTERISTIC P_TRGID_Nr.Dist_R08.Distab13_12T "" VALUE 0x1D2495 STANDARD_VALUE_U8 0.0 ident 0 31 /end CHARACTERISTIC
/begin CHARACTERISTIC P_TRGID_Nr.Dist_R09.Distab13_12T "" VALUE 0x1D24A5 STANDARD_VALUE_U8 0.0 ident 0 31 /end CHARACTERISTIC
/begin CHARACTERISTIC P_TRGID_Nr.Dist_R10.Distab13_12T "" VALUE 0x1D24B5 STANDARD_VALUE_U8 0.0 ident 0 31 /end CHARACTERISTIC
/begin CHARACTERISTIC P_TRGID_Nr.Dist_R11.Distab13_12T "" VALUE 0x1D24C5 STANDARD_VALUE_U8 0.0 ident 0 31 /end CHARACTERISTIC
/begin CHARACTERISTIC P_TRGID_Nr.Dist_R12.Distab13_12T "" VALUE 0x1D24D5 STANDARD_VALUE_U8 0.0 ident 0 31 /end CHARACTERISTIC
/begin CHARACTERISTIC P_TRGID_Val.Dist_B01.Distab13_12T "" VALUE 0x1D23BC STANDARD_VALUE_U32 0.0 ident 0 4294967295 /end CHARACTERISTIC
/begin CHARACTERISTIC P_TRGID_Val.Dist_B02.Distab13_12T "" VALUE 0x1D23D4 STANDARD_VALUE_U32 0.0 ident 0 4294967295 /end CHARACTERISTIC
/begin CHARACTERISTIC P_TRGID_Val.Dist_B03.Distab13_12T "" VALUE 0x1D23EC STANDARD_VALUE_U32 0.0 ident 0 4294967295 /end CHARACTERISTIC
/begin CHARACTERISTIC P_TRGID_Val.Dist_B04.Distab13_12T "" VALUE 0x1D2404 STANDARD_VALUE_U32 0.0 ident 0 4294967295 /end CHARACTERISTIC
/begin CHARACTERISTIC P_TRGID_Val.Dist_R01.Distab13_12T "" VALUE 0x1D241C STANDARD_VALUE_U32 0.0 ident 0 4294967295 /end CHARACTERISTIC
/begin CHARACTERISTIC P_TRGID_Val.Dist_R02.Distab13_12T "" VALUE 0x1D242C STANDARD_VALUE_U32 0.0 ident 0 4294967295 /end CHARACTERISTIC
/begin CHARACTERISTIC P_TRGID_Val.Dist_R03.Distab13_12T "" VALUE 0x1D243C STANDARD_VALUE_U32 0.0 ident 0 4294967295 /end CHARACTERISTIC
/begin CHARACTERISTIC P_TRGID_Val.Dist_R04.Distab13_12T "" VALUE 0x1D244C STANDARD_VALUE_U32 0.0 ident 0 4294967295 /end CHARACTERISTIC
/begin CHARACTERISTIC P_TRGID_Val.Dist_R05.Distab13_12T "" VALUE 0x1D245C STANDARD_VALUE_U32 0.0 ident 0 4294967295 /end CHARACTERISTIC
/begin CHARACTERISTIC P_TRGID_Val.Dist_R06.Distab13_12T "" VALUE 0x1D246C STANDARD_VALUE_U32 0.0 ident 0 4294967295 /end CHARACTERISTIC
/begin CHARACTERISTIC P_TRGID_Val.Dist_R07.Distab13_12T "" VALUE 0x1D247C STANDARD_VALUE_U32 0.0 ident 0 4294967295 /end CHARACTERISTIC
/begin CHARACTERISTIC P_TRGID_Val.Dist_R08.Distab13_12T "" VALUE 0x1D248C STANDARD_VALUE_U32 0.0 ident 0 4294967295 /end CHARACTERISTIC
/begin CHARACTERISTIC P_TRGID_Val.Dist_R09.Distab13_12T "" VALUE 0x1D249C STANDARD_VALUE_U32 0.0 ident 0 4294967295 /end CHARACTERISTIC
/begin CHARACTERISTIC P_TRGID_Val.Dist_R10.Distab13_12T "" VALUE 0x1D24AC STANDARD_VALUE_U32 0.0 ident 0 4294967295 /end CHARACTERISTIC
/begin CHARACTERISTIC P_TRGID_Val.Dist_R11.Distab13_12T "" VALUE 0x1D24BC STANDARD_VALUE_U32 0.0 ident 0 4294967295 /end CHARACTERISTIC
/begin CHARACTERISTIC P_TRGID_Val.Dist_R12.Distab13_12T "" VALUE 0x1D24CC STANDARD_VALUE_U32 0.0 ident 0 4294967295 /end CHARACTERISTIC
/begin CHARACTERISTIC P_U16_1.Cal_Measure "" VALUE 0x1D0126 STANDARD_VALUE_U16 0.0 ident 0.0 65535.0 /end CHARACTERISTIC
/begin CHARACTERISTIC P_U16_1.Shared.Cal_Measure "" VALUE 0x1D05B6 STANDARD_VALUE_U16 0.0 ident 0.0 65535.0 /end CHARACTERISTIC
/begin CHARACTERISTIC P_U16_2.Cal_Measure "" VALUE 0x1D0128 STANDARD_VALUE_U16 0.0 ident 0.0 65535.0 /end CHARACTERISTIC
/begin CHARACTERISTIC P_U16_2.Shared.Cal_Measure "" VALUE 0x1D05B8 STANDARD_VALUE_U16 0.0 ident 0.0 65535.0 /end CHARACTERISTIC
/begin CHARACTERISTIC P_U16_3.Cal_Measure "" VALUE 0x1D012A STANDARD_VALUE_U16 0.0 ident 0.0 65535.0 /end CHARACTERISTIC
/begin CHARACTERISTIC P_U16_3.Shared.Cal_Measure "" VALUE 0x1D05BA STANDARD_VALUE_U16 0.0 ident 0.0 65535.0 /end CHARACTERISTIC
/* /end C:/ETAS/ASCET513/target/mpc555/Add_ToolChain/ASAP_Templates\P_U16_FORMULA.a2l inserted by script merge_Tab.pl */
/begin CHARACTERISTIC P_U32_1.Cal_Measure "" VALUE 0x1D0118 STANDARD_VALUE_U32 0.0 ident 0.0 4294967295.0 /end CHARACTERISTIC
/begin CHARACTERISTIC P_U32_1.Shared.Cal_Measure "" VALUE 0x1D05A8 STANDARD_VALUE_U32 0.0 ident 0.0 4294967295.0 /end CHARACTERISTIC
/begin CHARACTERISTIC P_U32_2.Cal_Measure "" VALUE 0x1D011C STANDARD_VALUE_U32 0.0 ident 0.0 4294967295.0 /end CHARACTERISTIC
/begin CHARACTERISTIC P_U32_2.Shared.Cal_Measure "" VALUE 0x1D05AC STANDARD_VALUE_U32 0.0 ident 0.0 4294967295.0 /end CHARACTERISTIC
/* /end C:/ETAS/ASCET513/target/mpc555/Add_ToolChain/ASAP_Templates\P_U32_FORMULA.a2l inserted by script merge_Tab.pl */
/begin CHARACTERISTIC P_U8_1.Cal_Measure "" VALUE 0x1D0130 STANDARD_VALUE_U8 0.0 ident 0.0 255.0 /end CHARACTERISTIC
/begin CHARACTERISTIC P_U8_1.Shared.Cal_Measure "" VALUE 0x1D05C0 STANDARD_VALUE_U8 0.0 ident 0.0 255.0 /end CHARACTERISTIC
/begin CHARACTERISTIC P_U8_2.Cal_Measure "" VALUE 0x1D0131 STANDARD_VALUE_U8 0.0 ident 0.0 255.0 /end CHARACTERISTIC
/begin CHARACTERISTIC P_U8_2.Shared.Cal_Measure "" VALUE 0x1D05C1 STANDARD_VALUE_U8 0.0 ident 0.0 255.0 /end CHARACTERISTIC
/begin CHARACTERISTIC P_U8_3.Cal_Measure "" VALUE 0x1D0132 STANDARD_VALUE_U8 0.0 ident 0.0 255.0 /end CHARACTERISTIC
/begin CHARACTERISTIC P_U8_3.Shared.Cal_Measure "" VALUE 0x1D05C2 STANDARD_VALUE_U8 0.0 ident 0.0 255.0 /end CHARACTERISTIC
/begin CHARACTERISTIC P_U8_4.Cal_Measure "" VALUE 0x1D0133 STANDARD_VALUE_U8 0.0 ident 0.0 255.0 /end CHARACTERISTIC
/begin CHARACTERISTIC P_U8_4.Shared.Cal_Measure "" VALUE 0x1D05C3 STANDARD_VALUE_U8 0.0 ident 0.0 255.0 /end CHARACTERISTIC
/begin CHARACTERISTIC P_Uint16_array.Cal_Measure_Blocks "" VAL_BLK 0x1D04E8 STANDARD_VALUE_U16 0.0 ident 0.0 65535.0 MATRIX_DIM 6 1 1 DISPLAY_IDENTIFIER P_Uint16_array.Cal_Measure_Blocks_DISP_ID /end CHARACTERISTIC
/begin CHARACTERISTIC P_Uint16_matrix.Cal_Measure_Blocks "" VAL_BLK 0x1D04F4 STANDARD_VALUE_U16 0.0 ident 0.0 65535.0 MATRIX_DIM 5 6 1 DISPLAY_IDENTIFIER P_Uint16_matrix.Cal_Measure_Blocks_DISP_ID /end CHARACTERISTIC
/begin CHARACTERISTIC P_Uint16_matrix_1.Shared.Cal_Measure_Block16 "" VAL_BLK 0x1D05DC STANDARD_VALUE_U16 0.0 ident 0.0 65535.0 MATRIX_DIM 16 16 1 /end CHARACTERISTIC
/begin CHARACTERISTIC P_Uint16_matrix_2.Shared.Cal_Measure_Block16 "" VAL_BLK 0x1D07DC STANDARD_VALUE_U16 0.0 ident 0.0 65535.0 MATRIX_DIM 16 16 1 /end CHARACTERISTIC
/begin CHARACTERISTIC P_Uint16_matrix_3.Shared.Cal_Measure_Block16 "" VAL_BLK 0x1D09DC STANDARD_VALUE_U16 0.0 ident 0.0 65535.0 MATRIX_DIM 16 16 1 /end CHARACTERISTIC
/begin CHARACTERISTIC P_Uint16_matrix_4.Shared.Cal_Measure_Block16 "" VAL_BLK 0x1D0BDC STANDARD_VALUE_U16 0.0 ident 0.0 65535.0 MATRIX_DIM 16 16 1 /end CHARACTERISTIC
/begin CHARACTERISTIC P_Uint16_matrix_5.Shared.Cal_Measure_Block16 "" VAL_BLK 0x1D0DDC STANDARD_VALUE_U16 0.0 ident 0.0 65535.0 MATRIX_DIM 16 16 1 /end CHARACTERISTIC
/begin CHARACTERISTIC P_Uint32_array.Cal_Measure_Blocks "" VAL_BLK 0x1D0410 STANDARD_VALUE_U32 0.0 ident 0.0 4294967295.0 MATRIX_DIM 6 1 1 DISPLAY_IDENTIFIER P_Uint32_array.Cal_Measure_Blocks_DISP_ID /end CHARACTERISTIC
/begin CHARACTERISTIC P_Uint32_matrix.Cal_Measure_Blocks "" VAL_BLK 0x1D0428 STANDARD_VALUE_U32 0.0 ident 0.0 4294967295.0 MATRIX_DIM 5 6 1 DISPLAY_IDENTIFIER P_Uint32_matrix.Cal_Measure_Blocks_DISP_ID /end CHARACTERISTIC
/begin CHARACTERISTIC P_Uint8_array.Cal_Measure_Blocks "" VAL_BLK 0x1D0554 STANDARD_VALUE_U8 0.0 ident 0.0 255.0 MATRIX_DIM 6 1 1 DISPLAY_IDENTIFIER P_Uint8_array.Cal_Measure_Blocks_DISP_ID /end CHARACTERISTIC
/begin CHARACTERISTIC P_Uint8_matrix.Cal_Measure_Blocks "" VAL_BLK 0x1D055A STANDARD_VALUE_U8 0.0 ident 0.0 255.0 MATRIX_DIM 5 6 1 DISPLAY_IDENTIFIER P_Uint8_matrix.Cal_Measure_Blocks_DISP_ID /end CHARACTERISTIC
/begin CHARACTERISTIC PageSwitch_On.Curve_Module "" VALUE 0x1D1778 STANDARD_VALUE_S8 0.0 ident 0 1 BIT_MASK 0x1 /end CHARACTERISTIC
/begin CHARACTERISTIC pi_ActBdRate_u32.C_ClassDiagInfo.DiagKwpUds "" VALUE 0x1D00BC STANDARD_VALUE_U32 0.0 ident 0 4294967295 /end CHARACTERISTIC
/begin CHARACTERISTIC pi_ComMedium_u8.C_ClassDiagInfo.DiagKwpUds "" VALUE 0x1D00D8 STANDARD_VALUE_U8 0.0 ident 0 255 /end CHARACTERISTIC
/begin CHARACTERISTIC pi_ComProtocol_u8.C_ClassDiagInfo.DiagKwpUds "" VALUE 0x1D00D9 STANDARD_VALUE_U8 0.0 ident 0 255 /end CHARACTERISTIC
/begin CHARACTERISTIC pi_DiaMode_u8.C_ClassDiagInfo.DiagKwpUds "" VALUE 0x1D00DA STANDARD_VALUE_U8 0.0 ident 0 255 /end CHARACTERISTIC
/begin CHARACTERISTIC pi_P2max_u32.C_ClassDiagInfo.DiagKwpUds "" VALUE 0x1D00C0 STANDARD_VALUE_U32 0.0 TickType2ms 0.0 1227133.512857143 /end CHARACTERISTIC
/begin CHARACTERISTIC pi_P2min_u32.C_ClassDiagInfo.DiagKwpUds "" VALUE 0x1D00C4 STANDARD_VALUE_U32 0.0 TickType2ms 0.0 1227133.512857143 /end CHARACTERISTIC
/begin CHARACTERISTIC pi_P3max_u32.C_ClassDiagInfo.DiagKwpUds "" VALUE 0x1D00C8 STANDARD_VALUE_U32 0.0 TickType2ms 0.0 1227133.512857143 /end CHARACTERISTIC
/begin CHARACTERISTIC pi_P3min_u32.C_ClassDiagInfo.DiagKwpUds "" VALUE 0x1D00CC STANDARD_VALUE_U32 0.0 TickType2ms 0.0 1227133.512857143 /end CHARACTERISTIC
/begin CHARACTERISTIC pi_P4min_u32.C_ClassDiagInfo.DiagKwpUds "" VALUE 0x1D00D0 STANDARD_VALUE_U32 0.0 TickType2ms 0.0 1227133.512857143 /end CHARACTERISTIC
/begin CHARACTERISTIC pi_PhysEcuAddr_u8.C_ClassDiagInfo.DiagKwpUds "" VALUE 0x1D00DB STANDARD_VALUE_U8 0.0 ident 0 255 /end CHARACTERISTIC
/begin CHARACTERISTIC pi_ReqBdRate_u32.C_ClassDiagInfo.DiagKwpUds "" VALUE 0x1D00D4 STANDARD_VALUE_U32 0.0 ident 0 4294967295 /end CHARACTERISTIC
/begin CHARACTERISTIC pi_SecLevel_u8.C_ClassDiagInfo.DiagKwpUds "" VALUE 0x1D00DC STANDARD_VALUE_U8 0.0 ident 0 255 /end CHARACTERISTIC
/begin CHARACTERISTIC pi_StimuAddr_u8.C_ClassDiagInfo.DiagKwpUds "" VALUE 0x1D00DE STANDARD_VALUE_U8 0.0 ident 0 255 /end CHARACTERISTIC
/begin CHARACTERISTIC pi_StimuAddrMode_u8.C_ClassDiagInfo.DiagKwpUds "" VALUE 0x1D00DD STANDARD_VALUE_U8 0.0 ident 0 255 /end CHARACTERISTIC
/* /end C:/ETAS/ASCET513/target/mpc555/Add_ToolChain/ASAP_Templates\TestCuboid_4D_WFST.a2l inserted by script merge_Cuboid.pl */
/begin CHARACTERISTIC testPara.Curve_Module "" VALUE 0x1D1779 STANDARD_VALUE_U8 0.0 ident 0 255 /end CHARACTERISTIC
/begin AXIS_PTS Distrib1.Curve_Mod "" 0x1D16E0 M_In_fl32_Distrib1.Curve_Mod STANDARD_DIST_R64 0.0 ident 8 -1.e+037 1.e+037 /end AXIS_PTS
/begin AXIS_PTS Distrib2.Curve_Mod "" 0x1D1728 M_In_fl32_Distrib2.Curve_Mod STANDARD_DIST_R64 0.0 ident 8 -1.e+037 1.e+037 /end AXIS_PTS
/begin MEASUREMENT Active.Dist_B01.Distab13_12T "" UBYTE ident 1 100 0 255 ECU_ADDRESS 0x7F885A /end MEASUREMENT
/begin MEASUREMENT Active.Dist_B02.Distab13_12T "" UBYTE ident 1 100 0 255 ECU_ADDRESS 0x7F887E /end MEASUREMENT
/begin MEASUREMENT Active.Dist_B03.Distab13_12T "" UBYTE ident 1 100 0 255 ECU_ADDRESS 0x7F88A2 /end MEASUREMENT
/begin MEASUREMENT Active.Dist_B04.Distab13_12T "" UBYTE ident 1 100 0 255 ECU_ADDRESS 0x7F88C6 /end MEASUREMENT
/begin MEASUREMENT Active.Dist_R01.Distab13_12T "" UBYTE ident 1 100 0 255 ECU_ADDRESS 0x7F88EA /end MEASUREMENT
/begin MEASUREMENT Active.Dist_R02.Distab13_12T "" UBYTE ident 1 100 0 255 ECU_ADDRESS 0x7F88F2 /end MEASUREMENT
/begin MEASUREMENT Active.Dist_R03.Distab13_12T "" UBYTE ident 1 100 0 255 ECU_ADDRESS 0x7F88FA /end MEASUREMENT
/begin MEASUREMENT Active.Dist_R04.Distab13_12T "" UBYTE ident 1 100 0 255 ECU_ADDRESS 0x7F8902 /end MEASUREMENT
/begin MEASUREMENT Active.Dist_R05.Distab13_12T "" UBYTE ident 1 100 0 255 ECU_ADDRESS 0x7F890A /end MEASUREMENT
/begin MEASUREMENT Active.Dist_R06.Distab13_12T "" UBYTE ident 1 100 0 255 ECU_ADDRESS 0x7F8912 /end MEASUREMENT
/begin MEASUREMENT Active.Dist_R07.Distab13_12T "" UBYTE ident 1 100 0 255 ECU_ADDRESS 0x7F891A /end MEASUREMENT
/begin MEASUREMENT Active.Dist_R08.Distab13_12T "" UBYTE ident 1 100 0 255 ECU_ADDRESS 0x7F8922 /end MEASUREMENT
/begin MEASUREMENT Active.Dist_R09.Distab13_12T "" UBYTE ident 1 100 0 255 ECU_ADDRESS 0x7F892A /end MEASUREMENT
/begin MEASUREMENT Active.Dist_R10.Distab13_12T "" UBYTE ident 1 100 0 255 ECU_ADDRESS 0x7F8932 /end MEASUREMENT
/begin MEASUREMENT Active.Dist_R11.Distab13_12T "" UBYTE ident 1 100 0 255 ECU_ADDRESS 0x7F893A /end MEASUREMENT
/begin MEASUREMENT Active.Dist_R12.Distab13_12T "" UBYTE ident 1 100 0 255 ECU_ADDRESS 0x7F8942 /end MEASUREMENT
/begin MEASUREMENT Anzahl.StatisticValuesECU_V100.DiagP3MasterDownload.DiagKwpUds "" ULONG ident 1 100 0.0 4294967295.0 ECU_ADDRESS 0x7F87E8 /end MEASUREMENT
/begin MEASUREMENT Anzahl.StatisticValuesECU_V100.DiagSTminDownloadCF1CF2.DiagKwpUds "" ULONG ident 1 100 0.0 4294967295.0 ECU_ADDRESS 0x7F8814 /end MEASUREMENT
/begin MEASUREMENT Anzahl.StatisticValuesECU_V100.DiagSTminDownloadCF2CF3.DiagKwpUds "" ULONG ident 1 100 0.0 4294967295.0 ECU_ADDRESS 0x7F8840 /end MEASUREMENT
/begin MEASUREMENT B13_Mode.CanDriver "" UBYTE ident 1 100 0.0 255.0 ECU_ADDRESS 0x822738 /end MEASUREMENT
/begin MEASUREMENT B17_Mode.CanDriver "" UBYTE ident 1 100 0.0 255.0 ECU_ADDRESS 0x822739 /end MEASUREMENT
/begin MEASUREMENT B2_Mode.CanDriver "" UBYTE ident 1 100 0.0 255.0 ECU_ADDRESS 0x82273E /end MEASUREMENT
/begin MEASUREMENT B23_Mode.CanDriver "" UBYTE ident 1 100 0.0 255.0 ECU_ADDRESS 0x82273A /end MEASUREMENT
/begin MEASUREMENT B25_Mode.CanDriver "" UBYTE ident 1 100 0.0 255.0 ECU_ADDRESS 0x82273B /end MEASUREMENT
/begin MEASUREMENT B27_Mode.CanDriver "" UBYTE ident 1 100 0.0 255.0 ECU_ADDRESS 0x82273C /end MEASUREMENT
/begin MEASUREMENT B29_Mode.CanDriver "" UBYTE ident 1 100 0.0 255.0 ECU_ADDRESS 0x82273D /end MEASUREMENT
/begin MEASUREMENT B35_Mode.CanDriver "" UBYTE ident 1 100 0.0 255.0 ECU_ADDRESS 0x82273F /end MEASUREMENT
/begin MEASUREMENT B38_Mode.CanDriver "" UBYTE ident 1 100 0.0 255.0 ECU_ADDRESS 0x822740 /end MEASUREMENT
/begin MEASUREMENT B5_Mode.CanDriver "" UBYTE ident 1 100 0.0 255.0 ECU_ADDRESS 0x822742 /end MEASUREMENT
/begin MEASUREMENT B56_Mode.CanDriver "" UBYTE ident 1 100 0.0 255.0 ECU_ADDRESS 0x822741 /end MEASUREMENT
/begin MEASUREMENT B9_Mode.CanDriver "" UBYTE ident 1 100 0.0 255.0 ECU_ADDRESS 0x822743 /end MEASUREMENT
/begin MEASUREMENT CAN_Stat_Bx.CanDriver "" ULONG ident 1 100 0 4294967295 ECU_ADDRESS 0x7F820C MATRIX_DIM 64 1 1 /end MEASUREMENT
/begin MEASUREMENT CAN_Status.CanDriver "" UBYTE ident 1 100 0.0 255.0 ECU_ADDRESS 0x822744 /end MEASUREMENT
/begin MEASUREMENT cell_nr.Curve_Calc_16.Curve_Module "" UBYTE ident 1 100 0 255 ECU_ADDRESS 0x7F8592 /end MEASUREMENT
/begin MEASUREMENT cell_nr.Curve_Calc_32.Curve_Module "" UBYTE ident 1 100 0 255 ECU_ADDRESS 0x7F85EE /end MEASUREMENT
/begin MEASUREMENT cell_nr.Curve_Calc_real32.Curve_Module "" UBYTE ident 1 100 0 255 ECU_ADDRESS 0x7F85C0 /end MEASUREMENT
/begin MEASUREMENT Counter.Dist_B01.Distab13_12T "" UBYTE ident 1 100 0 255 ECU_ADDRESS 0x7F885B /end MEASUREMENT
/begin MEASUREMENT Counter.Dist_B02.Distab13_12T "" UBYTE ident 1 100 0 255 ECU_ADDRESS 0x7F887F /end MEASUREMENT
/begin MEASUREMENT Counter.Dist_B03.Distab13_12T "" UBYTE ident 1 100 0 255 ECU_ADDRESS 0x7F88A3 /end MEASUREMENT
/begin MEASUREMENT Counter.Dist_B04.Distab13_12T "" UBYTE ident 1 100 0 255 ECU_ADDRESS 0x7F88C7 /end MEASUREMENT
/begin MEASUREMENT curve_out.Curve_Calc_16.Curve_Module "" UWORD ident 1 100 0.0 65535.0 ECU_ADDRESS 0x7F857C /end MEASUREMENT
/begin MEASUREMENT curve_out.Curve_Calc_32.Curve_Module "" UWORD ident 1 100 0.0 65535.0 ECU_ADDRESS 0x7F85EC /end MEASUREMENT
/begin MEASUREMENT curve_out.Curve_Calc_real32.Curve_Module "" FLOAT32_IEEE ident 1 100 -1.e+037 1.e+037 ECU_ADDRESS 0x7F8594 /end MEASUREMENT
/begin MEASUREMENT g_CanError_au8.CanDriver "" ULONG ident 1 100 0 4294967295 ECU_ADDRESS 0x7F830C MATRIX_DIM 64 1 1 /end MEASUREMENT
/begin MEASUREMENT g_CarbPID05_deltaEnCoTemp40_u8.CRB_OBD "" UBYTE ident 1 100 0 255 ECU_ADDRESS 0x7FB424 /end MEASUREMENT
/begin MEASUREMENT g_CarbPID05_EnCoTemp40_u8.CRB_OBD "" UBYTE ident 1 100 0 255 ECU_ADDRESS 0x7F8578 /end MEASUREMENT
/begin MEASUREMENT g_CarbPID0C_deltaEngineRPM_u8.CRB_OBD "" UBYTE ident 1 100 0 255 ECU_ADDRESS 0x7FB425 /end MEASUREMENT
/begin MEASUREMENT g_CarbPID0C_EngineRPM_u16.CRB_OBD "" UWORD ident 1 100 0 65535 ECU_ADDRESS 0x7F857A /end MEASUREMENT
/begin MEASUREMENT g_DiagBSmax_u8.DiagKwpUds "" UBYTE ident 1 100 0 255 ECU_ADDRESS 0x7F8856 /end MEASUREMENT
/begin MEASUREMENT g_DiagErrorPrescaler_u8_unused.DiagKwpUds "" UBYTE ident 1 100 0 255 ECU_ADDRESS 0x7FB462 /end MEASUREMENT
/begin MEASUREMENT g_DiagMeasureMode_u8.DiagKwpUds "" UBYTE enum_DIAG_MEASURE_MODE_E 1 100 0 2 ECU_ADDRESS 0x7F8854 /end MEASUREMENT
/begin MEASUREMENT g_DiagNumError_u8.DiagKwpUds "" UBYTE ident 1 100 0 255 ECU_ADDRESS 0x7FB460 /end MEASUREMENT
/begin MEASUREMENT g_DiagProtocol_u8.DiagKwpUds "" UBYTE enum_ACTIVE_DIAG_PROTOCOL_E 1 100 0 3 ECU_ADDRESS 0x7F8855 /end MEASUREMENT
/begin MEASUREMENT g_DiagSTmin_u8.DiagKwpUds "" UBYTE ident 1 100 0 255 ECU_ADDRESS 0x7FB463 /end MEASUREMENT
/begin MEASUREMENT g_DiagTriggerError_u8.DiagKwpUds "" UBYTE enum_DIAG_ERROR_TRIGGER_E 1 100 0 2 ECU_ADDRESS 0x7FB461 /end MEASUREMENT
/begin MEASUREMENT g_DiagXDLmax_u16.DiagKwpUds "" UWORD ident 1 100 0 4095 ECU_ADDRESS 0x7FB464 /end MEASUREMENT
/begin MEASUREMENT g_fast_on_off_b.CanDriver "" UBYTE ident 1 100 0 1 BIT_MASK 0x1 ECU_ADDRESS 0x7F850C /end MEASUREMENT
/begin MEASUREMENT g_MaxTxDTCinBlock_u8.CRB_OBD "" UBYTE ident 1 100 0 255 ECU_ADDRESS 0x7FB426 /end MEASUREMENT
/begin MEASUREMENT g_MsbFirstMotorolaByteOrderCounter_R03_u32.DifferentByteOrder "" ULONG ident 1 100 0 4294967295 ECU_ADDRESS 0x7FB468 /end MEASUREMENT
/begin MEASUREMENT g_MsbFirstMswLastOrderCounter_R03_u32.DifferentByteOrder "" ULONG ident 1 100 0 4294967295 ECU_ADDRESS 0x7FB46C /end MEASUREMENT
/begin MEASUREMENT g_MsbLastIntelByteOrderCounter_R03_u32.DifferentByteOrder "" ULONG ident 1 100 0 4294967295 ECU_ADDRESS 0x7FB470 /end MEASUREMENT
/begin MEASUREMENT g_MsbLastMswFirstOrderCounter_R03_u32.DifferentByteOrder "" ULONG ident 1 100 0 4294967295 ECU_ADDRESS 0x7FB474 /end MEASUREMENT
/begin MEASUREMENT g_NumDTC_u16.CRB_OBD "" UWORD ident 1 100 0 65535 ECU_ADDRESS 0x7FB422 /end MEASUREMENT
/begin MEASUREMENT g_Ringbuffer_au8.CanDriver "" ULONG ident 1 100 0 4294967295 ECU_ADDRESS 0x7F840C MATRIX_DIM 64 1 1 /end MEASUREMENT
/begin MEASUREMENT g_RingBufRead_u8.CanDriver "" UBYTE ident 1 100 0 255 ECU_ADDRESS 0x822745 /end MEASUREMENT
/begin MEASUREMENT g_RingBufWrite_u8.CanDriver "" UBYTE ident 1 100 0 255 ECU_ADDRESS 0x822746 /end MEASUREMENT
/begin MEASUREMENT g_TestVarMsbFirstMotorolaByteOrder_0x87654321_u32.DifferentByteOrder "" ULONG ident 1 100 0 4294967295 ECU_ADDRESS 0x7FB478 /end MEASUREMENT
/begin MEASUREMENT g_TestVarMsbFirstMswLastByteOrder_0x43218765_u32.DifferentByteOrder "" ULONG ident 1 100 0 4294967295 ECU_ADDRESS 0x7FB47C /end MEASUREMENT
/begin MEASUREMENT g_TestVarMsbLastIntelByteOrder_0x21436587_u32.DifferentByteOrder "" ULONG ident 1 100 0 4294967295 ECU_ADDRESS 0x7FB480 /end MEASUREMENT
/begin MEASUREMENT g_TestVarMsbLastMswFirstByteOrder_0x65872143_u32.DifferentByteOrder "" ULONG ident 1 100 0 4294967295 ECU_ADDRESS 0x7FB484 /end MEASUREMENT
/begin MEASUREMENT i_0x21_rdbli_kwp_u32.C_ClassDiagCounter.DiagKwpUds "" ULONG ident 1 100 0 4294967295 ECU_ADDRESS 0x7FB380 /end MEASUREMENT
/begin MEASUREMENT i_0x22_rdbli_uds_u32.C_ClassDiagCounter.DiagKwpUds "" ULONG ident 1 100 0 4294967295 ECU_ADDRESS 0x7FB384 /end MEASUREMENT
/begin MEASUREMENT i_0x23_rmba_u32.C_ClassDiagCounter.DiagKwpUds "" ULONG ident 1 100 0 4294967295 ECU_ADDRESS 0x7FB388 /end MEASUREMENT
/begin MEASUREMENT i_ActBdRate_u32.C_ClassDiagInfo.DiagKwpUds "" ULONG ident 1 100 0 4294967295 ECU_ADDRESS 0x7FB38C /end MEASUREMENT
/begin MEASUREMENT i_CanID_u32.C_ClassUdsSendList01.UdsSendList "" ULONG ident 1 100 0 4294967295 ECU_ADDRESS 0x7F9138 /end MEASUREMENT
/begin MEASUREMENT i_CanID_u32.C_ClassUdsSendList02.UdsSendList "" ULONG ident 1 100 0 4294967295 ECU_ADDRESS 0x7F9150 /end MEASUREMENT
/begin MEASUREMENT i_CanID_u32.C_ClassUdsSendList03.UdsSendList "" ULONG ident 1 100 0 4294967295 ECU_ADDRESS 0x7F9168 /end MEASUREMENT
/begin MEASUREMENT i_CanID_u32.C_ClassUdsSendList04.UdsSendList "" ULONG ident 1 100 0 4294967295 ECU_ADDRESS 0x7F9180 /end MEASUREMENT
/begin MEASUREMENT i_CanID_u32.C_ClassUdsSendList05.UdsSendList "" ULONG ident 1 100 0 4294967295 ECU_ADDRESS 0x7F9198 /end MEASUREMENT
/begin MEASUREMENT i_CanID_u32.C_ClassUdsSendList06.UdsSendList "" ULONG ident 1 100 0 4294967295 ECU_ADDRESS 0x7F91B0 /end MEASUREMENT
/begin MEASUREMENT i_CanID_u32.C_ClassUdsSendList07.UdsSendList "" ULONG ident 1 100 0 4294967295 ECU_ADDRESS 0x7F91C8 /end MEASUREMENT
/begin MEASUREMENT i_CanID_u32.C_ClassUdsSendList08.UdsSendList "" ULONG ident 1 100 0 4294967295 ECU_ADDRESS 0x7F91E0 /end MEASUREMENT
/begin MEASUREMENT i_CanID_u32.C_ClassUdsSendList09.UdsSendList "" ULONG ident 1 100 0 4294967295 ECU_ADDRESS 0x7F91F8 /end MEASUREMENT
/begin MEASUREMENT i_CanID_u32.C_ClassUdsSendList10.UdsSendList "" ULONG ident 1 100 0 4294967295 ECU_ADDRESS 0x7F9210 /end MEASUREMENT
/begin MEASUREMENT i_CanID_u32.C_ClassUdsSendList11.UdsSendList "" ULONG ident 1 100 0 4294967295 ECU_ADDRESS 0x7F9228 /end MEASUREMENT
/begin MEASUREMENT i_CanID_u32.C_ClassUdsSendList12.UdsSendList "" ULONG ident 1 100 0 4294967295 ECU_ADDRESS 0x7F9240 /end MEASUREMENT
/begin MEASUREMENT i_CanID_u32.C_ClassUdsSendList13.UdsSendList "" ULONG ident 1 100 0 4294967295 ECU_ADDRESS 0x7F9258 /end MEASUREMENT
/begin MEASUREMENT i_CanID_u32.C_ClassUdsSendList14.UdsSendList "" ULONG ident 1 100 0 4294967295 ECU_ADDRESS 0x7F9270 /end MEASUREMENT
/begin MEASUREMENT i_CanID_u32.C_ClassUdsSendList15.UdsSendList "" ULONG ident 1 100 0 4294967295 ECU_ADDRESS 0x7F9288 /end MEASUREMENT
/begin MEASUREMENT i_CanID_u32.C_ClassUdsSendList16.UdsSendList "" ULONG ident 1 100 0 4294967295 ECU_ADDRESS 0x7F92A0 /end MEASUREMENT
/begin MEASUREMENT i_CanID_u32.C_ClassUdsSendList17.UdsSendList "" ULONG ident 1 100 0 4294967295 ECU_ADDRESS 0x7F92B8 /end MEASUREMENT
/begin MEASUREMENT i_CanID_u32.C_ClassUdsSendList18.UdsSendList "" ULONG ident 1 100 0 4294967295 ECU_ADDRESS 0x7F92D0 /end MEASUREMENT
/begin MEASUREMENT i_CanID_u32.C_ClassUdsSendList19.UdsSendList "" ULONG ident 1 100 0 4294967295 ECU_ADDRESS 0x7F92E8 /end MEASUREMENT
/begin MEASUREMENT i_CanID_u32.C_ClassUdsSendList20.UdsSendList "" ULONG ident 1 100 0 4294967295 ECU_ADDRESS 0x7F9300 /end MEASUREMENT
/begin MEASUREMENT i_CanID_u32.C_ClassUdsSendList21.UdsSendList "" ULONG ident 1 100 0 4294967295 ECU_ADDRESS 0x7F9318 /end MEASUREMENT
/begin MEASUREMENT i_CanID_u32.C_ClassUdsSendList22.UdsSendList "" ULONG ident 1 100 0 4294967295 ECU_ADDRESS 0x7F9330 /end MEASUREMENT
/begin MEASUREMENT i_CanID_u32.C_ClassUdsSendList23.UdsSendList "" ULONG ident 1 100 0 4294967295 ECU_ADDRESS 0x7F9348 /end MEASUREMENT
/begin MEASUREMENT i_CanID_u32.C_ClassUdsSendList24.UdsSendList "" ULONG ident 1 100 0 4294967295 ECU_ADDRESS 0x7F9360 /end MEASUREMENT
/begin MEASUREMENT i_ComMedium_u8.C_ClassDiagInfo.DiagKwpUds "" UBYTE ident 1 100 0 255 ECU_ADDRESS 0x7FB3A8 /end MEASUREMENT
/begin MEASUREMENT i_ComProtocol_u8.C_ClassDiagInfo.DiagKwpUds "" UBYTE ident 1 100 0 255 ECU_ADDRESS 0x7FB3A9 /end MEASUREMENT
/begin MEASUREMENT i_DiaMode_u8.C_ClassDiagInfo.DiagKwpUds "" UBYTE ident 1 100 0 255 ECU_ADDRESS 0x7FB3AA /end MEASUREMENT
/begin MEASUREMENT i_LocalId_u16.C_ClassUdsVIN.UdsLocIDs "" UWORD ident 1 100 0 65535 ECU_ADDRESS 0x7F9068 /end MEASUREMENT
/begin MEASUREMENT i_LocalId_u16.C_ClassUdsVIN2.UdsLocIDs "" UWORD ident 1 100 0 65535 ECU_ADDRESS 0x7F90C4 /end MEASUREMENT
/begin MEASUREMENT i_LocalIdData_au8.C_ClassUdsVIN.UdsLocIDs "" ULONG ident 1 100 0 4294967295 ECU_ADDRESS 0x7F9014 MATRIX_DIM 20 1 1 /end MEASUREMENT
/begin MEASUREMENT i_LocalIdData_au8.C_ClassUdsVIN2.UdsLocIDs "" ULONG ident 1 100 0 4294967295 ECU_ADDRESS 0x7F9070 MATRIX_DIM 20 1 1 /end MEASUREMENT
/begin MEASUREMENT i_LocalIds_pu32.C_ClassUdsVIN.UdsLocIDs "" ULONG ident 1 100 0 4294967295 ECU_ADDRESS 0x7F9064 /end MEASUREMENT
/begin MEASUREMENT i_LocalIds_pu32.C_ClassUdsVIN2.UdsLocIDs "" ULONG ident 1 100 0 4294967295 ECU_ADDRESS 0x7F90C0 /end MEASUREMENT
/begin MEASUREMENT i_NumEntries_u8.C_ClassUdsSendList01.UdsSendList "" UBYTE ident 1 100 0 255 ECU_ADDRESS 0x7F9142 /end MEASUREMENT
/begin MEASUREMENT i_NumEntries_u8.C_ClassUdsSendList02.UdsSendList "" UBYTE ident 1 100 0 255 ECU_ADDRESS 0x7F915A /end MEASUREMENT
/begin MEASUREMENT i_NumEntries_u8.C_ClassUdsSendList03.UdsSendList "" UBYTE ident 1 100 0 255 ECU_ADDRESS 0x7F9172 /end MEASUREMENT
/begin MEASUREMENT i_NumEntries_u8.C_ClassUdsSendList04.UdsSendList "" UBYTE ident 1 100 0 255 ECU_ADDRESS 0x7F918A /end MEASUREMENT
/begin MEASUREMENT i_NumEntries_u8.C_ClassUdsSendList05.UdsSendList "" UBYTE ident 1 100 0 255 ECU_ADDRESS 0x7F91A2 /end MEASUREMENT
/begin MEASUREMENT i_NumEntries_u8.C_ClassUdsSendList06.UdsSendList "" UBYTE ident 1 100 0 255 ECU_ADDRESS 0x7F91BA /end MEASUREMENT
/begin MEASUREMENT i_NumEntries_u8.C_ClassUdsSendList07.UdsSendList "" UBYTE ident 1 100 0 255 ECU_ADDRESS 0x7F91D2 /end MEASUREMENT
/begin MEASUREMENT i_NumEntries_u8.C_ClassUdsSendList08.UdsSendList "" UBYTE ident 1 100 0 255 ECU_ADDRESS 0x7F91EA /end MEASUREMENT
/begin MEASUREMENT i_NumEntries_u8.C_ClassUdsSendList09.UdsSendList "" UBYTE ident 1 100 0 255 ECU_ADDRESS 0x7F9202 /end MEASUREMENT
/begin MEASUREMENT i_NumEntries_u8.C_ClassUdsSendList10.UdsSendList "" UBYTE ident 1 100 0 255 ECU_ADDRESS 0x7F921A /end MEASUREMENT
/begin MEASUREMENT i_NumEntries_u8.C_ClassUdsSendList11.UdsSendList "" UBYTE ident 1 100 0 255 ECU_ADDRESS 0x7F9232 /end MEASUREMENT
/begin MEASUREMENT i_NumEntries_u8.C_ClassUdsSendList12.UdsSendList "" UBYTE ident 1 100 0 255 ECU_ADDRESS 0x7F924A /end MEASUREMENT
/begin MEASUREMENT i_NumEntries_u8.C_ClassUdsSendList13.UdsSendList "" UBYTE ident 1 100 0 255 ECU_ADDRESS 0x7F9262 /end MEASUREMENT
/begin MEASUREMENT i_NumEntries_u8.C_ClassUdsSendList14.UdsSendList "" UBYTE ident 1 100 0 255 ECU_ADDRESS 0x7F927A /end MEASUREMENT
/begin MEASUREMENT i_NumEntries_u8.C_ClassUdsSendList15.UdsSendList "" UBYTE ident 1 100 0 255 ECU_ADDRESS 0x7F9292 /end MEASUREMENT
/begin MEASUREMENT i_NumEntries_u8.C_ClassUdsSendList16.UdsSendList "" UBYTE ident 1 100 0 255 ECU_ADDRESS 0x7F92AA /end MEASUREMENT
/begin MEASUREMENT i_NumEntries_u8.C_ClassUdsSendList17.UdsSendList "" UBYTE ident 1 100 0 255 ECU_ADDRESS 0x7F92C2 /end MEASUREMENT
/begin MEASUREMENT i_NumEntries_u8.C_ClassUdsSendList18.UdsSendList "" UBYTE ident 1 100 0 255 ECU_ADDRESS 0x7F92DA /end MEASUREMENT
/begin MEASUREMENT i_NumEntries_u8.C_ClassUdsSendList19.UdsSendList "" UBYTE ident 1 100 0 255 ECU_ADDRESS 0x7F92F2 /end MEASUREMENT
/begin MEASUREMENT i_NumEntries_u8.C_ClassUdsSendList20.UdsSendList "" UBYTE ident 1 100 0 255 ECU_ADDRESS 0x7F930A /end MEASUREMENT
/begin MEASUREMENT i_NumEntries_u8.C_ClassUdsSendList21.UdsSendList "" UBYTE ident 1 100 0 255 ECU_ADDRESS 0x7F9322 /end MEASUREMENT
/begin MEASUREMENT i_NumEntries_u8.C_ClassUdsSendList22.UdsSendList "" UBYTE ident 1 100 0 255 ECU_ADDRESS 0x7F933A /end MEASUREMENT
/begin MEASUREMENT i_NumEntries_u8.C_ClassUdsSendList23.UdsSendList "" UBYTE ident 1 100 0 255 ECU_ADDRESS 0x7F9352 /end MEASUREMENT
/begin MEASUREMENT i_NumEntries_u8.C_ClassUdsSendList24.UdsSendList "" UBYTE ident 1 100 0 255 ECU_ADDRESS 0x7F936A /end MEASUREMENT
/begin MEASUREMENT i_P2max_u32.C_ClassDiagInfo.DiagKwpUds "" ULONG TickType2ms 1 100 0.0 1227133.512857143 ECU_ADDRESS 0x7FB390 /end MEASUREMENT
/begin MEASUREMENT i_P2min_u32.C_ClassDiagInfo.DiagKwpUds "" ULONG TickType2ms 1 100 0.0 1227133.512857143 ECU_ADDRESS 0x7FB394 /end MEASUREMENT
/begin MEASUREMENT i_P3max_u32.C_ClassDiagInfo.DiagKwpUds "" ULONG TickType2ms 1 100 0.0 1227133.512857143 ECU_ADDRESS 0x7FB398 /end MEASUREMENT
/begin MEASUREMENT i_P3min_u32.C_ClassDiagInfo.DiagKwpUds "" ULONG TickType2ms 1 100 0.0 1227133.512857143 ECU_ADDRESS 0x7FB39C /end MEASUREMENT
/begin MEASUREMENT i_P4min_u32.C_ClassDiagInfo.DiagKwpUds "" ULONG TickType2ms 1 100 0.0 1227133.512857143 ECU_ADDRESS 0x7FB3A0 /end MEASUREMENT
/begin MEASUREMENT i_PeriodicID_u16.C_ClassUdsSendList01.UdsSendList "" UWORD ident 1 100 0 65535 ECU_ADDRESS 0x7F9140 /end MEASUREMENT
/begin MEASUREMENT i_PeriodicID_u16.C_ClassUdsSendList02.UdsSendList "" UWORD ident 1 100 0 65535 ECU_ADDRESS 0x7F9158 /end MEASUREMENT
/begin MEASUREMENT i_PeriodicID_u16.C_ClassUdsSendList03.UdsSendList "" UWORD ident 1 100 0 65535 ECU_ADDRESS 0x7F9170 /end MEASUREMENT
/begin MEASUREMENT i_PeriodicID_u16.C_ClassUdsSendList04.UdsSendList "" UWORD ident 1 100 0 65535 ECU_ADDRESS 0x7F9188 /end MEASUREMENT
/begin MEASUREMENT i_PeriodicID_u16.C_ClassUdsSendList05.UdsSendList "" UWORD ident 1 100 0 65535 ECU_ADDRESS 0x7F91A0 /end MEASUREMENT
/begin MEASUREMENT i_PeriodicID_u16.C_ClassUdsSendList06.UdsSendList "" UWORD ident 1 100 0 65535 ECU_ADDRESS 0x7F91B8 /end MEASUREMENT
/begin MEASUREMENT i_PeriodicID_u16.C_ClassUdsSendList07.UdsSendList "" UWORD ident 1 100 0 65535 ECU_ADDRESS 0x7F91D0 /end MEASUREMENT
/begin MEASUREMENT i_PeriodicID_u16.C_ClassUdsSendList08.UdsSendList "" UWORD ident 1 100 0 65535 ECU_ADDRESS 0x7F91E8 /end MEASUREMENT
/begin MEASUREMENT i_PeriodicID_u16.C_ClassUdsSendList09.UdsSendList "" UWORD ident 1 100 0 65535 ECU_ADDRESS 0x7F9200 /end MEASUREMENT
/begin MEASUREMENT i_PeriodicID_u16.C_ClassUdsSendList10.UdsSendList "" UWORD ident 1 100 0 65535 ECU_ADDRESS 0x7F9218 /end MEASUREMENT
/begin MEASUREMENT i_PeriodicID_u16.C_ClassUdsSendList11.UdsSendList "" UWORD ident 1 100 0 65535 ECU_ADDRESS 0x7F9230 /end MEASUREMENT
/begin MEASUREMENT i_PeriodicID_u16.C_ClassUdsSendList12.UdsSendList "" UWORD ident 1 100 0 65535 ECU_ADDRESS 0x7F9248 /end MEASUREMENT
/begin MEASUREMENT i_PeriodicID_u16.C_ClassUdsSendList13.UdsSendList "" UWORD ident 1 100 0 65535 ECU_ADDRESS 0x7F9260 /end MEASUREMENT
/begin MEASUREMENT i_PeriodicID_u16.C_ClassUdsSendList14.UdsSendList "" UWORD ident 1 100 0 65535 ECU_ADDRESS 0x7F9278 /end MEASUREMENT
/begin MEASUREMENT i_PeriodicID_u16.C_ClassUdsSendList15.UdsSendList "" UWORD ident 1 100 0 65535 ECU_ADDRESS 0x7F9290 /end MEASUREMENT
/begin MEASUREMENT i_PeriodicID_u16.C_ClassUdsSendList16.UdsSendList "" UWORD ident 1 100 0 65535 ECU_ADDRESS 0x7F92A8 /end MEASUREMENT
/begin MEASUREMENT i_PeriodicID_u16.C_ClassUdsSendList17.UdsSendList "" UWORD ident 1 100 0 65535 ECU_ADDRESS 0x7F92C0 /end MEASUREMENT
/begin MEASUREMENT i_PeriodicID_u16.C_ClassUdsSendList18.UdsSendList "" UWORD ident 1 100 0 65535 ECU_ADDRESS 0x7F92D8 /end MEASUREMENT
/begin MEASUREMENT i_PeriodicID_u16.C_ClassUdsSendList19.UdsSendList "" UWORD ident 1 100 0 65535 ECU_ADDRESS 0x7F92F0 /end MEASUREMENT
/begin MEASUREMENT i_PeriodicID_u16.C_ClassUdsSendList20.UdsSendList "" UWORD ident 1 100 0 65535 ECU_ADDRESS 0x7F9308 /end MEASUREMENT
/begin MEASUREMENT i_PeriodicID_u16.C_ClassUdsSendList21.UdsSendList "" UWORD ident 1 100 0 65535 ECU_ADDRESS 0x7F9320 /end MEASUREMENT
/begin MEASUREMENT i_PeriodicID_u16.C_ClassUdsSendList22.UdsSendList "" UWORD ident 1 100 0 65535 ECU_ADDRESS 0x7F9338 /end MEASUREMENT
/begin MEASUREMENT i_PeriodicID_u16.C_ClassUdsSendList23.UdsSendList "" UWORD ident 1 100 0 65535 ECU_ADDRESS 0x7F9350 /end MEASUREMENT
/begin MEASUREMENT i_PeriodicID_u16.C_ClassUdsSendList24.UdsSendList "" UWORD ident 1 100 0 65535 ECU_ADDRESS 0x7F9368 /end MEASUREMENT
/begin MEASUREMENT i_PhysEcuAddr_u8.C_ClassDiagInfo.DiagKwpUds "" UBYTE ident 1 100 0 255 ECU_ADDRESS 0x7FB3AB /end MEASUREMENT
/begin MEASUREMENT i_RasterMode_u8.C_ClassUdsSendList01.UdsSendList "" UBYTE ident 1 100 0 255 ECU_ADDRESS 0x7F9143 /end MEASUREMENT
/begin MEASUREMENT i_RasterMode_u8.C_ClassUdsSendList02.UdsSendList "" UBYTE ident 1 100 0 255 ECU_ADDRESS 0x7F915B /end MEASUREMENT
/begin MEASUREMENT i_RasterMode_u8.C_ClassUdsSendList03.UdsSendList "" UBYTE ident 1 100 0 255 ECU_ADDRESS 0x7F9173 /end MEASUREMENT
/begin MEASUREMENT i_RasterMode_u8.C_ClassUdsSendList04.UdsSendList "" UBYTE ident 1 100 0 255 ECU_ADDRESS 0x7F918B /end MEASUREMENT
/begin MEASUREMENT i_RasterMode_u8.C_ClassUdsSendList05.UdsSendList "" UBYTE ident 1 100 0 255 ECU_ADDRESS 0x7F91A3 /end MEASUREMENT
/begin MEASUREMENT i_RasterMode_u8.C_ClassUdsSendList06.UdsSendList "" UBYTE ident 1 100 0 255 ECU_ADDRESS 0x7F91BB /end MEASUREMENT
/begin MEASUREMENT i_RasterMode_u8.C_ClassUdsSendList07.UdsSendList "" UBYTE ident 1 100 0 255 ECU_ADDRESS 0x7F91D3 /end MEASUREMENT
/begin MEASUREMENT i_RasterMode_u8.C_ClassUdsSendList08.UdsSendList "" UBYTE ident 1 100 0 255 ECU_ADDRESS 0x7F91EB /end MEASUREMENT
/begin MEASUREMENT i_RasterMode_u8.C_ClassUdsSendList09.UdsSendList "" UBYTE ident 1 100 0 255 ECU_ADDRESS 0x7F9203 /end MEASUREMENT
/begin MEASUREMENT i_RasterMode_u8.C_ClassUdsSendList10.UdsSendList "" UBYTE ident 1 100 0 255 ECU_ADDRESS 0x7F921B /end MEASUREMENT
/begin MEASUREMENT i_RasterMode_u8.C_ClassUdsSendList11.UdsSendList "" UBYTE ident 1 100 0 255 ECU_ADDRESS 0x7F9233 /end MEASUREMENT
/begin MEASUREMENT i_RasterMode_u8.C_ClassUdsSendList12.UdsSendList "" UBYTE ident 1 100 0 255 ECU_ADDRESS 0x7F924B /end MEASUREMENT
/begin MEASUREMENT i_RasterMode_u8.C_ClassUdsSendList13.UdsSendList "" UBYTE ident 1 100 0 255 ECU_ADDRESS 0x7F9263 /end MEASUREMENT
/begin MEASUREMENT i_RasterMode_u8.C_ClassUdsSendList14.UdsSendList "" UBYTE ident 1 100 0 255 ECU_ADDRESS 0x7F927B /end MEASUREMENT
/begin MEASUREMENT i_RasterMode_u8.C_ClassUdsSendList15.UdsSendList "" UBYTE ident 1 100 0 255 ECU_ADDRESS 0x7F9293 /end MEASUREMENT
/begin MEASUREMENT i_RasterMode_u8.C_ClassUdsSendList16.UdsSendList "" UBYTE ident 1 100 0 255 ECU_ADDRESS 0x7F92AB /end MEASUREMENT
/begin MEASUREMENT i_RasterMode_u8.C_ClassUdsSendList17.UdsSendList "" UBYTE ident 1 100 0 255 ECU_ADDRESS 0x7F92C3 /end MEASUREMENT
/begin MEASUREMENT i_RasterMode_u8.C_ClassUdsSendList18.UdsSendList "" UBYTE ident 1 100 0 255 ECU_ADDRESS 0x7F92DB /end MEASUREMENT
/begin MEASUREMENT i_RasterMode_u8.C_ClassUdsSendList19.UdsSendList "" UBYTE ident 1 100 0 255 ECU_ADDRESS 0x7F92F3 /end MEASUREMENT
/begin MEASUREMENT i_RasterMode_u8.C_ClassUdsSendList20.UdsSendList "" UBYTE ident 1 100 0 255 ECU_ADDRESS 0x7F930B /end MEASUREMENT
/begin MEASUREMENT i_RasterMode_u8.C_ClassUdsSendList21.UdsSendList "" UBYTE ident 1 100 0 255 ECU_ADDRESS 0x7F9323 /end MEASUREMENT
/begin MEASUREMENT i_RasterMode_u8.C_ClassUdsSendList22.UdsSendList "" UBYTE ident 1 100 0 255 ECU_ADDRESS 0x7F933B /end MEASUREMENT
/begin MEASUREMENT i_RasterMode_u8.C_ClassUdsSendList23.UdsSendList "" UBYTE ident 1 100 0 255 ECU_ADDRESS 0x7F9353 /end MEASUREMENT
/begin MEASUREMENT i_RasterMode_u8.C_ClassUdsSendList24.UdsSendList "" UBYTE ident 1 100 0 255 ECU_ADDRESS 0x7F936B /end MEASUREMENT
/begin MEASUREMENT i_ReqBdRate_u32.C_ClassDiagInfo.DiagKwpUds "" ULONG ident 1 100 0 4294967295 ECU_ADDRESS 0x7FB3A4 /end MEASUREMENT
/begin MEASUREMENT i_ResponceType_u8.C_ClassUdsSendList01.UdsSendList "" UBYTE ident 1 100 0 255 ECU_ADDRESS 0x7F9144 /end MEASUREMENT
/begin MEASUREMENT i_ResponceType_u8.C_ClassUdsSendList02.UdsSendList "" UBYTE ident 1 100 0 255 ECU_ADDRESS 0x7F915C /end MEASUREMENT
/begin MEASUREMENT i_ResponceType_u8.C_ClassUdsSendList03.UdsSendList "" UBYTE ident 1 100 0 255 ECU_ADDRESS 0x7F9174 /end MEASUREMENT
/begin MEASUREMENT i_ResponceType_u8.C_ClassUdsSendList04.UdsSendList "" UBYTE ident 1 100 0 255 ECU_ADDRESS 0x7F918C /end MEASUREMENT
/begin MEASUREMENT i_ResponceType_u8.C_ClassUdsSendList05.UdsSendList "" UBYTE ident 1 100 0 255 ECU_ADDRESS 0x7F91A4 /end MEASUREMENT
/begin MEASUREMENT i_ResponceType_u8.C_ClassUdsSendList06.UdsSendList "" UBYTE ident 1 100 0 255 ECU_ADDRESS 0x7F91BC /end MEASUREMENT
/begin MEASUREMENT i_ResponceType_u8.C_ClassUdsSendList07.UdsSendList "" UBYTE ident 1 100 0 255 ECU_ADDRESS 0x7F91D4 /end MEASUREMENT
/begin MEASUREMENT i_ResponceType_u8.C_ClassUdsSendList08.UdsSendList "" UBYTE ident 1 100 0 255 ECU_ADDRESS 0x7F91EC /end MEASUREMENT
/begin MEASUREMENT i_ResponceType_u8.C_ClassUdsSendList09.UdsSendList "" UBYTE ident 1 100 0 255 ECU_ADDRESS 0x7F9204 /end MEASUREMENT
/begin MEASUREMENT i_ResponceType_u8.C_ClassUdsSendList10.UdsSendList "" UBYTE ident 1 100 0 255 ECU_ADDRESS 0x7F921C /end MEASUREMENT
/begin MEASUREMENT i_ResponceType_u8.C_ClassUdsSendList11.UdsSendList "" UBYTE ident 1 100 0 255 ECU_ADDRESS 0x7F9234 /end MEASUREMENT
/begin MEASUREMENT i_ResponceType_u8.C_ClassUdsSendList12.UdsSendList "" UBYTE ident 1 100 0 255 ECU_ADDRESS 0x7F924C /end MEASUREMENT
/begin MEASUREMENT i_ResponceType_u8.C_ClassUdsSendList13.UdsSendList "" UBYTE ident 1 100 0 255 ECU_ADDRESS 0x7F9264 /end MEASUREMENT
/begin MEASUREMENT i_ResponceType_u8.C_ClassUdsSendList14.UdsSendList "" UBYTE ident 1 100 0 255 ECU_ADDRESS 0x7F927C /end MEASUREMENT
/begin MEASUREMENT i_ResponceType_u8.C_ClassUdsSendList15.UdsSendList "" UBYTE ident 1 100 0 255 ECU_ADDRESS 0x7F9294 /end MEASUREMENT
/begin MEASUREMENT i_ResponceType_u8.C_ClassUdsSendList16.UdsSendList "" UBYTE ident 1 100 0 255 ECU_ADDRESS 0x7F92AC /end MEASUREMENT
/begin MEASUREMENT i_ResponceType_u8.C_ClassUdsSendList17.UdsSendList "" UBYTE ident 1 100 0 255 ECU_ADDRESS 0x7F92C4 /end MEASUREMENT
/begin MEASUREMENT i_ResponceType_u8.C_ClassUdsSendList18.UdsSendList "" UBYTE ident 1 100 0 255 ECU_ADDRESS 0x7F92DC /end MEASUREMENT
/begin MEASUREMENT i_ResponceType_u8.C_ClassUdsSendList19.UdsSendList "" UBYTE ident 1 100 0 255 ECU_ADDRESS 0x7F92F4 /end MEASUREMENT
/begin MEASUREMENT i_ResponceType_u8.C_ClassUdsSendList20.UdsSendList "" UBYTE ident 1 100 0 255 ECU_ADDRESS 0x7F930C /end MEASUREMENT
/begin MEASUREMENT i_ResponceType_u8.C_ClassUdsSendList21.UdsSendList "" UBYTE ident 1 100 0 255 ECU_ADDRESS 0x7F9324 /end MEASUREMENT
/begin MEASUREMENT i_ResponceType_u8.C_ClassUdsSendList22.UdsSendList "" UBYTE ident 1 100 0 255 ECU_ADDRESS 0x7F933C /end MEASUREMENT
/begin MEASUREMENT i_ResponceType_u8.C_ClassUdsSendList23.UdsSendList "" UBYTE ident 1 100 0 255 ECU_ADDRESS 0x7F9354 /end MEASUREMENT
/begin MEASUREMENT i_ResponceType_u8.C_ClassUdsSendList24.UdsSendList "" UBYTE ident 1 100 0 255 ECU_ADDRESS 0x7F936C /end MEASUREMENT
/begin MEASUREMENT i_SampleBuf_au8.C_ClassUdsSendList01.UdsSendList "" UBYTE ident 1 100 0 255 ECU_ADDRESS 0x7F9145 MATRIX_DIM 9 1 1 /end MEASUREMENT
/begin MEASUREMENT i_SampleBuf_au8.C_ClassUdsSendList02.UdsSendList "" UBYTE ident 1 100 0 255 ECU_ADDRESS 0x7F915D MATRIX_DIM 9 1 1 /end MEASUREMENT
/begin MEASUREMENT i_SampleBuf_au8.C_ClassUdsSendList03.UdsSendList "" UBYTE ident 1 100 0 255 ECU_ADDRESS 0x7F9175 MATRIX_DIM 9 1 1 /end MEASUREMENT
/begin MEASUREMENT i_SampleBuf_au8.C_ClassUdsSendList04.UdsSendList "" UBYTE ident 1 100 0 255 ECU_ADDRESS 0x7F918D MATRIX_DIM 9 1 1 /end MEASUREMENT
/begin MEASUREMENT i_SampleBuf_au8.C_ClassUdsSendList05.UdsSendList "" UBYTE ident 1 100 0 255 ECU_ADDRESS 0x7F91A5 MATRIX_DIM 9 1 1 /end MEASUREMENT
/begin MEASUREMENT i_SampleBuf_au8.C_ClassUdsSendList06.UdsSendList "" UBYTE ident 1 100 0 255 ECU_ADDRESS 0x7F91BD MATRIX_DIM 9 1 1 /end MEASUREMENT
/begin MEASUREMENT i_SampleBuf_au8.C_ClassUdsSendList07.UdsSendList "" UBYTE ident 1 100 0 255 ECU_ADDRESS 0x7F91D5 MATRIX_DIM 9 1 1 /end MEASUREMENT
/begin MEASUREMENT i_SampleBuf_au8.C_ClassUdsSendList08.UdsSendList "" UBYTE ident 1 100 0 255 ECU_ADDRESS 0x7F91ED MATRIX_DIM 9 1 1 /end MEASUREMENT
/begin MEASUREMENT i_SampleBuf_au8.C_ClassUdsSendList09.UdsSendList "" UBYTE ident 1 100 0 255 ECU_ADDRESS 0x7F9205 MATRIX_DIM 9 1 1 /end MEASUREMENT
/begin MEASUREMENT i_SampleBuf_au8.C_ClassUdsSendList10.UdsSendList "" UBYTE ident 1 100 0 255 ECU_ADDRESS 0x7F921D MATRIX_DIM 9 1 1 /end MEASUREMENT
/begin MEASUREMENT i_SampleBuf_au8.C_ClassUdsSendList11.UdsSendList "" UBYTE ident 1 100 0 255 ECU_ADDRESS 0x7F9235 MATRIX_DIM 9 1 1 /end MEASUREMENT
/begin MEASUREMENT i_SampleBuf_au8.C_ClassUdsSendList12.UdsSendList "" UBYTE ident 1 100 0 255 ECU_ADDRESS 0x7F924D MATRIX_DIM 9 1 1 /end MEASUREMENT
/begin MEASUREMENT i_SampleBuf_au8.C_ClassUdsSendList13.UdsSendList "" UBYTE ident 1 100 0 255 ECU_ADDRESS 0x7F9265 MATRIX_DIM 9 1 1 /end MEASUREMENT
/begin MEASUREMENT i_SampleBuf_au8.C_ClassUdsSendList14.UdsSendList "" UBYTE ident 1 100 0 255 ECU_ADDRESS 0x7F927D MATRIX_DIM 9 1 1 /end MEASUREMENT
/begin MEASUREMENT i_SampleBuf_au8.C_ClassUdsSendList15.UdsSendList "" UBYTE ident 1 100 0 255 ECU_ADDRESS 0x7F9295 MATRIX_DIM 9 1 1 /end MEASUREMENT
/begin MEASUREMENT i_SampleBuf_au8.C_ClassUdsSendList16.UdsSendList "" UBYTE ident 1 100 0 255 ECU_ADDRESS 0x7F92AD MATRIX_DIM 9 1 1 /end MEASUREMENT
/begin MEASUREMENT i_SampleBuf_au8.C_ClassUdsSendList17.UdsSendList "" UBYTE ident 1 100 0 255 ECU_ADDRESS 0x7F92C5 MATRIX_DIM 9 1 1 /end MEASUREMENT
/begin MEASUREMENT i_SampleBuf_au8.C_ClassUdsSendList18.UdsSendList "" UBYTE ident 1 100 0 255 ECU_ADDRESS 0x7F92DD MATRIX_DIM 9 1 1 /end MEASUREMENT
/begin MEASUREMENT i_SampleBuf_au8.C_ClassUdsSendList19.UdsSendList "" UBYTE ident 1 100 0 255 ECU_ADDRESS 0x7F92F5 MATRIX_DIM 9 1 1 /end MEASUREMENT
/begin MEASUREMENT i_SampleBuf_au8.C_ClassUdsSendList20.UdsSendList "" UBYTE ident 1 100 0 255 ECU_ADDRESS 0x7F930D MATRIX_DIM 9 1 1 /end MEASUREMENT
/begin MEASUREMENT i_SampleBuf_au8.C_ClassUdsSendList21.UdsSendList "" UBYTE ident 1 100 0 255 ECU_ADDRESS 0x7F9325 MATRIX_DIM 9 1 1 /end MEASUREMENT
/begin MEASUREMENT i_SampleBuf_au8.C_ClassUdsSendList22.UdsSendList "" UBYTE ident 1 100 0 255 ECU_ADDRESS 0x7F933D MATRIX_DIM 9 1 1 /end MEASUREMENT
/begin MEASUREMENT i_SampleBuf_au8.C_ClassUdsSendList23.UdsSendList "" UBYTE ident 1 100 0 255 ECU_ADDRESS 0x7F9355 MATRIX_DIM 9 1 1 /end MEASUREMENT
/begin MEASUREMENT i_SampleBuf_au8.C_ClassUdsSendList24.UdsSendList "" UBYTE ident 1 100 0 255 ECU_ADDRESS 0x7F936D MATRIX_DIM 9 1 1 /end MEASUREMENT
/begin MEASUREMENT i_SecLevel_u8.C_ClassDiagInfo.DiagKwpUds "" UBYTE ident 1 100 0 255 ECU_ADDRESS 0x7FB3AC /end MEASUREMENT
/begin MEASUREMENT i_StimuAddr_u8.C_ClassDiagInfo.DiagKwpUds "" UBYTE ident 1 100 0 255 ECU_ADDRESS 0x7FB3AE /end MEASUREMENT
/begin MEASUREMENT i_StimuAddrMode_u8.C_ClassDiagInfo.DiagKwpUds "" UBYTE ident 1 100 0 255 ECU_ADDRESS 0x7FB3AD /end MEASUREMENT
/begin MEASUREMENT i_UdsDaqList_pu32.C_ClassUdsSendList01.UdsSendList "" ULONG ident 1 100 0 4294967295 ECU_ADDRESS 0x7F913C /end MEASUREMENT
/begin MEASUREMENT i_UdsDaqList_pu32.C_ClassUdsSendList02.UdsSendList "" ULONG ident 1 100 0 4294967295 ECU_ADDRESS 0x7F9154 /end MEASUREMENT
/begin MEASUREMENT i_UdsDaqList_pu32.C_ClassUdsSendList03.UdsSendList "" ULONG ident 1 100 0 4294967295 ECU_ADDRESS 0x7F916C /end MEASUREMENT
/begin MEASUREMENT i_UdsDaqList_pu32.C_ClassUdsSendList04.UdsSendList "" ULONG ident 1 100 0 4294967295 ECU_ADDRESS 0x7F9184 /end MEASUREMENT
/begin MEASUREMENT i_UdsDaqList_pu32.C_ClassUdsSendList05.UdsSendList "" ULONG ident 1 100 0 4294967295 ECU_ADDRESS 0x7F919C /end MEASUREMENT
/begin MEASUREMENT i_UdsDaqList_pu32.C_ClassUdsSendList06.UdsSendList "" ULONG ident 1 100 0 4294967295 ECU_ADDRESS 0x7F91B4 /end MEASUREMENT
/begin MEASUREMENT i_UdsDaqList_pu32.C_ClassUdsSendList07.UdsSendList "" ULONG ident 1 100 0 4294967295 ECU_ADDRESS 0x7F91CC /end MEASUREMENT
/begin MEASUREMENT i_UdsDaqList_pu32.C_ClassUdsSendList08.UdsSendList "" ULONG ident 1 100 0 4294967295 ECU_ADDRESS 0x7F91E4 /end MEASUREMENT
/begin MEASUREMENT i_UdsDaqList_pu32.C_ClassUdsSendList09.UdsSendList "" ULONG ident 1 100 0 4294967295 ECU_ADDRESS 0x7F91FC /end MEASUREMENT
/begin MEASUREMENT i_UdsDaqList_pu32.C_ClassUdsSendList10.UdsSendList "" ULONG ident 1 100 0 4294967295 ECU_ADDRESS 0x7F9214 /end MEASUREMENT
/begin MEASUREMENT i_UdsDaqList_pu32.C_ClassUdsSendList11.UdsSendList "" ULONG ident 1 100 0 4294967295 ECU_ADDRESS 0x7F922C /end MEASUREMENT
/begin MEASUREMENT i_UdsDaqList_pu32.C_ClassUdsSendList12.UdsSendList "" ULONG ident 1 100 0 4294967295 ECU_ADDRESS 0x7F9244 /end MEASUREMENT
/begin MEASUREMENT i_UdsDaqList_pu32.C_ClassUdsSendList13.UdsSendList "" ULONG ident 1 100 0 4294967295 ECU_ADDRESS 0x7F925C /end MEASUREMENT
/begin MEASUREMENT i_UdsDaqList_pu32.C_ClassUdsSendList14.UdsSendList "" ULONG ident 1 100 0 4294967295 ECU_ADDRESS 0x7F9274 /end MEASUREMENT
/begin MEASUREMENT i_UdsDaqList_pu32.C_ClassUdsSendList15.UdsSendList "" ULONG ident 1 100 0 4294967295 ECU_ADDRESS 0x7F928C /end MEASUREMENT
/begin MEASUREMENT i_UdsDaqList_pu32.C_ClassUdsSendList16.UdsSendList "" ULONG ident 1 100 0 4294967295 ECU_ADDRESS 0x7F92A4 /end MEASUREMENT
/begin MEASUREMENT i_UdsDaqList_pu32.C_ClassUdsSendList17.UdsSendList "" ULONG ident 1 100 0 4294967295 ECU_ADDRESS 0x7F92BC /end MEASUREMENT
/begin MEASUREMENT i_UdsDaqList_pu32.C_ClassUdsSendList18.UdsSendList "" ULONG ident 1 100 0 4294967295 ECU_ADDRESS 0x7F92D4 /end MEASUREMENT
/begin MEASUREMENT i_UdsDaqList_pu32.C_ClassUdsSendList19.UdsSendList "" ULONG ident 1 100 0 4294967295 ECU_ADDRESS 0x7F92EC /end MEASUREMENT
/begin MEASUREMENT i_UdsDaqList_pu32.C_ClassUdsSendList20.UdsSendList "" ULONG ident 1 100 0 4294967295 ECU_ADDRESS 0x7F9304 /end MEASUREMENT
/begin MEASUREMENT i_UdsDaqList_pu32.C_ClassUdsSendList21.UdsSendList "" ULONG ident 1 100 0 4294967295 ECU_ADDRESS 0x7F931C /end MEASUREMENT
/begin MEASUREMENT i_UdsDaqList_pu32.C_ClassUdsSendList22.UdsSendList "" ULONG ident 1 100 0 4294967295 ECU_ADDRESS 0x7F9334 /end MEASUREMENT
/begin MEASUREMENT i_UdsDaqList_pu32.C_ClassUdsSendList23.UdsSendList "" ULONG ident 1 100 0 4294967295 ECU_ADDRESS 0x7F934C /end MEASUREMENT
/begin MEASUREMENT i_UdsDaqList_pu32.C_ClassUdsSendList24.UdsSendList "" ULONG ident 1 100 0 4294967295 ECU_ADDRESS 0x7F9364 /end MEASUREMENT
/begin MEASUREMENT i_UdsSendListState_u8.C_ClassUdsSendList01.UdsSendList "" UBYTE enum_UDS_SENDLISTSTATE_E 1 100 0 2 ECU_ADDRESS 0x7F914E /end MEASUREMENT
/begin MEASUREMENT i_UdsSendListState_u8.C_ClassUdsSendList02.UdsSendList "" UBYTE enum_UDS_SENDLISTSTATE_E 1 100 0 2 ECU_ADDRESS 0x7F9166 /end MEASUREMENT
/begin MEASUREMENT i_UdsSendListState_u8.C_ClassUdsSendList03.UdsSendList "" UBYTE enum_UDS_SENDLISTSTATE_E 1 100 0 2 ECU_ADDRESS 0x7F917E /end MEASUREMENT
/begin MEASUREMENT i_UdsSendListState_u8.C_ClassUdsSendList04.UdsSendList "" UBYTE enum_UDS_SENDLISTSTATE_E 1 100 0 2 ECU_ADDRESS 0x7F9196 /end MEASUREMENT
/begin MEASUREMENT i_UdsSendListState_u8.C_ClassUdsSendList05.UdsSendList "" UBYTE enum_UDS_SENDLISTSTATE_E 1 100 0 2 ECU_ADDRESS 0x7F91AE /end MEASUREMENT
/begin MEASUREMENT i_UdsSendListState_u8.C_ClassUdsSendList06.UdsSendList "" UBYTE enum_UDS_SENDLISTSTATE_E 1 100 0 2 ECU_ADDRESS 0x7F91C6 /end MEASUREMENT
/begin MEASUREMENT i_UdsSendListState_u8.C_ClassUdsSendList07.UdsSendList "" UBYTE enum_UDS_SENDLISTSTATE_E 1 100 0 2 ECU_ADDRESS 0x7F91DE /end MEASUREMENT
/begin MEASUREMENT i_UdsSendListState_u8.C_ClassUdsSendList08.UdsSendList "" UBYTE enum_UDS_SENDLISTSTATE_E 1 100 0 2 ECU_ADDRESS 0x7F91F6 /end MEASUREMENT
/begin MEASUREMENT i_UdsSendListState_u8.C_ClassUdsSendList09.UdsSendList "" UBYTE enum_UDS_SENDLISTSTATE_E 1 100 0 2 ECU_ADDRESS 0x7F920E /end MEASUREMENT
/begin MEASUREMENT i_UdsSendListState_u8.C_ClassUdsSendList10.UdsSendList "" UBYTE enum_UDS_SENDLISTSTATE_E 1 100 0 2 ECU_ADDRESS 0x7F9226 /end MEASUREMENT
/begin MEASUREMENT i_UdsSendListState_u8.C_ClassUdsSendList11.UdsSendList "" UBYTE enum_UDS_SENDLISTSTATE_E 1 100 0 2 ECU_ADDRESS 0x7F923E /end MEASUREMENT
/begin MEASUREMENT i_UdsSendListState_u8.C_ClassUdsSendList12.UdsSendList "" UBYTE enum_UDS_SENDLISTSTATE_E 1 100 0 2 ECU_ADDRESS 0x7F9256 /end MEASUREMENT
/begin MEASUREMENT i_UdsSendListState_u8.C_ClassUdsSendList13.UdsSendList "" UBYTE enum_UDS_SENDLISTSTATE_E 1 100 0 2 ECU_ADDRESS 0x7F926E /end MEASUREMENT
/begin MEASUREMENT i_UdsSendListState_u8.C_ClassUdsSendList14.UdsSendList "" UBYTE enum_UDS_SENDLISTSTATE_E 1 100 0 2 ECU_ADDRESS 0x7F9286 /end MEASUREMENT
/begin MEASUREMENT i_UdsSendListState_u8.C_ClassUdsSendList15.UdsSendList "" UBYTE enum_UDS_SENDLISTSTATE_E 1 100 0 2 ECU_ADDRESS 0x7F929E /end MEASUREMENT
/begin MEASUREMENT i_UdsSendListState_u8.C_ClassUdsSendList16.UdsSendList "" UBYTE enum_UDS_SENDLISTSTATE_E 1 100 0 2 ECU_ADDRESS 0x7F92B6 /end MEASUREMENT
/begin MEASUREMENT i_UdsSendListState_u8.C_ClassUdsSendList17.UdsSendList "" UBYTE enum_UDS_SENDLISTSTATE_E 1 100 0 2 ECU_ADDRESS 0x7F92CE /end MEASUREMENT
/begin MEASUREMENT i_UdsSendListState_u8.C_ClassUdsSendList18.UdsSendList "" UBYTE enum_UDS_SENDLISTSTATE_E 1 100 0 2 ECU_ADDRESS 0x7F92E6 /end MEASUREMENT
/begin MEASUREMENT i_UdsSendListState_u8.C_ClassUdsSendList19.UdsSendList "" UBYTE enum_UDS_SENDLISTSTATE_E 1 100 0 2 ECU_ADDRESS 0x7F92FE /end MEASUREMENT
/begin MEASUREMENT i_UdsSendListState_u8.C_ClassUdsSendList20.UdsSendList "" UBYTE enum_UDS_SENDLISTSTATE_E 1 100 0 2 ECU_ADDRESS 0x7F9316 /end MEASUREMENT
/begin MEASUREMENT i_UdsSendListState_u8.C_ClassUdsSendList21.UdsSendList "" UBYTE enum_UDS_SENDLISTSTATE_E 1 100 0 2 ECU_ADDRESS 0x7F932E /end MEASUREMENT
/begin MEASUREMENT i_UdsSendListState_u8.C_ClassUdsSendList22.UdsSendList "" UBYTE enum_UDS_SENDLISTSTATE_E 1 100 0 2 ECU_ADDRESS 0x7F9346 /end MEASUREMENT
/begin MEASUREMENT i_UdsSendListState_u8.C_ClassUdsSendList23.UdsSendList "" UBYTE enum_UDS_SENDLISTSTATE_E 1 100 0 2 ECU_ADDRESS 0x7F935E /end MEASUREMENT
/begin MEASUREMENT i_UdsSendListState_u8.C_ClassUdsSendList24.UdsSendList "" UBYTE enum_UDS_SENDLISTSTATE_E 1 100 0 2 ECU_ADDRESS 0x7F9376 /end MEASUREMENT
/begin MEASUREMENT Index_x.Cal_Measure_Blocks "" UBYTE ident 1 100 0 255 ECU_ADDRESS 0x7FB3F8 DISPLAY_IDENTIFIER Index_x.Cal_Measure_Blocks_DISP_ID /end MEASUREMENT
/begin MEASUREMENT Index_x.Shared.Cal_Measure_Block16 "" UBYTE ident 1 100 0 255 ECU_ADDRESS 0x7FB3FC /end MEASUREMENT
/begin MEASUREMENT Index_y.Cal_Measure_Blocks "" UBYTE ident 1 100 0 255 ECU_ADDRESS 0x7FB3F9 DISPLAY_IDENTIFIER Index_y.Cal_Measure_Blocks_DISP_ID /end MEASUREMENT
/begin MEASUREMENT Index_y.Shared.Cal_Measure_Block16 "" UBYTE ident 1 100 0 255 ECU_ADDRESS 0x7FB3FD /end MEASUREMENT
/begin MEASUREMENT input_array.Curve_Calc_16.Curve_Module "" UWORD ident 1 100 0.0 65535.0 ECU_ADDRESS 0x7F857E MATRIX_DIM 10 1 1 /end MEASUREMENT
/begin MEASUREMENT input_array.Curve_Calc_32.Curve_Module "" ULONG ident 1 100 0.0 4294967295.0 ECU_ADDRESS 0x7F85C4 MATRIX_DIM 10 1 1 /end MEASUREMENT
/begin MEASUREMENT input_array.Curve_Calc_real32.Curve_Module "" FLOAT32_IEEE ident 1 100 -1.e+037 1.e+037 ECU_ADDRESS 0x7F8598 MATRIX_DIM 10 1 1 /end MEASUREMENT
/begin MEASUREMENT is_started.Time_Calc.Curve_Module "" UBYTE ident 1 100 0 1 ECU_ADDRESS 0x7F861C MATRIX_DIM 3 1 1 /end MEASUREMENT
/begin MEASUREMENT l_ResetTimer_b.DiagP3MasterDownload.DiagKwpUds "" UBYTE ident 1 100 0 1 BIT_MASK 0x1 ECU_ADDRESS 0x7F87D8 /end MEASUREMENT
/begin MEASUREMENT l_ResetTimer_b.DiagSTminDownloadCF1CF2.DiagKwpUds "" UBYTE ident 1 100 0 1 BIT_MASK 0x1 ECU_ADDRESS 0x7F8804 /end MEASUREMENT
/begin MEASUREMENT l_ResetTimer_b.DiagSTminDownloadCF2CF3.DiagKwpUds "" UBYTE ident 1 100 0 1 BIT_MASK 0x1 ECU_ADDRESS 0x7F8830 /end MEASUREMENT
/begin MEASUREMENT l_StartTicks_u32.DiagP3MasterDownload.DiagKwpUds "" ULONG ident 1 100 0 4294967295 ECU_ADDRESS 0x7F87D0 /end MEASUREMENT
/begin MEASUREMENT l_StartTicks_u32.DiagSTminDownloadCF1CF2.DiagKwpUds "" ULONG ident 1 100 0 4294967295 ECU_ADDRESS 0x7F87FC /end MEASUREMENT
/begin MEASUREMENT l_StartTicks_u32.DiagSTminDownloadCF2CF3.DiagKwpUds "" ULONG ident 1 100 0 4294967295 ECU_ADDRESS 0x7F8828 /end MEASUREMENT
/begin MEASUREMENT l_StopTicks_u32.DiagP3MasterDownload.DiagKwpUds "" ULONG ident 1 100 0 4294967295 ECU_ADDRESS 0x7F87D4 /end MEASUREMENT
/begin MEASUREMENT l_StopTicks_u32.DiagSTminDownloadCF1CF2.DiagKwpUds "" ULONG ident 1 100 0 4294967295 ECU_ADDRESS 0x7F8800 /end MEASUREMENT
/begin MEASUREMENT l_StopTicks_u32.DiagSTminDownloadCF2CF3.DiagKwpUds "" ULONG ident 1 100 0 4294967295 ECU_ADDRESS 0x7F882C /end MEASUREMENT
/begin MEASUREMENT l_Timeout_b.DiagP3MasterDownload.DiagKwpUds "" UBYTE ident 1 100 0 1 BIT_MASK 0x1 ECU_ADDRESS 0x7F87D9 /end MEASUREMENT
/begin MEASUREMENT l_Timeout_b.DiagSTminDownloadCF1CF2.DiagKwpUds "" UBYTE ident 1 100 0 1 BIT_MASK 0x1 ECU_ADDRESS 0x7F8805 /end MEASUREMENT
/begin MEASUREMENT l_Timeout_b.DiagSTminDownloadCF2CF3.DiagKwpUds "" UBYTE ident 1 100 0 1 BIT_MASK 0x1 ECU_ADDRESS 0x7F8831 /end MEASUREMENT
/begin MEASUREMENT loop_counter.Curve_Module "" UWORD ident 1 100 0 65535 ECU_ADDRESS 0x7F85F0 /end MEASUREMENT
/begin MEASUREMENT M_F32_1.Cal_Measure "" FLOAT32_IEEE ident 1 100 -1.e+037 1.e+037 ECU_ADDRESS 0x6D0108 /end MEASUREMENT
/begin MEASUREMENT M_F32_1.Shared.Cal_Measure "" FLOAT32_IEEE ident 1 100 -1.e+037 1.e+037 ECU_ADDRESS 0x6D0598 /end MEASUREMENT
/begin MEASUREMENT M_F32_2.Cal_Measure "" FLOAT32_IEEE ident 1 100 -1.e+037 1.e+037 ECU_ADDRESS 0x6D010C /end MEASUREMENT
/begin MEASUREMENT M_F32_2.Shared.Cal_Measure "" FLOAT32_IEEE ident 1 100 -1.e+037 1.e+037 ECU_ADDRESS 0x6D059C /end MEASUREMENT
/* /end C:/ETAS/ASCET513/target/mpc555/Add_ToolChain/ASAP_Templates\M_F32_FORMULA.a2l inserted by script merge_Tab.pl */
/begin MEASUREMENT M_F64_1.Cal_Measure "" FLOAT64_IEEE ident 1 100 -1.e+037 1.e+037 ECU_ADDRESS 0x6D00F8 /end MEASUREMENT
/begin MEASUREMENT M_F64_1.Shared.Cal_Measure "" FLOAT64_IEEE ident 1 100 -1.e+037 1.e+037 ECU_ADDRESS 0x6D0588 /end MEASUREMENT
/begin MEASUREMENT M_F64_2.Cal_Measure "" FLOAT64_IEEE ident 1 100 -1.e+037 1.e+037 ECU_ADDRESS 0x6D0100 /end MEASUREMENT
/begin MEASUREMENT M_F64_2.Shared.Cal_Measure "" FLOAT64_IEEE ident 1 100 -1.e+037 1.e+037 ECU_ADDRESS 0x6D0590 /end MEASUREMENT
/* /end C:/ETAS/ASCET513/target/mpc555/Add_ToolChain/ASAP_Templates\M_F64_FORMULA.a2l inserted by script merge_Tab.pl */
/begin MEASUREMENT M_Fl32_array.Cal_Measure_Blocks "" FLOAT64_IEEE ident 1 100 -1.e+037 1.e+037 ECU_ADDRESS 0x6D0140 MATRIX_DIM 6 1 1 /end MEASUREMENT
/begin MEASUREMENT M_Fl32_matrix.Cal_Measure_Blocks "" FLOAT64_IEEE ident 1 100 -1.e+037 1.e+037 ECU_ADDRESS 0x6D0170 MATRIX_DIM 5 6 1 /end MEASUREMENT
/begin MEASUREMENT M_Fl64_array.Cal_Measure_Blocks "" FLOAT64_IEEE ident 1 100 -1.e+037 1.e+037 ECU_ADDRESS 0x6D0260 MATRIX_DIM 6 1 1 /end MEASUREMENT
/begin MEASUREMENT M_Fl64_matrix.Cal_Measure_Blocks "" FLOAT64_IEEE ident 1 100 -1.e+037 1.e+037 ECU_ADDRESS 0x6D0290 MATRIX_DIM 5 6 1 /end MEASUREMENT
/begin MEASUREMENT M_In_fl32_Distrib1.Curve_Mod "" FLOAT64_IEEE ident 1 100 -1.e+037 1.e+037 ECU_ADDRESS 0x7FB430 /end MEASUREMENT
/begin MEASUREMENT M_In_fl32_Distrib2.Curve_Mod "" FLOAT64_IEEE ident 1 100 -1.e+037 1.e+037 ECU_ADDRESS 0x7FB438 /end MEASUREMENT
/begin MEASUREMENT M_In_KL_Direct_fl32.Curve_Mod "" FLOAT64_IEEE ident 1 100 -1.e+037 1.e+037 ECU_ADDRESS 0x7FB428 /end MEASUREMENT
/begin MEASUREMENT M_Out_KL_Direct_fl32.Curve_Mod "" FLOAT64_IEEE ident 1 100 -1.e+037 1.e+037 ECU_ADDRESS 0x7FB458 /end MEASUREMENT
/begin MEASUREMENT M_Out_KL1_Distr_fl32_Distrib1.Curve_Mod "" FLOAT64_IEEE ident 1 100 -1.e+037 1.e+037 ECU_ADDRESS 0x7FB440 /end MEASUREMENT
/begin MEASUREMENT M_Out_KL2_Distr_fl32_Distrib1.Curve_Mod "" FLOAT64_IEEE ident 1 100 -1.e+037 1.e+037 ECU_ADDRESS 0x7FB448 /end MEASUREMENT
/begin MEASUREMENT M_Out_KL3_Distr_fl32_Distrib2.Curve_Mod "" FLOAT64_IEEE ident 1 100 -1.e+037 1.e+037 ECU_ADDRESS 0x7FB450 /end MEASUREMENT
/begin MEASUREMENT M_S16_1.Cal_Measure "" SWORD ident 1 100 -32768.0 32767.0 ECU_ADDRESS 0x6D0120 /end MEASUREMENT
/begin MEASUREMENT M_S16_1.Shared.Cal_Measure "" SWORD ident 1 100 -32768.0 32767.0 ECU_ADDRESS 0x6D05B0 /end MEASUREMENT
/begin MEASUREMENT M_S16_2.Cal_Measure "" SWORD ident 1 100 -32768.0 32767.0 ECU_ADDRESS 0x6D0122 /end MEASUREMENT
/begin MEASUREMENT M_S16_2.Shared.Cal_Measure "" SWORD ident 1 100 -32768.0 32767.0 ECU_ADDRESS 0x6D05B2 /end MEASUREMENT
/begin MEASUREMENT M_S16_3.Cal_Measure "" SWORD ident 1 100 -32768.0 32767.0 ECU_ADDRESS 0x6D0124 /end MEASUREMENT
/begin MEASUREMENT M_S16_3.Shared.Cal_Measure "" SWORD ident 1 100 -32768.0 32767.0 ECU_ADDRESS 0x6D05B4 /end MEASUREMENT
/* /end C:/ETAS/ASCET513/target/mpc555/Add_ToolChain/ASAP_Templates\M_S16_FORMULA.a2l inserted by script merge_Tab.pl */
/begin MEASUREMENT M_S32_1.Cal_Measure "" SLONG ident 1 100 -2147483648.0 2147483647.0 ECU_ADDRESS 0x6D0110 /end MEASUREMENT
/begin MEASUREMENT M_S32_1.Shared.Cal_Measure "" SLONG ident 1 100 -2147483648.0 2147483647.0 ECU_ADDRESS 0x6D05A0 /end MEASUREMENT
/begin MEASUREMENT M_S32_2.Cal_Measure "" SLONG ident 1 100 -2147483648.0 2147483647.0 ECU_ADDRESS 0x6D0114 /end MEASUREMENT
/begin MEASUREMENT M_S32_2.Shared.Cal_Measure "" SLONG ident 1 100 -2147483648.0 2147483647.0 ECU_ADDRESS 0x6D05A4 /end MEASUREMENT
/* /end C:/ETAS/ASCET513/target/mpc555/Add_ToolChain/ASAP_Templates\M_S32_FORMULA.a2l inserted by script merge_Tab.pl */
/begin MEASUREMENT M_S8_1.Cal_Measure "" SBYTE ident 1 100 -128.0 127.0 ECU_ADDRESS 0x6D012C /end MEASUREMENT
/begin MEASUREMENT M_S8_1.Shared.Cal_Measure "" SBYTE ident 1 100 -128.0 127.0 ECU_ADDRESS 0x6D05BC /end MEASUREMENT
/begin MEASUREMENT M_S8_2.Cal_Measure "" SBYTE ident 1 100 -128.0 127.0 ECU_ADDRESS 0x6D012D /end MEASUREMENT
/begin MEASUREMENT M_S8_2.Shared.Cal_Measure "" SBYTE ident 1 100 -128.0 127.0 ECU_ADDRESS 0x6D05BD /end MEASUREMENT
/begin MEASUREMENT M_S8_3.Cal_Measure "" SBYTE ident 1 100 -128.0 127.0 ECU_ADDRESS 0x6D012E /end MEASUREMENT
/begin MEASUREMENT M_S8_3.Shared.Cal_Measure "" SBYTE ident 1 100 -128.0 127.0 ECU_ADDRESS 0x6D05BE /end MEASUREMENT
/begin MEASUREMENT M_S8_4.Cal_Measure "" SBYTE ident 1 100 -128.0 127.0 ECU_ADDRESS 0x6D012F /end MEASUREMENT
/begin MEASUREMENT M_S8_4.Shared.Cal_Measure "" SBYTE ident 1 100 -128.0 127.0 ECU_ADDRESS 0x6D05BF /end MEASUREMENT
/* /end C:/ETAS/ASCET513/target/mpc555/Add_ToolChain/ASAP_Templates\M_S8_FORMULA.a2l inserted by script merge_Tab.pl */
/begin MEASUREMENT M_Sint16_array.Cal_Measure_Blocks "" SWORD ident 1 100 -32768.0 32767.0 ECU_ADDRESS 0x6D04A0 MATRIX_DIM 6 1 1 /end MEASUREMENT
/begin MEASUREMENT M_Sint16_matrix.Cal_Measure_Blocks "" SWORD ident 1 100 -32768.0 32767.0 ECU_ADDRESS 0x6D04AC MATRIX_DIM 5 6 1 /end MEASUREMENT
/begin MEASUREMENT M_Sint32_array.Cal_Measure_Blocks "" SLONG ident 1 100 -2147483648.0 2147483647.0 ECU_ADDRESS 0x6D0380 MATRIX_DIM 6 1 1 /end MEASUREMENT
/begin MEASUREMENT M_Sint32_matrix.Cal_Measure_Blocks "" SLONG ident 1 100 -2147483648.0 2147483647.0 ECU_ADDRESS 0x6D0398 MATRIX_DIM 5 6 1 /end MEASUREMENT
/begin MEASUREMENT M_Sint8_array.Cal_Measure_Blocks "" SBYTE ident 1 100 -128.0 127.0 ECU_ADDRESS 0x6D0530 MATRIX_DIM 6 1 1 /end MEASUREMENT
/begin MEASUREMENT M_Sint8_matrix.Cal_Measure_Blocks "" SBYTE ident 1 100 -128.0 127.0 ECU_ADDRESS 0x6D0536 MATRIX_DIM 5 6 1 /end MEASUREMENT
/begin MEASUREMENT M_U16_1.Cal_Measure "" UWORD ident 1 100 0.0 65535.0 ECU_ADDRESS 0x6D0126 /end MEASUREMENT
/begin MEASUREMENT M_U16_1.Shared.Cal_Measure "" UWORD ident 1 100 0.0 65535.0 ECU_ADDRESS 0x6D05B6 /end MEASUREMENT
/begin MEASUREMENT M_U16_2.Cal_Measure "" UWORD ident 1 100 0.0 65535.0 ECU_ADDRESS 0x6D0128 /end MEASUREMENT
/begin MEASUREMENT M_U16_2.Shared.Cal_Measure "" UWORD ident 1 100 0.0 65535.0 ECU_ADDRESS 0x6D05B8 /end MEASUREMENT
/begin MEASUREMENT M_U16_3.Cal_Measure "" UWORD ident 1 100 0.0 65535.0 ECU_ADDRESS 0x6D012A /end MEASUREMENT
/begin MEASUREMENT M_U16_3.Shared.Cal_Measure "" UWORD ident 1 100 0.0 65535.0 ECU_ADDRESS 0x6D05BA /end MEASUREMENT
/* /end C:/ETAS/ASCET513/target/mpc555/Add_ToolChain/ASAP_Templates\M_U16_FORMULA.a2l inserted by script merge_Tab.pl */
/begin MEASUREMENT M_U32_1.Cal_Measure "" ULONG ident 1 100 0.0 4294967295.0 ECU_ADDRESS 0x6D0118 /end MEASUREMENT
/begin MEASUREMENT M_U32_1.Shared.Cal_Measure "" ULONG ident 1 100 0.0 4294967295.0 ECU_ADDRESS 0x6D05A8 /end MEASUREMENT
/begin MEASUREMENT M_U32_2.Cal_Measure "" ULONG ident 1 100 0.0 4294967295.0 ECU_ADDRESS 0x6D011C /end MEASUREMENT
/begin MEASUREMENT M_U32_2.Shared.Cal_Measure "" ULONG ident 1 100 0.0 4294967295.0 ECU_ADDRESS 0x6D05AC /end MEASUREMENT
/* /end C:/ETAS/ASCET513/target/mpc555/Add_ToolChain/ASAP_Templates\M_U32_FORMULA.a2l inserted by script merge_Tab.pl */
/begin MEASUREMENT M_U8_1.Cal_Measure "" UBYTE ident 1 100 0.0 255.0 ECU_ADDRESS 0x6D0130 /end MEASUREMENT
/begin MEASUREMENT M_U8_1.Shared.Cal_Measure "" UBYTE ident 1 100 0.0 255.0 ECU_ADDRESS 0x6D05C0 /end MEASUREMENT
/begin MEASUREMENT M_U8_2.Cal_Measure "" UBYTE ident 1 100 0.0 255.0 ECU_ADDRESS 0x6D0131 /end MEASUREMENT
/begin MEASUREMENT M_U8_2.Shared.Cal_Measure "" UBYTE ident 1 100 0.0 255.0 ECU_ADDRESS 0x6D05C1 /end MEASUREMENT
/begin MEASUREMENT M_U8_3.Cal_Measure "" UBYTE ident 1 100 0.0 255.0 ECU_ADDRESS 0x6D0132 /end MEASUREMENT
/begin MEASUREMENT M_U8_3.Shared.Cal_Measure "" UBYTE ident 1 100 0.0 255.0 ECU_ADDRESS 0x6D05C2 /end MEASUREMENT
/begin MEASUREMENT M_U8_4.Cal_Measure "" UBYTE ident 1 100 0.0 255.0 ECU_ADDRESS 0x6D0133 /end MEASUREMENT
/begin MEASUREMENT M_U8_4.Shared.Cal_Measure "" UBYTE ident 1 100 0.0 255.0 ECU_ADDRESS 0x6D05C3 /end MEASUREMENT
/* /end C:/ETAS/ASCET513/target/mpc555/Add_ToolChain/ASAP_Templates\M_U8_FORMULA.a2l inserted by script merge_Tab.pl */
/begin MEASUREMENT M_Uint16_array.Cal_Measure_Blocks "" UWORD ident 1 100 0.0 65535.0 ECU_ADDRESS 0x6D04E8 MATRIX_DIM 6 1 1 /end MEASUREMENT
/begin MEASUREMENT M_Uint16_matrix.Cal_Measure_Blocks "" UWORD ident 1 100 0.0 65535.0 ECU_ADDRESS 0x6D04F4 MATRIX_DIM 5 6 1 /end MEASUREMENT
/begin MEASUREMENT M_Uint16_matrix.Shared.Cal_Measure_Block16 "" UWORD ident 1 100 0.0 65535.0 ECU_ADDRESS 0x82000C MATRIX_DIM 1 1 1 /end MEASUREMENT
/begin MEASUREMENT M_Uint32_array.Cal_Measure_Blocks "" ULONG ident 1 100 0.0 4294967295.0 ECU_ADDRESS 0x6D0410 MATRIX_DIM 6 1 1 /end MEASUREMENT
/begin MEASUREMENT M_Uint32_matrix.Cal_Measure_Blocks "" ULONG ident 1 100 0.0 4294967295.0 ECU_ADDRESS 0x6D0428 MATRIX_DIM 5 6 1 /end MEASUREMENT
/begin MEASUREMENT M_Uint8_array.Cal_Measure_Blocks "" UBYTE ident 1 100 0.0 255.0 ECU_ADDRESS 0x6D0554 MATRIX_DIM 6 1 1 /end MEASUREMENT
/begin MEASUREMENT M_Uint8_matrix.Cal_Measure_Blocks "" UBYTE ident 1 100 0.0 255.0 ECU_ADDRESS 0x6D055A MATRIX_DIM 5 6 1 /end MEASUREMENT
/begin MEASUREMENT Max.Distab.Dist_B01.Distab13_12T "" ULONG TickType2ms 1 100 0.0 1227133.512857143 ECU_ADDRESS 0x7F8864 /end MEASUREMENT
/begin MEASUREMENT Max.Distab.Dist_B02.Distab13_12T "" ULONG TickType2ms 1 100 0.0 1227133.512857143 ECU_ADDRESS 0x7F8888 /end MEASUREMENT
/begin MEASUREMENT Max.Distab.Dist_B03.Distab13_12T "" ULONG TickType2ms 1 100 0.0 1227133.512857143 ECU_ADDRESS 0x7F88AC /end MEASUREMENT
/begin MEASUREMENT Max.Distab.Dist_B04.Distab13_12T "" ULONG TickType2ms 1 100 0.0 1227133.512857143 ECU_ADDRESS 0x7F88D0 /end MEASUREMENT
/begin MEASUREMENT Max.MIN_MAX_Tick2Time.DiagP3MasterDownload.DiagKwpUds "" ULONG TickType2ms 1 100 0.0 1227133.512857143 ECU_ADDRESS 0x7F87DC /end MEASUREMENT
/begin MEASUREMENT Max.MIN_MAX_Tick2Time.DiagSTminDownloadCF1CF2.DiagKwpUds "" ULONG TickType2ms 1 100 0.0 1227133.512857143 ECU_ADDRESS 0x7F8808 /end MEASUREMENT
/begin MEASUREMENT Max.MIN_MAX_Tick2Time.DiagSTminDownloadCF2CF3.DiagKwpUds "" ULONG TickType2ms 1 100 0.0 1227133.512857143 ECU_ADDRESS 0x7F8834 /end MEASUREMENT
/begin MEASUREMENT Max.Roundtrip.Dist_B01.Distab13_12T "" ULONG TickType2ms 1 100 0.0 1227133.512857143 ECU_ADDRESS 0x7F8870 /end MEASUREMENT
/begin MEASUREMENT Max.Roundtrip.Dist_B02.Distab13_12T "" ULONG TickType2ms 1 100 0.0 1227133.512857143 ECU_ADDRESS 0x7F8894 /end MEASUREMENT
/begin MEASUREMENT Max.Roundtrip.Dist_B03.Distab13_12T "" ULONG TickType2ms 1 100 0.0 1227133.512857143 ECU_ADDRESS 0x7F88B8 /end MEASUREMENT
/begin MEASUREMENT Max.Roundtrip.Dist_B04.Distab13_12T "" ULONG TickType2ms 1 100 0.0 1227133.512857143 ECU_ADDRESS 0x7F88DC /end MEASUREMENT
/begin MEASUREMENT Min.Distab.Dist_B01.Distab13_12T "" ULONG TickType2ms 1 100 0.0 1227133.512857143 ECU_ADDRESS 0x7F8868 /end MEASUREMENT
/begin MEASUREMENT Min.Distab.Dist_B02.Distab13_12T "" ULONG TickType2ms 1 100 0.0 1227133.512857143 ECU_ADDRESS 0x7F888C /end MEASUREMENT
/begin MEASUREMENT Min.Distab.Dist_B03.Distab13_12T "" ULONG TickType2ms 1 100 0.0 1227133.512857143 ECU_ADDRESS 0x7F88B0 /end MEASUREMENT
/begin MEASUREMENT Min.Distab.Dist_B04.Distab13_12T "" ULONG TickType2ms 1 100 0.0 1227133.512857143 ECU_ADDRESS 0x7F88D4 /end MEASUREMENT
/begin MEASUREMENT Min.MIN_MAX_Tick2Time.DiagP3MasterDownload.DiagKwpUds "" ULONG TickType2ms 1 100 0.0 1227133.512857143 ECU_ADDRESS 0x7F87E0 /end MEASUREMENT
/begin MEASUREMENT Min.MIN_MAX_Tick2Time.DiagSTminDownloadCF1CF2.DiagKwpUds "" ULONG TickType2ms 1 100 0.0 1227133.512857143 ECU_ADDRESS 0x7F880C /end MEASUREMENT
/begin MEASUREMENT Min.MIN_MAX_Tick2Time.DiagSTminDownloadCF2CF3.DiagKwpUds "" ULONG TickType2ms 1 100 0.0 1227133.512857143 ECU_ADDRESS 0x7F8838 /end MEASUREMENT
/begin MEASUREMENT Min.Roundtrip.Dist_B01.Distab13_12T "" ULONG TickType2ms 1 100 0.0 1227133.512857143 ECU_ADDRESS 0x7F8874 /end MEASUREMENT
/begin MEASUREMENT Min.Roundtrip.Dist_B02.Distab13_12T "" ULONG TickType2ms 1 100 0.0 1227133.512857143 ECU_ADDRESS 0x7F8898 /end MEASUREMENT
/begin MEASUREMENT Min.Roundtrip.Dist_B03.Distab13_12T "" ULONG TickType2ms 1 100 0.0 1227133.512857143 ECU_ADDRESS 0x7F88BC /end MEASUREMENT
/begin MEASUREMENT Min.Roundtrip.Dist_B04.Distab13_12T "" ULONG TickType2ms 1 100 0.0 1227133.512857143 ECU_ADDRESS 0x7F88E0 /end MEASUREMENT
/begin MEASUREMENT Mittelwert.StatisticValuesECU_V100.DiagP3MasterDownload.DiagKwpUds "" ULONG TickType2ms 1 100 0.0 1227133.512857143 ECU_ADDRESS 0x7F87EC /end MEASUREMENT
/begin MEASUREMENT Mittelwert.StatisticValuesECU_V100.DiagSTminDownloadCF1CF2.DiagKwpUds "" ULONG TickType2ms 1 100 0.0 1227133.512857143 ECU_ADDRESS 0x7F8818 /end MEASUREMENT
/begin MEASUREMENT Mittelwert.StatisticValuesECU_V100.DiagSTminDownloadCF2CF3.DiagKwpUds "" ULONG TickType2ms 1 100 0.0 1227133.512857143 ECU_ADDRESS 0x7F8844 /end MEASUREMENT
/begin MEASUREMENT NrBytes_Total.Dist_B01.Distab13_12T "" UWORD ident 1 100 0 65535 ECU_ADDRESS 0x7F8858 /end MEASUREMENT
/begin MEASUREMENT NrBytes_Total.Dist_B02.Distab13_12T "" UWORD ident 1 100 0 65535 ECU_ADDRESS 0x7F887C /end MEASUREMENT
/begin MEASUREMENT NrBytes_Total.Dist_B03.Distab13_12T "" UWORD ident 1 100 0 65535 ECU_ADDRESS 0x7F88A0 /end MEASUREMENT
/begin MEASUREMENT NrBytes_Total.Dist_B04.Distab13_12T "" UWORD ident 1 100 0 65535 ECU_ADDRESS 0x7F88C4 /end MEASUREMENT
/begin MEASUREMENT NrBytes_Total.Dist_R01.Distab13_12T "" UWORD ident 1 100 0 1024 ECU_ADDRESS 0x7F88E8 /end MEASUREMENT
/begin MEASUREMENT NrBytes_Total.Dist_R02.Distab13_12T "" UWORD ident 1 100 0 1024 ECU_ADDRESS 0x7F88F0 /end MEASUREMENT
/begin MEASUREMENT NrBytes_Total.Dist_R03.Distab13_12T "" UWORD ident 1 100 0 1024 ECU_ADDRESS 0x7F88F8 /end MEASUREMENT
/begin MEASUREMENT NrBytes_Total.Dist_R04.Distab13_12T "" UWORD ident 1 100 0 1024 ECU_ADDRESS 0x7F8900 /end MEASUREMENT
/begin MEASUREMENT NrBytes_Total.Dist_R05.Distab13_12T "" UWORD ident 1 100 0 1024 ECU_ADDRESS 0x7F8908 /end MEASUREMENT
/begin MEASUREMENT NrBytes_Total.Dist_R06.Distab13_12T "" UWORD ident 1 100 0 1024 ECU_ADDRESS 0x7F8910 /end MEASUREMENT
/begin MEASUREMENT NrBytes_Total.Dist_R07.Distab13_12T "" UWORD ident 1 100 0 1024 ECU_ADDRESS 0x7F8918 /end MEASUREMENT
/begin MEASUREMENT NrBytes_Total.Dist_R08.Distab13_12T "" UWORD ident 1 100 0 1024 ECU_ADDRESS 0x7F8920 /end MEASUREMENT
/begin MEASUREMENT NrBytes_Total.Dist_R09.Distab13_12T "" UWORD ident 1 100 0 1024 ECU_ADDRESS 0x7F8928 /end MEASUREMENT
/begin MEASUREMENT NrBytes_Total.Dist_R10.Distab13_12T "" UWORD ident 1 100 0 1024 ECU_ADDRESS 0x7F8930 /end MEASUREMENT
/begin MEASUREMENT NrBytes_Total.Dist_R11.Distab13_12T "" UWORD ident 1 100 0 1024 ECU_ADDRESS 0x7F8938 /end MEASUREMENT
/begin MEASUREMENT NrBytes_Total.Dist_R12.Distab13_12T "" UWORD ident 1 100 0 1024 ECU_ADDRESS 0x7F8940 /end MEASUREMENT
/begin MEASUREMENT NrVar_1Byte.Dist_B01.Distab13_12T "" UBYTE ident 1 100 0 255 ECU_ADDRESS 0x7F885C /end MEASUREMENT
/begin MEASUREMENT NrVar_1Byte.Dist_B02.Distab13_12T "" UBYTE ident 1 100 0 255 ECU_ADDRESS 0x7F8880 /end MEASUREMENT
/begin MEASUREMENT NrVar_1Byte.Dist_B03.Distab13_12T "" UBYTE ident 1 100 0 255 ECU_ADDRESS 0x7F88A4 /end MEASUREMENT
/begin MEASUREMENT NrVar_1Byte.Dist_B04.Distab13_12T "" UBYTE ident 1 100 0 255 ECU_ADDRESS 0x7F88C8 /end MEASUREMENT
/begin MEASUREMENT NrVar_1Byte.Dist_R01.Distab13_12T "" UBYTE ident 1 100 0 255 ECU_ADDRESS 0x7F88EB /end MEASUREMENT
/begin MEASUREMENT NrVar_1Byte.Dist_R02.Distab13_12T "" UBYTE ident 1 100 0 255 ECU_ADDRESS 0x7F88F3 /end MEASUREMENT
/begin MEASUREMENT NrVar_1Byte.Dist_R03.Distab13_12T "" UBYTE ident 1 100 0 255 ECU_ADDRESS 0x7F88FB /end MEASUREMENT
/begin MEASUREMENT NrVar_1Byte.Dist_R04.Distab13_12T "" UBYTE ident 1 100 0 255 ECU_ADDRESS 0x7F8903 /end MEASUREMENT
/begin MEASUREMENT NrVar_1Byte.Dist_R05.Distab13_12T "" UBYTE ident 1 100 0 255 ECU_ADDRESS 0x7F890B /end MEASUREMENT
/begin MEASUREMENT NrVar_1Byte.Dist_R06.Distab13_12T "" UBYTE ident 1 100 0 255 ECU_ADDRESS 0x7F8913 /end MEASUREMENT
/begin MEASUREMENT NrVar_1Byte.Dist_R07.Distab13_12T "" UBYTE ident 1 100 0 255 ECU_ADDRESS 0x7F891B /end MEASUREMENT
/begin MEASUREMENT NrVar_1Byte.Dist_R08.Distab13_12T "" UBYTE ident 1 100 0 255 ECU_ADDRESS 0x7F8923 /end MEASUREMENT
/begin MEASUREMENT NrVar_1Byte.Dist_R09.Distab13_12T "" UBYTE ident 1 100 0 255 ECU_ADDRESS 0x7F892B /end MEASUREMENT
/begin MEASUREMENT NrVar_1Byte.Dist_R10.Distab13_12T "" UBYTE ident 1 100 0 255 ECU_ADDRESS 0x7F8933 /end MEASUREMENT
/begin MEASUREMENT NrVar_1Byte.Dist_R11.Distab13_12T "" UBYTE ident 1 100 0 255 ECU_ADDRESS 0x7F893B /end MEASUREMENT
/begin MEASUREMENT NrVar_1Byte.Dist_R12.Distab13_12T "" UBYTE ident 1 100 0 255 ECU_ADDRESS 0x7F8943 /end MEASUREMENT
/begin MEASUREMENT NrVar_2Byte.Dist_B01.Distab13_12T "" UBYTE ident 1 100 0 255 ECU_ADDRESS 0x7F885D /end MEASUREMENT
/begin MEASUREMENT NrVar_2Byte.Dist_B02.Distab13_12T "" UBYTE ident 1 100 0 255 ECU_ADDRESS 0x7F8881 /end MEASUREMENT
/begin MEASUREMENT NrVar_2Byte.Dist_B03.Distab13_12T "" UBYTE ident 1 100 0 255 ECU_ADDRESS 0x7F88A5 /end MEASUREMENT
/begin MEASUREMENT NrVar_2Byte.Dist_B04.Distab13_12T "" UBYTE ident 1 100 0 255 ECU_ADDRESS 0x7F88C9 /end MEASUREMENT
/begin MEASUREMENT NrVar_2Byte.Dist_R01.Distab13_12T "" UBYTE ident 1 100 0 255 ECU_ADDRESS 0x7F88EC /end MEASUREMENT
/begin MEASUREMENT NrVar_2Byte.Dist_R02.Distab13_12T "" UBYTE ident 1 100 0 255 ECU_ADDRESS 0x7F88F4 /end MEASUREMENT
/begin MEASUREMENT NrVar_2Byte.Dist_R03.Distab13_12T "" UBYTE ident 1 100 0 255 ECU_ADDRESS 0x7F88FC /end MEASUREMENT
/begin MEASUREMENT NrVar_2Byte.Dist_R04.Distab13_12T "" UBYTE ident 1 100 0 255 ECU_ADDRESS 0x7F8904 /end MEASUREMENT
/begin MEASUREMENT NrVar_2Byte.Dist_R05.Distab13_12T "" UBYTE ident 1 100 0 255 ECU_ADDRESS 0x7F890C /end MEASUREMENT
/begin MEASUREMENT NrVar_2Byte.Dist_R06.Distab13_12T "" UBYTE ident 1 100 0 255 ECU_ADDRESS 0x7F8914 /end MEASUREMENT
/begin MEASUREMENT NrVar_2Byte.Dist_R07.Distab13_12T "" UBYTE ident 1 100 0 255 ECU_ADDRESS 0x7F891C /end MEASUREMENT
/begin MEASUREMENT NrVar_2Byte.Dist_R08.Distab13_12T "" UBYTE ident 1 100 0 255 ECU_ADDRESS 0x7F8924 /end MEASUREMENT
/begin MEASUREMENT NrVar_2Byte.Dist_R09.Distab13_12T "" UBYTE ident 1 100 0 255 ECU_ADDRESS 0x7F892C /end MEASUREMENT
/begin MEASUREMENT NrVar_2Byte.Dist_R10.Distab13_12T "" UBYTE ident 1 100 0 255 ECU_ADDRESS 0x7F8934 /end MEASUREMENT
/begin MEASUREMENT NrVar_2Byte.Dist_R11.Distab13_12T "" UBYTE ident 1 100 0 255 ECU_ADDRESS 0x7F893C /end MEASUREMENT
/begin MEASUREMENT NrVar_2Byte.Dist_R12.Distab13_12T "" UBYTE ident 1 100 0 255 ECU_ADDRESS 0x7F8944 /end MEASUREMENT
/begin MEASUREMENT NrVar_4Byte.Dist_B01.Distab13_12T "" UBYTE ident 1 100 0 255 ECU_ADDRESS 0x7F885E /end MEASUREMENT
/begin MEASUREMENT NrVar_4Byte.Dist_B02.Distab13_12T "" UBYTE ident 1 100 0 255 ECU_ADDRESS 0x7F8882 /end MEASUREMENT
/begin MEASUREMENT NrVar_4Byte.Dist_B03.Distab13_12T "" UBYTE ident 1 100 0 255 ECU_ADDRESS 0x7F88A6 /end MEASUREMENT
/begin MEASUREMENT NrVar_4Byte.Dist_B04.Distab13_12T "" UBYTE ident 1 100 0 255 ECU_ADDRESS 0x7F88CA /end MEASUREMENT
/begin MEASUREMENT NrVar_4Byte.Dist_R01.Distab13_12T "" UBYTE ident 1 100 0 255 ECU_ADDRESS 0x7F88ED /end MEASUREMENT
/begin MEASUREMENT NrVar_4Byte.Dist_R02.Distab13_12T "" UBYTE ident 1 100 0 255 ECU_ADDRESS 0x7F88F5 /end MEASUREMENT
/begin MEASUREMENT NrVar_4Byte.Dist_R03.Distab13_12T "" UBYTE ident 1 100 0 255 ECU_ADDRESS 0x7F88FD /end MEASUREMENT
/begin MEASUREMENT NrVar_4Byte.Dist_R04.Distab13_12T "" UBYTE ident 1 100 0 255 ECU_ADDRESS 0x7F8905 /end MEASUREMENT
/begin MEASUREMENT NrVar_4Byte.Dist_R05.Distab13_12T "" UBYTE ident 1 100 0 255 ECU_ADDRESS 0x7F890D /end MEASUREMENT
/begin MEASUREMENT NrVar_4Byte.Dist_R06.Distab13_12T "" UBYTE ident 1 100 0 255 ECU_ADDRESS 0x7F8915 /end MEASUREMENT
/begin MEASUREMENT NrVar_4Byte.Dist_R07.Distab13_12T "" UBYTE ident 1 100 0 255 ECU_ADDRESS 0x7F891D /end MEASUREMENT
/begin MEASUREMENT NrVar_4Byte.Dist_R08.Distab13_12T "" UBYTE ident 1 100 0 255 ECU_ADDRESS 0x7F8925 /end MEASUREMENT
/begin MEASUREMENT NrVar_4Byte.Dist_R09.Distab13_12T "" UBYTE ident 1 100 0 255 ECU_ADDRESS 0x7F892D /end MEASUREMENT
/begin MEASUREMENT NrVar_4Byte.Dist_R10.Distab13_12T "" UBYTE ident 1 100 0 255 ECU_ADDRESS 0x7F8935 /end MEASUREMENT
/begin MEASUREMENT NrVar_4Byte.Dist_R11.Distab13_12T "" UBYTE ident 1 100 0 255 ECU_ADDRESS 0x7F893D /end MEASUREMENT
/begin MEASUREMENT NrVar_4Byte.Dist_R12.Distab13_12T "" UBYTE ident 1 100 0 255 ECU_ADDRESS 0x7F8945 /end MEASUREMENT
/begin MEASUREMENT NrVar_8Byte.Dist_B01.Distab13_12T "" UBYTE ident 1 100 0 255 ECU_ADDRESS 0x7F885F /end MEASUREMENT
/begin MEASUREMENT NrVar_8Byte.Dist_B02.Distab13_12T "" UBYTE ident 1 100 0 255 ECU_ADDRESS 0x7F8883 /end MEASUREMENT
/begin MEASUREMENT NrVar_8Byte.Dist_B03.Distab13_12T "" UBYTE ident 1 100 0 255 ECU_ADDRESS 0x7F88A7 /end MEASUREMENT
/begin MEASUREMENT NrVar_8Byte.Dist_B04.Distab13_12T "" UBYTE ident 1 100 0 255 ECU_ADDRESS 0x7F88CB /end MEASUREMENT
/begin MEASUREMENT NrVar_8Byte.Dist_R01.Distab13_12T "" UBYTE ident 1 100 0 255 ECU_ADDRESS 0x7F88EE /end MEASUREMENT
/begin MEASUREMENT NrVar_8Byte.Dist_R02.Distab13_12T "" UBYTE ident 1 100 0 255 ECU_ADDRESS 0x7F88F6 /end MEASUREMENT
/begin MEASUREMENT NrVar_8Byte.Dist_R03.Distab13_12T "" UBYTE ident 1 100 0 255 ECU_ADDRESS 0x7F88FE /end MEASUREMENT
/begin MEASUREMENT NrVar_8Byte.Dist_R04.Distab13_12T "" UBYTE ident 1 100 0 255 ECU_ADDRESS 0x7F8906 /end MEASUREMENT
/begin MEASUREMENT NrVar_8Byte.Dist_R05.Distab13_12T "" UBYTE ident 1 100 0 255 ECU_ADDRESS 0x7F890E /end MEASUREMENT
/begin MEASUREMENT NrVar_8Byte.Dist_R06.Distab13_12T "" UBYTE ident 1 100 0 255 ECU_ADDRESS 0x7F8916 /end MEASUREMENT
/begin MEASUREMENT NrVar_8Byte.Dist_R07.Distab13_12T "" UBYTE ident 1 100 0 255 ECU_ADDRESS 0x7F891E /end MEASUREMENT
/begin MEASUREMENT NrVar_8Byte.Dist_R08.Distab13_12T "" UBYTE ident 1 100 0 255 ECU_ADDRESS 0x7F8926 /end MEASUREMENT
/begin MEASUREMENT NrVar_8Byte.Dist_R09.Distab13_12T "" UBYTE ident 1 100 0 255 ECU_ADDRESS 0x7F892E /end MEASUREMENT
/begin MEASUREMENT NrVar_8Byte.Dist_R10.Distab13_12T "" UBYTE ident 1 100 0 255 ECU_ADDRESS 0x7F8936 /end MEASUREMENT
/begin MEASUREMENT NrVar_8Byte.Dist_R11.Distab13_12T "" UBYTE ident 1 100 0 255 ECU_ADDRESS 0x7F893E /end MEASUREMENT
/begin MEASUREMENT NrVar_8Byte.Dist_R12.Distab13_12T "" UBYTE ident 1 100 0 255 ECU_ADDRESS 0x7F8946 /end MEASUREMENT
/begin MEASUREMENT Result.Dist_B01.Distab13_12T "" UBYTE ident 1 100 0 255 ECU_ADDRESS 0x7F8860 /end MEASUREMENT
/begin MEASUREMENT Result.Dist_B02.Distab13_12T "" UBYTE ident 1 100 0 255 ECU_ADDRESS 0x7F8884 /end MEASUREMENT
/begin MEASUREMENT Result.Dist_B03.Distab13_12T "" UBYTE ident 1 100 0 255 ECU_ADDRESS 0x7F88A8 /end MEASUREMENT
/begin MEASUREMENT Result.Dist_B04.Distab13_12T "" UBYTE ident 1 100 0 255 ECU_ADDRESS 0x7F88CC /end MEASUREMENT
/begin MEASUREMENT Result.Dist_R01.Distab13_12T "" UBYTE ident 1 100 0 255 ECU_ADDRESS 0x7F88EF /end MEASUREMENT
/begin MEASUREMENT Result.Dist_R02.Distab13_12T "" UBYTE ident 1 100 0 255 ECU_ADDRESS 0x7F88F7 /end MEASUREMENT
/begin MEASUREMENT Result.Dist_R03.Distab13_12T "" UBYTE ident 1 100 0 255 ECU_ADDRESS 0x7F88FF /end MEASUREMENT
/begin MEASUREMENT Result.Dist_R04.Distab13_12T "" UBYTE ident 1 100 0 255 ECU_ADDRESS 0x7F8907 /end MEASUREMENT
/begin MEASUREMENT Result.Dist_R05.Distab13_12T "" UBYTE ident 1 100 0 255 ECU_ADDRESS 0x7F890F /end MEASUREMENT
/begin MEASUREMENT Result.Dist_R06.Distab13_12T "" UBYTE ident 1 100 0 255 ECU_ADDRESS 0x7F8917 /end MEASUREMENT
/begin MEASUREMENT Result.Dist_R07.Distab13_12T "" UBYTE ident 1 100 0 255 ECU_ADDRESS 0x7F891F /end MEASUREMENT
/begin MEASUREMENT Result.Dist_R08.Distab13_12T "" UBYTE ident 1 100 0 255 ECU_ADDRESS 0x7F8927 /end MEASUREMENT
/begin MEASUREMENT Result.Dist_R09.Distab13_12T "" UBYTE ident 1 100 0 255 ECU_ADDRESS 0x7F892F /end MEASUREMENT
/begin MEASUREMENT Result.Dist_R10.Distab13_12T "" UBYTE ident 1 100 0 255 ECU_ADDRESS 0x7F8937 /end MEASUREMENT
/begin MEASUREMENT Result.Dist_R11.Distab13_12T "" UBYTE ident 1 100 0 255 ECU_ADDRESS 0x7F893F /end MEASUREMENT
/begin MEASUREMENT Result.Dist_R12.Distab13_12T "" UBYTE ident 1 100 0 255 ECU_ADDRESS 0x7F8947 /end MEASUREMENT
/begin MEASUREMENT Result.Time_Calc.Curve_Module "" ULONG TickType2ms 1 100 0.1428571428571429 600000.0 ECU_ADDRESS 0x7F85F8 MATRIX_DIM 3 1 1 /end MEASUREMENT
/begin MEASUREMENT Summe.StatisticValuesECU_V100.DiagP3MasterDownload.DiagKwpUds "" ULONG TickType2ms 1 100 0.0 1227133.512857143 ECU_ADDRESS 0x7F87F0 /end MEASUREMENT
/begin MEASUREMENT Summe.StatisticValuesECU_V100.DiagSTminDownloadCF1CF2.DiagKwpUds "" ULONG TickType2ms 1 100 0.0 1227133.512857143 ECU_ADDRESS 0x7F881C /end MEASUREMENT
/begin MEASUREMENT Summe.StatisticValuesECU_V100.DiagSTminDownloadCF2CF3.DiagKwpUds "" ULONG TickType2ms 1 100 0.0 1227133.512857143 ECU_ADDRESS 0x7F8848 /end MEASUREMENT
/begin MEASUREMENT SummeQuad.StatisticValuesECU_V100.DiagP3MasterDownload.DiagKwpUds "" FLOAT32_IEEE ident 1 100 0.0 4294967295.0 ECU_ADDRESS 0x7F87F4 /end MEASUREMENT
/begin MEASUREMENT SummeQuad.StatisticValuesECU_V100.DiagSTminDownloadCF1CF2.DiagKwpUds "" FLOAT32_IEEE ident 1 100 0.0 4294967295.0 ECU_ADDRESS 0x7F8820 /end MEASUREMENT
/begin MEASUREMENT SummeQuad.StatisticValuesECU_V100.DiagSTminDownloadCF2CF3.DiagKwpUds "" FLOAT32_IEEE ident 1 100 0.0 4294967295.0 ECU_ADDRESS 0x7F884C /end MEASUREMENT
/begin MEASUREMENT testVariable.Curve_Module "" UBYTE ident 1 100 0 255 ECU_ADDRESS 0x7F85F2 MATRIX_DIM 3 1 1 /end MEASUREMENT
/begin MEASUREMENT Time.Distab.Dist_B01.Distab13_12T "" ULONG TickType2ms 1 100 0.0 1227133.512857143 ECU_ADDRESS 0x7F886C /end MEASUREMENT
/begin MEASUREMENT Time.Distab.Dist_B02.Distab13_12T "" ULONG TickType2ms 1 100 0.0 1227133.512857143 ECU_ADDRESS 0x7F8890 /end MEASUREMENT
/begin MEASUREMENT Time.Distab.Dist_B03.Distab13_12T "" ULONG TickType2ms 1 100 0.0 1227133.512857143 ECU_ADDRESS 0x7F88B4 /end MEASUREMENT
/begin MEASUREMENT Time.Distab.Dist_B04.Distab13_12T "" ULONG TickType2ms 1 100 0.0 1227133.512857143 ECU_ADDRESS 0x7F88D8 /end MEASUREMENT
/begin MEASUREMENT Time.MIN_MAX_Tick2Time.DiagP3MasterDownload.DiagKwpUds "" ULONG TickType2ms 1 100 0.0 1227133.512857143 ECU_ADDRESS 0x7F87E4 /end MEASUREMENT
/begin MEASUREMENT Time.MIN_MAX_Tick2Time.DiagSTminDownloadCF1CF2.DiagKwpUds "" ULONG TickType2ms 1 100 0.0 1227133.512857143 ECU_ADDRESS 0x7F8810 /end MEASUREMENT
/begin MEASUREMENT Time.MIN_MAX_Tick2Time.DiagSTminDownloadCF2CF3.DiagKwpUds "" ULONG TickType2ms 1 100 0.0 1227133.512857143 ECU_ADDRESS 0x7F883C /end MEASUREMENT
/begin MEASUREMENT Time.Roundtrip.Dist_B01.Distab13_12T "" ULONG TickType2ms 1 100 0.0 1227133.512857143 ECU_ADDRESS 0x7F8878 /end MEASUREMENT
/begin MEASUREMENT Time.Roundtrip.Dist_B02.Distab13_12T "" ULONG TickType2ms 1 100 0.0 1227133.512857143 ECU_ADDRESS 0x7F889C /end MEASUREMENT
/begin MEASUREMENT Time.Roundtrip.Dist_B03.Distab13_12T "" ULONG TickType2ms 1 100 0.0 1227133.512857143 ECU_ADDRESS 0x7F88C0 /end MEASUREMENT
/begin MEASUREMENT Time.Roundtrip.Dist_B04.Distab13_12T "" ULONG TickType2ms 1 100 0.0 1227133.512857143 ECU_ADDRESS 0x7F88E4 /end MEASUREMENT
/begin MEASUREMENT Timeout_RoundTrip.Dist_B01.Distab13_12T "" UBYTE ident 1 100 0 1 BIT_MASK 0x1 ECU_ADDRESS 0x7F8861 /end MEASUREMENT
/begin MEASUREMENT Timeout_RoundTrip.Dist_B02.Distab13_12T "" UBYTE ident 1 100 0 1 BIT_MASK 0x1 ECU_ADDRESS 0x7F8885 /end MEASUREMENT
/begin MEASUREMENT Timeout_RoundTrip.Dist_B03.Distab13_12T "" UBYTE ident 1 100 0 1 BIT_MASK 0x1 ECU_ADDRESS 0x7F88A9 /end MEASUREMENT
/begin MEASUREMENT Timeout_RoundTrip.Dist_B04.Distab13_12T "" UBYTE ident 1 100 0 1 BIT_MASK 0x1 ECU_ADDRESS 0x7F88CD /end MEASUREMENT
/begin MEASUREMENT TimeStampOne.Time_Calc.Curve_Module "" ULONG TickType2ms 1 100 0.1428571428571429 600000.0 ECU_ADDRESS 0x7F8604 MATRIX_DIM 3 1 1 /end MEASUREMENT
/begin MEASUREMENT TimeStampTwo.Time_Calc.Curve_Module "" ULONG TickType2ms 1 100 0.1428571428571429 600000.0 ECU_ADDRESS 0x7F8610 MATRIX_DIM 3 1 1 /end MEASUREMENT
/begin MEASUREMENT V_counter_1.Counter_R01_1.Counter_module_Mle "" UWORD ident 1 100 0 65535 ECU_ADDRESS 0x7FB41E /end MEASUREMENT
/begin MEASUREMENT V_DetectDTCDuringDriveCycle_b.CRB_OBD "" UBYTE ident 1 100 0 1 BIT_MASK 0x1 ECU_ADDRESS 0x7F8579 /end MEASUREMENT
/begin MEASUREMENT V_EmissionRelatedDTCStored_b.CRB_OBD "" UBYTE ident 1 100 0 1 BIT_MASK 0x1 ECU_ADDRESS 0x7F8577 /end MEASUREMENT
/* /end C:/ETAS/ASCET513/target/mpc555/Add_ToolChain/ASAP_Templates\v_Formula_u8.a2l inserted by script merge_Tab.pl */
/begin MEASUREMENT V_FreezeFrameDataStored_b.CRB_OBD "" UBYTE ident 1 100 0 1 BIT_MASK 0x1 ECU_ADDRESS 0x7F8576 /end MEASUREMENT
/begin MEASUREMENT v_Matrix1_u16_1.Shared.Cal_Measure_Block16 "" UWORD ident 1 100 0.0 65535.0 ECU_ADDRESS 0x82000E /end MEASUREMENT
/begin MEASUREMENT v_Matrix1_u16_2.Shared.Cal_Measure_Block16 "" UWORD ident 1 100 0.0 65535.0 ECU_ADDRESS 0x820010 /end MEASUREMENT
/begin MEASUREMENT v_Matrix1_u16_3.Shared.Cal_Measure_Block16 "" UWORD ident 1 100 0.0 65535.0 ECU_ADDRESS 0x820012 /end MEASUREMENT
/begin MEASUREMENT v_Matrix1_u16_4.Shared.Cal_Measure_Block16 "" UWORD ident 1 100 0.0 65535.0 ECU_ADDRESS 0x820014 /end MEASUREMENT
/begin MEASUREMENT v_Matrix1_u16_5.Shared.Cal_Measure_Block16 "" UWORD ident 1 100 0.0 65535.0 ECU_ADDRESS 0x820016 /end MEASUREMENT
/* /end C:/ETAS/ASCET513/target/mpc555/Add_ToolChain/ASAP_Templates\v_TabIntp_u8.a2l inserted by script merge_Tab.pl */
/begin MEASUREMENT Var.StatisticValuesECU_V100.DiagP3MasterDownload.DiagKwpUds "" FLOAT32_IEEE ident 1 100 0.0 4294967295.0 ECU_ADDRESS 0x7F87F8 /end MEASUREMENT
/begin MEASUREMENT Var.StatisticValuesECU_V100.DiagSTminDownloadCF1CF2.DiagKwpUds "" FLOAT32_IEEE ident 1 100 0.0 4294967295.0 ECU_ADDRESS 0x7F8824 /end MEASUREMENT
/begin MEASUREMENT Var.StatisticValuesECU_V100.DiagSTminDownloadCF2CF3.DiagKwpUds "" FLOAT32_IEEE ident 1 100 0.0 4294967295.0 ECU_ADDRESS 0x7F8850 /end MEASUREMENT
/begin COMPU_METHOD 1_1000 "" RAT_FUNC "%12.4" "" COEFFS 0 1000 0 0 0 1 /end COMPU_METHOD
/begin COMPU_METHOD ADC_PT1000 "OP Amp:     315 / 215" RAT_FUNC "%12.4" "V" COEFFS 0 299.7627906976744 0 0 0 1 /end COMPU_METHOD
/begin COMPU_METHOD enum_ACTIVE_DIAG_PROTOCOL_E "" TAB_VERB "%8.4" "" COEFFS 0 1 0 0 0 1 COMPU_TAB_REF enum_ACTIVE_DIAG_PROTOCOL_E_tab_ref /end COMPU_METHOD
/begin COMPU_METHOD enum_DIAG_ERROR_TRIGGER_E "" TAB_VERB "%8.4" "" COEFFS 0 1 0 0 0 1 COMPU_TAB_REF enum_DIAG_ERROR_TRIGGER_E_tab_ref /end COMPU_METHOD
/begin COMPU_METHOD enum_DIAG_MEASURE_MODE_E "" TAB_VERB "%8.4" "" COEFFS 0 1 0 0 0 1 COMPU_TAB_REF enum_DIAG_MEASURE_MODE_E_tab_ref /end COMPU_METHOD
/begin COMPU_METHOD enum_DIAG_RESP_CODE_E "" TAB_VERB "%8.4" "" COEFFS 0 1 0 0 0 1 COMPU_TAB_REF enum_DIAG_RESP_CODE_E_tab_ref /end COMPU_METHOD
/begin COMPU_METHOD enum_DIAGINFO_e "" TAB_VERB "%8.4" "" COEFFS 0 1 0 0 0 1 COMPU_TAB_REF enum_DIAGINFO_e_tab_ref /end COMPU_METHOD
/begin COMPU_METHOD enum_RESET_COUNTER_E "" TAB_VERB "%8.4" "" COEFFS 0 1 0 0 0 1 COMPU_TAB_REF enum_RESET_COUNTER_E_tab_ref /end COMPU_METHOD
/begin COMPU_METHOD enum_UDS_SENDLISTSTATE_E "" TAB_VERB "%8.4" "" COEFFS 0 1 0 0 0 1 COMPU_TAB_REF enum_UDS_SENDLISTSTATE_E_tab_ref /end COMPU_METHOD
/begin COMPU_METHOD enum_UPDOWN_ENUM "" TAB_VERB "%8.4" "" COEFFS 0 1 0 0 0 1 COMPU_TAB_REF enum_UPDOWN_ENUM_tab_ref /end COMPU_METHOD
/begin COMPU_METHOD ident "" RAT_FUNC "%12.4" "" COEFFS 0 1 0 0 0 1 /end COMPU_METHOD
/begin COMPU_METHOD TickType2ms "" RAT_FUNC "%12.4" "ms" COEFFS 0 3500.0 0 0 0 1 /end COMPU_METHOD
/begin COMPU_VTAB enum_ACTIVE_DIAG_PROTOCOL_E_tab_ref "" TAB_VERB 4 0 "KWP2000_PROTOCOL_00" 1 "UNDEF_01" 2 "UDS_KB_ECUPROGRAMMINGMODE_02" 3 "UDS_STANDARDDIAGNOSTICMODE_03" DEFAULT_VALUE "Error" /end COMPU_VTAB
/begin COMPU_VTAB enum_DIAG_ERROR_TRIGGER_E_tab_ref "" TAB_VERB 3 0 "ERROR_TRIGGER_NO" 1 "ERROR_TRIGGER_ONCE" 2 "ERROR_TRIGGER_CYCLIC" DEFAULT_VALUE "Error" /end COMPU_VTAB
/begin COMPU_VTAB enum_DIAG_MEASURE_MODE_E_tab_ref "" TAB_VERB 3 0 "ADDRESS_MODE" 1 "BLOCK_MODE" 2 "FREERUNNING_MODE" DEFAULT_VALUE "Error" /end COMPU_VTAB
/begin COMPU_VTAB enum_DIAG_RESP_CODE_E_tab_ref "" TAB_VERB 10 0 "K2SESS_NIL" 1 "K2SESS_POS" 2 "K2SESS_NEG" 3 "K2SESS_NORESP" 4 "K2SESS_POSAGAIN" 5 "K2SESS_NEGAGAIN" 6 "K2SESS_NORESPAGAIN" 7 "K2SESS_WAIT" 8 "K2SESS_WAITPEND" 9 "K2SESS_WAITHS" DEFAULT_VALUE "Error" /end COMPU_VTAB
/begin COMPU_VTAB enum_DIAGINFO_e_tab_ref "" TAB_VERB 16 0 "READ_0" 1 "SET_P2MIN_1" 2 "SET_P2MAX_2" 3 "SET_P3MIN_3" 4 "SET_P3MAX_4" 5 "SET_P4MAX_5" 6 "SET_ComMedium_6" 7 "SET_ComProtocol_7" 8 "SET_StimuAddr_8" 9 "SET_StimuAddrMode_9" 10 "SET_DiaMode_10" 11 "SET_SecLevel_11" 12 "SET_ActBdRate_12" 13 "SET_ReqBdRate_13" 14 "SET_PhysEcuAddr_14" 15 "SET_ALL_16" DEFAULT_VALUE "Error" /end COMPU_VTAB
/begin COMPU_VTAB enum_RESET_COUNTER_E_tab_ref "" TAB_VERB 2 0 "NoReset_0" 1 "Reset_1" DEFAULT_VALUE "Error" /end COMPU_VTAB
/begin COMPU_VTAB enum_UDS_SENDLISTSTATE_E_tab_ref "" TAB_VERB 3 0 "FREE_0" 1 "IDLE_1" 2 "SAMPLED_2" DEFAULT_VALUE "Error" /end COMPU_VTAB
/begin COMPU_VTAB enum_UPDOWN_ENUM_tab_ref "" TAB_VERB 2 0 "UP" 1 "DOWN" DEFAULT_VALUE "Error" /end COMPU_VTAB
/begin GROUP CRB_OBD "" ROOT
 /begin REF_MEASUREMENT V_DetectDTCDuringDriveCycle_b.CRB_OBD V_EmissionRelatedDTCStored_b.CRB_OBD V_FreezeFrameDataStored_b.CRB_OBD g_CarbPID05_EnCoTemp40_u8.CRB_OBD g_CarbPID05_deltaEnCoTemp40_u8.CRB_OBD g_CarbPID0C_EngineRPM_u16.CRB_OBD g_CarbPID0C_deltaEngineRPM_u8.CRB_OBD g_MaxTxDTCinBlock_u8.CRB_OBD g_NumDTC_u16.CRB_OBD /end REF_MEASUREMENT
 /begin REF_CHARACTERISTIC P_Card01PID01_MIL_b.CRB_OBD P_DetectDTCDuringDriveCycle_b.CRB_OBD P_EmissionRelatedDTCStored_b.CRB_OBD P_FreezeFrameDataStored_b.CRB_OBD p_CarbPID05_deltaEnCoTemp40_u8.CRB_OBD p_CarbPID0C_deltaEngineRPM_u8.CRB_OBD p_MaxTxDTCinBlock_u8.CRB_OBD p_NumDTC_u16.CRB_OBD p_TableDTC_u16.CRB_OBD /end REF_CHARACTERISTIC
/end GROUP
/begin GROUP CURVE_Axis "" ROOT /begin SUB_GROUP Axis_Input.CURVE_Axis /end SUB_GROUP /end GROUP
/begin GROUP C_ClassDiagCounter.DiagKwpUds ""
 /begin REF_MEASUREMENT i_0x21_rdbli_kwp_u32.C_ClassDiagCounter.DiagKwpUds i_0x22_rdbli_uds_u32.C_ClassDiagCounter.DiagKwpUds i_0x23_rmba_u32.C_ClassDiagCounter.DiagKwpUds /end REF_MEASUREMENT
 /begin REF_CHARACTERISTIC p_ResetCounter_u8.C_ClassDiagCounter.DiagKwpUds /end REF_CHARACTERISTIC
/end GROUP
/begin GROUP C_ClassDiagInfo.DiagKwpUds ""
 /begin REF_MEASUREMENT i_ActBdRate_u32.C_ClassDiagInfo.DiagKwpUds i_ComMedium_u8.C_ClassDiagInfo.DiagKwpUds i_ComProtocol_u8.C_ClassDiagInfo.DiagKwpUds i_DiaMode_u8.C_ClassDiagInfo.DiagKwpUds i_P2max_u32.C_ClassDiagInfo.DiagKwpUds i_P2min_u32.C_ClassDiagInfo.DiagKwpUds i_P3max_u32.C_ClassDiagInfo.DiagKwpUds i_P3min_u32.C_ClassDiagInfo.DiagKwpUds i_P4min_u32.C_ClassDiagInfo.DiagKwpUds i_PhysEcuAddr_u8.C_ClassDiagInfo.DiagKwpUds i_ReqBdRate_u32.C_ClassDiagInfo.DiagKwpUds i_SecLevel_u8.C_ClassDiagInfo.DiagKwpUds i_StimuAddrMode_u8.C_ClassDiagInfo.DiagKwpUds i_StimuAddr_u8.C_ClassDiagInfo.DiagKwpUds /end REF_MEASUREMENT
 /begin REF_CHARACTERISTIC pi_ActBdRate_u32.C_ClassDiagInfo.DiagKwpUds pi_ComMedium_u8.C_ClassDiagInfo.DiagKwpUds pi_ComProtocol_u8.C_ClassDiagInfo.DiagKwpUds pi_DiaMode_u8.C_ClassDiagInfo.DiagKwpUds pi_P2max_u32.C_ClassDiagInfo.DiagKwpUds pi_P2min_u32.C_ClassDiagInfo.DiagKwpUds pi_P3max_u32.C_ClassDiagInfo.DiagKwpUds pi_P3min_u32.C_ClassDiagInfo.DiagKwpUds pi_P4min_u32.C_ClassDiagInfo.DiagKwpUds pi_PhysEcuAddr_u8.C_ClassDiagInfo.DiagKwpUds pi_ReqBdRate_u32.C_ClassDiagInfo.DiagKwpUds pi_SecLevel_u8.C_ClassDiagInfo.DiagKwpUds pi_StimuAddrMode_u8.C_ClassDiagInfo.DiagKwpUds pi_StimuAddr_u8.C_ClassDiagInfo.DiagKwpUds /end REF_CHARACTERISTIC
/end GROUP
/begin GROUP C_ClassUdsSendList01.UdsSendList ""
 /begin REF_MEASUREMENT i_CanID_u32.C_ClassUdsSendList01.UdsSendList i_NumEntries_u8.C_ClassUdsSendList01.UdsSendList i_PeriodicID_u16.C_ClassUdsSendList01.UdsSendList i_RasterMode_u8.C_ClassUdsSendList01.UdsSendList i_ResponceType_u8.C_ClassUdsSendList01.UdsSendList i_SampleBuf_au8.C_ClassUdsSendList01.UdsSendList i_UdsDaqList_pu32.C_ClassUdsSendList01.UdsSendList i_UdsSendListState_u8.C_ClassUdsSendList01.UdsSendList /end REF_MEASUREMENT
/end GROUP
/begin GROUP C_ClassUdsSendList02.UdsSendList ""
 /begin REF_MEASUREMENT i_CanID_u32.C_ClassUdsSendList02.UdsSendList i_NumEntries_u8.C_ClassUdsSendList02.UdsSendList i_PeriodicID_u16.C_ClassUdsSendList02.UdsSendList i_RasterMode_u8.C_ClassUdsSendList02.UdsSendList i_ResponceType_u8.C_ClassUdsSendList02.UdsSendList i_SampleBuf_au8.C_ClassUdsSendList02.UdsSendList i_UdsDaqList_pu32.C_ClassUdsSendList02.UdsSendList i_UdsSendListState_u8.C_ClassUdsSendList02.UdsSendList /end REF_MEASUREMENT
/end GROUP
/begin GROUP C_ClassUdsSendList03.UdsSendList ""
 /begin REF_MEASUREMENT i_CanID_u32.C_ClassUdsSendList03.UdsSendList i_NumEntries_u8.C_ClassUdsSendList03.UdsSendList i_PeriodicID_u16.C_ClassUdsSendList03.UdsSendList i_RasterMode_u8.C_ClassUdsSendList03.UdsSendList i_ResponceType_u8.C_ClassUdsSendList03.UdsSendList i_SampleBuf_au8.C_ClassUdsSendList03.UdsSendList i_UdsDaqList_pu32.C_ClassUdsSendList03.UdsSendList i_UdsSendListState_u8.C_ClassUdsSendList03.UdsSendList /end REF_MEASUREMENT
/end GROUP
/begin GROUP C_ClassUdsSendList04.UdsSendList ""
 /begin REF_MEASUREMENT i_CanID_u32.C_ClassUdsSendList04.UdsSendList i_NumEntries_u8.C_ClassUdsSendList04.UdsSendList i_PeriodicID_u16.C_ClassUdsSendList04.UdsSendList i_RasterMode_u8.C_ClassUdsSendList04.UdsSendList i_ResponceType_u8.C_ClassUdsSendList04.UdsSendList i_SampleBuf_au8.C_ClassUdsSendList04.UdsSendList i_UdsDaqList_pu32.C_ClassUdsSendList04.UdsSendList i_UdsSendListState_u8.C_ClassUdsSendList04.UdsSendList /end REF_MEASUREMENT
/end GROUP
/begin GROUP C_ClassUdsSendList05.UdsSendList ""
 /begin REF_MEASUREMENT i_CanID_u32.C_ClassUdsSendList05.UdsSendList i_NumEntries_u8.C_ClassUdsSendList05.UdsSendList i_PeriodicID_u16.C_ClassUdsSendList05.UdsSendList i_RasterMode_u8.C_ClassUdsSendList05.UdsSendList i_ResponceType_u8.C_ClassUdsSendList05.UdsSendList i_SampleBuf_au8.C_ClassUdsSendList05.UdsSendList i_UdsDaqList_pu32.C_ClassUdsSendList05.UdsSendList i_UdsSendListState_u8.C_ClassUdsSendList05.UdsSendList /end REF_MEASUREMENT
/end GROUP
/begin GROUP C_ClassUdsSendList06.UdsSendList ""
 /begin REF_MEASUREMENT i_CanID_u32.C_ClassUdsSendList06.UdsSendList i_NumEntries_u8.C_ClassUdsSendList06.UdsSendList i_PeriodicID_u16.C_ClassUdsSendList06.UdsSendList i_RasterMode_u8.C_ClassUdsSendList06.UdsSendList i_ResponceType_u8.C_ClassUdsSendList06.UdsSendList i_SampleBuf_au8.C_ClassUdsSendList06.UdsSendList i_UdsDaqList_pu32.C_ClassUdsSendList06.UdsSendList i_UdsSendListState_u8.C_ClassUdsSendList06.UdsSendList /end REF_MEASUREMENT
/end GROUP
/begin GROUP C_ClassUdsSendList07.UdsSendList ""
 /begin REF_MEASUREMENT i_CanID_u32.C_ClassUdsSendList07.UdsSendList i_NumEntries_u8.C_ClassUdsSendList07.UdsSendList i_PeriodicID_u16.C_ClassUdsSendList07.UdsSendList i_RasterMode_u8.C_ClassUdsSendList07.UdsSendList i_ResponceType_u8.C_ClassUdsSendList07.UdsSendList i_SampleBuf_au8.C_ClassUdsSendList07.UdsSendList i_UdsDaqList_pu32.C_ClassUdsSendList07.UdsSendList i_UdsSendListState_u8.C_ClassUdsSendList07.UdsSendList /end REF_MEASUREMENT
/end GROUP
/begin GROUP C_ClassUdsSendList08.UdsSendList ""
 /begin REF_MEASUREMENT i_CanID_u32.C_ClassUdsSendList08.UdsSendList i_NumEntries_u8.C_ClassUdsSendList08.UdsSendList i_PeriodicID_u16.C_ClassUdsSendList08.UdsSendList i_RasterMode_u8.C_ClassUdsSendList08.UdsSendList i_ResponceType_u8.C_ClassUdsSendList08.UdsSendList i_SampleBuf_au8.C_ClassUdsSendList08.UdsSendList i_UdsDaqList_pu32.C_ClassUdsSendList08.UdsSendList i_UdsSendListState_u8.C_ClassUdsSendList08.UdsSendList /end REF_MEASUREMENT
/end GROUP
/begin GROUP C_ClassUdsSendList09.UdsSendList ""
 /begin REF_MEASUREMENT i_CanID_u32.C_ClassUdsSendList09.UdsSendList i_NumEntries_u8.C_ClassUdsSendList09.UdsSendList i_PeriodicID_u16.C_ClassUdsSendList09.UdsSendList i_RasterMode_u8.C_ClassUdsSendList09.UdsSendList i_ResponceType_u8.C_ClassUdsSendList09.UdsSendList i_SampleBuf_au8.C_ClassUdsSendList09.UdsSendList i_UdsDaqList_pu32.C_ClassUdsSendList09.UdsSendList i_UdsSendListState_u8.C_ClassUdsSendList09.UdsSendList /end REF_MEASUREMENT
/end GROUP
/begin GROUP C_ClassUdsSendList10.UdsSendList ""
 /begin REF_MEASUREMENT i_CanID_u32.C_ClassUdsSendList10.UdsSendList i_NumEntries_u8.C_ClassUdsSendList10.UdsSendList i_PeriodicID_u16.C_ClassUdsSendList10.UdsSendList i_RasterMode_u8.C_ClassUdsSendList10.UdsSendList i_ResponceType_u8.C_ClassUdsSendList10.UdsSendList i_SampleBuf_au8.C_ClassUdsSendList10.UdsSendList i_UdsDaqList_pu32.C_ClassUdsSendList10.UdsSendList i_UdsSendListState_u8.C_ClassUdsSendList10.UdsSendList /end REF_MEASUREMENT
/end GROUP
/begin GROUP C_ClassUdsSendList11.UdsSendList ""
 /begin REF_MEASUREMENT i_CanID_u32.C_ClassUdsSendList11.UdsSendList i_NumEntries_u8.C_ClassUdsSendList11.UdsSendList i_PeriodicID_u16.C_ClassUdsSendList11.UdsSendList i_RasterMode_u8.C_ClassUdsSendList11.UdsSendList i_ResponceType_u8.C_ClassUdsSendList11.UdsSendList i_SampleBuf_au8.C_ClassUdsSendList11.UdsSendList i_UdsDaqList_pu32.C_ClassUdsSendList11.UdsSendList i_UdsSendListState_u8.C_ClassUdsSendList11.UdsSendList /end REF_MEASUREMENT
/end GROUP
/begin GROUP C_ClassUdsSendList12.UdsSendList ""
 /begin REF_MEASUREMENT i_CanID_u32.C_ClassUdsSendList12.UdsSendList i_NumEntries_u8.C_ClassUdsSendList12.UdsSendList i_PeriodicID_u16.C_ClassUdsSendList12.UdsSendList i_RasterMode_u8.C_ClassUdsSendList12.UdsSendList i_ResponceType_u8.C_ClassUdsSendList12.UdsSendList i_SampleBuf_au8.C_ClassUdsSendList12.UdsSendList i_UdsDaqList_pu32.C_ClassUdsSendList12.UdsSendList i_UdsSendListState_u8.C_ClassUdsSendList12.UdsSendList /end REF_MEASUREMENT
/end GROUP
/begin GROUP C_ClassUdsSendList13.UdsSendList ""
 /begin REF_MEASUREMENT i_CanID_u32.C_ClassUdsSendList13.UdsSendList i_NumEntries_u8.C_ClassUdsSendList13.UdsSendList i_PeriodicID_u16.C_ClassUdsSendList13.UdsSendList i_RasterMode_u8.C_ClassUdsSendList13.UdsSendList i_ResponceType_u8.C_ClassUdsSendList13.UdsSendList i_SampleBuf_au8.C_ClassUdsSendList13.UdsSendList i_UdsDaqList_pu32.C_ClassUdsSendList13.UdsSendList i_UdsSendListState_u8.C_ClassUdsSendList13.UdsSendList /end REF_MEASUREMENT
/end GROUP
/begin GROUP C_ClassUdsSendList14.UdsSendList ""
 /begin REF_MEASUREMENT i_CanID_u32.C_ClassUdsSendList14.UdsSendList i_NumEntries_u8.C_ClassUdsSendList14.UdsSendList i_PeriodicID_u16.C_ClassUdsSendList14.UdsSendList i_RasterMode_u8.C_ClassUdsSendList14.UdsSendList i_ResponceType_u8.C_ClassUdsSendList14.UdsSendList i_SampleBuf_au8.C_ClassUdsSendList14.UdsSendList i_UdsDaqList_pu32.C_ClassUdsSendList14.UdsSendList i_UdsSendListState_u8.C_ClassUdsSendList14.UdsSendList /end REF_MEASUREMENT
/end GROUP
/begin GROUP C_ClassUdsSendList15.UdsSendList ""
 /begin REF_MEASUREMENT i_CanID_u32.C_ClassUdsSendList15.UdsSendList i_NumEntries_u8.C_ClassUdsSendList15.UdsSendList i_PeriodicID_u16.C_ClassUdsSendList15.UdsSendList i_RasterMode_u8.C_ClassUdsSendList15.UdsSendList i_ResponceType_u8.C_ClassUdsSendList15.UdsSendList i_SampleBuf_au8.C_ClassUdsSendList15.UdsSendList i_UdsDaqList_pu32.C_ClassUdsSendList15.UdsSendList i_UdsSendListState_u8.C_ClassUdsSendList15.UdsSendList /end REF_MEASUREMENT
/end GROUP
/begin GROUP C_ClassUdsSendList16.UdsSendList ""
 /begin REF_MEASUREMENT i_CanID_u32.C_ClassUdsSendList16.UdsSendList i_NumEntries_u8.C_ClassUdsSendList16.UdsSendList i_PeriodicID_u16.C_ClassUdsSendList16.UdsSendList i_RasterMode_u8.C_ClassUdsSendList16.UdsSendList i_ResponceType_u8.C_ClassUdsSendList16.UdsSendList i_SampleBuf_au8.C_ClassUdsSendList16.UdsSendList i_UdsDaqList_pu32.C_ClassUdsSendList16.UdsSendList i_UdsSendListState_u8.C_ClassUdsSendList16.UdsSendList /end REF_MEASUREMENT
/end GROUP
/begin GROUP C_ClassUdsSendList17.UdsSendList ""
 /begin REF_MEASUREMENT i_CanID_u32.C_ClassUdsSendList17.UdsSendList i_NumEntries_u8.C_ClassUdsSendList17.UdsSendList i_PeriodicID_u16.C_ClassUdsSendList17.UdsSendList i_RasterMode_u8.C_ClassUdsSendList17.UdsSendList i_ResponceType_u8.C_ClassUdsSendList17.UdsSendList i_SampleBuf_au8.C_ClassUdsSendList17.UdsSendList i_UdsDaqList_pu32.C_ClassUdsSendList17.UdsSendList i_UdsSendListState_u8.C_ClassUdsSendList17.UdsSendList /end REF_MEASUREMENT
/end GROUP
/begin GROUP C_ClassUdsSendList18.UdsSendList ""
 /begin REF_MEASUREMENT i_CanID_u32.C_ClassUdsSendList18.UdsSendList i_NumEntries_u8.C_ClassUdsSendList18.UdsSendList i_PeriodicID_u16.C_ClassUdsSendList18.UdsSendList i_RasterMode_u8.C_ClassUdsSendList18.UdsSendList i_ResponceType_u8.C_ClassUdsSendList18.UdsSendList i_SampleBuf_au8.C_ClassUdsSendList18.UdsSendList i_UdsDaqList_pu32.C_ClassUdsSendList18.UdsSendList i_UdsSendListState_u8.C_ClassUdsSendList18.UdsSendList /end REF_MEASUREMENT
/end GROUP
/begin GROUP C_ClassUdsSendList19.UdsSendList ""
 /begin REF_MEASUREMENT i_CanID_u32.C_ClassUdsSendList19.UdsSendList i_NumEntries_u8.C_ClassUdsSendList19.UdsSendList i_PeriodicID_u16.C_ClassUdsSendList19.UdsSendList i_RasterMode_u8.C_ClassUdsSendList19.UdsSendList i_ResponceType_u8.C_ClassUdsSendList19.UdsSendList i_SampleBuf_au8.C_ClassUdsSendList19.UdsSendList i_UdsDaqList_pu32.C_ClassUdsSendList19.UdsSendList i_UdsSendListState_u8.C_ClassUdsSendList19.UdsSendList /end REF_MEASUREMENT
/end GROUP
/begin GROUP C_ClassUdsSendList20.UdsSendList ""
 /begin REF_MEASUREMENT i_CanID_u32.C_ClassUdsSendList20.UdsSendList i_NumEntries_u8.C_ClassUdsSendList20.UdsSendList i_PeriodicID_u16.C_ClassUdsSendList20.UdsSendList i_RasterMode_u8.C_ClassUdsSendList20.UdsSendList i_ResponceType_u8.C_ClassUdsSendList20.UdsSendList i_SampleBuf_au8.C_ClassUdsSendList20.UdsSendList i_UdsDaqList_pu32.C_ClassUdsSendList20.UdsSendList i_UdsSendListState_u8.C_ClassUdsSendList20.UdsSendList /end REF_MEASUREMENT
/end GROUP
/begin GROUP C_ClassUdsSendList21.UdsSendList ""
 /begin REF_MEASUREMENT i_CanID_u32.C_ClassUdsSendList21.UdsSendList i_NumEntries_u8.C_ClassUdsSendList21.UdsSendList i_PeriodicID_u16.C_ClassUdsSendList21.UdsSendList i_RasterMode_u8.C_ClassUdsSendList21.UdsSendList i_ResponceType_u8.C_ClassUdsSendList21.UdsSendList i_SampleBuf_au8.C_ClassUdsSendList21.UdsSendList i_UdsDaqList_pu32.C_ClassUdsSendList21.UdsSendList i_UdsSendListState_u8.C_ClassUdsSendList21.UdsSendList /end REF_MEASUREMENT
/end GROUP
/begin GROUP C_ClassUdsSendList22.UdsSendList ""
 /begin REF_MEASUREMENT i_CanID_u32.C_ClassUdsSendList22.UdsSendList i_NumEntries_u8.C_ClassUdsSendList22.UdsSendList i_PeriodicID_u16.C_ClassUdsSendList22.UdsSendList i_RasterMode_u8.C_ClassUdsSendList22.UdsSendList i_ResponceType_u8.C_ClassUdsSendList22.UdsSendList i_SampleBuf_au8.C_ClassUdsSendList22.UdsSendList i_UdsDaqList_pu32.C_ClassUdsSendList22.UdsSendList i_UdsSendListState_u8.C_ClassUdsSendList22.UdsSendList /end REF_MEASUREMENT
/end GROUP
/begin GROUP C_ClassUdsSendList23.UdsSendList ""
 /begin REF_MEASUREMENT i_CanID_u32.C_ClassUdsSendList23.UdsSendList i_NumEntries_u8.C_ClassUdsSendList23.UdsSendList i_PeriodicID_u16.C_ClassUdsSendList23.UdsSendList i_RasterMode_u8.C_ClassUdsSendList23.UdsSendList i_ResponceType_u8.C_ClassUdsSendList23.UdsSendList i_SampleBuf_au8.C_ClassUdsSendList23.UdsSendList i_UdsDaqList_pu32.C_ClassUdsSendList23.UdsSendList i_UdsSendListState_u8.C_ClassUdsSendList23.UdsSendList /end REF_MEASUREMENT
/end GROUP
/begin GROUP C_ClassUdsSendList24.UdsSendList ""
 /begin REF_MEASUREMENT i_CanID_u32.C_ClassUdsSendList24.UdsSendList i_NumEntries_u8.C_ClassUdsSendList24.UdsSendList i_PeriodicID_u16.C_ClassUdsSendList24.UdsSendList i_RasterMode_u8.C_ClassUdsSendList24.UdsSendList i_ResponceType_u8.C_ClassUdsSendList24.UdsSendList i_SampleBuf_au8.C_ClassUdsSendList24.UdsSendList i_UdsDaqList_pu32.C_ClassUdsSendList24.UdsSendList i_UdsSendListState_u8.C_ClassUdsSendList24.UdsSendList /end REF_MEASUREMENT
/end GROUP
/begin GROUP C_ClassUdsVIN.UdsLocIDs ""
 /begin REF_MEASUREMENT i_LocalIdData_au8.C_ClassUdsVIN.UdsLocIDs i_LocalId_u16.C_ClassUdsVIN.UdsLocIDs i_LocalIds_pu32.C_ClassUdsVIN.UdsLocIDs /end REF_MEASUREMENT
 /begin REF_CHARACTERISTIC ip_NumEntries_u8.C_ClassUdsVIN.UdsLocIDs /end REF_CHARACTERISTIC
/end GROUP
/begin GROUP C_ClassUdsVIN2.UdsLocIDs ""
 /begin REF_MEASUREMENT i_LocalIdData_au8.C_ClassUdsVIN2.UdsLocIDs i_LocalId_u16.C_ClassUdsVIN2.UdsLocIDs i_LocalIds_pu32.C_ClassUdsVIN2.UdsLocIDs /end REF_MEASUREMENT
 /begin REF_CHARACTERISTIC ip_NumEntries_u8.C_ClassUdsVIN2.UdsLocIDs /end REF_CHARACTERISTIC
/end GROUP
/begin GROUP Cal_Measure "" ROOT
 /begin REF_MEASUREMENT M_F32_1.Cal_Measure M_F32_1.Shared.Cal_Measure M_F32_2.Cal_Measure M_F32_2.Shared.Cal_Measure M_F64_1.Cal_Measure M_F64_1.Shared.Cal_Measure M_F64_2.Cal_Measure M_F64_2.Shared.Cal_Measure M_S16_1.Cal_Measure M_S16_1.Shared.Cal_Measure M_S16_2.Cal_Measure M_S16_2.Shared.Cal_Measure M_S16_3.Cal_Measure M_S16_3.Shared.Cal_Measure M_S32_1.Cal_Measure M_S32_1.Shared.Cal_Measure M_S32_2.Cal_Measure M_S32_2.Shared.Cal_Measure M_S8_1.Cal_Measure M_S8_1.Shared.Cal_Measure M_S8_2.Cal_Measure M_S8_2.Shared.Cal_Measure M_S8_3.Cal_Measure M_S8_3.Shared.Cal_Measure M_S8_4.Cal_Measure M_S8_4.Shared.Cal_Measure M_U16_1.Cal_Measure M_U16_1.Shared.Cal_Measure M_U16_2.Cal_Measure M_U16_2.Shared.Cal_Measure M_U16_3.Cal_Measure M_U16_3.Shared.Cal_Measure M_U32_1.Cal_Measure M_U32_1.Shared.Cal_Measure M_U32_2.Cal_Measure M_U32_2.Shared.Cal_Measure M_U8_1.Cal_Measure M_U8_1.Shared.Cal_Measure M_U8_2.Cal_Measure M_U8_2.Shared.Cal_Measure M_U8_3.Cal_Measure M_U8_3.Shared.Cal_Measure M_U8_4.Cal_Measure M_U8_4.Shared.Cal_Measure /end REF_MEASUREMENT
 /begin REF_CHARACTERISTIC P_F32_1.Cal_Measure P_F32_1.Shared.Cal_Measure P_F32_2.Cal_Measure P_F32_2.Shared.Cal_Measure P_F64_1.Cal_Measure P_F64_1.Shared.Cal_Measure P_F64_2.Cal_Measure P_F64_2.Shared.Cal_Measure P_S16_1.Cal_Measure P_S16_1.Shared.Cal_Measure P_S16_2.Cal_Measure P_S16_2.Shared.Cal_Measure P_S16_3.Cal_Measure P_S16_3.Shared.Cal_Measure P_S32_1.Cal_Measure P_S32_1.Shared.Cal_Measure P_S32_2.Cal_Measure P_S32_2.Shared.Cal_Measure P_S8_1.Cal_Measure P_S8_1.Shared.Cal_Measure P_S8_2.Cal_Measure P_S8_2.Shared.Cal_Measure P_S8_3.Cal_Measure P_S8_3.Shared.Cal_Measure P_S8_4.Cal_Measure P_S8_4.Shared.Cal_Measure P_U16_1.Cal_Measure P_U16_1.Shared.Cal_Measure P_U16_2.Cal_Measure P_U16_2.Shared.Cal_Measure P_U16_3.Cal_Measure P_U16_3.Shared.Cal_Measure P_U32_1.Cal_Measure P_U32_1.Shared.Cal_Measure P_U32_2.Cal_Measure P_U32_2.Shared.Cal_Measure P_U8_1.Cal_Measure P_U8_1.Shared.Cal_Measure P_U8_2.Cal_Measure P_U8_2.Shared.Cal_Measure P_U8_3.Cal_Measure P_U8_3.Shared.Cal_Measure P_U8_4.Cal_Measure P_U8_4.Shared.Cal_Measure _element_of_base_folder_will_be_removed.Cal_Measure /end REF_CHARACTERISTIC
 /begin SUB_GROUP Shared.Cal_Measure /end SUB_GROUP
/end GROUP
/begin GROUP Cal_Measure_Block16 "" ROOT
 /begin REF_MEASUREMENT Index_x.Shared.Cal_Measure_Block16 Index_y.Shared.Cal_Measure_Block16 M_Uint16_matrix.Shared.Cal_Measure_Block16 v_Matrix1_u16_1.Shared.Cal_Measure_Block16 v_Matrix1_u16_2.Shared.Cal_Measure_Block16 v_Matrix1_u16_3.Shared.Cal_Measure_Block16 v_Matrix1_u16_4.Shared.Cal_Measure_Block16 v_Matrix1_u16_5.Shared.Cal_Measure_Block16 /end REF_MEASUREMENT
 /begin REF_CHARACTERISTIC P_Uint16_matrix_1.Shared.Cal_Measure_Block16 P_Uint16_matrix_2.Shared.Cal_Measure_Block16 P_Uint16_matrix_3.Shared.Cal_Measure_Block16 P_Uint16_matrix_4.Shared.Cal_Measure_Block16 P_Uint16_matrix_5.Shared.Cal_Measure_Block16 p_Index_x.Shared.Cal_Measure_Block16 p_Index_y.Shared.Cal_Measure_Block16 /end REF_CHARACTERISTIC
 /begin SUB_GROUP Shared.Cal_Measure_Block16 /end SUB_GROUP
/end GROUP
/begin GROUP Cal_Measure_Blocks "" ROOT
 /begin REF_MEASUREMENT Index_x.Cal_Measure_Blocks Index_y.Cal_Measure_Blocks M_Fl32_array.Cal_Measure_Blocks M_Fl32_matrix.Cal_Measure_Blocks M_Fl64_array.Cal_Measure_Blocks M_Fl64_matrix.Cal_Measure_Blocks M_Sint16_array.Cal_Measure_Blocks M_Sint16_matrix.Cal_Measure_Blocks M_Sint32_array.Cal_Measure_Blocks M_Sint32_matrix.Cal_Measure_Blocks M_Sint8_array.Cal_Measure_Blocks M_Sint8_matrix.Cal_Measure_Blocks M_Uint16_array.Cal_Measure_Blocks M_Uint16_matrix.Cal_Measure_Blocks M_Uint32_array.Cal_Measure_Blocks M_Uint32_matrix.Cal_Measure_Blocks M_Uint8_array.Cal_Measure_Blocks M_Uint8_matrix.Cal_Measure_Blocks /end REF_MEASUREMENT
 /begin REF_CHARACTERISTIC P_Fl32_array.Cal_Measure_Blocks P_Fl32_matrix.Cal_Measure_Blocks P_Fl64_array.Cal_Measure_Blocks P_Fl64_matrix.Cal_Measure_Blocks P_Sint16_array.Cal_Measure_Blocks P_Sint16_matrix.Cal_Measure_Blocks P_Sint32_array.Cal_Measure_Blocks P_Sint32_matrix.Cal_Measure_Blocks P_Sint8_array.Cal_Measure_Blocks P_Sint8_matrix.Cal_Measure_Blocks P_Uint16_array.Cal_Measure_Blocks P_Uint16_matrix.Cal_Measure_Blocks P_Uint32_array.Cal_Measure_Blocks P_Uint32_matrix.Cal_Measure_Blocks P_Uint8_array.Cal_Measure_Blocks P_Uint8_matrix.Cal_Measure_Blocks /end REF_CHARACTERISTIC
/end GROUP
/begin GROUP CanDriver "" ROOT
 /begin REF_MEASUREMENT B13_Mode.CanDriver B17_Mode.CanDriver B23_Mode.CanDriver B25_Mode.CanDriver B27_Mode.CanDriver B29_Mode.CanDriver B2_Mode.CanDriver B35_Mode.CanDriver B38_Mode.CanDriver B56_Mode.CanDriver B5_Mode.CanDriver B9_Mode.CanDriver CAN_Stat_Bx.CanDriver CAN_Status.CanDriver g_CanError_au8.CanDriver g_RingBufRead_u8.CanDriver g_RingBufWrite_u8.CanDriver g_Ringbuffer_au8.CanDriver g_fast_on_off_b.CanDriver /end REF_MEASUREMENT
 /begin REF_CHARACTERISTIC P_CAN_C_Buf.CanDriver P_CAN_C_IdTyp.CanDriver P_CAN_DataSwitch.CanDriver P_CAN_IDs.CanDriver P_CAN_IDs_fast.CanDriver P_CAN_Length.CanDriver P_CAN_Length_fast.CanDriver P_CAN_R01_Enable.CanDriver P_CAN_R02_Enable.CanDriver P_CAN_R03_Enable.CanDriver P_CAN_R04_Enable.CanDriver P_CAN_R05_Enable.CanDriver P_CAN_R06_Enable.CanDriver P_CAN_R07_Enable.CanDriver P_CAN_R08_Enable.CanDriver P_CAN_R09_Enable.CanDriver P_CAN_R10_Enable.CanDriver P_CAN_R11_Enable.CanDriver P_CAN_R12_Enable.CanDriver P_CAN_R13_Enable.CanDriver P_CAN_R14_Enable.CanDriver P_CAN_R15_Enable.CanDriver P_CAN_R16_Enable.CanDriver P_Reset_CAN_Err_Counter.CanDriver P_can_on_off.CanDriver P_extended_on_off.CanDriver P_fast_on_off.CanDriver P_standard_on_off.CanDriver /end REF_CHARACTERISTIC
/end GROUP
/begin GROUP Counter_R01_1.Counter_module_Mle "" /begin REF_MEASUREMENT V_counter_1.Counter_R01_1.Counter_module_Mle /end REF_MEASUREMENT /end GROUP
/begin GROUP Counter_module_Mle "" ROOT /begin REF_MEASUREMENT V_counter_1.Counter_R01_1.Counter_module_Mle /end REF_MEASUREMENT
 /begin REF_CHARACTERISTIC P_counter_1_delta.Counter_module_Mle P_counter_1_updown.Counter_module_Mle P_reset_counter.Counter_module_Mle /end REF_CHARACTERISTIC
 /begin SUB_GROUP Counter_R01_1.Counter_module_Mle /end SUB_GROUP
/end GROUP
/begin GROUP Curve_Calc_16.Curve_Module ""
 /begin REF_MEASUREMENT cell_nr.Curve_Calc_16.Curve_Module curve_out.Curve_Calc_16.Curve_Module input_array.Curve_Calc_16.Curve_Module /end REF_MEASUREMENT
 /begin REF_CHARACTERISTIC curve_table.Curve_Calc_16.Curve_Module nr_of_cells.Curve_Calc_16.Curve_Module /end REF_CHARACTERISTIC
/end GROUP
/begin GROUP Curve_Calc_32.Curve_Module ""
 /begin REF_MEASUREMENT cell_nr.Curve_Calc_32.Curve_Module curve_out.Curve_Calc_32.Curve_Module input_array.Curve_Calc_32.Curve_Module /end REF_MEASUREMENT
 /begin REF_CHARACTERISTIC curve_table.Curve_Calc_32.Curve_Module nr_of_cells.Curve_Calc_32.Curve_Module /end REF_CHARACTERISTIC
/end GROUP
/begin GROUP Curve_Calc_real32.Curve_Module ""
 /begin REF_MEASUREMENT cell_nr.Curve_Calc_real32.Curve_Module curve_out.Curve_Calc_real32.Curve_Module input_array.Curve_Calc_real32.Curve_Module /end REF_MEASUREMENT
 /begin REF_CHARACTERISTIC curve_table.Curve_Calc_real32.Curve_Module nr_of_cells.Curve_Calc_real32.Curve_Module /end REF_CHARACTERISTIC
/end GROUP
/begin GROUP Curve_Mod "" ROOT
 /begin REF_MEASUREMENT M_In_KL_Direct_fl32.Curve_Mod M_In_fl32_Distrib1.Curve_Mod M_In_fl32_Distrib2.Curve_Mod M_Out_KL1_Distr_fl32_Distrib1.Curve_Mod M_Out_KL2_Distr_fl32_Distrib1.Curve_Mod M_Out_KL3_Distr_fl32_Distrib2.Curve_Mod M_Out_KL_Direct_fl32.Curve_Mod /end REF_MEASUREMENT
 /begin REF_CHARACTERISTIC KL1_Distr_fl32_Distrib1.Curve_Mod KL2_Distr_fl32_Distrib1.Curve_Mod KL3_Distr_fl32_Distrib2.Curve_Mod KL_Direct_fl32.Curve_Mod P_In_KL_Direct_fl32.Curve_Mod P_In_fl32_Distrib1.Curve_Mod P_In_fl32_Distrib2.Curve_Mod /end REF_CHARACTERISTIC
/end GROUP
/begin GROUP Curve_Module "" ROOT
 /begin REF_MEASUREMENT Result.Time_Calc.Curve_Module TimeStampOne.Time_Calc.Curve_Module TimeStampTwo.Time_Calc.Curve_Module cell_nr.Curve_Calc_16.Curve_Module cell_nr.Curve_Calc_32.Curve_Module cell_nr.Curve_Calc_real32.Curve_Module curve_out.Curve_Calc_16.Curve_Module curve_out.Curve_Calc_32.Curve_Module curve_out.Curve_Calc_real32.Curve_Module input_array.Curve_Calc_16.Curve_Module input_array.Curve_Calc_32.Curve_Module input_array.Curve_Calc_real32.Curve_Module is_started.Time_Calc.Curve_Module loop_counter.Curve_Module testVariable.Curve_Module /end REF_MEASUREMENT
 /begin REF_CHARACTERISTIC PageSwitch_On.Curve_Module calc_loops_16.Curve_Module calc_loops_32.Curve_Module curve_table.Curve_Calc_16.Curve_Module curve_table.Curve_Calc_32.Curve_Module curve_table.Curve_Calc_real32.Curve_Module nr_of_cells.Curve_Calc_16.Curve_Module nr_of_cells.Curve_Calc_32.Curve_Module nr_of_cells.Curve_Calc_real32.Curve_Module testPara.Curve_Module /end REF_CHARACTERISTIC
 /begin SUB_GROUP Curve_Calc_16.Curve_Module Curve_Calc_32.Curve_Module Curve_Calc_real32.Curve_Module Time_Calc.Curve_Module /end SUB_GROUP
/end GROUP
/begin GROUP Curves_Raster_1 "" ROOT /begin REF_CHARACTERISTIC P_Do_Curves.Curves_Raster_1 /end REF_CHARACTERISTIC
 /begin SUB_GROUP All_Curves_FIX.Curves_Raster_1 All_Curves_GRP.Curves_Raster_1 All_Curves_STD.Curves_Raster_1 /end SUB_GROUP
/end GROUP
/begin GROUP Curves_Raster_2 "" ROOT /begin REF_CHARACTERISTIC P_Do_Curves.Curves_Raster_2 /end REF_CHARACTERISTIC
 /begin SUB_GROUP All_Curves_FIX.Curves_Raster_2 All_Curves_GRP.Curves_Raster_2 All_Curves_STD.Curves_Raster_2 /end SUB_GROUP
/end GROUP
/begin GROUP Curves_Raster_3 "" ROOT /begin REF_CHARACTERISTIC P_Do_Curves.Curves_Raster_3 /end REF_CHARACTERISTIC
 /begin SUB_GROUP All_Curves_FIX.Curves_Raster_3 All_Curves_GRP.Curves_Raster_3 All_Curves_STD.Curves_Raster_3 /end SUB_GROUP
/end GROUP
/begin GROUP DAQ2_Sample.CCP_SHELL "" /begin SUB_GROUP MIN_MAX_Tick2Time.DAQ2_Sample.CCP_SHELL /end SUB_GROUP /end GROUP
/begin GROUP DAQ2_Tx.CCP_SHELL "" /begin SUB_GROUP Time.DAQ2_Tx.CCP_SHELL TimeSum.DAQ2_Tx.CCP_SHELL /end SUB_GROUP /end GROUP
/begin GROUP DiagKwpUds "" ROOT
 /begin REF_MEASUREMENT Anzahl.StatisticValuesECU_V100.DiagP3MasterDownload.DiagKwpUds Anzahl.StatisticValuesECU_V100.DiagSTminDownloadCF1CF2.DiagKwpUds Anzahl.StatisticValuesECU_V100.DiagSTminDownloadCF2CF3.DiagKwpUds Max.MIN_MAX_Tick2Time.DiagP3MasterDownload.DiagKwpUds Max.MIN_MAX_Tick2Time.DiagSTminDownloadCF1CF2.DiagKwpUds Max.MIN_MAX_Tick2Time.DiagSTminDownloadCF2CF3.DiagKwpUds Min.MIN_MAX_Tick2Time.DiagP3MasterDownload.DiagKwpUds Min.MIN_MAX_Tick2Time.DiagSTminDownloadCF1CF2.DiagKwpUds Min.MIN_MAX_Tick2Time.DiagSTminDownloadCF2CF3.DiagKwpUds Mittelwert.StatisticValuesECU_V100.DiagP3MasterDownload.DiagKwpUds Mittelwert.StatisticValuesECU_V100.DiagSTminDownloadCF1CF2.DiagKwpUds Mittelwert.StatisticValuesECU_V100.DiagSTminDownloadCF2CF3.DiagKwpUds Summe.StatisticValuesECU_V100.DiagP3MasterDownload.DiagKwpUds Summe.StatisticValuesECU_V100.DiagSTminDownloadCF1CF2.DiagKwpUds Summe.StatisticValuesECU_V100.DiagSTminDownloadCF2CF3.DiagKwpUds SummeQuad.StatisticValuesECU_V100.DiagP3MasterDownload.DiagKwpUds SummeQuad.StatisticValuesECU_V100.DiagSTminDownloadCF1CF2.DiagKwpUds SummeQuad.StatisticValuesECU_V100.DiagSTminDownloadCF2CF3.DiagKwpUds Time.MIN_MAX_Tick2Time.DiagP3MasterDownload.DiagKwpUds Time.MIN_MAX_Tick2Time.DiagSTminDownloadCF1CF2.DiagKwpUds Time.MIN_MAX_Tick2Time.DiagSTminDownloadCF2CF3.DiagKwpUds Var.StatisticValuesECU_V100.DiagP3MasterDownload.DiagKwpUds Var.StatisticValuesECU_V100.DiagSTminDownloadCF1CF2.DiagKwpUds Var.StatisticValuesECU_V100.DiagSTminDownloadCF2CF3.DiagKwpUds g_DiagBSmax_u8.DiagKwpUds g_DiagErrorPrescaler_u8_unused.DiagKwpUds g_DiagMeasureMode_u8.DiagKwpUds g_DiagNumError_u8.DiagKwpUds g_DiagProtocol_u8.DiagKwpUds g_DiagSTmin_u8.DiagKwpUds g_DiagTriggerError_u8.DiagKwpUds g_DiagXDLmax_u16.DiagKwpUds i_0x21_rdbli_kwp_u32.C_ClassDiagCounter.DiagKwpUds i_0x22_rdbli_uds_u32.C_ClassDiagCounter.DiagKwpUds i_0x23_rmba_u32.C_ClassDiagCounter.DiagKwpUds i_ActBdRate_u32.C_ClassDiagInfo.DiagKwpUds i_ComMedium_u8.C_ClassDiagInfo.DiagKwpUds i_ComProtocol_u8.C_ClassDiagInfo.DiagKwpUds i_DiaMode_u8.C_ClassDiagInfo.DiagKwpUds i_P2max_u32.C_ClassDiagInfo.DiagKwpUds i_P2min_u32.C_ClassDiagInfo.DiagKwpUds i_P3max_u32.C_ClassDiagInfo.DiagKwpUds i_P3min_u32.C_ClassDiagInfo.DiagKwpUds i_P4min_u32.C_ClassDiagInfo.DiagKwpUds i_PhysEcuAddr_u8.C_ClassDiagInfo.DiagKwpUds i_ReqBdRate_u32.C_ClassDiagInfo.DiagKwpUds i_SecLevel_u8.C_ClassDiagInfo.DiagKwpUds i_StimuAddrMode_u8.C_ClassDiagInfo.DiagKwpUds i_StimuAddr_u8.C_ClassDiagInfo.DiagKwpUds l_ResetTimer_b.DiagP3MasterDownload.DiagKwpUds l_ResetTimer_b.DiagSTminDownloadCF1CF2.DiagKwpUds l_ResetTimer_b.DiagSTminDownloadCF2CF3.DiagKwpUds l_StartTicks_u32.DiagP3MasterDownload.DiagKwpUds l_StartTicks_u32.DiagSTminDownloadCF1CF2.DiagKwpUds l_StartTicks_u32.DiagSTminDownloadCF2CF3.DiagKwpUds l_StopTicks_u32.DiagP3MasterDownload.DiagKwpUds l_StopTicks_u32.DiagSTminDownloadCF1CF2.DiagKwpUds l_StopTicks_u32.DiagSTminDownloadCF2CF3.DiagKwpUds l_Timeout_b.DiagP3MasterDownload.DiagKwpUds l_Timeout_b.DiagSTminDownloadCF1CF2.DiagKwpUds l_Timeout_b.DiagSTminDownloadCF2CF3.DiagKwpUds /end REF_MEASUREMENT
 /begin REF_CHARACTERISTIC p_DefaultDiagProtocol_u8.DiagKwpUds p_DiagBSmax_u8.DiagKwpUds p_DiagErrorPrescaler_u8.DiagKwpUds p_DiagErrorSID_u8.DiagKwpUds p_DiagGenNumByteRespError_u8.DiagKwpUds p_DiagInfoSetGet_u8.DiagKwpUds p_DiagNumError_u8.DiagKwpUds p_DiagRespCode_u8.DiagKwpUds p_DiagResponce_u8.DiagKwpUds p_DiagSTmin_u8.DiagKwpUds p_DiagTriggerError_u8.DiagKwpUds p_ResetCounter_u8.C_ClassDiagCounter.DiagKwpUds p_ResetTimer_b.DiagP3MasterDownload.DiagKwpUds p_ResetTimer_b.DiagSTminDownloadCF1CF2.DiagKwpUds p_ResetTimer_b.DiagSTminDownloadCF2CF3.DiagKwpUds pi_ActBdRate_u32.C_ClassDiagInfo.DiagKwpUds pi_ComMedium_u8.C_ClassDiagInfo.DiagKwpUds pi_ComProtocol_u8.C_ClassDiagInfo.DiagKwpUds pi_DiaMode_u8.C_ClassDiagInfo.DiagKwpUds pi_P2max_u32.C_ClassDiagInfo.DiagKwpUds pi_P2min_u32.C_ClassDiagInfo.DiagKwpUds pi_P3max_u32.C_ClassDiagInfo.DiagKwpUds pi_P3min_u32.C_ClassDiagInfo.DiagKwpUds pi_P4min_u32.C_ClassDiagInfo.DiagKwpUds pi_PhysEcuAddr_u8.C_ClassDiagInfo.DiagKwpUds pi_ReqBdRate_u32.C_ClassDiagInfo.DiagKwpUds pi_SecLevel_u8.C_ClassDiagInfo.DiagKwpUds pi_StimuAddrMode_u8.C_ClassDiagInfo.DiagKwpUds pi_StimuAddr_u8.C_ClassDiagInfo.DiagKwpUds /end REF_CHARACTERISTIC
 /begin SUB_GROUP C_ClassDiagCounter.DiagKwpUds C_ClassDiagInfo.DiagKwpUds DiagP3MasterDownload.DiagKwpUds DiagSTminDownloadCF1CF2.DiagKwpUds DiagSTminDownloadCF2CF3.DiagKwpUds /end SUB_GROUP
/end GROUP
/begin GROUP DiagP3MasterDownload.DiagKwpUds ""
 /begin REF_MEASUREMENT Anzahl.StatisticValuesECU_V100.DiagP3MasterDownload.DiagKwpUds Max.MIN_MAX_Tick2Time.DiagP3MasterDownload.DiagKwpUds Min.MIN_MAX_Tick2Time.DiagP3MasterDownload.DiagKwpUds Mittelwert.StatisticValuesECU_V100.DiagP3MasterDownload.DiagKwpUds Summe.StatisticValuesECU_V100.DiagP3MasterDownload.DiagKwpUds SummeQuad.StatisticValuesECU_V100.DiagP3MasterDownload.DiagKwpUds Time.MIN_MAX_Tick2Time.DiagP3MasterDownload.DiagKwpUds Var.StatisticValuesECU_V100.DiagP3MasterDownload.DiagKwpUds l_ResetTimer_b.DiagP3MasterDownload.DiagKwpUds l_StartTicks_u32.DiagP3MasterDownload.DiagKwpUds l_StopTicks_u32.DiagP3MasterDownload.DiagKwpUds l_Timeout_b.DiagP3MasterDownload.DiagKwpUds /end REF_MEASUREMENT
 /begin REF_CHARACTERISTIC p_ResetTimer_b.DiagP3MasterDownload.DiagKwpUds /end REF_CHARACTERISTIC
 /begin SUB_GROUP MIN_MAX_Tick2Time.DiagP3MasterDownload.DiagKwpUds StatisticValuesECU_V100.DiagP3MasterDownload.DiagKwpUds /end SUB_GROUP
/end GROUP
/begin GROUP DiagSTminDownloadCF1CF2.DiagKwpUds ""
 /begin REF_MEASUREMENT Anzahl.StatisticValuesECU_V100.DiagSTminDownloadCF1CF2.DiagKwpUds Max.MIN_MAX_Tick2Time.DiagSTminDownloadCF1CF2.DiagKwpUds Min.MIN_MAX_Tick2Time.DiagSTminDownloadCF1CF2.DiagKwpUds Mittelwert.StatisticValuesECU_V100.DiagSTminDownloadCF1CF2.DiagKwpUds Summe.StatisticValuesECU_V100.DiagSTminDownloadCF1CF2.DiagKwpUds SummeQuad.StatisticValuesECU_V100.DiagSTminDownloadCF1CF2.DiagKwpUds Time.MIN_MAX_Tick2Time.DiagSTminDownloadCF1CF2.DiagKwpUds Var.StatisticValuesECU_V100.DiagSTminDownloadCF1CF2.DiagKwpUds l_ResetTimer_b.DiagSTminDownloadCF1CF2.DiagKwpUds l_StartTicks_u32.DiagSTminDownloadCF1CF2.DiagKwpUds l_StopTicks_u32.DiagSTminDownloadCF1CF2.DiagKwpUds l_Timeout_b.DiagSTminDownloadCF1CF2.DiagKwpUds /end REF_MEASUREMENT
 /begin REF_CHARACTERISTIC p_ResetTimer_b.DiagSTminDownloadCF1CF2.DiagKwpUds /end REF_CHARACTERISTIC
 /begin SUB_GROUP MIN_MAX_Tick2Time.DiagSTminDownloadCF1CF2.DiagKwpUds StatisticValuesECU_V100.DiagSTminDownloadCF1CF2.DiagKwpUds /end SUB_GROUP
/end GROUP
/begin GROUP DiagSTminDownloadCF2CF3.DiagKwpUds ""
 /begin REF_MEASUREMENT Anzahl.StatisticValuesECU_V100.DiagSTminDownloadCF2CF3.DiagKwpUds Max.MIN_MAX_Tick2Time.DiagSTminDownloadCF2CF3.DiagKwpUds Min.MIN_MAX_Tick2Time.DiagSTminDownloadCF2CF3.DiagKwpUds Mittelwert.StatisticValuesECU_V100.DiagSTminDownloadCF2CF3.DiagKwpUds Summe.StatisticValuesECU_V100.DiagSTminDownloadCF2CF3.DiagKwpUds SummeQuad.StatisticValuesECU_V100.DiagSTminDownloadCF2CF3.DiagKwpUds Time.MIN_MAX_Tick2Time.DiagSTminDownloadCF2CF3.DiagKwpUds Var.StatisticValuesECU_V100.DiagSTminDownloadCF2CF3.DiagKwpUds l_ResetTimer_b.DiagSTminDownloadCF2CF3.DiagKwpUds l_StartTicks_u32.DiagSTminDownloadCF2CF3.DiagKwpUds l_StopTicks_u32.DiagSTminDownloadCF2CF3.DiagKwpUds l_Timeout_b.DiagSTminDownloadCF2CF3.DiagKwpUds /end REF_MEASUREMENT
 /begin REF_CHARACTERISTIC p_ResetTimer_b.DiagSTminDownloadCF2CF3.DiagKwpUds /end REF_CHARACTERISTIC
 /begin SUB_GROUP MIN_MAX_Tick2Time.DiagSTminDownloadCF2CF3.DiagKwpUds StatisticValuesECU_V100.DiagSTminDownloadCF2CF3.DiagKwpUds /end SUB_GROUP
/end GROUP
/begin GROUP DifferentByteOrder "" ROOT
 /begin REF_MEASUREMENT g_MsbFirstMotorolaByteOrderCounter_R03_u32.DifferentByteOrder g_MsbFirstMswLastOrderCounter_R03_u32.DifferentByteOrder g_MsbLastIntelByteOrderCounter_R03_u32.DifferentByteOrder g_MsbLastMswFirstOrderCounter_R03_u32.DifferentByteOrder g_TestVarMsbFirstMotorolaByteOrder_0x87654321_u32.DifferentByteOrder g_TestVarMsbFirstMswLastByteOrder_0x43218765_u32.DifferentByteOrder g_TestVarMsbLastIntelByteOrder_0x21436587_u32.DifferentByteOrder g_TestVarMsbLastMswFirstByteOrder_0x65872143_u32.DifferentByteOrder /end REF_MEASUREMENT
 /begin REF_CHARACTERISTIC p_TestVarMsbFirstMotorolaByteOrder_0x87654321_u32.DifferentByteOrder p_TestVarMsbFirstMswLastByteOrder_0x43218765_u32.DifferentByteOrder p_TestVarMsbLastIntelByteOrder_0x21436587_u32.DifferentByteOrder p_TestVarMsbLastMswFirstByteOrder_0x65872143_u32.DifferentByteOrder /end REF_CHARACTERISTIC
/end GROUP
/begin GROUP Dist_B01.Distab13_12T ""
 /begin REF_MEASUREMENT Active.Dist_B01.Distab13_12T Counter.Dist_B01.Distab13_12T Max.Distab.Dist_B01.Distab13_12T Max.Roundtrip.Dist_B01.Distab13_12T Min.Distab.Dist_B01.Distab13_12T Min.Roundtrip.Dist_B01.Distab13_12T NrBytes_Total.Dist_B01.Distab13_12T NrVar_1Byte.Dist_B01.Distab13_12T NrVar_2Byte.Dist_B01.Distab13_12T NrVar_4Byte.Dist_B01.Distab13_12T NrVar_8Byte.Dist_B01.Distab13_12T Result.Dist_B01.Distab13_12T Time.Distab.Dist_B01.Distab13_12T Time.Roundtrip.Dist_B01.Distab13_12T Timeout_RoundTrip.Dist_B01.Distab13_12T /end REF_MEASUREMENT
 /begin REF_CHARACTERISTIC P_Enable.Dist_B01.Distab13_12T P_TRGID_Nr.Dist_B01.Distab13_12T P_TRGID_Val.Dist_B01.Distab13_12T P_TRG_Direct.Dist_B01.Distab13_12T P_TRG_Nr.Dist_B01.Distab13_12T P_TRG_Val.Dist_B01.Distab13_12T /end REF_CHARACTERISTIC
 /begin SUB_GROUP Distab.Dist_B01.Distab13_12T Roundtrip.Dist_B01.Distab13_12T /end SUB_GROUP
/end GROUP
/begin GROUP Dist_B02.Distab13_12T ""
 /begin REF_MEASUREMENT Active.Dist_B02.Distab13_12T Counter.Dist_B02.Distab13_12T Max.Distab.Dist_B02.Distab13_12T Max.Roundtrip.Dist_B02.Distab13_12T Min.Distab.Dist_B02.Distab13_12T Min.Roundtrip.Dist_B02.Distab13_12T NrBytes_Total.Dist_B02.Distab13_12T NrVar_1Byte.Dist_B02.Distab13_12T NrVar_2Byte.Dist_B02.Distab13_12T NrVar_4Byte.Dist_B02.Distab13_12T NrVar_8Byte.Dist_B02.Distab13_12T Result.Dist_B02.Distab13_12T Time.Distab.Dist_B02.Distab13_12T Time.Roundtrip.Dist_B02.Distab13_12T Timeout_RoundTrip.Dist_B02.Distab13_12T /end REF_MEASUREMENT
 /begin REF_CHARACTERISTIC P_Enable.Dist_B02.Distab13_12T P_TRGID_Nr.Dist_B02.Distab13_12T P_TRGID_Val.Dist_B02.Distab13_12T P_TRG_Direct.Dist_B02.Distab13_12T P_TRG_Nr.Dist_B02.Distab13_12T P_TRG_Val.Dist_B02.Distab13_12T /end REF_CHARACTERISTIC
 /begin SUB_GROUP Distab.Dist_B02.Distab13_12T Roundtrip.Dist_B02.Distab13_12T /end SUB_GROUP
/end GROUP
/begin GROUP Dist_B03.Distab13_12T ""
 /begin REF_MEASUREMENT Active.Dist_B03.Distab13_12T Counter.Dist_B03.Distab13_12T Max.Distab.Dist_B03.Distab13_12T Max.Roundtrip.Dist_B03.Distab13_12T Min.Distab.Dist_B03.Distab13_12T Min.Roundtrip.Dist_B03.Distab13_12T NrBytes_Total.Dist_B03.Distab13_12T NrVar_1Byte.Dist_B03.Distab13_12T NrVar_2Byte.Dist_B03.Distab13_12T NrVar_4Byte.Dist_B03.Distab13_12T NrVar_8Byte.Dist_B03.Distab13_12T Result.Dist_B03.Distab13_12T Time.Distab.Dist_B03.Distab13_12T Time.Roundtrip.Dist_B03.Distab13_12T Timeout_RoundTrip.Dist_B03.Distab13_12T /end REF_MEASUREMENT
 /begin REF_CHARACTERISTIC P_Enable.Dist_B03.Distab13_12T P_TRGID_Nr.Dist_B03.Distab13_12T P_TRGID_Val.Dist_B03.Distab13_12T P_TRG_Direct.Dist_B03.Distab13_12T P_TRG_Nr.Dist_B03.Distab13_12T P_TRG_Val.Dist_B03.Distab13_12T /end REF_CHARACTERISTIC
 /begin SUB_GROUP Distab.Dist_B03.Distab13_12T Roundtrip.Dist_B03.Distab13_12T /end SUB_GROUP
/end GROUP
/begin GROUP Dist_B04.Distab13_12T ""
 /begin REF_MEASUREMENT Active.Dist_B04.Distab13_12T Counter.Dist_B04.Distab13_12T Max.Distab.Dist_B04.Distab13_12T Max.Roundtrip.Dist_B04.Distab13_12T Min.Distab.Dist_B04.Distab13_12T Min.Roundtrip.Dist_B04.Distab13_12T NrBytes_Total.Dist_B04.Distab13_12T NrVar_1Byte.Dist_B04.Distab13_12T NrVar_2Byte.Dist_B04.Distab13_12T NrVar_4Byte.Dist_B04.Distab13_12T NrVar_8Byte.Dist_B04.Distab13_12T Result.Dist_B04.Distab13_12T Time.Distab.Dist_B04.Distab13_12T Time.Roundtrip.Dist_B04.Distab13_12T Timeout_RoundTrip.Dist_B04.Distab13_12T /end REF_MEASUREMENT
 /begin REF_CHARACTERISTIC P_Enable.Dist_B04.Distab13_12T P_TRGID_Nr.Dist_B04.Distab13_12T P_TRGID_Val.Dist_B04.Distab13_12T P_TRG_Direct.Dist_B04.Distab13_12T P_TRG_Nr.Dist_B04.Distab13_12T P_TRG_Val.Dist_B04.Distab13_12T /end REF_CHARACTERISTIC
 /begin SUB_GROUP Distab.Dist_B04.Distab13_12T Roundtrip.Dist_B04.Distab13_12T /end SUB_GROUP
/end GROUP
/begin GROUP Dist_R01.Distab13_12T ""
 /begin REF_MEASUREMENT Active.Dist_R01.Distab13_12T NrBytes_Total.Dist_R01.Distab13_12T NrVar_1Byte.Dist_R01.Distab13_12T NrVar_2Byte.Dist_R01.Distab13_12T NrVar_4Byte.Dist_R01.Distab13_12T NrVar_8Byte.Dist_R01.Distab13_12T Result.Dist_R01.Distab13_12T /end REF_MEASUREMENT
 /begin REF_CHARACTERISTIC P_Enable.Dist_R01.Distab13_12T P_TRGID_Nr.Dist_R01.Distab13_12T P_TRGID_Val.Dist_R01.Distab13_12T P_TRG_Direct.Dist_R01.Distab13_12T P_TRG_Nr.Dist_R01.Distab13_12T P_TRG_Val.Dist_R01.Distab13_12T /end REF_CHARACTERISTIC
/end GROUP
/begin GROUP Dist_R02.Distab13_12T ""
 /begin REF_MEASUREMENT Active.Dist_R02.Distab13_12T NrBytes_Total.Dist_R02.Distab13_12T NrVar_1Byte.Dist_R02.Distab13_12T NrVar_2Byte.Dist_R02.Distab13_12T NrVar_4Byte.Dist_R02.Distab13_12T NrVar_8Byte.Dist_R02.Distab13_12T Result.Dist_R02.Distab13_12T /end REF_MEASUREMENT
 /begin REF_CHARACTERISTIC P_Enable.Dist_R02.Distab13_12T P_TRGID_Nr.Dist_R02.Distab13_12T P_TRGID_Val.Dist_R02.Distab13_12T P_TRG_Direct.Dist_R02.Distab13_12T P_TRG_Nr.Dist_R02.Distab13_12T P_TRG_Val.Dist_R02.Distab13_12T /end REF_CHARACTERISTIC
/end GROUP
/begin GROUP Dist_R03.Distab13_12T ""
 /begin REF_MEASUREMENT Active.Dist_R03.Distab13_12T NrBytes_Total.Dist_R03.Distab13_12T NrVar_1Byte.Dist_R03.Distab13_12T NrVar_2Byte.Dist_R03.Distab13_12T NrVar_4Byte.Dist_R03.Distab13_12T NrVar_8Byte.Dist_R03.Distab13_12T Result.Dist_R03.Distab13_12T /end REF_MEASUREMENT
 /begin REF_CHARACTERISTIC P_Enable.Dist_R03.Distab13_12T P_TRGID_Nr.Dist_R03.Distab13_12T P_TRGID_Val.Dist_R03.Distab13_12T P_TRG_Direct.Dist_R03.Distab13_12T P_TRG_Nr.Dist_R03.Distab13_12T P_TRG_Val.Dist_R03.Distab13_12T /end REF_CHARACTERISTIC
/end GROUP
/begin GROUP Dist_R04.Distab13_12T ""
 /begin REF_MEASUREMENT Active.Dist_R04.Distab13_12T NrBytes_Total.Dist_R04.Distab13_12T NrVar_1Byte.Dist_R04.Distab13_12T NrVar_2Byte.Dist_R04.Distab13_12T NrVar_4Byte.Dist_R04.Distab13_12T NrVar_8Byte.Dist_R04.Distab13_12T Result.Dist_R04.Distab13_12T /end REF_MEASUREMENT
 /begin REF_CHARACTERISTIC P_Enable.Dist_R04.Distab13_12T P_TRGID_Nr.Dist_R04.Distab13_12T P_TRGID_Val.Dist_R04.Distab13_12T P_TRG_Direct.Dist_R04.Distab13_12T P_TRG_Nr.Dist_R04.Distab13_12T P_TRG_Val.Dist_R04.Distab13_12T /end REF_CHARACTERISTIC
/end GROUP
/begin GROUP Dist_R05.Distab13_12T ""
 /begin REF_MEASUREMENT Active.Dist_R05.Distab13_12T NrBytes_Total.Dist_R05.Distab13_12T NrVar_1Byte.Dist_R05.Distab13_12T NrVar_2Byte.Dist_R05.Distab13_12T NrVar_4Byte.Dist_R05.Distab13_12T NrVar_8Byte.Dist_R05.Distab13_12T Result.Dist_R05.Distab13_12T /end REF_MEASUREMENT
 /begin REF_CHARACTERISTIC P_Enable.Dist_R05.Distab13_12T P_TRGID_Nr.Dist_R05.Distab13_12T P_TRGID_Val.Dist_R05.Distab13_12T P_TRG_Direct.Dist_R05.Distab13_12T P_TRG_Nr.Dist_R05.Distab13_12T P_TRG_Val.Dist_R05.Distab13_12T /end REF_CHARACTERISTIC
/end GROUP
/begin GROUP Dist_R06.Distab13_12T ""
 /begin REF_MEASUREMENT Active.Dist_R06.Distab13_12T NrBytes_Total.Dist_R06.Distab13_12T NrVar_1Byte.Dist_R06.Distab13_12T NrVar_2Byte.Dist_R06.Distab13_12T NrVar_4Byte.Dist_R06.Distab13_12T NrVar_8Byte.Dist_R06.Distab13_12T Result.Dist_R06.Distab13_12T /end REF_MEASUREMENT
 /begin REF_CHARACTERISTIC P_Enable.Dist_R06.Distab13_12T P_TRGID_Nr.Dist_R06.Distab13_12T P_TRGID_Val.Dist_R06.Distab13_12T P_TRG_Direct.Dist_R06.Distab13_12T P_TRG_Nr.Dist_R06.Distab13_12T P_TRG_Val.Dist_R06.Distab13_12T /end REF_CHARACTERISTIC
/end GROUP
/begin GROUP Dist_R07.Distab13_12T ""
 /begin REF_MEASUREMENT Active.Dist_R07.Distab13_12T NrBytes_Total.Dist_R07.Distab13_12T NrVar_1Byte.Dist_R07.Distab13_12T NrVar_2Byte.Dist_R07.Distab13_12T NrVar_4Byte.Dist_R07.Distab13_12T NrVar_8Byte.Dist_R07.Distab13_12T Result.Dist_R07.Distab13_12T /end REF_MEASUREMENT
 /begin REF_CHARACTERISTIC P_Enable.Dist_R07.Distab13_12T P_TRGID_Nr.Dist_R07.Distab13_12T P_TRGID_Val.Dist_R07.Distab13_12T P_TRG_Direct.Dist_R07.Distab13_12T P_TRG_Nr.Dist_R07.Distab13_12T P_TRG_Val.Dist_R07.Distab13_12T /end REF_CHARACTERISTIC
/end GROUP
/begin GROUP Dist_R08.Distab13_12T ""
 /begin REF_MEASUREMENT Active.Dist_R08.Distab13_12T NrBytes_Total.Dist_R08.Distab13_12T NrVar_1Byte.Dist_R08.Distab13_12T NrVar_2Byte.Dist_R08.Distab13_12T NrVar_4Byte.Dist_R08.Distab13_12T NrVar_8Byte.Dist_R08.Distab13_12T Result.Dist_R08.Distab13_12T /end REF_MEASUREMENT
 /begin REF_CHARACTERISTIC P_Enable.Dist_R08.Distab13_12T P_TRGID_Nr.Dist_R08.Distab13_12T P_TRGID_Val.Dist_R08.Distab13_12T P_TRG_Direct.Dist_R08.Distab13_12T P_TRG_Nr.Dist_R08.Distab13_12T P_TRG_Val.Dist_R08.Distab13_12T /end REF_CHARACTERISTIC
/end GROUP
/begin GROUP Dist_R09.Distab13_12T ""
 /begin REF_MEASUREMENT Active.Dist_R09.Distab13_12T NrBytes_Total.Dist_R09.Distab13_12T NrVar_1Byte.Dist_R09.Distab13_12T NrVar_2Byte.Dist_R09.Distab13_12T NrVar_4Byte.Dist_R09.Distab13_12T NrVar_8Byte.Dist_R09.Distab13_12T Result.Dist_R09.Distab13_12T /end REF_MEASUREMENT
 /begin REF_CHARACTERISTIC P_Enable.Dist_R09.Distab13_12T P_TRGID_Nr.Dist_R09.Distab13_12T P_TRGID_Val.Dist_R09.Distab13_12T P_TRG_Direct.Dist_R09.Distab13_12T P_TRG_Nr.Dist_R09.Distab13_12T P_TRG_Val.Dist_R09.Distab13_12T /end REF_CHARACTERISTIC
/end GROUP
/begin GROUP Dist_R10.Distab13_12T ""
 /begin REF_MEASUREMENT Active.Dist_R10.Distab13_12T NrBytes_Total.Dist_R10.Distab13_12T NrVar_1Byte.Dist_R10.Distab13_12T NrVar_2Byte.Dist_R10.Distab13_12T NrVar_4Byte.Dist_R10.Distab13_12T NrVar_8Byte.Dist_R10.Distab13_12T Result.Dist_R10.Distab13_12T /end REF_MEASUREMENT
 /begin REF_CHARACTERISTIC P_Enable.Dist_R10.Distab13_12T P_TRGID_Nr.Dist_R10.Distab13_12T P_TRGID_Val.Dist_R10.Distab13_12T P_TRG_Direct.Dist_R10.Distab13_12T P_TRG_Nr.Dist_R10.Distab13_12T P_TRG_Val.Dist_R10.Distab13_12T /end REF_CHARACTERISTIC
/end GROUP
/begin GROUP Dist_R11.Distab13_12T ""
 /begin REF_MEASUREMENT Active.Dist_R11.Distab13_12T NrBytes_Total.Dist_R11.Distab13_12T NrVar_1Byte.Dist_R11.Distab13_12T NrVar_2Byte.Dist_R11.Distab13_12T NrVar_4Byte.Dist_R11.Distab13_12T NrVar_8Byte.Dist_R11.Distab13_12T Result.Dist_R11.Distab13_12T /end REF_MEASUREMENT
 /begin REF_CHARACTERISTIC P_Enable.Dist_R11.Distab13_12T P_TRGID_Nr.Dist_R11.Distab13_12T P_TRGID_Val.Dist_R11.Distab13_12T P_TRG_Direct.Dist_R11.Distab13_12T P_TRG_Nr.Dist_R11.Distab13_12T P_TRG_Val.Dist_R11.Distab13_12T /end REF_CHARACTERISTIC
/end GROUP
/begin GROUP Dist_R12.Distab13_12T ""
 /begin REF_MEASUREMENT Active.Dist_R12.Distab13_12T NrBytes_Total.Dist_R12.Distab13_12T NrVar_1Byte.Dist_R12.Distab13_12T NrVar_2Byte.Dist_R12.Distab13_12T NrVar_4Byte.Dist_R12.Distab13_12T NrVar_8Byte.Dist_R12.Distab13_12T Result.Dist_R12.Distab13_12T /end REF_MEASUREMENT
 /begin REF_CHARACTERISTIC P_Enable.Dist_R12.Distab13_12T P_TRGID_Nr.Dist_R12.Distab13_12T P_TRGID_Val.Dist_R12.Distab13_12T P_TRG_Direct.Dist_R12.Distab13_12T P_TRG_Nr.Dist_R12.Distab13_12T P_TRG_Val.Dist_R12.Distab13_12T /end REF_CHARACTERISTIC
/end GROUP
/begin GROUP Distab.Dist_B01.Distab13_12T ""
 /begin REF_MEASUREMENT Max.Distab.Dist_B01.Distab13_12T Min.Distab.Dist_B01.Distab13_12T Time.Distab.Dist_B01.Distab13_12T /end REF_MEASUREMENT
/end GROUP
/begin GROUP Distab.Dist_B02.Distab13_12T ""
 /begin REF_MEASUREMENT Max.Distab.Dist_B02.Distab13_12T Min.Distab.Dist_B02.Distab13_12T Time.Distab.Dist_B02.Distab13_12T /end REF_MEASUREMENT
/end GROUP
/begin GROUP Distab.Dist_B03.Distab13_12T ""
 /begin REF_MEASUREMENT Max.Distab.Dist_B03.Distab13_12T Min.Distab.Dist_B03.Distab13_12T Time.Distab.Dist_B03.Distab13_12T /end REF_MEASUREMENT
/end GROUP
/begin GROUP Distab.Dist_B04.Distab13_12T ""
 /begin REF_MEASUREMENT Max.Distab.Dist_B04.Distab13_12T Min.Distab.Dist_B04.Distab13_12T Time.Distab.Dist_B04.Distab13_12T /end REF_MEASUREMENT
/end GROUP
/begin GROUP Distab13_12T "" ROOT
 /begin REF_MEASUREMENT Active.Dist_B01.Distab13_12T Active.Dist_B02.Distab13_12T Active.Dist_B03.Distab13_12T Active.Dist_B04.Distab13_12T Active.Dist_R01.Distab13_12T Active.Dist_R02.Distab13_12T Active.Dist_R03.Distab13_12T Active.Dist_R04.Distab13_12T Active.Dist_R05.Distab13_12T Active.Dist_R06.Distab13_12T Active.Dist_R07.Distab13_12T Active.Dist_R08.Distab13_12T Active.Dist_R09.Distab13_12T Active.Dist_R10.Distab13_12T Active.Dist_R11.Distab13_12T Active.Dist_R12.Distab13_12T Counter.Dist_B01.Distab13_12T Counter.Dist_B02.Distab13_12T Counter.Dist_B03.Distab13_12T Counter.Dist_B04.Distab13_12T Max.Distab.Dist_B01.Distab13_12T Max.Distab.Dist_B02.Distab13_12T Max.Distab.Dist_B03.Distab13_12T Max.Distab.Dist_B04.Distab13_12T Max.Roundtrip.Dist_B01.Distab13_12T Max.Roundtrip.Dist_B02.Distab13_12T Max.Roundtrip.Dist_B03.Distab13_12T Max.Roundtrip.Dist_B04.Distab13_12T Min.Distab.Dist_B01.Distab13_12T Min.Distab.Dist_B02.Distab13_12T Min.Distab.Dist_B03.Distab13_12T Min.Distab.Dist_B04.Distab13_12T Min.Roundtrip.Dist_B01.Distab13_12T Min.Roundtrip.Dist_B02.Distab13_12T Min.Roundtrip.Dist_B03.Distab13_12T Min.Roundtrip.Dist_B04.Distab13_12T NrBytes_Total.Dist_B01.Distab13_12T NrBytes_Total.Dist_B02.Distab13_12T NrBytes_Total.Dist_B03.Distab13_12T NrBytes_Total.Dist_B04.Distab13_12T NrBytes_Total.Dist_R01.Distab13_12T NrBytes_Total.Dist_R02.Distab13_12T NrBytes_Total.Dist_R03.Distab13_12T NrBytes_Total.Dist_R04.Distab13_12T NrBytes_Total.Dist_R05.Distab13_12T NrBytes_Total.Dist_R06.Distab13_12T NrBytes_Total.Dist_R07.Distab13_12T NrBytes_Total.Dist_R08.Distab13_12T NrBytes_Total.Dist_R09.Distab13_12T NrBytes_Total.Dist_R10.Distab13_12T NrBytes_Total.Dist_R11.Distab13_12T NrBytes_Total.Dist_R12.Distab13_12T NrVar_1Byte.Dist_B01.Distab13_12T NrVar_1Byte.Dist_B02.Distab13_12T NrVar_1Byte.Dist_B03.Distab13_12T NrVar_1Byte.Dist_B04.Distab13_12T NrVar_1Byte.Dist_R01.Distab13_12T NrVar_1Byte.Dist_R02.Distab13_12T NrVar_1Byte.Dist_R03.Distab13_12T NrVar_1Byte.Dist_R04.Distab13_12T NrVar_1Byte.Dist_R05.Distab13_12T NrVar_1Byte.Dist_R06.Distab13_12T NrVar_1Byte.Dist_R07.Distab13_12T NrVar_1Byte.Dist_R08.Distab13_12T NrVar_1Byte.Dist_R09.Distab13_12T NrVar_1Byte.Dist_R10.Distab13_12T NrVar_1Byte.Dist_R11.Distab13_12T NrVar_1Byte.Dist_R12.Distab13_12T NrVar_2Byte.Dist_B01.Distab13_12T NrVar_2Byte.Dist_B02.Distab13_12T NrVar_2Byte.Dist_B03.Distab13_12T NrVar_2Byte.Dist_B04.Distab13_12T NrVar_2Byte.Dist_R01.Distab13_12T NrVar_2Byte.Dist_R02.Distab13_12T NrVar_2Byte.Dist_R03.Distab13_12T NrVar_2Byte.Dist_R04.Distab13_12T NrVar_2Byte.Dist_R05.Distab13_12T NrVar_2Byte.Dist_R06.Distab13_12T NrVar_2Byte.Dist_R07.Distab13_12T NrVar_2Byte.Dist_R08.Distab13_12T NrVar_2Byte.Dist_R09.Distab13_12T NrVar_2Byte.Dist_R10.Distab13_12T NrVar_2Byte.Dist_R11.Distab13_12T NrVar_2Byte.Dist_R12.Distab13_12T NrVar_4Byte.Dist_B01.Distab13_12T NrVar_4Byte.Dist_B02.Distab13_12T NrVar_4Byte.Dist_B03.Distab13_12T NrVar_4Byte.Dist_B04.Distab13_12T NrVar_4Byte.Dist_R01.Distab13_12T NrVar_4Byte.Dist_R02.Distab13_12T NrVar_4Byte.Dist_R03.Distab13_12T NrVar_4Byte.Dist_R04.Distab13_12T NrVar_4Byte.Dist_R05.Distab13_12T NrVar_4Byte.Dist_R06.Distab13_12T NrVar_4Byte.Dist_R07.Distab13_12T NrVar_4Byte.Dist_R08.Distab13_12T NrVar_4Byte.Dist_R09.Distab13_12T NrVar_4Byte.Dist_R10.Distab13_12T NrVar_4Byte.Dist_R11.Distab13_12T NrVar_4Byte.Dist_R12.Distab13_12T NrVar_8Byte.Dist_B01.Distab13_12T NrVar_8Byte.Dist_B02.Distab13_12T NrVar_8Byte.Dist_B03.Distab13_12T NrVar_8Byte.Dist_B04.Distab13_12T NrVar_8Byte.Dist_R01.Distab13_12T NrVar_8Byte.Dist_R02.Distab13_12T NrVar_8Byte.Dist_R03.Distab13_12T NrVar_8Byte.Dist_R04.Distab13_12T NrVar_8Byte.Dist_R05.Distab13_12T NrVar_8Byte.Dist_R06.Distab13_12T NrVar_8Byte.Dist_R07.Distab13_12T NrVar_8Byte.Dist_R08.Distab13_12T NrVar_8Byte.Dist_R09.Distab13_12T NrVar_8Byte.Dist_R10.Distab13_12T NrVar_8Byte.Dist_R11.Distab13_12T NrVar_8Byte.Dist_R12.Distab13_12T Result.Dist_B01.Distab13_12T Result.Dist_B02.Distab13_12T Result.Dist_B03.Distab13_12T Result.Dist_B04.Distab13_12T Result.Dist_R01.Distab13_12T Result.Dist_R02.Distab13_12T Result.Dist_R03.Distab13_12T Result.Dist_R04.Distab13_12T Result.Dist_R05.Distab13_12T Result.Dist_R06.Distab13_12T Result.Dist_R07.Distab13_12T Result.Dist_R08.Distab13_12T Result.Dist_R09.Distab13_12T Result.Dist_R10.Distab13_12T Result.Dist_R11.Distab13_12T Result.Dist_R12.Distab13_12T Time.Distab.Dist_B01.Distab13_12T Time.Distab.Dist_B02.Distab13_12T Time.Distab.Dist_B03.Distab13_12T Time.Distab.Dist_B04.Distab13_12T Time.Roundtrip.Dist_B01.Distab13_12T Time.Roundtrip.Dist_B02.Distab13_12T Time.Roundtrip.Dist_B03.Distab13_12T Time.Roundtrip.Dist_B04.Distab13_12T Timeout_RoundTrip.Dist_B01.Distab13_12T Timeout_RoundTrip.Dist_B02.Distab13_12T Timeout_RoundTrip.Dist_B03.Distab13_12T Timeout_RoundTrip.Dist_B04.Distab13_12T /end REF_MEASUREMENT
 /begin REF_CHARACTERISTIC P_Enable.Dist_B01.Distab13_12T P_Enable.Dist_B02.Distab13_12T P_Enable.Dist_B03.Distab13_12T P_Enable.Dist_B04.Distab13_12T P_Enable.Dist_R01.Distab13_12T P_Enable.Dist_R02.Distab13_12T P_Enable.Dist_R03.Distab13_12T P_Enable.Dist_R04.Distab13_12T P_Enable.Dist_R05.Distab13_12T P_Enable.Dist_R06.Distab13_12T P_Enable.Dist_R07.Distab13_12T P_Enable.Dist_R08.Distab13_12T P_Enable.Dist_R09.Distab13_12T P_Enable.Dist_R10.Distab13_12T P_Enable.Dist_R11.Distab13_12T P_Enable.Dist_R12.Distab13_12T P_TRGID_Nr.Dist_B01.Distab13_12T P_TRGID_Nr.Dist_B02.Distab13_12T P_TRGID_Nr.Dist_B03.Distab13_12T P_TRGID_Nr.Dist_B04.Distab13_12T P_TRGID_Nr.Dist_R01.Distab13_12T P_TRGID_Nr.Dist_R02.Distab13_12T P_TRGID_Nr.Dist_R03.Distab13_12T P_TRGID_Nr.Dist_R04.Distab13_12T P_TRGID_Nr.Dist_R05.Distab13_12T P_TRGID_Nr.Dist_R06.Distab13_12T P_TRGID_Nr.Dist_R07.Distab13_12T P_TRGID_Nr.Dist_R08.Distab13_12T P_TRGID_Nr.Dist_R09.Distab13_12T P_TRGID_Nr.Dist_R10.Distab13_12T P_TRGID_Nr.Dist_R11.Distab13_12T P_TRGID_Nr.Dist_R12.Distab13_12T P_TRGID_Val.Dist_B01.Distab13_12T P_TRGID_Val.Dist_B02.Distab13_12T P_TRGID_Val.Dist_B03.Distab13_12T P_TRGID_Val.Dist_B04.Distab13_12T P_TRGID_Val.Dist_R01.Distab13_12T P_TRGID_Val.Dist_R02.Distab13_12T P_TRGID_Val.Dist_R03.Distab13_12T P_TRGID_Val.Dist_R04.Distab13_12T P_TRGID_Val.Dist_R05.Distab13_12T P_TRGID_Val.Dist_R06.Distab13_12T P_TRGID_Val.Dist_R07.Distab13_12T P_TRGID_Val.Dist_R08.Distab13_12T P_TRGID_Val.Dist_R09.Distab13_12T P_TRGID_Val.Dist_R10.Distab13_12T P_TRGID_Val.Dist_R11.Distab13_12T P_TRGID_Val.Dist_R12.Distab13_12T P_TRG_Direct.Dist_B01.Distab13_12T P_TRG_Direct.Dist_B02.Distab13_12T P_TRG_Direct.Dist_B03.Distab13_12T P_TRG_Direct.Dist_B04.Distab13_12T P_TRG_Direct.Dist_R01.Distab13_12T P_TRG_Direct.Dist_R02.Distab13_12T P_TRG_Direct.Dist_R03.Distab13_12T P_TRG_Direct.Dist_R04.Distab13_12T P_TRG_Direct.Dist_R05.Distab13_12T P_TRG_Direct.Dist_R06.Distab13_12T P_TRG_Direct.Dist_R07.Distab13_12T P_TRG_Direct.Dist_R08.Distab13_12T P_TRG_Direct.Dist_R09.Distab13_12T P_TRG_Direct.Dist_R10.Distab13_12T P_TRG_Direct.Dist_R11.Distab13_12T P_TRG_Direct.Dist_R12.Distab13_12T P_TRG_Nr.Dist_B01.Distab13_12T P_TRG_Nr.Dist_B02.Distab13_12T P_TRG_Nr.Dist_B03.Distab13_12T P_TRG_Nr.Dist_B04.Distab13_12T P_TRG_Nr.Dist_R01.Distab13_12T P_TRG_Nr.Dist_R02.Distab13_12T P_TRG_Nr.Dist_R03.Distab13_12T P_TRG_Nr.Dist_R04.Distab13_12T P_TRG_Nr.Dist_R05.Distab13_12T P_TRG_Nr.Dist_R06.Distab13_12T P_TRG_Nr.Dist_R07.Distab13_12T P_TRG_Nr.Dist_R08.Distab13_12T P_TRG_Nr.Dist_R09.Distab13_12T P_TRG_Nr.Dist_R10.Distab13_12T P_TRG_Nr.Dist_R11.Distab13_12T P_TRG_Nr.Dist_R12.Distab13_12T P_TRG_Val.Dist_B01.Distab13_12T P_TRG_Val.Dist_B02.Distab13_12T P_TRG_Val.Dist_B03.Distab13_12T P_TRG_Val.Dist_B04.Distab13_12T P_TRG_Val.Dist_R01.Distab13_12T P_TRG_Val.Dist_R02.Distab13_12T P_TRG_Val.Dist_R03.Distab13_12T P_TRG_Val.Dist_R04.Distab13_12T P_TRG_Val.Dist_R05.Distab13_12T P_TRG_Val.Dist_R06.Distab13_12T P_TRG_Val.Dist_R07.Distab13_12T P_TRG_Val.Dist_R08.Distab13_12T P_TRG_Val.Dist_R09.Distab13_12T P_TRG_Val.Dist_R10.Distab13_12T P_TRG_Val.Dist_R11.Distab13_12T P_TRG_Val.Dist_R12.Distab13_12T /end REF_CHARACTERISTIC
/end GROUP
/begin GROUP MIN_MAX_Tick2Time.DiagP3MasterDownload.DiagKwpUds ""
 /begin REF_MEASUREMENT Max.MIN_MAX_Tick2Time.DiagP3MasterDownload.DiagKwpUds Min.MIN_MAX_Tick2Time.DiagP3MasterDownload.DiagKwpUds Time.MIN_MAX_Tick2Time.DiagP3MasterDownload.DiagKwpUds /end REF_MEASUREMENT
/end GROUP
/begin GROUP MIN_MAX_Tick2Time.DiagSTminDownloadCF1CF2.DiagKwpUds ""
 /begin REF_MEASUREMENT Max.MIN_MAX_Tick2Time.DiagSTminDownloadCF1CF2.DiagKwpUds Min.MIN_MAX_Tick2Time.DiagSTminDownloadCF1CF2.DiagKwpUds Time.MIN_MAX_Tick2Time.DiagSTminDownloadCF1CF2.DiagKwpUds /end REF_MEASUREMENT
/end GROUP
/begin GROUP MIN_MAX_Tick2Time.DiagSTminDownloadCF2CF3.DiagKwpUds ""
 /begin REF_MEASUREMENT Max.MIN_MAX_Tick2Time.DiagSTminDownloadCF2CF3.DiagKwpUds Min.MIN_MAX_Tick2Time.DiagSTminDownloadCF2CF3.DiagKwpUds Time.MIN_MAX_Tick2Time.DiagSTminDownloadCF2CF3.DiagKwpUds /end REF_MEASUREMENT
/end GROUP
/begin GROUP Roundtrip.Dist_B01.Distab13_12T ""
 /begin REF_MEASUREMENT Max.Roundtrip.Dist_B01.Distab13_12T Min.Roundtrip.Dist_B01.Distab13_12T Time.Roundtrip.Dist_B01.Distab13_12T /end REF_MEASUREMENT
/end GROUP
/begin GROUP Roundtrip.Dist_B02.Distab13_12T ""
 /begin REF_MEASUREMENT Max.Roundtrip.Dist_B02.Distab13_12T Min.Roundtrip.Dist_B02.Distab13_12T Time.Roundtrip.Dist_B02.Distab13_12T /end REF_MEASUREMENT
/end GROUP
/begin GROUP Roundtrip.Dist_B03.Distab13_12T ""
 /begin REF_MEASUREMENT Max.Roundtrip.Dist_B03.Distab13_12T Min.Roundtrip.Dist_B03.Distab13_12T Time.Roundtrip.Dist_B03.Distab13_12T /end REF_MEASUREMENT
/end GROUP
/begin GROUP Roundtrip.Dist_B04.Distab13_12T ""
 /begin REF_MEASUREMENT Max.Roundtrip.Dist_B04.Distab13_12T Min.Roundtrip.Dist_B04.Distab13_12T Time.Roundtrip.Dist_B04.Distab13_12T /end REF_MEASUREMENT
/end GROUP
/begin GROUP Shared.Cal_Measure ""
 /begin REF_MEASUREMENT M_F32_1.Shared.Cal_Measure M_F32_2.Shared.Cal_Measure M_F64_1.Shared.Cal_Measure M_F64_2.Shared.Cal_Measure M_S16_1.Shared.Cal_Measure M_S16_2.Shared.Cal_Measure M_S16_3.Shared.Cal_Measure M_S32_1.Shared.Cal_Measure M_S32_2.Shared.Cal_Measure M_S8_1.Shared.Cal_Measure M_S8_2.Shared.Cal_Measure M_S8_3.Shared.Cal_Measure M_S8_4.Shared.Cal_Measure M_U16_1.Shared.Cal_Measure M_U16_2.Shared.Cal_Measure M_U16_3.Shared.Cal_Measure M_U32_1.Shared.Cal_Measure M_U32_2.Shared.Cal_Measure M_U8_1.Shared.Cal_Measure M_U8_2.Shared.Cal_Measure M_U8_3.Shared.Cal_Measure M_U8_4.Shared.Cal_Measure /end REF_MEASUREMENT
 /begin REF_CHARACTERISTIC P_F32_1.Shared.Cal_Measure P_F32_2.Shared.Cal_Measure P_F64_1.Shared.Cal_Measure P_F64_2.Shared.Cal_Measure P_S16_1.Shared.Cal_Measure P_S16_2.Shared.Cal_Measure P_S16_3.Shared.Cal_Measure P_S32_1.Shared.Cal_Measure P_S32_2.Shared.Cal_Measure P_S8_1.Shared.Cal_Measure P_S8_2.Shared.Cal_Measure P_S8_3.Shared.Cal_Measure P_S8_4.Shared.Cal_Measure P_U16_1.Shared.Cal_Measure P_U16_2.Shared.Cal_Measure P_U16_3.Shared.Cal_Measure P_U32_1.Shared.Cal_Measure P_U32_2.Shared.Cal_Measure P_U8_1.Shared.Cal_Measure P_U8_2.Shared.Cal_Measure P_U8_3.Shared.Cal_Measure P_U8_4.Shared.Cal_Measure /end REF_CHARACTERISTIC
/end GROUP
/begin GROUP Shared.Cal_Measure_Block16 ""
 /begin REF_MEASUREMENT Index_x.Shared.Cal_Measure_Block16 Index_y.Shared.Cal_Measure_Block16 M_Uint16_matrix.Shared.Cal_Measure_Block16 v_Matrix1_u16_1.Shared.Cal_Measure_Block16 v_Matrix1_u16_2.Shared.Cal_Measure_Block16 v_Matrix1_u16_3.Shared.Cal_Measure_Block16 v_Matrix1_u16_4.Shared.Cal_Measure_Block16 v_Matrix1_u16_5.Shared.Cal_Measure_Block16 /end REF_MEASUREMENT
 /begin REF_CHARACTERISTIC P_Uint16_matrix_1.Shared.Cal_Measure_Block16 P_Uint16_matrix_2.Shared.Cal_Measure_Block16 P_Uint16_matrix_3.Shared.Cal_Measure_Block16 P_Uint16_matrix_4.Shared.Cal_Measure_Block16 P_Uint16_matrix_5.Shared.Cal_Measure_Block16 p_Index_x.Shared.Cal_Measure_Block16 p_Index_y.Shared.Cal_Measure_Block16 /end REF_CHARACTERISTIC
/end GROUP
/begin GROUP StatisticValuesECU_V100.DiagP3MasterDownload.DiagKwpUds ""
 /begin REF_MEASUREMENT Anzahl.StatisticValuesECU_V100.DiagP3MasterDownload.DiagKwpUds Mittelwert.StatisticValuesECU_V100.DiagP3MasterDownload.DiagKwpUds Summe.StatisticValuesECU_V100.DiagP3MasterDownload.DiagKwpUds SummeQuad.StatisticValuesECU_V100.DiagP3MasterDownload.DiagKwpUds Var.StatisticValuesECU_V100.DiagP3MasterDownload.DiagKwpUds /end REF_MEASUREMENT
/end GROUP
/begin GROUP StatisticValuesECU_V100.DiagSTminDownloadCF1CF2.DiagKwpUds ""
 /begin REF_MEASUREMENT Anzahl.StatisticValuesECU_V100.DiagSTminDownloadCF1CF2.DiagKwpUds Mittelwert.StatisticValuesECU_V100.DiagSTminDownloadCF1CF2.DiagKwpUds Summe.StatisticValuesECU_V100.DiagSTminDownloadCF1CF2.DiagKwpUds SummeQuad.StatisticValuesECU_V100.DiagSTminDownloadCF1CF2.DiagKwpUds Var.StatisticValuesECU_V100.DiagSTminDownloadCF1CF2.DiagKwpUds /end REF_MEASUREMENT
/end GROUP
/begin GROUP StatisticValuesECU_V100.DiagSTminDownloadCF2CF3.DiagKwpUds ""
 /begin REF_MEASUREMENT Anzahl.StatisticValuesECU_V100.DiagSTminDownloadCF2CF3.DiagKwpUds Mittelwert.StatisticValuesECU_V100.DiagSTminDownloadCF2CF3.DiagKwpUds Summe.StatisticValuesECU_V100.DiagSTminDownloadCF2CF3.DiagKwpUds SummeQuad.StatisticValuesECU_V100.DiagSTminDownloadCF2CF3.DiagKwpUds Var.StatisticValuesECU_V100.DiagSTminDownloadCF2CF3.DiagKwpUds /end REF_MEASUREMENT
/end GROUP
/begin GROUP Time_Calc.Curve_Module ""
 /begin REF_MEASUREMENT Result.Time_Calc.Curve_Module TimeStampOne.Time_Calc.Curve_Module TimeStampTwo.Time_Calc.Curve_Module is_started.Time_Calc.Curve_Module /end REF_MEASUREMENT
/end GROUP
/begin GROUP UdsLocIDs "" ROOT
 /begin REF_MEASUREMENT i_LocalIdData_au8.C_ClassUdsVIN.UdsLocIDs i_LocalIdData_au8.C_ClassUdsVIN2.UdsLocIDs i_LocalId_u16.C_ClassUdsVIN.UdsLocIDs i_LocalId_u16.C_ClassUdsVIN2.UdsLocIDs i_LocalIds_pu32.C_ClassUdsVIN.UdsLocIDs i_LocalIds_pu32.C_ClassUdsVIN2.UdsLocIDs /end REF_MEASUREMENT
 /begin REF_CHARACTERISTIC ip_NumEntries_u8.C_ClassUdsVIN.UdsLocIDs ip_NumEntries_u8.C_ClassUdsVIN2.UdsLocIDs /end REF_CHARACTERISTIC
/end GROUP
/begin GROUP UdsSendList "" ROOT
 /begin REF_MEASUREMENT i_CanID_u32.C_ClassUdsSendList01.UdsSendList i_CanID_u32.C_ClassUdsSendList02.UdsSendList i_CanID_u32.C_ClassUdsSendList03.UdsSendList i_CanID_u32.C_ClassUdsSendList04.UdsSendList i_CanID_u32.C_ClassUdsSendList05.UdsSendList i_CanID_u32.C_ClassUdsSendList06.UdsSendList i_CanID_u32.C_ClassUdsSendList07.UdsSendList i_CanID_u32.C_ClassUdsSendList08.UdsSendList i_CanID_u32.C_ClassUdsSendList09.UdsSendList i_CanID_u32.C_ClassUdsSendList10.UdsSendList i_CanID_u32.C_ClassUdsSendList11.UdsSendList i_CanID_u32.C_ClassUdsSendList12.UdsSendList i_CanID_u32.C_ClassUdsSendList13.UdsSendList i_CanID_u32.C_ClassUdsSendList14.UdsSendList i_CanID_u32.C_ClassUdsSendList15.UdsSendList i_CanID_u32.C_ClassUdsSendList16.UdsSendList i_CanID_u32.C_ClassUdsSendList17.UdsSendList i_CanID_u32.C_ClassUdsSendList18.UdsSendList i_CanID_u32.C_ClassUdsSendList19.UdsSendList i_CanID_u32.C_ClassUdsSendList20.UdsSendList i_CanID_u32.C_ClassUdsSendList21.UdsSendList i_CanID_u32.C_ClassUdsSendList22.UdsSendList i_CanID_u32.C_ClassUdsSendList23.UdsSendList i_CanID_u32.C_ClassUdsSendList24.UdsSendList i_NumEntries_u8.C_ClassUdsSendList01.UdsSendList i_NumEntries_u8.C_ClassUdsSendList02.UdsSendList i_NumEntries_u8.C_ClassUdsSendList03.UdsSendList i_NumEntries_u8.C_ClassUdsSendList04.UdsSendList i_NumEntries_u8.C_ClassUdsSendList05.UdsSendList i_NumEntries_u8.C_ClassUdsSendList06.UdsSendList i_NumEntries_u8.C_ClassUdsSendList07.UdsSendList i_NumEntries_u8.C_ClassUdsSendList08.UdsSendList i_NumEntries_u8.C_ClassUdsSendList09.UdsSendList i_NumEntries_u8.C_ClassUdsSendList10.UdsSendList i_NumEntries_u8.C_ClassUdsSendList11.UdsSendList i_NumEntries_u8.C_ClassUdsSendList12.UdsSendList i_NumEntries_u8.C_ClassUdsSendList13.UdsSendList i_NumEntries_u8.C_ClassUdsSendList14.UdsSendList i_NumEntries_u8.C_ClassUdsSendList15.UdsSendList i_NumEntries_u8.C_ClassUdsSendList16.UdsSendList i_NumEntries_u8.C_ClassUdsSendList17.UdsSendList i_NumEntries_u8.C_ClassUdsSendList18.UdsSendList i_NumEntries_u8.C_ClassUdsSendList19.UdsSendList i_NumEntries_u8.C_ClassUdsSendList20.UdsSendList i_NumEntries_u8.C_ClassUdsSendList21.UdsSendList i_NumEntries_u8.C_ClassUdsSendList22.UdsSendList i_NumEntries_u8.C_ClassUdsSendList23.UdsSendList i_NumEntries_u8.C_ClassUdsSendList24.UdsSendList i_PeriodicID_u16.C_ClassUdsSendList01.UdsSendList i_PeriodicID_u16.C_ClassUdsSendList02.UdsSendList i_PeriodicID_u16.C_ClassUdsSendList03.UdsSendList i_PeriodicID_u16.C_ClassUdsSendList04.UdsSendList i_PeriodicID_u16.C_ClassUdsSendList05.UdsSendList i_PeriodicID_u16.C_ClassUdsSendList06.UdsSendList i_PeriodicID_u16.C_ClassUdsSendList07.UdsSendList i_PeriodicID_u16.C_ClassUdsSendList08.UdsSendList i_PeriodicID_u16.C_ClassUdsSendList09.UdsSendList i_PeriodicID_u16.C_ClassUdsSendList10.UdsSendList i_PeriodicID_u16.C_ClassUdsSendList11.UdsSendList i_PeriodicID_u16.C_ClassUdsSendList12.UdsSendList i_PeriodicID_u16.C_ClassUdsSendList13.UdsSendList i_PeriodicID_u16.C_ClassUdsSendList14.UdsSendList i_PeriodicID_u16.C_ClassUdsSendList15.UdsSendList i_PeriodicID_u16.C_ClassUdsSendList16.UdsSendList i_PeriodicID_u16.C_ClassUdsSendList17.UdsSendList i_PeriodicID_u16.C_ClassUdsSendList18.UdsSendList i_PeriodicID_u16.C_ClassUdsSendList19.UdsSendList i_PeriodicID_u16.C_ClassUdsSendList20.UdsSendList i_PeriodicID_u16.C_ClassUdsSendList21.UdsSendList i_PeriodicID_u16.C_ClassUdsSendList22.UdsSendList i_PeriodicID_u16.C_ClassUdsSendList23.UdsSendList i_PeriodicID_u16.C_ClassUdsSendList24.UdsSendList i_RasterMode_u8.C_ClassUdsSendList01.UdsSendList i_RasterMode_u8.C_ClassUdsSendList02.UdsSendList i_RasterMode_u8.C_ClassUdsSendList03.UdsSendList i_RasterMode_u8.C_ClassUdsSendList04.UdsSendList i_RasterMode_u8.C_ClassUdsSendList05.UdsSendList i_RasterMode_u8.C_ClassUdsSendList06.UdsSendList i_RasterMode_u8.C_ClassUdsSendList07.UdsSendList i_RasterMode_u8.C_ClassUdsSendList08.UdsSendList i_RasterMode_u8.C_ClassUdsSendList09.UdsSendList i_RasterMode_u8.C_ClassUdsSendList10.UdsSendList i_RasterMode_u8.C_ClassUdsSendList11.UdsSendList i_RasterMode_u8.C_ClassUdsSendList12.UdsSendList i_RasterMode_u8.C_ClassUdsSendList13.UdsSendList i_RasterMode_u8.C_ClassUdsSendList14.UdsSendList i_RasterMode_u8.C_ClassUdsSendList15.UdsSendList i_RasterMode_u8.C_ClassUdsSendList16.UdsSendList i_RasterMode_u8.C_ClassUdsSendList17.UdsSendList i_RasterMode_u8.C_ClassUdsSendList18.UdsSendList i_RasterMode_u8.C_ClassUdsSendList19.UdsSendList i_RasterMode_u8.C_ClassUdsSendList20.UdsSendList i_RasterMode_u8.C_ClassUdsSendList21.UdsSendList i_RasterMode_u8.C_ClassUdsSendList22.UdsSendList i_RasterMode_u8.C_ClassUdsSendList23.UdsSendList i_RasterMode_u8.C_ClassUdsSendList24.UdsSendList i_ResponceType_u8.C_ClassUdsSendList01.UdsSendList i_ResponceType_u8.C_ClassUdsSendList02.UdsSendList i_ResponceType_u8.C_ClassUdsSendList03.UdsSendList i_ResponceType_u8.C_ClassUdsSendList04.UdsSendList i_ResponceType_u8.C_ClassUdsSendList05.UdsSendList i_ResponceType_u8.C_ClassUdsSendList06.UdsSendList i_ResponceType_u8.C_ClassUdsSendList07.UdsSendList i_ResponceType_u8.C_ClassUdsSendList08.UdsSendList i_ResponceType_u8.C_ClassUdsSendList09.UdsSendList i_ResponceType_u8.C_ClassUdsSendList10.UdsSendList i_ResponceType_u8.C_ClassUdsSendList11.UdsSendList i_ResponceType_u8.C_ClassUdsSendList12.UdsSendList i_ResponceType_u8.C_ClassUdsSendList13.UdsSendList i_ResponceType_u8.C_ClassUdsSendList14.UdsSendList i_ResponceType_u8.C_ClassUdsSendList15.UdsSendList i_ResponceType_u8.C_ClassUdsSendList16.UdsSendList i_ResponceType_u8.C_ClassUdsSendList17.UdsSendList i_ResponceType_u8.C_ClassUdsSendList18.UdsSendList i_ResponceType_u8.C_ClassUdsSendList19.UdsSendList i_ResponceType_u8.C_ClassUdsSendList20.UdsSendList i_ResponceType_u8.C_ClassUdsSendList21.UdsSendList i_ResponceType_u8.C_ClassUdsSendList22.UdsSendList i_ResponceType_u8.C_ClassUdsSendList23.UdsSendList i_ResponceType_u8.C_ClassUdsSendList24.UdsSendList i_SampleBuf_au8.C_ClassUdsSendList01.UdsSendList i_SampleBuf_au8.C_ClassUdsSendList02.UdsSendList i_SampleBuf_au8.C_ClassUdsSendList03.UdsSendList i_SampleBuf_au8.C_ClassUdsSendList04.UdsSendList i_SampleBuf_au8.C_ClassUdsSendList05.UdsSendList i_SampleBuf_au8.C_ClassUdsSendList06.UdsSendList i_SampleBuf_au8.C_ClassUdsSendList07.UdsSendList i_SampleBuf_au8.C_ClassUdsSendList08.UdsSendList i_SampleBuf_au8.C_ClassUdsSendList09.UdsSendList i_SampleBuf_au8.C_ClassUdsSendList10.UdsSendList i_SampleBuf_au8.C_ClassUdsSendList11.UdsSendList i_SampleBuf_au8.C_ClassUdsSendList12.UdsSendList i_SampleBuf_au8.C_ClassUdsSendList13.UdsSendList i_SampleBuf_au8.C_ClassUdsSendList14.UdsSendList i_SampleBuf_au8.C_ClassUdsSendList15.UdsSendList i_SampleBuf_au8.C_ClassUdsSendList16.UdsSendList i_SampleBuf_au8.C_ClassUdsSendList17.UdsSendList i_SampleBuf_au8.C_ClassUdsSendList18.UdsSendList i_SampleBuf_au8.C_ClassUdsSendList19.UdsSendList i_SampleBuf_au8.C_ClassUdsSendList20.UdsSendList i_SampleBuf_au8.C_ClassUdsSendList21.UdsSendList i_SampleBuf_au8.C_ClassUdsSendList22.UdsSendList i_SampleBuf_au8.C_ClassUdsSendList23.UdsSendList i_SampleBuf_au8.C_ClassUdsSendList24.UdsSendList i_UdsDaqList_pu32.C_ClassUdsSendList01.UdsSendList i_UdsDaqList_pu32.C_ClassUdsSendList02.UdsSendList i_UdsDaqList_pu32.C_ClassUdsSendList03.UdsSendList i_UdsDaqList_pu32.C_ClassUdsSendList04.UdsSendList i_UdsDaqList_pu32.C_ClassUdsSendList05.UdsSendList i_UdsDaqList_pu32.C_ClassUdsSendList06.UdsSendList i_UdsDaqList_pu32.C_ClassUdsSendList07.UdsSendList i_UdsDaqList_pu32.C_ClassUdsSendList08.UdsSendList i_UdsDaqList_pu32.C_ClassUdsSendList09.UdsSendList i_UdsDaqList_pu32.C_ClassUdsSendList10.UdsSendList i_UdsDaqList_pu32.C_ClassUdsSendList11.UdsSendList i_UdsDaqList_pu32.C_ClassUdsSendList12.UdsSendList i_UdsDaqList_pu32.C_ClassUdsSendList13.UdsSendList i_UdsDaqList_pu32.C_ClassUdsSendList14.UdsSendList i_UdsDaqList_pu32.C_ClassUdsSendList15.UdsSendList i_UdsDaqList_pu32.C_ClassUdsSendList16.UdsSendList i_UdsDaqList_pu32.C_ClassUdsSendList17.UdsSendList i_UdsDaqList_pu32.C_ClassUdsSendList18.UdsSendList i_UdsDaqList_pu32.C_ClassUdsSendList19.UdsSendList i_UdsDaqList_pu32.C_ClassUdsSendList20.UdsSendList i_UdsDaqList_pu32.C_ClassUdsSendList21.UdsSendList i_UdsDaqList_pu32.C_ClassUdsSendList22.UdsSendList i_UdsDaqList_pu32.C_ClassUdsSendList23.UdsSendList i_UdsDaqList_pu32.C_ClassUdsSendList24.UdsSendList i_UdsSendListState_u8.C_ClassUdsSendList01.UdsSendList i_UdsSendListState_u8.C_ClassUdsSendList02.UdsSendList i_UdsSendListState_u8.C_ClassUdsSendList03.UdsSendList i_UdsSendListState_u8.C_ClassUdsSendList04.UdsSendList i_UdsSendListState_u8.C_ClassUdsSendList05.UdsSendList i_UdsSendListState_u8.C_ClassUdsSendList06.UdsSendList i_UdsSendListState_u8.C_ClassUdsSendList07.UdsSendList i_UdsSendListState_u8.C_ClassUdsSendList08.UdsSendList i_UdsSendListState_u8.C_ClassUdsSendList09.UdsSendList i_UdsSendListState_u8.C_ClassUdsSendList10.UdsSendList i_UdsSendListState_u8.C_ClassUdsSendList11.UdsSendList i_UdsSendListState_u8.C_ClassUdsSendList12.UdsSendList i_UdsSendListState_u8.C_ClassUdsSendList13.UdsSendList i_UdsSendListState_u8.C_ClassUdsSendList14.UdsSendList i_UdsSendListState_u8.C_ClassUdsSendList15.UdsSendList i_UdsSendListState_u8.C_ClassUdsSendList16.UdsSendList i_UdsSendListState_u8.C_ClassUdsSendList17.UdsSendList i_UdsSendListState_u8.C_ClassUdsSendList18.UdsSendList i_UdsSendListState_u8.C_ClassUdsSendList19.UdsSendList i_UdsSendListState_u8.C_ClassUdsSendList20.UdsSendList i_UdsSendListState_u8.C_ClassUdsSendList21.UdsSendList i_UdsSendListState_u8.C_ClassUdsSendList22.UdsSendList i_UdsSendListState_u8.C_ClassUdsSendList23.UdsSendList i_UdsSendListState_u8.C_ClassUdsSendList24.UdsSendList /end REF_MEASUREMENT
/end GROUP
/begin RECORD_LAYOUT STANDARD_CURVE_R32R32 FNC_VALUES 3 FLOAT32_IEEE COLUMN_DIR DIRECT AXIS_PTS_X 2 FLOAT32_IEEE INDEX_INCR DIRECT NO_AXIS_PTS_X 1 UWORD /end RECORD_LAYOUT
/begin RECORD_LAYOUT STANDARD_CURVE_R64R64 FNC_VALUES 3 FLOAT64_IEEE COLUMN_DIR DIRECT AXIS_PTS_X 2 FLOAT64_IEEE INDEX_INCR DIRECT NO_AXIS_PTS_X 1 UWORD /end RECORD_LAYOUT
/begin RECORD_LAYOUT STANDARD_CURVE_U16U16 FNC_VALUES 3 UWORD COLUMN_DIR DIRECT AXIS_PTS_X 2 UWORD INDEX_INCR DIRECT NO_AXIS_PTS_X 1 UWORD /end RECORD_LAYOUT
/begin RECORD_LAYOUT STANDARD_CURVE_U32U16 FNC_VALUES 3 UWORD COLUMN_DIR DIRECT AXIS_PTS_X 2 ULONG INDEX_INCR DIRECT NO_AXIS_PTS_X 1 UWORD /end RECORD_LAYOUT
/begin RECORD_LAYOUT STANDARD_DIST_R64 AXIS_PTS_X 2 FLOAT64_IEEE INDEX_INCR DIRECT NO_AXIS_PTS_X 1 UWORD /end RECORD_LAYOUT
/begin RECORD_LAYOUT STANDARD_GROUP_R64 FNC_VALUES 1 FLOAT64_IEEE COLUMN_DIR DIRECT /end RECORD_LAYOUT
/begin RECORD_LAYOUT STANDARD_VALUE_BIT FNC_VALUES 1 UBYTE COLUMN_DIR DIRECT /end RECORD_LAYOUT
/begin RECORD_LAYOUT STANDARD_VALUE_R32 FNC_VALUES 1 FLOAT32_IEEE COLUMN_DIR DIRECT /end RECORD_LAYOUT
/begin RECORD_LAYOUT STANDARD_VALUE_R64 FNC_VALUES 1 FLOAT64_IEEE COLUMN_DIR DIRECT /end RECORD_LAYOUT
/begin RECORD_LAYOUT STANDARD_VALUE_S16 FNC_VALUES 1 SWORD COLUMN_DIR DIRECT /end RECORD_LAYOUT
/begin RECORD_LAYOUT STANDARD_VALUE_S32 FNC_VALUES 1 SLONG COLUMN_DIR DIRECT /end RECORD_LAYOUT
/begin RECORD_LAYOUT STANDARD_VALUE_S8 FNC_VALUES 1 SBYTE COLUMN_DIR DIRECT /end RECORD_LAYOUT
/begin RECORD_LAYOUT STANDARD_VALUE_U16 FNC_VALUES 1 UWORD COLUMN_DIR DIRECT /end RECORD_LAYOUT
/begin RECORD_LAYOUT STANDARD_VALUE_U32 FNC_VALUES 1 ULONG COLUMN_DIR DIRECT /end RECORD_LAYOUT
/begin RECORD_LAYOUT STANDARD_VALUE_U8 FNC_VALUES 1 UBYTE COLUMN_DIR DIRECT /end RECORD_LAYOUT
/end MODULE
/end PROJECT
