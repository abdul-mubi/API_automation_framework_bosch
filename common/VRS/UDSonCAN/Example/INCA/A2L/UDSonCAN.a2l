ASAP2_VERSION 1 61
/begin PROJECT HWA_UDSonCAN_ReferenceSystem "Modified for UDSonCAN Tests with new CalMeasure Mapping"
/begin HEADER "" VERSION "000" PROJECT_NO ASD /end HEADER
/begin MODULE HWA_UDSonCAN_ReferenceSystem "Modified for UDSonCAN Tests with new CalMeasure Mapping"
/begin MOD_COMMON "2013-05-06 09:52:20	create by ETASHexVirtualAddressTableHeaderV2" BYTE_ORDER MSB_FIRST ALIGNMENT_BYTE 1 ALIGNMENT_WORD 2 ALIGNMENT_LONG 4 ALIGNMENT_FLOAT32_IEEE 4 ALIGNMENT_FLOAT64_IEEE 8 /end MOD_COMMON
/begin CHARACTERISTIC EBYP_BitOff_OS01_En.Distab13_12T "" VALUE 0x1D2380 STANDARD_VALUE_U8 0.0 ident 0 7 /end CHARACTERISTIC
/begin CHARACTERISTIC EBYP_BitOff_OS01_V.Distab13_12T "" VALUE 0x1D2381 STANDARD_VALUE_U8 0.0 ident 0 7 /end CHARACTERISTIC
/begin CHARACTERISTIC EBYP_BitOff_OS02_En.Distab13_12T "" VALUE 0x1D2382 STANDARD_VALUE_U8 0.0 ident 0 7 /end CHARACTERISTIC
/begin CHARACTERISTIC EBYP_BitOff_OS02_V.Distab13_12T "" VALUE 0x1D2383 STANDARD_VALUE_U8 0.0 ident 0 7 /end CHARACTERISTIC
/begin CHARACTERISTIC EBYP_BitOff_OS03.Distab13_12T "" VALUE 0x1D2384 STANDARD_VALUE_U8 0.0 ident 0 7 /end CHARACTERISTIC
/begin CHARACTERISTIC EBYP_BitOff_OS04.Distab13_12T "" VALUE 0x1D2385 STANDARD_VALUE_U8 0.0 ident 0 7 /end CHARACTERISTIC
/begin CHARACTERISTIC EBYP_BitOff_OS05a.Distab13_12T "" VALUE 0x1D2386 STANDARD_VALUE_U8 0.0 ident 0 7 /end CHARACTERISTIC
/begin CHARACTERISTIC EBYP_BitOff_OS05b.Distab13_12T "" VALUE 0x1D2387 STANDARD_VALUE_U8 0.0 ident 0 7 /end CHARACTERISTIC
/begin CHARACTERISTIC EBYP_BitOff_OS05c.Distab13_12T "" VALUE 0x1D2388 STANDARD_VALUE_U8 0.0 ident 0 7 /end CHARACTERISTIC
/begin CHARACTERISTIC EBYP_BitOff_OS06.Distab13_12T "" VALUE 0x1D2389 STANDARD_VALUE_U8 0.0 ident 0 7 /end CHARACTERISTIC
/begin CHARACTERISTIC EBYP_BitOff_OS07.Distab13_12T "" VALUE 0x1D238A STANDARD_VALUE_U8 0.0 ident 0 7 /end CHARACTERISTIC
/begin CHARACTERISTIC EBYP_BitOff_OS08.Distab13_12T "" VALUE 0x1D238B STANDARD_VALUE_U8 0.0 ident 0 7 /end CHARACTERISTIC
/begin CHARACTERISTIC EBYP_BitOff_OS09.Distab13_12T "" VALUE 0x1D238C STANDARD_VALUE_U8 0.0 ident 0 7 /end CHARACTERISTIC
/begin CHARACTERISTIC EBYP_BitOff_OS10.Distab13_12T "" VALUE 0x1D238D STANDARD_VALUE_U8 0.0 ident 0 7 /end CHARACTERISTIC
/begin CHARACTERISTIC EBYP_BitOff_OS11.Distab13_12T "" VALUE 0x1D238E STANDARD_VALUE_U8 0.0 ident 0 7 /end CHARACTERISTIC
/begin CHARACTERISTIC EBYP_BitOff_OS12.Distab13_12T "" VALUE 0x1D238F STANDARD_VALUE_U8 0.0 ident 0 7 /end CHARACTERISTIC
/begin CHARACTERISTIC EBYP_BitOff_OS13.Distab13_12T "" VALUE 0x1D2390 STANDARD_VALUE_U8 0.0 ident 0 7 /end CHARACTERISTIC
/begin CHARACTERISTIC EBYP_BitOff_OS14.Distab13_12T "" VALUE 0x1D2391 STANDARD_VALUE_U8 0.0 ident 0 7 /end CHARACTERISTIC
/begin CHARACTERISTIC EBYP_BitOff_OS15.Distab13_12T "" VALUE 0x1D2392 STANDARD_VALUE_U8 0.0 ident 0 7 /end CHARACTERISTIC
/begin CHARACTERISTIC EBYP_BitOff_OSMR.Distab13_12T "" VALUE 0x1D2393 STANDARD_VALUE_U8 0.0 ident 0 7 /end CHARACTERISTIC
/begin CHARACTERISTIC EBYP_Off_OIC01_Dcyc.Distab13_12T "" VALUE 0x1D2394 STANDARD_VALUE_U8 0.0 ident 0 255 /end CHARACTERISTIC
/begin CHARACTERISTIC EBYP_Off_OIC02_Dcyc.Distab13_12T "" VALUE 0x1D2395 STANDARD_VALUE_U8 0.0 ident 0 255 /end CHARACTERISTIC
/begin CHARACTERISTIC EBYP_Off_OPI01_Dcyc.Distab13_12T "" VALUE 0x1D2396 STANDARD_VALUE_U8 0.0 ident 0 255 /end CHARACTERISTIC
/begin CHARACTERISTIC EBYP_Off_OPI02_Dcyc.Distab13_12T "" VALUE 0x1D2397 STANDARD_VALUE_U8 0.0 ident 0 255 /end CHARACTERISTIC
/begin CHARACTERISTIC EBYP_Off_OPI03_Dcyc.Distab13_12T "" VALUE 0x1D2398 STANDARD_VALUE_U8 0.0 ident 0 255 /end CHARACTERISTIC
/begin CHARACTERISTIC EBYP_Off_OPI04_Dcyc.Distab13_12T "" VALUE 0x1D2399 STANDARD_VALUE_U8 0.0 ident 0 255 /end CHARACTERISTIC
/begin CHARACTERISTIC EBYP_Off_OPI05_Dcyc.Distab13_12T "" VALUE 0x1D239A STANDARD_VALUE_U8 0.0 ident 0 255 /end CHARACTERISTIC
/begin CHARACTERISTIC EBYP_Off_OPI06_Dcyc.Distab13_12T "" VALUE 0x1D239B STANDARD_VALUE_U8 0.0 ident 0 255 /end CHARACTERISTIC
/begin CHARACTERISTIC EBYP_Off_OPI07_Dcyc.Distab13_12T "" VALUE 0x1D239C STANDARD_VALUE_U8 0.0 ident 0 255 /end CHARACTERISTIC
/begin CHARACTERISTIC EBYP_Off_OS01_En.Distab13_12T "" VALUE 0x1D239D STANDARD_VALUE_U8 0.0 ident 0 255 /end CHARACTERISTIC
/begin CHARACTERISTIC EBYP_Off_OS01_S_Dcyc.Distab13_12T "" VALUE 0x1D239E STANDARD_VALUE_U8 0.0 ident 0 255 /end CHARACTERISTIC
/begin CHARACTERISTIC EBYP_Off_OS01_V.Distab13_12T "" VALUE 0x1D239F STANDARD_VALUE_U8 0.0 ident 0 255 /end CHARACTERISTIC
/begin CHARACTERISTIC EBYP_Off_OS02_En.Distab13_12T "" VALUE 0x1D23A0 STANDARD_VALUE_U8 0.0 ident 0 255 /end CHARACTERISTIC
/begin CHARACTERISTIC EBYP_Off_OS02_S_Dcyc.Distab13_12T "" VALUE 0x1D23A1 STANDARD_VALUE_U8 0.0 ident 0 255 /end CHARACTERISTIC
/begin CHARACTERISTIC EBYP_Off_OS02_V.Distab13_12T "" VALUE 0x1D23A2 STANDARD_VALUE_U8 0.0 ident 0 255 /end CHARACTERISTIC
/begin CHARACTERISTIC EBYP_Off_OS03.Distab13_12T "" VALUE 0x1D23A3 STANDARD_VALUE_U8 0.0 ident 0 255 /end CHARACTERISTIC
/begin CHARACTERISTIC EBYP_Off_OS04.Distab13_12T "" VALUE 0x1D23A4 STANDARD_VALUE_U8 0.0 ident 0 255 /end CHARACTERISTIC
/begin CHARACTERISTIC EBYP_Off_OS05a.Distab13_12T "" VALUE 0x1D23A5 STANDARD_VALUE_U8 0.0 ident 0 255 /end CHARACTERISTIC
/begin CHARACTERISTIC EBYP_Off_OS05b.Distab13_12T "" VALUE 0x1D23A6 STANDARD_VALUE_U8 0.0 ident 0 255 /end CHARACTERISTIC
/begin CHARACTERISTIC EBYP_Off_OS05c.Distab13_12T "" VALUE 0x1D23A7 STANDARD_VALUE_U8 0.0 ident 0 255 /end CHARACTERISTIC
/begin CHARACTERISTIC EBYP_Off_OS06.Distab13_12T "" VALUE 0x1D23A8 STANDARD_VALUE_U8 0.0 ident 0 255 /end CHARACTERISTIC
/begin CHARACTERISTIC EBYP_Off_OS07.Distab13_12T "" VALUE 0x1D23A9 STANDARD_VALUE_U8 0.0 ident 0 255 /end CHARACTERISTIC
/begin CHARACTERISTIC EBYP_Off_OS08.Distab13_12T "" VALUE 0x1D23AA STANDARD_VALUE_U8 0.0 ident 0 255 /end CHARACTERISTIC
/begin CHARACTERISTIC EBYP_Off_OS09.Distab13_12T "" VALUE 0x1D23AB STANDARD_VALUE_U8 0.0 ident 0 255 /end CHARACTERISTIC
/begin CHARACTERISTIC EBYP_Off_OS10.Distab13_12T "" VALUE 0x1D23AC STANDARD_VALUE_U8 0.0 ident 0 255 /end CHARACTERISTIC
/begin CHARACTERISTIC EBYP_Off_OS11.Distab13_12T "" VALUE 0x1D23AD STANDARD_VALUE_U8 0.0 ident 0 255 /end CHARACTERISTIC
/begin CHARACTERISTIC EBYP_Off_OS12.Distab13_12T "" VALUE 0x1D23AE STANDARD_VALUE_U8 0.0 ident 0 255 /end CHARACTERISTIC
/begin CHARACTERISTIC EBYP_Off_OS13.Distab13_12T "" VALUE 0x1D23AF STANDARD_VALUE_U8 0.0 ident 0 255 /end CHARACTERISTIC
/begin CHARACTERISTIC EBYP_Off_OS14.Distab13_12T "" VALUE 0x1D23B0 STANDARD_VALUE_U8 0.0 ident 0 255 /end CHARACTERISTIC
/begin CHARACTERISTIC EBYP_Off_OS15.Distab13_12T "" VALUE 0x1D23B1 STANDARD_VALUE_U8 0.0 ident 0 255 /end CHARACTERISTIC
/begin CHARACTERISTIC EBYP_Off_OSMR.Distab13_12T "" VALUE 0x1D23B2 STANDARD_VALUE_U8 0.0 ident 0 255 /end CHARACTERISTIC
/begin CHARACTERISTIC P_AML1_1_3P2R_Compatibility.Distab13_12T "True = 3Measurement +2 Bypass Raster Compatible to AML 1.1 and Triggermode  1 (MAC2/ES1200/ES1201) " VALUE 0x1D23B3 STANDARD_VALUE_U8 0.0 ident 0 1 BIT_MASK 0x1 /end CHARACTERISTIC
/begin CHARACTERISTIC P_Byp_Roundtrip_Timeout_Time.Distab13_12T "" VALUE 0x1D237C STANDARD_VALUE_U32 0.0 TickType2ms 0.0 1227133.512857143 /end CHARACTERISTIC
/begin CHARACTERISTIC P_Do_TRG_Without_Distab.Distab13_12T "" VALUE 0x1D23B4 STANDARD_VALUE_U8 0.0 ident 0 1 BIT_MASK 0x1 /end CHARACTERISTIC
/begin CHARACTERISTIC P_Enable_ETK.Distab13_12T "" VALUE 0x1D23B5 STANDARD_VALUE_U8 0.0 ident 0 1 BIT_MASK 0x1 /end CHARACTERISTIC
/begin CHARACTERISTIC p_ResetTimer_b.EV0_Roundtrip.XCP_SHELL "" VALUE 0x1DAB50 STANDARD_VALUE_U8 0.0 ident 0 1 BIT_MASK 0x1 /end CHARACTERISTIC
/begin CHARACTERISTIC p_ResetTimer_b.EV0_Rx.XCP_SHELL "" VALUE 0x1DAB5C STANDARD_VALUE_U8 0.0 ident 0 1 BIT_MASK 0x1 /end CHARACTERISTIC
/begin CHARACTERISTIC p_ResetTimer_b.EV0_Sample.XCP_SHELL "" VALUE 0x1DAB6C STANDARD_VALUE_U8 0.0 ident 0 1 BIT_MASK 0x1 /end CHARACTERISTIC
/begin CHARACTERISTIC p_ResetTimer_b.EV0_Stim.XCP_SHELL "" VALUE 0x1DAB78 STANDARD_VALUE_U8 0.0 ident 0 1 BIT_MASK 0x1 /end CHARACTERISTIC
/begin CHARACTERISTIC p_ResetTimer_b.EV0_Tx.XCP_SHELL "" VALUE 0x1DAB84 STANDARD_VALUE_U8 0.0 ident 0 1 BIT_MASK 0x1 /end CHARACTERISTIC
/begin CHARACTERISTIC P_Wait_Bypass_Roundtrip.Distab13_12T "" VALUE 0x1D23B6 STANDARD_VALUE_U8 0.0 ident 0 1 BIT_MASK 0x1 /end CHARACTERISTIC
/begin CHARACTERISTIC TST_OIC01_Dcyc.Distab13_12T "" VALUE 0x1D24D8 STANDARD_VALUE_U16 0.0 TPU_Dcyc 0.0 100.0 /end CHARACTERISTIC
/begin CHARACTERISTIC TST_OIC02_Dcyc.Distab13_12T "" VALUE 0x1D24DA STANDARD_VALUE_U16 0.0 TPU_Dcyc 0.0 100.0 /end CHARACTERISTIC
/begin CHARACTERISTIC TST_OPI01_Dcyc.Distab13_12T "" VALUE 0x1D24E2 STANDARD_VALUE_U16 0.0 TPU_Dcyc 0.0 100.0 /end CHARACTERISTIC
/begin CHARACTERISTIC TST_OPI02_Dcyc.Distab13_12T "" VALUE 0x1D2508 STANDARD_VALUE_U16 0.0 TPU_Dcyc 0.0 100.0 /end CHARACTERISTIC
/begin CHARACTERISTIC TST_OPI03_Dcyc.Distab13_12T "" VALUE 0x1D24FC STANDARD_VALUE_U16 0.0 TPU_Dcyc 0.0 100.0 /end CHARACTERISTIC
/begin CHARACTERISTIC TST_OPI04_Dcyc.Distab13_12T "" VALUE 0x1D2502 STANDARD_VALUE_U16 0.0 TPU_Dcyc 0.0 100.0 /end CHARACTERISTIC
/begin CHARACTERISTIC TST_OPI05_Dcyc.Distab13_12T "" VALUE 0x1D250C STANDARD_VALUE_U16 0.0 TPU_Dcyc 0.0 100.0 /end CHARACTERISTIC
/begin CHARACTERISTIC TST_OPI06_Dcyc.Distab13_12T "" VALUE 0x1D24DC STANDARD_VALUE_U16 0.0 TPU_Dcyc 0.0 100.0 /end CHARACTERISTIC
/begin CHARACTERISTIC TST_OPI07_Dcyc.Distab13_12T "" VALUE 0x1D24EC STANDARD_VALUE_U16 0.0 TPU_Dcyc 0.0 100.0 /end CHARACTERISTIC
/begin CHARACTERISTIC TST_OPI08_Dcyc.Distab13_12T "" VALUE 0x1D2500 STANDARD_VALUE_U16 0.0 TPU_Dcyc 0.0 100.0 /end CHARACTERISTIC
/begin CHARACTERISTIC TST_OPI09_Dcyc.Distab13_12T "" VALUE 0x1D24FE STANDARD_VALUE_U16 0.0 TPU_Dcyc 0.0 100.0 /end CHARACTERISTIC
/begin CHARACTERISTIC TST_OPI10_Dcyc.Distab13_12T "" VALUE 0x1D24DE STANDARD_VALUE_U16 0.0 TPU_Dcyc 0.0 100.0 /end CHARACTERISTIC
/begin CHARACTERISTIC TST_OPI11_Dcyc.Distab13_12T "" VALUE 0x1D24F2 STANDARD_VALUE_U16 0.0 TPU_Dcyc 0.0 100.0 /end CHARACTERISTIC
/begin CHARACTERISTIC TST_OS_MR.Distab13_12T "" VALUE 0x1D24E4 STANDARD_VALUE_U8 0.0 ident 0 1 BIT_MASK 0x1 /end CHARACTERISTIC
/begin CHARACTERISTIC TST_OS01_En.Distab13_12T "" VALUE 0x1D2506 STANDARD_VALUE_U8 0.0 ident 0 1 BIT_MASK 0x1 /end CHARACTERISTIC
/begin CHARACTERISTIC TST_OS01_S_Dcyc.Distab13_12T "" VALUE 0x1D24E8 STANDARD_VALUE_U16 0.0 TPU_Dcyc 0.0 100.0 /end CHARACTERISTIC
/begin CHARACTERISTIC TST_OS01_V.Distab13_12T "" VALUE 0x1D24EF STANDARD_VALUE_U8 0.0 ident 0 1 BIT_MASK 0x1 /end CHARACTERISTIC
/begin CHARACTERISTIC TST_OS02_En.Distab13_12T "" VALUE 0x1D24EB STANDARD_VALUE_U8 0.0 ident 0 1 BIT_MASK 0x1 /end CHARACTERISTIC
/begin CHARACTERISTIC TST_OS02_S_Dcyc.Distab13_12T "" VALUE 0x1D24F6 STANDARD_VALUE_U16 0.0 TPU_Dcyc 0.0 100.0 /end CHARACTERISTIC
/begin CHARACTERISTIC TST_OS02_V.Distab13_12T "" VALUE 0x1D24EE STANDARD_VALUE_U8 0.0 ident 0 1 BIT_MASK 0x1 /end CHARACTERISTIC
/begin CHARACTERISTIC TST_OS03.Distab13_12T "" VALUE 0x1D2505 STANDARD_VALUE_U8 0.0 ident 0 1 BIT_MASK 0x1 /end CHARACTERISTIC
/begin CHARACTERISTIC TST_OS04.Distab13_12T "" VALUE 0x1D250E STANDARD_VALUE_U8 0.0 ident 0 1 BIT_MASK 0x1 /end CHARACTERISTIC
/begin CHARACTERISTIC TST_OS05a.Distab13_12T "" VALUE 0x1D24F5 STANDARD_VALUE_U8 0.0 ident 0 1 BIT_MASK 0x1 /end CHARACTERISTIC
/begin CHARACTERISTIC TST_OS05b.Distab13_12T "" VALUE 0x1D24E7 STANDARD_VALUE_U8 0.0 ident 0 1 BIT_MASK 0x1 /end CHARACTERISTIC
/begin CHARACTERISTIC TST_OS05c.Distab13_12T "" VALUE 0x1D24F8 STANDARD_VALUE_U8 0.0 ident 0 1 BIT_MASK 0x1 /end CHARACTERISTIC
/begin CHARACTERISTIC TST_OS06.Distab13_12T "" VALUE 0x1D2504 STANDARD_VALUE_U8 0.0 ident 0 1 BIT_MASK 0x1 /end CHARACTERISTIC
/begin CHARACTERISTIC TST_OS07.Distab13_12T "" VALUE 0x1D24EA STANDARD_VALUE_U8 0.0 ident 0 1 BIT_MASK 0x1 /end CHARACTERISTIC
/begin CHARACTERISTIC TST_OS08.Distab13_12T "" VALUE 0x1D24FA STANDARD_VALUE_U8 0.0 ident 0 1 BIT_MASK 0x1 /end CHARACTERISTIC
/begin CHARACTERISTIC TST_OS09.Distab13_12T "" VALUE 0x1D24F4 STANDARD_VALUE_U8 0.0 ident 0 1 BIT_MASK 0x1 /end CHARACTERISTIC
/begin CHARACTERISTIC TST_OS10.Distab13_12T "" VALUE 0x1D24F0 STANDARD_VALUE_U8 0.0 ident 0 1 BIT_MASK 0x1 /end CHARACTERISTIC
/begin CHARACTERISTIC TST_OS11.Distab13_12T "" VALUE 0x1D24E5 STANDARD_VALUE_U8 0.0 ident 0 1 BIT_MASK 0x1 /end CHARACTERISTIC
/begin CHARACTERISTIC TST_OS12.Distab13_12T "" VALUE 0x1D24E6 STANDARD_VALUE_U8 0.0 ident 0 1 BIT_MASK 0x1 /end CHARACTERISTIC
/begin CHARACTERISTIC TST_OS13.Distab13_12T "" VALUE 0x1D250A STANDARD_VALUE_U8 0.0 ident 0 1 BIT_MASK 0x1 /end CHARACTERISTIC
/begin CHARACTERISTIC TST_OS14.Distab13_12T "" VALUE 0x1D24E0 STANDARD_VALUE_U8 0.0 ident 0 1 BIT_MASK 0x1 /end CHARACTERISTIC
/begin CHARACTERISTIC TST_OS15.Distab13_12T "" VALUE 0x1D24F9 STANDARD_VALUE_U8 0.0 ident 0 1 BIT_MASK 0x1 /end CHARACTERISTIC
/begin MEASUREMENT fl32_01.E_fl32.R01_B "" FLOAT32_IEEE ident 1 100 -9.999999999999998e+036 9.999999999999998e+036 ECU_ADDRESS 0x8229B8 /end MEASUREMENT
/begin MEASUREMENT fl32_01.E_fl32.R02_B "" FLOAT32_IEEE ident 1 100 -9.999999999999998e+036 9.999999999999998e+036 ECU_ADDRESS 0x822A88 /end MEASUREMENT
/begin MEASUREMENT fl32_01.E_fl32.R03_B "" FLOAT32_IEEE ident 1 100 -9.999999999999998e+036 9.999999999999998e+036 ECU_ADDRESS 0x822B58 /end MEASUREMENT
/begin MEASUREMENT fl32_01.E_fl32.R04_B "" FLOAT32_IEEE ident 1 100 -9.999999999999998e+036 9.999999999999998e+036 ECU_ADDRESS 0x822C28 /end MEASUREMENT
/begin MEASUREMENT fl32_02.E_fl32.R01_B "" FLOAT32_IEEE ident 1 100 -9.999999999999998e+036 9.999999999999998e+036 ECU_ADDRESS 0x8229BC /end MEASUREMENT
/begin MEASUREMENT fl32_02.E_fl32.R02_B "" FLOAT32_IEEE ident 1 100 -9.999999999999998e+036 9.999999999999998e+036 ECU_ADDRESS 0x822A8C /end MEASUREMENT
/begin MEASUREMENT fl32_02.E_fl32.R03_B "" FLOAT32_IEEE ident 1 100 -9.999999999999998e+036 9.999999999999998e+036 ECU_ADDRESS 0x822B5C /end MEASUREMENT
/begin MEASUREMENT fl32_02.E_fl32.R04_B "" FLOAT32_IEEE ident 1 100 -9.999999999999998e+036 9.999999999999998e+036 ECU_ADDRESS 0x822C2C /end MEASUREMENT
/begin MEASUREMENT fl32_03.E_fl32.R01_B "" FLOAT32_IEEE ident 1 100 -9.999999999999998e+036 9.999999999999998e+036 ECU_ADDRESS 0x8229C0 /end MEASUREMENT
/begin MEASUREMENT fl32_03.E_fl32.R02_B "" FLOAT32_IEEE ident 1 100 -9.999999999999998e+036 9.999999999999998e+036 ECU_ADDRESS 0x822A90 /end MEASUREMENT
/begin MEASUREMENT fl32_03.E_fl32.R03_B "" FLOAT32_IEEE ident 1 100 -9.999999999999998e+036 9.999999999999998e+036 ECU_ADDRESS 0x822B60 /end MEASUREMENT
/begin MEASUREMENT fl32_03.E_fl32.R04_B "" FLOAT32_IEEE ident 1 100 -9.999999999999998e+036 9.999999999999998e+036 ECU_ADDRESS 0x822C30 /end MEASUREMENT
/begin MEASUREMENT fl32_04.E_fl32.R01_B "" FLOAT32_IEEE ident 1 100 -9.999999999999998e+036 9.999999999999998e+036 ECU_ADDRESS 0x8229C4 /end MEASUREMENT
/begin MEASUREMENT fl32_04.E_fl32.R02_B "" FLOAT32_IEEE ident 1 100 -9.999999999999998e+036 9.999999999999998e+036 ECU_ADDRESS 0x822A94 /end MEASUREMENT
/begin MEASUREMENT fl32_04.E_fl32.R03_B "" FLOAT32_IEEE ident 1 100 -9.999999999999998e+036 9.999999999999998e+036 ECU_ADDRESS 0x822B64 /end MEASUREMENT
/begin MEASUREMENT fl32_04.E_fl32.R04_B "" FLOAT32_IEEE ident 1 100 -9.999999999999998e+036 9.999999999999998e+036 ECU_ADDRESS 0x822C34 /end MEASUREMENT
/begin MEASUREMENT fl32_05.E_fl32.R01_B "" FLOAT32_IEEE ident 1 100 -9.999999999999998e+036 9.999999999999998e+036 ECU_ADDRESS 0x8229C8 /end MEASUREMENT
/begin MEASUREMENT fl32_05.E_fl32.R02_B "" FLOAT32_IEEE ident 1 100 -9.999999999999998e+036 9.999999999999998e+036 ECU_ADDRESS 0x822A98 /end MEASUREMENT
/begin MEASUREMENT fl32_05.E_fl32.R03_B "" FLOAT32_IEEE ident 1 100 -9.999999999999998e+036 9.999999999999998e+036 ECU_ADDRESS 0x822B68 /end MEASUREMENT
/begin MEASUREMENT fl32_05.E_fl32.R04_B "" FLOAT32_IEEE ident 1 100 -9.999999999999998e+036 9.999999999999998e+036 ECU_ADDRESS 0x822C38 /end MEASUREMENT
/begin MEASUREMENT fl32_06.E_fl32.R01_B "" FLOAT32_IEEE ident 1 100 -9.999999999999998e+036 9.999999999999998e+036 ECU_ADDRESS 0x8229CC /end MEASUREMENT
/begin MEASUREMENT fl32_06.E_fl32.R02_B "" FLOAT32_IEEE ident 1 100 -9.999999999999998e+036 9.999999999999998e+036 ECU_ADDRESS 0x822A9C /end MEASUREMENT
/begin MEASUREMENT fl32_06.E_fl32.R03_B "" FLOAT32_IEEE ident 1 100 -9.999999999999998e+036 9.999999999999998e+036 ECU_ADDRESS 0x822B6C /end MEASUREMENT
/begin MEASUREMENT fl32_06.E_fl32.R04_B "" FLOAT32_IEEE ident 1 100 -9.999999999999998e+036 9.999999999999998e+036 ECU_ADDRESS 0x822C3C /end MEASUREMENT
/begin MEASUREMENT fl32_07.E_fl32.R01_B "" FLOAT32_IEEE ident 1 100 -9.999999999999998e+036 9.999999999999998e+036 ECU_ADDRESS 0x8229D0 /end MEASUREMENT
/begin MEASUREMENT fl32_07.E_fl32.R02_B "" FLOAT32_IEEE ident 1 100 -9.999999999999998e+036 9.999999999999998e+036 ECU_ADDRESS 0x822AA0 /end MEASUREMENT
/begin MEASUREMENT fl32_07.E_fl32.R03_B "" FLOAT32_IEEE ident 1 100 -9.999999999999998e+036 9.999999999999998e+036 ECU_ADDRESS 0x822B70 /end MEASUREMENT
/begin MEASUREMENT fl32_07.E_fl32.R04_B "" FLOAT32_IEEE ident 1 100 -9.999999999999998e+036 9.999999999999998e+036 ECU_ADDRESS 0x822C40 /end MEASUREMENT
/begin MEASUREMENT fl32_08.E_fl32.R01_B "" FLOAT32_IEEE ident 1 100 -9.999999999999998e+036 9.999999999999998e+036 ECU_ADDRESS 0x8229D4 /end MEASUREMENT
/begin MEASUREMENT fl32_08.E_fl32.R02_B "" FLOAT32_IEEE ident 1 100 -9.999999999999998e+036 9.999999999999998e+036 ECU_ADDRESS 0x822AA4 /end MEASUREMENT
/begin MEASUREMENT fl32_08.E_fl32.R03_B "" FLOAT32_IEEE ident 1 100 -9.999999999999998e+036 9.999999999999998e+036 ECU_ADDRESS 0x822B74 /end MEASUREMENT
/begin MEASUREMENT fl32_08.E_fl32.R04_B "" FLOAT32_IEEE ident 1 100 -9.999999999999998e+036 9.999999999999998e+036 ECU_ADDRESS 0x822C44 /end MEASUREMENT
/begin MEASUREMENT fl64_01.E_fl64.R01_B "" FLOAT64_IEEE ident 1 100 -1.e+037 1.e+037 ECU_ADDRESS 0x8229D8 /end MEASUREMENT
/begin MEASUREMENT fl64_01.E_fl64.R02_B "" FLOAT64_IEEE ident 1 100 -1.e+037 1.e+037 ECU_ADDRESS 0x822AA8 /end MEASUREMENT
/begin MEASUREMENT fl64_01.E_fl64.R03_B "" FLOAT64_IEEE ident 1 100 -1.e+037 1.e+037 ECU_ADDRESS 0x822B78 /end MEASUREMENT
/begin MEASUREMENT fl64_01.E_fl64.R04_B "" FLOAT64_IEEE ident 1 100 -1.e+037 1.e+037 ECU_ADDRESS 0x822C48 /end MEASUREMENT
/begin MEASUREMENT fl64_02.E_fl64.R01_B "" FLOAT64_IEEE ident 1 100 -1.e+037 1.e+037 ECU_ADDRESS 0x8229E0 /end MEASUREMENT
/begin MEASUREMENT fl64_02.E_fl64.R02_B "" FLOAT64_IEEE ident 1 100 -1.e+037 1.e+037 ECU_ADDRESS 0x822AB0 /end MEASUREMENT
/begin MEASUREMENT fl64_02.E_fl64.R03_B "" FLOAT64_IEEE ident 1 100 -1.e+037 1.e+037 ECU_ADDRESS 0x822B80 /end MEASUREMENT
/begin MEASUREMENT fl64_02.E_fl64.R04_B "" FLOAT64_IEEE ident 1 100 -1.e+037 1.e+037 ECU_ADDRESS 0x822C50 /end MEASUREMENT
/begin MEASUREMENT fl64_03.E_fl64.R01_B "" FLOAT64_IEEE ident 1 100 -1.e+037 1.e+037 ECU_ADDRESS 0x8229E8 /end MEASUREMENT
/begin MEASUREMENT fl64_03.E_fl64.R02_B "" FLOAT64_IEEE ident 1 100 -1.e+037 1.e+037 ECU_ADDRESS 0x822AB8 /end MEASUREMENT
/begin MEASUREMENT fl64_03.E_fl64.R03_B "" FLOAT64_IEEE ident 1 100 -1.e+037 1.e+037 ECU_ADDRESS 0x822B88 /end MEASUREMENT
/begin MEASUREMENT fl64_03.E_fl64.R04_B "" FLOAT64_IEEE ident 1 100 -1.e+037 1.e+037 ECU_ADDRESS 0x822C58 /end MEASUREMENT
/begin MEASUREMENT fl64_04.E_fl64.R01_B "" FLOAT64_IEEE ident 1 100 -1.e+037 1.e+037 ECU_ADDRESS 0x8229F0 /end MEASUREMENT
/begin MEASUREMENT fl64_04.E_fl64.R02_B "" FLOAT64_IEEE ident 1 100 -1.e+037 1.e+037 ECU_ADDRESS 0x822AC0 /end MEASUREMENT
/begin MEASUREMENT fl64_04.E_fl64.R03_B "" FLOAT64_IEEE ident 1 100 -1.e+037 1.e+037 ECU_ADDRESS 0x822B90 /end MEASUREMENT
/begin MEASUREMENT fl64_04.E_fl64.R04_B "" FLOAT64_IEEE ident 1 100 -1.e+037 1.e+037 ECU_ADDRESS 0x822C60 /end MEASUREMENT
/begin MEASUREMENT fl64_05.E_fl64.R01_B "" FLOAT64_IEEE ident 1 100 -1.e+037 1.e+037 ECU_ADDRESS 0x8229F8 /end MEASUREMENT
/begin MEASUREMENT fl64_05.E_fl64.R02_B "" FLOAT64_IEEE ident 1 100 -1.e+037 1.e+037 ECU_ADDRESS 0x822AC8 /end MEASUREMENT
/begin MEASUREMENT fl64_05.E_fl64.R03_B "" FLOAT64_IEEE ident 1 100 -1.e+037 1.e+037 ECU_ADDRESS 0x822B98 /end MEASUREMENT
/begin MEASUREMENT fl64_05.E_fl64.R04_B "" FLOAT64_IEEE ident 1 100 -1.e+037 1.e+037 ECU_ADDRESS 0x822C68 /end MEASUREMENT
/begin MEASUREMENT fl64_06.E_fl64.R01_B "" FLOAT64_IEEE ident 1 100 -1.e+037 1.e+037 ECU_ADDRESS 0x822A00 /end MEASUREMENT
/begin MEASUREMENT fl64_06.E_fl64.R02_B "" FLOAT64_IEEE ident 1 100 -1.e+037 1.e+037 ECU_ADDRESS 0x822AD0 /end MEASUREMENT
/begin MEASUREMENT fl64_06.E_fl64.R03_B "" FLOAT64_IEEE ident 1 100 -1.e+037 1.e+037 ECU_ADDRESS 0x822BA0 /end MEASUREMENT
/begin MEASUREMENT fl64_06.E_fl64.R04_B "" FLOAT64_IEEE ident 1 100 -1.e+037 1.e+037 ECU_ADDRESS 0x822C70 /end MEASUREMENT
/begin MEASUREMENT fl64_07.E_fl64.R01_B "" FLOAT64_IEEE ident 1 100 -1.e+037 1.e+037 ECU_ADDRESS 0x822A08 /end MEASUREMENT
/begin MEASUREMENT fl64_07.E_fl64.R02_B "" FLOAT64_IEEE ident 1 100 -1.e+037 1.e+037 ECU_ADDRESS 0x822AD8 /end MEASUREMENT
/begin MEASUREMENT fl64_07.E_fl64.R03_B "" FLOAT64_IEEE ident 1 100 -1.e+037 1.e+037 ECU_ADDRESS 0x822BA8 /end MEASUREMENT
/begin MEASUREMENT fl64_07.E_fl64.R04_B "" FLOAT64_IEEE ident 1 100 -1.e+037 1.e+037 ECU_ADDRESS 0x822C78 /end MEASUREMENT
/begin MEASUREMENT fl64_08.E_fl64.R01_B "" FLOAT64_IEEE ident 1 100 -1.e+037 1.e+037 ECU_ADDRESS 0x822A10 /end MEASUREMENT
/begin MEASUREMENT fl64_08.E_fl64.R02_B "" FLOAT64_IEEE ident 1 100 -1.e+037 1.e+037 ECU_ADDRESS 0x822AE0 /end MEASUREMENT
/begin MEASUREMENT fl64_08.E_fl64.R03_B "" FLOAT64_IEEE ident 1 100 -1.e+037 1.e+037 ECU_ADDRESS 0x822BB0 /end MEASUREMENT
/begin MEASUREMENT fl64_08.E_fl64.R04_B "" FLOAT64_IEEE ident 1 100 -1.e+037 1.e+037 ECU_ADDRESS 0x822C80 /end MEASUREMENT
/begin MEASUREMENT FSW_OIC01_Dcyc.Distab13_12T "" UWORD TPU_Dcyc 1 100 0.0 100.0 ECU_ADDRESS 0x822750 /end MEASUREMENT
/begin MEASUREMENT FSW_OIC02_Dcyc.Distab13_12T "" UWORD TPU_Dcyc 1 100 0.0 100.0 ECU_ADDRESS 0x822752 /end MEASUREMENT
/begin MEASUREMENT FSW_OPI01_Dcyc.Distab13_12T "" UWORD TPU_Dcyc 1 100 0.0 100.0 ECU_ADDRESS 0x822754 /end MEASUREMENT
/begin MEASUREMENT FSW_OPI02_Dcyc.Distab13_12T "" UWORD TPU_Dcyc 1 100 0.0 100.0 ECU_ADDRESS 0x822756 /end MEASUREMENT
/begin MEASUREMENT FSW_OPI03_Dcyc.Distab13_12T "" UWORD TPU_Dcyc 1 100 0.0 100.0 ECU_ADDRESS 0x822758 /end MEASUREMENT
/begin MEASUREMENT FSW_OPI04_Dcyc.Distab13_12T "" UWORD TPU_Dcyc 1 100 0.0 100.0 ECU_ADDRESS 0x82275A /end MEASUREMENT
/begin MEASUREMENT FSW_OPI05_Dcyc.Distab13_12T "" UWORD TPU_Dcyc 1 100 0.0 100.0 ECU_ADDRESS 0x82275C /end MEASUREMENT
/begin MEASUREMENT FSW_OPI06_Dcyc.Distab13_12T "" UWORD TPU_Dcyc 1 100 0.0 100.0 ECU_ADDRESS 0x82275E /end MEASUREMENT
/begin MEASUREMENT FSW_OPI07_Dcyc.Distab13_12T "" UWORD TPU_Dcyc 1 100 0.0 100.0 ECU_ADDRESS 0x822760 /end MEASUREMENT
/begin MEASUREMENT FSW_OPI08_Dcyc.Distab13_12T "" UWORD TPU_Dcyc 1 100 0.0 100.0 ECU_ADDRESS 0x822762 /end MEASUREMENT
/begin MEASUREMENT FSW_OPI09_Dcyc.Distab13_12T "" UWORD TPU_Dcyc 1 100 0.0 100.0 ECU_ADDRESS 0x822764 /end MEASUREMENT
/begin MEASUREMENT FSW_OPI10_Dcyc.Distab13_12T "" UWORD TPU_Dcyc 1 100 0.0 100.0 ECU_ADDRESS 0x822766 /end MEASUREMENT
/begin MEASUREMENT FSW_OPI11_Dcyc.Distab13_12T "" UWORD TPU_Dcyc 1 100 0.0 100.0 ECU_ADDRESS 0x822768 /end MEASUREMENT
/begin MEASUREMENT FSW_OS_MR.Distab13_12T "" UBYTE ident 1 100 0 1 BIT_MASK 0x1 ECU_ADDRESS 0x822781 /end MEASUREMENT
/begin MEASUREMENT FSW_OS01_En.Distab13_12T "" UBYTE ident 1 100 0 1 BIT_MASK 0x1 ECU_ADDRESS 0x82276E /end MEASUREMENT
/begin MEASUREMENT FSW_OS01_S_Dcyc.Distab13_12T "" UWORD TPU_Dcyc 1 100 0.0 100.0 ECU_ADDRESS 0x82276A /end MEASUREMENT
/begin MEASUREMENT FSW_OS01_V.Distab13_12T "" UBYTE ident 1 100 0 1 BIT_MASK 0x1 ECU_ADDRESS 0x82276F /end MEASUREMENT
/begin MEASUREMENT FSW_OS02_En.Distab13_12T "" UBYTE ident 1 100 0 1 BIT_MASK 0x1 ECU_ADDRESS 0x822770 /end MEASUREMENT
/begin MEASUREMENT FSW_OS02_S_Dcyc.Distab13_12T "" UWORD TPU_Dcyc 1 100 0.0 100.0 ECU_ADDRESS 0x82276C /end MEASUREMENT
/begin MEASUREMENT FSW_OS02_V.Distab13_12T "" UBYTE ident 1 100 0 1 BIT_MASK 0x1 ECU_ADDRESS 0x822771 /end MEASUREMENT
/begin MEASUREMENT FSW_OS03.Distab13_12T "" UBYTE ident 1 100 0 1 BIT_MASK 0x1 ECU_ADDRESS 0x822772 /end MEASUREMENT
/begin MEASUREMENT FSW_OS04.Distab13_12T "" UBYTE ident 1 100 0 1 BIT_MASK 0x1 ECU_ADDRESS 0x822773 /end MEASUREMENT
/begin MEASUREMENT FSW_OS05a.Distab13_12T "" UBYTE ident 1 100 0 1 BIT_MASK 0x1 ECU_ADDRESS 0x822774 /end MEASUREMENT
/begin MEASUREMENT FSW_OS05b.Distab13_12T "" UBYTE ident 1 100 0 1 BIT_MASK 0x1 ECU_ADDRESS 0x822775 /end MEASUREMENT
/begin MEASUREMENT FSW_OS05c.Distab13_12T "" UBYTE ident 1 100 0 1 BIT_MASK 0x1 ECU_ADDRESS 0x822776 /end MEASUREMENT
/begin MEASUREMENT FSW_OS06.Distab13_12T "" UBYTE ident 1 100 0 1 BIT_MASK 0x1 ECU_ADDRESS 0x822777 /end MEASUREMENT
/begin MEASUREMENT FSW_OS07.Distab13_12T "" UBYTE ident 1 100 0 1 BIT_MASK 0x1 ECU_ADDRESS 0x822778 /end MEASUREMENT
/begin MEASUREMENT FSW_OS08.Distab13_12T "" UBYTE ident 1 100 0 1 BIT_MASK 0x1 ECU_ADDRESS 0x822779 /end MEASUREMENT
/begin MEASUREMENT FSW_OS09.Distab13_12T "" UBYTE ident 1 100 0 1 BIT_MASK 0x1 ECU_ADDRESS 0x82277A /end MEASUREMENT
/begin MEASUREMENT FSW_OS10.Distab13_12T "" UBYTE ident 1 100 0 1 BIT_MASK 0x1 ECU_ADDRESS 0x82277B /end MEASUREMENT
/begin MEASUREMENT FSW_OS11.Distab13_12T "" UBYTE ident 1 100 0 1 BIT_MASK 0x1 ECU_ADDRESS 0x82277C /end MEASUREMENT
/begin MEASUREMENT FSW_OS12.Distab13_12T "" UBYTE ident 1 100 0 1 BIT_MASK 0x1 ECU_ADDRESS 0x82277D /end MEASUREMENT
/begin MEASUREMENT FSW_OS13.Distab13_12T "" UBYTE ident 1 100 0 1 BIT_MASK 0x1 ECU_ADDRESS 0x82277E /end MEASUREMENT
/begin MEASUREMENT FSW_OS14.Distab13_12T "" UBYTE ident 1 100 0 1 BIT_MASK 0x1 ECU_ADDRESS 0x82277F /end MEASUREMENT
/begin MEASUREMENT FSW_OS15.Distab13_12T "" UBYTE ident 1 100 0 1 BIT_MASK 0x1 ECU_ADDRESS 0x822780 /end MEASUREMENT
/begin MEASUREMENT l_ResetTimer_b.EV0_Roundtrip.XCP_SHELL "" UBYTE ident 1 100 0 1 BIT_MASK 0x1 ECU_ADDRESS 0x7F9390 /end MEASUREMENT
/begin MEASUREMENT l_ResetTimer_b.EV0_Rx.XCP_SHELL "" UBYTE ident 1 100 0 1 BIT_MASK 0x1 ECU_ADDRESS 0x7F93AC /end MEASUREMENT
/begin MEASUREMENT l_ResetTimer_b.EV0_Sample.XCP_SHELL "" UBYTE ident 1 100 0 1 BIT_MASK 0x1 ECU_ADDRESS 0x7F93D0 /end MEASUREMENT
/begin MEASUREMENT l_ResetTimer_b.EV0_Stim.XCP_SHELL "" UBYTE ident 1 100 0 1 BIT_MASK 0x1 ECU_ADDRESS 0x7F93E8 /end MEASUREMENT
/begin MEASUREMENT l_ResetTimer_b.EV0_Tx.XCP_SHELL "" UBYTE ident 1 100 0 1 BIT_MASK 0x1 ECU_ADDRESS 0x7F9404 /end MEASUREMENT
/begin MEASUREMENT l_StartTicks_u32.EV0_Roundtrip.XCP_SHELL "" ULONG ident 1 100 0 4294967295 ECU_ADDRESS 0x7F9388 /end MEASUREMENT
/begin MEASUREMENT l_StartTicks_u32.EV0_Rx.XCP_SHELL "" ULONG ident 1 100 0 4294967295 ECU_ADDRESS 0x7F93A0 /end MEASUREMENT
/begin MEASUREMENT l_StartTicks_u32.EV0_Sample.XCP_SHELL "" ULONG ident 1 100 0 4294967295 ECU_ADDRESS 0x7F93C8 /end MEASUREMENT
/begin MEASUREMENT l_StartTicks_u32.EV0_Stim.XCP_SHELL "" ULONG ident 1 100 0 4294967295 ECU_ADDRESS 0x7F93E0 /end MEASUREMENT
/begin MEASUREMENT l_StartTicks_u32.EV0_Tx.XCP_SHELL "" ULONG ident 1 100 0 4294967295 ECU_ADDRESS 0x7F93F8 /end MEASUREMENT
/begin MEASUREMENT l_StopTicks_u32.EV0_Roundtrip.XCP_SHELL "" ULONG ident 1 100 0 4294967295 ECU_ADDRESS 0x7F938C /end MEASUREMENT
/begin MEASUREMENT l_StopTicks_u32.EV0_Rx.XCP_SHELL "" ULONG ident 1 100 0 4294967295 ECU_ADDRESS 0x7F93A4 /end MEASUREMENT
/begin MEASUREMENT l_StopTicks_u32.EV0_Sample.XCP_SHELL "" ULONG ident 1 100 0 4294967295 ECU_ADDRESS 0x7F93CC /end MEASUREMENT
/begin MEASUREMENT l_StopTicks_u32.EV0_Stim.XCP_SHELL "" ULONG ident 1 100 0 4294967295 ECU_ADDRESS 0x7F93E4 /end MEASUREMENT
/begin MEASUREMENT l_StopTicks_u32.EV0_Tx.XCP_SHELL "" ULONG ident 1 100 0 4294967295 ECU_ADDRESS 0x7F93FC /end MEASUREMENT
/begin MEASUREMENT l_Timeout_b.EV0_Roundtrip.XCP_SHELL "" UBYTE ident 1 100 0 1 BIT_MASK 0x1 ECU_ADDRESS 0x7F9391 /end MEASUREMENT
/begin MEASUREMENT l_Timeout_b.EV0_Rx.XCP_SHELL "" UBYTE ident 1 100 0 1 BIT_MASK 0x1 ECU_ADDRESS 0x7F93AD /end MEASUREMENT
/begin MEASUREMENT l_Timeout_b.EV0_Sample.XCP_SHELL "" UBYTE ident 1 100 0 1 BIT_MASK 0x1 ECU_ADDRESS 0x7F93D1 /end MEASUREMENT
/begin MEASUREMENT l_Timeout_b.EV0_Stim.XCP_SHELL "" UBYTE ident 1 100 0 1 BIT_MASK 0x1 ECU_ADDRESS 0x7F93E9 /end MEASUREMENT
/begin MEASUREMENT l_Timeout_b.EV0_Tx.XCP_SHELL "" UBYTE ident 1 100 0 1 BIT_MASK 0x1 ECU_ADDRESS 0x7F9405 /end MEASUREMENT
/begin MEASUREMENT l_TimeSum_u32.EV0_Rx.XCP_SHELL "" ULONG TickType2ms 1 100 0.0 1227133.512857143 ECU_ADDRESS 0x7F93A8 /end MEASUREMENT
/begin MEASUREMENT l_TimeSum_u32.EV0_Tx.XCP_SHELL "" ULONG TickType2ms 1 100 0.0 1227133.512857143 ECU_ADDRESS 0x7F9400 /end MEASUREMENT
/begin MEASUREMENT Max.MIN_MAX_Tick2Time.EV0_Roundtrip.XCP_SHELL "" ULONG TickType2ms 1 100 0.0 1227133.512857143 ECU_ADDRESS 0x7F9394 /end MEASUREMENT
/begin MEASUREMENT Max.MIN_MAX_Tick2Time.EV0_Sample.XCP_SHELL "" ULONG TickType2ms 1 100 0.0 1227133.512857143 ECU_ADDRESS 0x7F93D4 /end MEASUREMENT
/begin MEASUREMENT Max.MIN_MAX_Tick2Time.EV0_Stim.XCP_SHELL "" ULONG TickType2ms 1 100 0.0 1227133.512857143 ECU_ADDRESS 0x7F93EC /end MEASUREMENT
/begin MEASUREMENT Max.Time.EV0_Rx.XCP_SHELL "" ULONG TickType2ms 1 100 0.0 1227133.512857143 ECU_ADDRESS 0x7F93B0 /end MEASUREMENT
/begin MEASUREMENT Max.Time.EV0_Tx.XCP_SHELL "" ULONG TickType2ms 1 100 0.0 1227133.512857143 ECU_ADDRESS 0x7F9408 /end MEASUREMENT
/begin MEASUREMENT Max.TimeSum.EV0_Rx.XCP_SHELL "" ULONG TickType2ms 1 100 0.0 1227133.512857143 ECU_ADDRESS 0x7F93BC /end MEASUREMENT
/begin MEASUREMENT Max.TimeSum.EV0_Tx.XCP_SHELL "" ULONG TickType2ms 1 100 0.0 1227133.512857143 ECU_ADDRESS 0x7F9414 /end MEASUREMENT
/begin MEASUREMENT Min.MIN_MAX_Tick2Time.EV0_Roundtrip.XCP_SHELL "" ULONG TickType2ms 1 100 0.0 1227133.512857143 ECU_ADDRESS 0x7F9398 /end MEASUREMENT
/begin MEASUREMENT Min.MIN_MAX_Tick2Time.EV0_Sample.XCP_SHELL "" ULONG TickType2ms 1 100 0.0 1227133.512857143 ECU_ADDRESS 0x7F93D8 /end MEASUREMENT
/begin MEASUREMENT Min.MIN_MAX_Tick2Time.EV0_Stim.XCP_SHELL "" ULONG TickType2ms 1 100 0.0 1227133.512857143 ECU_ADDRESS 0x7F93F0 /end MEASUREMENT
/begin MEASUREMENT Min.Time.EV0_Rx.XCP_SHELL "" ULONG TickType2ms 1 100 0.0 1227133.512857143 ECU_ADDRESS 0x7F93B4 /end MEASUREMENT
/begin MEASUREMENT Min.Time.EV0_Tx.XCP_SHELL "" ULONG TickType2ms 1 100 0.0 1227133.512857143 ECU_ADDRESS 0x7F940C /end MEASUREMENT
/begin MEASUREMENT Min.TimeSum.EV0_Rx.XCP_SHELL "" ULONG TickType2ms 1 100 0.0 1227133.512857143 ECU_ADDRESS 0x7F93C0 /end MEASUREMENT
/begin MEASUREMENT Min.TimeSum.EV0_Tx.XCP_SHELL "" ULONG TickType2ms 1 100 0.0 1227133.512857143 ECU_ADDRESS 0x7F9418 /end MEASUREMENT
/begin MEASUREMENT sint16_01.E_sint16.R01 "" SWORD ident 1 100 -32768 32767 ECU_ADDRESS 0x822888 DISPLAY_IDENTIFIER sint16_01.E_sint16.R01_DISP_ID_R01 /end MEASUREMENT
/begin MEASUREMENT sint16_01.E_sint16.R02 "" SWORD ident 1 100 -32768 32767 ECU_ADDRESS 0x822A58 DISPLAY_IDENTIFIER sint16_01.E_sint16.R02_DISP_ID_R02 /end MEASUREMENT
/begin MEASUREMENT sint16_01.E_sint16.R03 "" SWORD ident 1 100 -32768 32767 ECU_ADDRESS 0x822B28 DISPLAY_IDENTIFIER sint16_01.E_sint16.R03_DISP_ID_R03 /end MEASUREMENT
/begin MEASUREMENT sint16_01.E_sint16.R04 "" SWORD ident 1 100 -32768 32767 ECU_ADDRESS 0x822BF8 /end MEASUREMENT
/begin MEASUREMENT sint16_01.E_sint16.R05 "" SWORD ident 1 100 -32768 32767 ECU_ADDRESS 0x822CC8 /end MEASUREMENT
/begin MEASUREMENT sint16_01.E_sint16.R06 "" SWORD ident 1 100 -32768 32767 ECU_ADDRESS 0x822CF8 /end MEASUREMENT
/begin MEASUREMENT sint16_01.E_sint16.R07 "" SWORD ident 1 100 -32768 32767 ECU_ADDRESS 0x822D28 /end MEASUREMENT
/begin MEASUREMENT sint16_01.E_sint16.R08 "" SWORD ident 1 100 -32768 32767 ECU_ADDRESS 0x822D58 /end MEASUREMENT
/begin MEASUREMENT sint16_01.E_sint16.R09 "" SWORD ident 1 100 -32768 32767 ECU_ADDRESS 0x822D88 /end MEASUREMENT
/begin MEASUREMENT sint16_01.E_sint16.R10 "" SWORD ident 1 100 -32768 32767 ECU_ADDRESS 0x822DB8 /end MEASUREMENT
/begin MEASUREMENT sint16_01.E_sint16.R11 "" SWORD ident 1 100 -32768 32767 ECU_ADDRESS 0x822DE8 /end MEASUREMENT
/begin MEASUREMENT sint16_01.E_sint16.R12 "" SWORD ident 1 100 -32768 32767 ECU_ADDRESS 0x822E18 /end MEASUREMENT
/begin MEASUREMENT sint16_01.E_sint16.R13 "" SWORD ident 1 100 -32768 32767 ECU_ADDRESS 0x822E48 /end MEASUREMENT
/begin MEASUREMENT sint16_01.E_sint16.R14 "" SWORD ident 1 100 -32768 32767 ECU_ADDRESS 0x822E78 /end MEASUREMENT
/begin MEASUREMENT sint16_01.E_sint16.R15 "" SWORD ident 1 100 -32768 32767 ECU_ADDRESS 0x822EA8 /end MEASUREMENT
/begin MEASUREMENT sint16_01.E_sint16_1.R01_16bit "" SWORD ident 1 100 -32768 32767 ECU_ADDRESS 0x8228B8 /end MEASUREMENT
/begin MEASUREMENT sint16_01.E_sint16_2.R01_16bit "" SWORD ident 1 100 -32768 32767 ECU_ADDRESS 0x8228C8 /end MEASUREMENT
/begin MEASUREMENT sint16_01.E_sint16_3.R01_16bit "" SWORD ident 1 100 -32768 32767 ECU_ADDRESS 0x8228D8 /end MEASUREMENT
/begin MEASUREMENT sint16_01.E_sint16_4.R01_16bit "" SWORD ident 1 100 -32768 32767 ECU_ADDRESS 0x8228E8 /end MEASUREMENT
/begin MEASUREMENT sint16_02.E_sint16.R01 "" SWORD ident 1 100 -32768 32767 ECU_ADDRESS 0x82288A DISPLAY_IDENTIFIER sint16_02.E_sint16.R01_DISP_ID_R01 /end MEASUREMENT
/begin MEASUREMENT sint16_02.E_sint16.R02 "" SWORD ident 1 100 -32768 32767 ECU_ADDRESS 0x822A5A DISPLAY_IDENTIFIER sint16_02.E_sint16.R02_DISP_ID_R02 /end MEASUREMENT
/begin MEASUREMENT sint16_02.E_sint16.R03 "" SWORD ident 1 100 -32768 32767 ECU_ADDRESS 0x822B2A DISPLAY_IDENTIFIER sint16_02.E_sint16.R03_DISP_ID_R03 /end MEASUREMENT
/begin MEASUREMENT sint16_02.E_sint16.R04 "" SWORD ident 1 100 -32768 32767 ECU_ADDRESS 0x822BFA /end MEASUREMENT
/begin MEASUREMENT sint16_02.E_sint16.R05 "" SWORD ident 1 100 -32768 32767 ECU_ADDRESS 0x822CCA /end MEASUREMENT
/begin MEASUREMENT sint16_02.E_sint16.R06 "" SWORD ident 1 100 -32768 32767 ECU_ADDRESS 0x822CFA /end MEASUREMENT
/begin MEASUREMENT sint16_02.E_sint16.R07 "" SWORD ident 1 100 -32768 32767 ECU_ADDRESS 0x822D2A /end MEASUREMENT
/begin MEASUREMENT sint16_02.E_sint16.R08 "" SWORD ident 1 100 -32768 32767 ECU_ADDRESS 0x822D5A /end MEASUREMENT
/begin MEASUREMENT sint16_02.E_sint16.R09 "" SWORD ident 1 100 -32768 32767 ECU_ADDRESS 0x822D8A /end MEASUREMENT
/begin MEASUREMENT sint16_02.E_sint16.R10 "" SWORD ident 1 100 -32768 32767 ECU_ADDRESS 0x822DBA /end MEASUREMENT
/begin MEASUREMENT sint16_02.E_sint16.R11 "" SWORD ident 1 100 -32768 32767 ECU_ADDRESS 0x822DEA /end MEASUREMENT
/begin MEASUREMENT sint16_02.E_sint16.R12 "" SWORD ident 1 100 -32768 32767 ECU_ADDRESS 0x822E1A /end MEASUREMENT
/begin MEASUREMENT sint16_02.E_sint16.R13 "" SWORD ident 1 100 -32768 32767 ECU_ADDRESS 0x822E4A /end MEASUREMENT
/begin MEASUREMENT sint16_02.E_sint16.R14 "" SWORD ident 1 100 -32768 32767 ECU_ADDRESS 0x822E7A /end MEASUREMENT
/begin MEASUREMENT sint16_02.E_sint16.R15 "" SWORD ident 1 100 -32768 32767 ECU_ADDRESS 0x822EAA /end MEASUREMENT
/begin MEASUREMENT sint16_02.E_sint16_1.R01_16bit "" SWORD ident 1 100 -32768 32767 ECU_ADDRESS 0x8228BA /end MEASUREMENT
/begin MEASUREMENT sint16_02.E_sint16_2.R01_16bit "" SWORD ident 1 100 -32768 32767 ECU_ADDRESS 0x8228CA /end MEASUREMENT
/begin MEASUREMENT sint16_02.E_sint16_3.R01_16bit "" SWORD ident 1 100 -32768 32767 ECU_ADDRESS 0x8228DA /end MEASUREMENT
/begin MEASUREMENT sint16_02.E_sint16_4.R01_16bit "" SWORD ident 1 100 -32768 32767 ECU_ADDRESS 0x8228EA /end MEASUREMENT
/begin MEASUREMENT sint16_03.E_sint16.R01 "" SWORD ident 1 100 -32768 32767 ECU_ADDRESS 0x82288C DISPLAY_IDENTIFIER sint16_03.E_sint16.R01_DISP_ID_R01 /end MEASUREMENT
/begin MEASUREMENT sint16_03.E_sint16.R02 "" SWORD ident 1 100 -32768 32767 ECU_ADDRESS 0x822A5C DISPLAY_IDENTIFIER sint16_03.E_sint16.R02_DISP_ID_R02 /end MEASUREMENT
/begin MEASUREMENT sint16_03.E_sint16.R03 "" SWORD ident 1 100 -32768 32767 ECU_ADDRESS 0x822B2C DISPLAY_IDENTIFIER sint16_03.E_sint16.R03_DISP_ID_R03 /end MEASUREMENT
/begin MEASUREMENT sint16_03.E_sint16.R04 "" SWORD ident 1 100 -32768 32767 ECU_ADDRESS 0x822BFC /end MEASUREMENT
/begin MEASUREMENT sint16_03.E_sint16.R05 "" SWORD ident 1 100 -32768 32767 ECU_ADDRESS 0x822CCC /end MEASUREMENT
/begin MEASUREMENT sint16_03.E_sint16.R06 "" SWORD ident 1 100 -32768 32767 ECU_ADDRESS 0x822CFC /end MEASUREMENT
/begin MEASUREMENT sint16_03.E_sint16.R07 "" SWORD ident 1 100 -32768 32767 ECU_ADDRESS 0x822D2C /end MEASUREMENT
/begin MEASUREMENT sint16_03.E_sint16.R08 "" SWORD ident 1 100 -32768 32767 ECU_ADDRESS 0x822D5C /end MEASUREMENT
/begin MEASUREMENT sint16_03.E_sint16.R09 "" SWORD ident 1 100 -32768 32767 ECU_ADDRESS 0x822D8C /end MEASUREMENT
/begin MEASUREMENT sint16_03.E_sint16.R10 "" SWORD ident 1 100 -32768 32767 ECU_ADDRESS 0x822DBC /end MEASUREMENT
/begin MEASUREMENT sint16_03.E_sint16.R11 "" SWORD ident 1 100 -32768 32767 ECU_ADDRESS 0x822DEC /end MEASUREMENT
/begin MEASUREMENT sint16_03.E_sint16.R12 "" SWORD ident 1 100 -32768 32767 ECU_ADDRESS 0x822E1C /end MEASUREMENT
/begin MEASUREMENT sint16_03.E_sint16.R13 "" SWORD ident 1 100 -32768 32767 ECU_ADDRESS 0x822E4C /end MEASUREMENT
/begin MEASUREMENT sint16_03.E_sint16.R14 "" SWORD ident 1 100 -32768 32767 ECU_ADDRESS 0x822E7C /end MEASUREMENT
/begin MEASUREMENT sint16_03.E_sint16.R15 "" SWORD ident 1 100 -32768 32767 ECU_ADDRESS 0x822EAC /end MEASUREMENT
/begin MEASUREMENT sint16_03.E_sint16_1.R01_16bit "" SWORD ident 1 100 -32768 32767 ECU_ADDRESS 0x8228BC /end MEASUREMENT
/begin MEASUREMENT sint16_03.E_sint16_2.R01_16bit "" SWORD ident 1 100 -32768 32767 ECU_ADDRESS 0x8228CC /end MEASUREMENT
/begin MEASUREMENT sint16_03.E_sint16_3.R01_16bit "" SWORD ident 1 100 -32768 32767 ECU_ADDRESS 0x8228DC /end MEASUREMENT
/begin MEASUREMENT sint16_03.E_sint16_4.R01_16bit "" SWORD ident 1 100 -32768 32767 ECU_ADDRESS 0x8228EC /end MEASUREMENT
/begin MEASUREMENT sint16_04.E_sint16.R01 "" SWORD ident 1 100 -32768 32767 ECU_ADDRESS 0x82288E DISPLAY_IDENTIFIER sint16_04.E_sint16.R01_DISP_ID_R01 /end MEASUREMENT
/begin MEASUREMENT sint16_04.E_sint16.R02 "" SWORD ident 1 100 -32768 32767 ECU_ADDRESS 0x822A5E DISPLAY_IDENTIFIER sint16_04.E_sint16.R02_DISP_ID_R02 /end MEASUREMENT
/begin MEASUREMENT sint16_04.E_sint16.R03 "" SWORD ident 1 100 -32768 32767 ECU_ADDRESS 0x822B2E DISPLAY_IDENTIFIER sint16_04.E_sint16.R03_DISP_ID_R03 /end MEASUREMENT
/begin MEASUREMENT sint16_04.E_sint16.R04 "" SWORD ident 1 100 -32768 32767 ECU_ADDRESS 0x822BFE /end MEASUREMENT
/begin MEASUREMENT sint16_04.E_sint16.R05 "" SWORD ident 1 100 -32768 32767 ECU_ADDRESS 0x822CCE /end MEASUREMENT
/begin MEASUREMENT sint16_04.E_sint16.R06 "" SWORD ident 1 100 -32768 32767 ECU_ADDRESS 0x822CFE /end MEASUREMENT
/begin MEASUREMENT sint16_04.E_sint16.R07 "" SWORD ident 1 100 -32768 32767 ECU_ADDRESS 0x822D2E /end MEASUREMENT
/begin MEASUREMENT sint16_04.E_sint16.R08 "" SWORD ident 1 100 -32768 32767 ECU_ADDRESS 0x822D5E /end MEASUREMENT
/begin MEASUREMENT sint16_04.E_sint16.R09 "" SWORD ident 1 100 -32768 32767 ECU_ADDRESS 0x822D8E /end MEASUREMENT
/begin MEASUREMENT sint16_04.E_sint16.R10 "" SWORD ident 1 100 -32768 32767 ECU_ADDRESS 0x822DBE /end MEASUREMENT
/begin MEASUREMENT sint16_04.E_sint16.R11 "" SWORD ident 1 100 -32768 32767 ECU_ADDRESS 0x822DEE /end MEASUREMENT
/begin MEASUREMENT sint16_04.E_sint16.R12 "" SWORD ident 1 100 -32768 32767 ECU_ADDRESS 0x822E1E /end MEASUREMENT
/begin MEASUREMENT sint16_04.E_sint16.R13 "" SWORD ident 1 100 -32768 32767 ECU_ADDRESS 0x822E4E /end MEASUREMENT
/begin MEASUREMENT sint16_04.E_sint16.R14 "" SWORD ident 1 100 -32768 32767 ECU_ADDRESS 0x822E7E /end MEASUREMENT
/begin MEASUREMENT sint16_04.E_sint16.R15 "" SWORD ident 1 100 -32768 32767 ECU_ADDRESS 0x822EAE /end MEASUREMENT
/begin MEASUREMENT sint16_04.E_sint16_1.R01_16bit "" SWORD ident 1 100 -32768 32767 ECU_ADDRESS 0x8228BE /end MEASUREMENT
/begin MEASUREMENT sint16_04.E_sint16_2.R01_16bit "" SWORD ident 1 100 -32768 32767 ECU_ADDRESS 0x8228CE /end MEASUREMENT
/begin MEASUREMENT sint16_04.E_sint16_3.R01_16bit "" SWORD ident 1 100 -32768 32767 ECU_ADDRESS 0x8228DE /end MEASUREMENT
/begin MEASUREMENT sint16_04.E_sint16_4.R01_16bit "" SWORD ident 1 100 -32768 32767 ECU_ADDRESS 0x8228EE /end MEASUREMENT
/begin MEASUREMENT sint16_05.E_sint16.R01 "" SWORD ident 1 100 -32768 32767 ECU_ADDRESS 0x822890 DISPLAY_IDENTIFIER sint16_05.E_sint16.R01_DISP_ID_R01 /end MEASUREMENT
/begin MEASUREMENT sint16_05.E_sint16.R02 "" SWORD ident 1 100 -32768 32767 ECU_ADDRESS 0x822A60 DISPLAY_IDENTIFIER sint16_05.E_sint16.R02_DISP_ID_R02 /end MEASUREMENT
/begin MEASUREMENT sint16_05.E_sint16.R03 "" SWORD ident 1 100 -32768 32767 ECU_ADDRESS 0x822B30 DISPLAY_IDENTIFIER sint16_05.E_sint16.R03_DISP_ID_R03 /end MEASUREMENT
/begin MEASUREMENT sint16_05.E_sint16.R04 "" SWORD ident 1 100 -32768 32767 ECU_ADDRESS 0x822C00 /end MEASUREMENT
/begin MEASUREMENT sint16_05.E_sint16.R05 "" SWORD ident 1 100 -32768 32767 ECU_ADDRESS 0x822CD0 /end MEASUREMENT
/begin MEASUREMENT sint16_05.E_sint16.R06 "" SWORD ident 1 100 -32768 32767 ECU_ADDRESS 0x822D00 /end MEASUREMENT
/begin MEASUREMENT sint16_05.E_sint16.R07 "" SWORD ident 1 100 -32768 32767 ECU_ADDRESS 0x822D30 /end MEASUREMENT
/begin MEASUREMENT sint16_05.E_sint16.R08 "" SWORD ident 1 100 -32768 32767 ECU_ADDRESS 0x822D60 /end MEASUREMENT
/begin MEASUREMENT sint16_05.E_sint16.R09 "" SWORD ident 1 100 -32768 32767 ECU_ADDRESS 0x822D90 /end MEASUREMENT
/begin MEASUREMENT sint16_05.E_sint16.R10 "" SWORD ident 1 100 -32768 32767 ECU_ADDRESS 0x822DC0 /end MEASUREMENT
/begin MEASUREMENT sint16_05.E_sint16.R11 "" SWORD ident 1 100 -32768 32767 ECU_ADDRESS 0x822DF0 /end MEASUREMENT
/begin MEASUREMENT sint16_05.E_sint16.R12 "" SWORD ident 1 100 -32768 32767 ECU_ADDRESS 0x822E20 /end MEASUREMENT
/begin MEASUREMENT sint16_05.E_sint16.R13 "" SWORD ident 1 100 -32768 32767 ECU_ADDRESS 0x822E50 /end MEASUREMENT
/begin MEASUREMENT sint16_05.E_sint16.R14 "" SWORD ident 1 100 -32768 32767 ECU_ADDRESS 0x822E80 /end MEASUREMENT
/begin MEASUREMENT sint16_05.E_sint16.R15 "" SWORD ident 1 100 -32768 32767 ECU_ADDRESS 0x822EB0 /end MEASUREMENT
/begin MEASUREMENT sint16_05.E_sint16_1.R01_16bit "" SWORD ident 1 100 -32768 32767 ECU_ADDRESS 0x8228C0 /end MEASUREMENT
/begin MEASUREMENT sint16_05.E_sint16_2.R01_16bit "" SWORD ident 1 100 -32768 32767 ECU_ADDRESS 0x8228D0 /end MEASUREMENT
/begin MEASUREMENT sint16_05.E_sint16_3.R01_16bit "" SWORD ident 1 100 -32768 32767 ECU_ADDRESS 0x8228E0 /end MEASUREMENT
/begin MEASUREMENT sint16_05.E_sint16_4.R01_16bit "" SWORD ident 1 100 -32768 32767 ECU_ADDRESS 0x8228F0 /end MEASUREMENT
/begin MEASUREMENT sint16_06.E_sint16.R01 "" SWORD ident 1 100 -32768 32767 ECU_ADDRESS 0x822892 DISPLAY_IDENTIFIER sint16_06.E_sint16.R01_DISP_ID_R01 /end MEASUREMENT
/begin MEASUREMENT sint16_06.E_sint16.R02 "" SWORD ident 1 100 -32768 32767 ECU_ADDRESS 0x822A62 DISPLAY_IDENTIFIER sint16_06.E_sint16.R02_DISP_ID_R02 /end MEASUREMENT
/begin MEASUREMENT sint16_06.E_sint16.R03 "" SWORD ident 1 100 -32768 32767 ECU_ADDRESS 0x822B32 DISPLAY_IDENTIFIER sint16_06.E_sint16.R03_DISP_ID_R03 /end MEASUREMENT
/begin MEASUREMENT sint16_06.E_sint16.R04 "" SWORD ident 1 100 -32768 32767 ECU_ADDRESS 0x822C02 /end MEASUREMENT
/begin MEASUREMENT sint16_06.E_sint16.R05 "" SWORD ident 1 100 -32768 32767 ECU_ADDRESS 0x822CD2 /end MEASUREMENT
/begin MEASUREMENT sint16_06.E_sint16.R06 "" SWORD ident 1 100 -32768 32767 ECU_ADDRESS 0x822D02 /end MEASUREMENT
/begin MEASUREMENT sint16_06.E_sint16.R07 "" SWORD ident 1 100 -32768 32767 ECU_ADDRESS 0x822D32 /end MEASUREMENT
/begin MEASUREMENT sint16_06.E_sint16.R08 "" SWORD ident 1 100 -32768 32767 ECU_ADDRESS 0x822D62 /end MEASUREMENT
/begin MEASUREMENT sint16_06.E_sint16.R09 "" SWORD ident 1 100 -32768 32767 ECU_ADDRESS 0x822D92 /end MEASUREMENT
/begin MEASUREMENT sint16_06.E_sint16.R10 "" SWORD ident 1 100 -32768 32767 ECU_ADDRESS 0x822DC2 /end MEASUREMENT
/begin MEASUREMENT sint16_06.E_sint16.R11 "" SWORD ident 1 100 -32768 32767 ECU_ADDRESS 0x822DF2 /end MEASUREMENT
/begin MEASUREMENT sint16_06.E_sint16.R12 "" SWORD ident 1 100 -32768 32767 ECU_ADDRESS 0x822E22 /end MEASUREMENT
/begin MEASUREMENT sint16_06.E_sint16.R13 "" SWORD ident 1 100 -32768 32767 ECU_ADDRESS 0x822E52 /end MEASUREMENT
/begin MEASUREMENT sint16_06.E_sint16.R14 "" SWORD ident 1 100 -32768 32767 ECU_ADDRESS 0x822E82 /end MEASUREMENT
/begin MEASUREMENT sint16_06.E_sint16.R15 "" SWORD ident 1 100 -32768 32767 ECU_ADDRESS 0x822EB2 /end MEASUREMENT
/begin MEASUREMENT sint16_06.E_sint16_1.R01_16bit "" SWORD ident 1 100 -32768 32767 ECU_ADDRESS 0x8228C2 /end MEASUREMENT
/begin MEASUREMENT sint16_06.E_sint16_2.R01_16bit "" SWORD ident 1 100 -32768 32767 ECU_ADDRESS 0x8228D2 /end MEASUREMENT
/begin MEASUREMENT sint16_06.E_sint16_3.R01_16bit "" SWORD ident 1 100 -32768 32767 ECU_ADDRESS 0x8228E2 /end MEASUREMENT
/begin MEASUREMENT sint16_06.E_sint16_4.R01_16bit "" SWORD ident 1 100 -32768 32767 ECU_ADDRESS 0x8228F2 /end MEASUREMENT
/begin MEASUREMENT sint16_07.E_sint16.R01 "" SWORD ident 1 100 -32768 32767 ECU_ADDRESS 0x822894 DISPLAY_IDENTIFIER sint16_07.E_sint16.R01_DISP_ID_R01 /end MEASUREMENT
/begin MEASUREMENT sint16_07.E_sint16.R02 "" SWORD ident 1 100 -32768 32767 ECU_ADDRESS 0x822A64 DISPLAY_IDENTIFIER sint16_07.E_sint16.R02_DISP_ID_R02 /end MEASUREMENT
/begin MEASUREMENT sint16_07.E_sint16.R03 "" SWORD ident 1 100 -32768 32767 ECU_ADDRESS 0x822B34 DISPLAY_IDENTIFIER sint16_07.E_sint16.R03_DISP_ID_R03 /end MEASUREMENT
/begin MEASUREMENT sint16_07.E_sint16.R04 "" SWORD ident 1 100 -32768 32767 ECU_ADDRESS 0x822C04 /end MEASUREMENT
/begin MEASUREMENT sint16_07.E_sint16.R05 "" SWORD ident 1 100 -32768 32767 ECU_ADDRESS 0x822CD4 /end MEASUREMENT
/begin MEASUREMENT sint16_07.E_sint16.R06 "" SWORD ident 1 100 -32768 32767 ECU_ADDRESS 0x822D04 /end MEASUREMENT
/begin MEASUREMENT sint16_07.E_sint16.R07 "" SWORD ident 1 100 -32768 32767 ECU_ADDRESS 0x822D34 /end MEASUREMENT
/begin MEASUREMENT sint16_07.E_sint16.R08 "" SWORD ident 1 100 -32768 32767 ECU_ADDRESS 0x822D64 /end MEASUREMENT
/begin MEASUREMENT sint16_07.E_sint16.R09 "" SWORD ident 1 100 -32768 32767 ECU_ADDRESS 0x822D94 /end MEASUREMENT
/begin MEASUREMENT sint16_07.E_sint16.R10 "" SWORD ident 1 100 -32768 32767 ECU_ADDRESS 0x822DC4 /end MEASUREMENT
/begin MEASUREMENT sint16_07.E_sint16.R11 "" SWORD ident 1 100 -32768 32767 ECU_ADDRESS 0x822DF4 /end MEASUREMENT
/begin MEASUREMENT sint16_07.E_sint16.R12 "" SWORD ident 1 100 -32768 32767 ECU_ADDRESS 0x822E24 /end MEASUREMENT
/begin MEASUREMENT sint16_07.E_sint16.R13 "" SWORD ident 1 100 -32768 32767 ECU_ADDRESS 0x822E54 /end MEASUREMENT
/begin MEASUREMENT sint16_07.E_sint16.R14 "" SWORD ident 1 100 -32768 32767 ECU_ADDRESS 0x822E84 /end MEASUREMENT
/begin MEASUREMENT sint16_07.E_sint16.R15 "" SWORD ident 1 100 -32768 32767 ECU_ADDRESS 0x822EB4 /end MEASUREMENT
/begin MEASUREMENT sint16_07.E_sint16_1.R01_16bit "" SWORD ident 1 100 -32768 32767 ECU_ADDRESS 0x8228C4 /end MEASUREMENT
/begin MEASUREMENT sint16_07.E_sint16_2.R01_16bit "" SWORD ident 1 100 -32768 32767 ECU_ADDRESS 0x8228D4 /end MEASUREMENT
/begin MEASUREMENT sint16_07.E_sint16_3.R01_16bit "" SWORD ident 1 100 -32768 32767 ECU_ADDRESS 0x8228E4 /end MEASUREMENT
/begin MEASUREMENT sint16_07.E_sint16_4.R01_16bit "" SWORD ident 1 100 -32768 32767 ECU_ADDRESS 0x8228F4 /end MEASUREMENT
/begin MEASUREMENT sint16_08.E_sint16.R01 "" SWORD ident 1 100 -32768 32767 ECU_ADDRESS 0x822896 DISPLAY_IDENTIFIER sint16_08.E_sint16.R01_DISP_ID_R01 /end MEASUREMENT
/begin MEASUREMENT sint16_08.E_sint16.R02 "" SWORD ident 1 100 -32768 32767 ECU_ADDRESS 0x822A66 DISPLAY_IDENTIFIER sint16_08.E_sint16.R02_DISP_ID_R02 /end MEASUREMENT
/begin MEASUREMENT sint16_08.E_sint16.R03 "" SWORD ident 1 100 -32768 32767 ECU_ADDRESS 0x822B36 DISPLAY_IDENTIFIER sint16_08.E_sint16.R03_DISP_ID_R03 /end MEASUREMENT
/begin MEASUREMENT sint16_08.E_sint16.R04 "" SWORD ident 1 100 -32768 32767 ECU_ADDRESS 0x822C06 /end MEASUREMENT
/begin MEASUREMENT sint16_08.E_sint16.R05 "" SWORD ident 1 100 -32768 32767 ECU_ADDRESS 0x822CD6 /end MEASUREMENT
/begin MEASUREMENT sint16_08.E_sint16.R06 "" SWORD ident 1 100 -32768 32767 ECU_ADDRESS 0x822D06 /end MEASUREMENT
/begin MEASUREMENT sint16_08.E_sint16.R07 "" SWORD ident 1 100 -32768 32767 ECU_ADDRESS 0x822D36 /end MEASUREMENT
/begin MEASUREMENT sint16_08.E_sint16.R08 "" SWORD ident 1 100 -32768 32767 ECU_ADDRESS 0x822D66 /end MEASUREMENT
/begin MEASUREMENT sint16_08.E_sint16.R09 "" SWORD ident 1 100 -32768 32767 ECU_ADDRESS 0x822D96 /end MEASUREMENT
/begin MEASUREMENT sint16_08.E_sint16.R10 "" SWORD ident 1 100 -32768 32767 ECU_ADDRESS 0x822DC6 /end MEASUREMENT
/begin MEASUREMENT sint16_08.E_sint16.R11 "" SWORD ident 1 100 -32768 32767 ECU_ADDRESS 0x822DF6 /end MEASUREMENT
/begin MEASUREMENT sint16_08.E_sint16.R12 "" SWORD ident 1 100 -32768 32767 ECU_ADDRESS 0x822E26 /end MEASUREMENT
/begin MEASUREMENT sint16_08.E_sint16.R13 "" SWORD ident 1 100 -32768 32767 ECU_ADDRESS 0x822E56 /end MEASUREMENT
/begin MEASUREMENT sint16_08.E_sint16.R14 "" SWORD ident 1 100 -32768 32767 ECU_ADDRESS 0x822E86 /end MEASUREMENT
/begin MEASUREMENT sint16_08.E_sint16.R15 "" SWORD ident 1 100 -32768 32767 ECU_ADDRESS 0x822EB6 /end MEASUREMENT
/begin MEASUREMENT sint16_08.E_sint16_1.R01_16bit "" SWORD ident 1 100 -32768 32767 ECU_ADDRESS 0x8228C6 /end MEASUREMENT
/begin MEASUREMENT sint16_08.E_sint16_2.R01_16bit "" SWORD ident 1 100 -32768 32767 ECU_ADDRESS 0x8228D6 /end MEASUREMENT
/begin MEASUREMENT sint16_08.E_sint16_3.R01_16bit "" SWORD ident 1 100 -32768 32767 ECU_ADDRESS 0x8228E6 /end MEASUREMENT
/begin MEASUREMENT sint16_08.E_sint16_4.R01_16bit "" SWORD ident 1 100 -32768 32767 ECU_ADDRESS 0x8228F6 /end MEASUREMENT
/begin MEASUREMENT sint32_01.E_sint32.R01_B "" SLONG ident 1 100 -2147483648 2147483647 ECU_ADDRESS 0x822A18 /end MEASUREMENT
/begin MEASUREMENT sint32_01.E_sint32.R02_B "" SLONG ident 1 100 -2147483648 2147483647 ECU_ADDRESS 0x822AE8 /end MEASUREMENT
/begin MEASUREMENT sint32_01.E_sint32.R03_B "" SLONG ident 1 100 -2147483648 2147483647 ECU_ADDRESS 0x822BB8 /end MEASUREMENT
/begin MEASUREMENT sint32_01.E_sint32.R04_B "" SLONG ident 1 100 -2147483648 2147483647 ECU_ADDRESS 0x822C88 /end MEASUREMENT
/begin MEASUREMENT sint32_02.E_sint32.R01_B "" SLONG ident 1 100 -2147483648 2147483647 ECU_ADDRESS 0x822A1C /end MEASUREMENT
/begin MEASUREMENT sint32_02.E_sint32.R02_B "" SLONG ident 1 100 -2147483648 2147483647 ECU_ADDRESS 0x822AEC /end MEASUREMENT
/begin MEASUREMENT sint32_02.E_sint32.R03_B "" SLONG ident 1 100 -2147483648 2147483647 ECU_ADDRESS 0x822BBC /end MEASUREMENT
/begin MEASUREMENT sint32_02.E_sint32.R04_B "" SLONG ident 1 100 -2147483648 2147483647 ECU_ADDRESS 0x822C8C /end MEASUREMENT
/begin MEASUREMENT sint32_03.E_sint32.R01_B "" SLONG ident 1 100 -2147483648 2147483647 ECU_ADDRESS 0x822A20 /end MEASUREMENT
/begin MEASUREMENT sint32_03.E_sint32.R02_B "" SLONG ident 1 100 -2147483648 2147483647 ECU_ADDRESS 0x822AF0 /end MEASUREMENT
/begin MEASUREMENT sint32_03.E_sint32.R03_B "" SLONG ident 1 100 -2147483648 2147483647 ECU_ADDRESS 0x822BC0 /end MEASUREMENT
/begin MEASUREMENT sint32_03.E_sint32.R04_B "" SLONG ident 1 100 -2147483648 2147483647 ECU_ADDRESS 0x822C90 /end MEASUREMENT
/begin MEASUREMENT sint32_04.E_sint32.R01_B "" SLONG ident 1 100 -2147483648 2147483647 ECU_ADDRESS 0x822A24 /end MEASUREMENT
/begin MEASUREMENT sint32_04.E_sint32.R02_B "" SLONG ident 1 100 -2147483648 2147483647 ECU_ADDRESS 0x822AF4 /end MEASUREMENT
/begin MEASUREMENT sint32_04.E_sint32.R03_B "" SLONG ident 1 100 -2147483648 2147483647 ECU_ADDRESS 0x822BC4 /end MEASUREMENT
/begin MEASUREMENT sint32_04.E_sint32.R04_B "" SLONG ident 1 100 -2147483648 2147483647 ECU_ADDRESS 0x822C94 /end MEASUREMENT
/begin MEASUREMENT sint32_05.E_sint32.R01_B "" SLONG ident 1 100 -2147483648 2147483647 ECU_ADDRESS 0x822A28 /end MEASUREMENT
/begin MEASUREMENT sint32_05.E_sint32.R02_B "" SLONG ident 1 100 -2147483648 2147483647 ECU_ADDRESS 0x822AF8 /end MEASUREMENT
/begin MEASUREMENT sint32_05.E_sint32.R03_B "" SLONG ident 1 100 -2147483648 2147483647 ECU_ADDRESS 0x822BC8 /end MEASUREMENT
/begin MEASUREMENT sint32_05.E_sint32.R04_B "" SLONG ident 1 100 -2147483648 2147483647 ECU_ADDRESS 0x822C98 /end MEASUREMENT
/begin MEASUREMENT sint32_06.E_sint32.R01_B "" SLONG ident 1 100 -2147483648 2147483647 ECU_ADDRESS 0x822A2C /end MEASUREMENT
/begin MEASUREMENT sint32_06.E_sint32.R02_B "" SLONG ident 1 100 -2147483648 2147483647 ECU_ADDRESS 0x822AFC /end MEASUREMENT
/begin MEASUREMENT sint32_06.E_sint32.R03_B "" SLONG ident 1 100 -2147483648 2147483647 ECU_ADDRESS 0x822BCC /end MEASUREMENT
/begin MEASUREMENT sint32_06.E_sint32.R04_B "" SLONG ident 1 100 -2147483648 2147483647 ECU_ADDRESS 0x822C9C /end MEASUREMENT
/begin MEASUREMENT sint32_07.E_sint32.R01_B "" SLONG ident 1 100 -2147483648 2147483647 ECU_ADDRESS 0x822A30 /end MEASUREMENT
/begin MEASUREMENT sint32_07.E_sint32.R02_B "" SLONG ident 1 100 -2147483648 2147483647 ECU_ADDRESS 0x822B00 /end MEASUREMENT
/begin MEASUREMENT sint32_07.E_sint32.R03_B "" SLONG ident 1 100 -2147483648 2147483647 ECU_ADDRESS 0x822BD0 /end MEASUREMENT
/begin MEASUREMENT sint32_07.E_sint32.R04_B "" SLONG ident 1 100 -2147483648 2147483647 ECU_ADDRESS 0x822CA0 /end MEASUREMENT
/begin MEASUREMENT sint32_08.E_sint32.R01_B "" SLONG ident 1 100 -2147483648 2147483647 ECU_ADDRESS 0x822A34 /end MEASUREMENT
/begin MEASUREMENT sint32_08.E_sint32.R02_B "" SLONG ident 1 100 -2147483648 2147483647 ECU_ADDRESS 0x822B04 /end MEASUREMENT
/begin MEASUREMENT sint32_08.E_sint32.R03_B "" SLONG ident 1 100 -2147483648 2147483647 ECU_ADDRESS 0x822BD4 /end MEASUREMENT
/begin MEASUREMENT sint32_08.E_sint32.R04_B "" SLONG ident 1 100 -2147483648 2147483647 ECU_ADDRESS 0x822CA4 /end MEASUREMENT
/begin MEASUREMENT sint8_01.E_sint8.R01 "" SBYTE ident 1 100 -128 127 ECU_ADDRESS 0x822898 DISPLAY_IDENTIFIER sint8_01.E_sint8.R01_DISP_ID_R01 /end MEASUREMENT
/begin MEASUREMENT sint8_01.E_sint8.R02 "" SBYTE ident 1 100 -128 127 ECU_ADDRESS 0x822A68 DISPLAY_IDENTIFIER sint8_01.E_sint8.R02_DISP_ID_R02 /end MEASUREMENT
/begin MEASUREMENT sint8_01.E_sint8.R03 "" SBYTE ident 1 100 -128 127 ECU_ADDRESS 0x822B38 DISPLAY_IDENTIFIER sint8_01.E_sint8.R03_DISP_ID_R03 /end MEASUREMENT
/begin MEASUREMENT sint8_01.E_sint8.R04 "" SBYTE ident 1 100 -128 127 ECU_ADDRESS 0x822C08 /end MEASUREMENT
/begin MEASUREMENT sint8_01.E_sint8.R05 "" SBYTE ident 1 100 -128 127 ECU_ADDRESS 0x822CD8 /end MEASUREMENT
/begin MEASUREMENT sint8_01.E_sint8.R06 "" SBYTE ident 1 100 -128 127 ECU_ADDRESS 0x822D08 /end MEASUREMENT
/begin MEASUREMENT sint8_01.E_sint8.R07 "" SBYTE ident 1 100 -128 127 ECU_ADDRESS 0x822D38 /end MEASUREMENT
/begin MEASUREMENT sint8_01.E_sint8.R08 "" SBYTE ident 1 100 -128 127 ECU_ADDRESS 0x822D68 /end MEASUREMENT
/begin MEASUREMENT sint8_01.E_sint8.R09 "" SBYTE ident 1 100 -128 127 ECU_ADDRESS 0x822D98 /end MEASUREMENT
/begin MEASUREMENT sint8_01.E_sint8.R10 "" SBYTE ident 1 100 -128 127 ECU_ADDRESS 0x822DC8 /end MEASUREMENT
/begin MEASUREMENT sint8_01.E_sint8.R11 "" SBYTE ident 1 100 -128 127 ECU_ADDRESS 0x822DF8 /end MEASUREMENT
/begin MEASUREMENT sint8_01.E_sint8.R12 "" SBYTE ident 1 100 -128 127 ECU_ADDRESS 0x822E28 /end MEASUREMENT
/begin MEASUREMENT sint8_01.E_sint8.R13 "" SBYTE ident 1 100 -128 127 ECU_ADDRESS 0x822E58 /end MEASUREMENT
/begin MEASUREMENT sint8_01.E_sint8.R14 "" SBYTE ident 1 100 -128 127 ECU_ADDRESS 0x822E88 /end MEASUREMENT
/begin MEASUREMENT sint8_01.E_sint8.R15 "" SBYTE ident 1 100 -128 127 ECU_ADDRESS 0x822EB8 /end MEASUREMENT
/begin MEASUREMENT sint8_01.E_sint8.R16 "" SBYTE ident 1 100 -128 127 ECU_ADDRESS 0x822ED8 /end MEASUREMENT
/begin MEASUREMENT sint8_01.E_sint8_1.R01_8bit "" SBYTE ident 1 100 -128 127 ECU_ADDRESS 0x822938 /end MEASUREMENT
/begin MEASUREMENT sint8_01.E_sint8_2.R01_8bit "" SBYTE ident 1 100 -128 127 ECU_ADDRESS 0x822940 /end MEASUREMENT
/begin MEASUREMENT sint8_01.E_sint8_3.R01_8bit "" SBYTE ident 1 100 -128 127 ECU_ADDRESS 0x822948 /end MEASUREMENT
/begin MEASUREMENT sint8_01.E_sint8_4.R01_8bit "" SBYTE ident 1 100 -128 127 ECU_ADDRESS 0x822950 /end MEASUREMENT
/begin MEASUREMENT sint8_01.E_sint8_5.R01_8bit "" SBYTE ident 1 100 -128 127 ECU_ADDRESS 0x822958 /end MEASUREMENT
/begin MEASUREMENT sint8_01.E_sint8_6.R01_8bit "" SBYTE ident 1 100 -128 127 ECU_ADDRESS 0x822960 /end MEASUREMENT
/begin MEASUREMENT sint8_01.E_sint8_7.R01_8bit "" SBYTE ident 1 100 -128 127 ECU_ADDRESS 0x822968 /end MEASUREMENT
/begin MEASUREMENT sint8_01.E_sint8_8.R01_8bit "" SBYTE ident 1 100 -128 127 ECU_ADDRESS 0x822970 /end MEASUREMENT
/begin MEASUREMENT sint8_02.E_sint8.R01 "" SBYTE ident 1 100 -128 127 ECU_ADDRESS 0x822899 DISPLAY_IDENTIFIER sint8_02.E_sint8.R01_DISP_ID_R01 /end MEASUREMENT
/begin MEASUREMENT sint8_02.E_sint8.R02 "" SBYTE ident 1 100 -128 127 ECU_ADDRESS 0x822A69 DISPLAY_IDENTIFIER sint8_02.E_sint8.R02_DISP_ID_R02 /end MEASUREMENT
/begin MEASUREMENT sint8_02.E_sint8.R03 "" SBYTE ident 1 100 -128 127 ECU_ADDRESS 0x822B39 DISPLAY_IDENTIFIER sint8_02.E_sint8.R03_DISP_ID_R03 /end MEASUREMENT
/begin MEASUREMENT sint8_02.E_sint8.R04 "" SBYTE ident 1 100 -128 127 ECU_ADDRESS 0x822C09 /end MEASUREMENT
/begin MEASUREMENT sint8_02.E_sint8.R05 "" SBYTE ident 1 100 -128 127 ECU_ADDRESS 0x822CD9 /end MEASUREMENT
/begin MEASUREMENT sint8_02.E_sint8.R06 "" SBYTE ident 1 100 -128 127 ECU_ADDRESS 0x822D09 /end MEASUREMENT
/begin MEASUREMENT sint8_02.E_sint8.R07 "" SBYTE ident 1 100 -128 127 ECU_ADDRESS 0x822D39 /end MEASUREMENT
/begin MEASUREMENT sint8_02.E_sint8.R08 "" SBYTE ident 1 100 -128 127 ECU_ADDRESS 0x822D69 /end MEASUREMENT
/begin MEASUREMENT sint8_02.E_sint8.R09 "" SBYTE ident 1 100 -128 127 ECU_ADDRESS 0x822D99 /end MEASUREMENT
/begin MEASUREMENT sint8_02.E_sint8.R10 "" SBYTE ident 1 100 -128 127 ECU_ADDRESS 0x822DC9 /end MEASUREMENT
/begin MEASUREMENT sint8_02.E_sint8.R11 "" SBYTE ident 1 100 -128 127 ECU_ADDRESS 0x822DF9 /end MEASUREMENT
/begin MEASUREMENT sint8_02.E_sint8.R12 "" SBYTE ident 1 100 -128 127 ECU_ADDRESS 0x822E29 /end MEASUREMENT
/begin MEASUREMENT sint8_02.E_sint8.R13 "" SBYTE ident 1 100 -128 127 ECU_ADDRESS 0x822E59 /end MEASUREMENT
/begin MEASUREMENT sint8_02.E_sint8.R14 "" SBYTE ident 1 100 -128 127 ECU_ADDRESS 0x822E89 /end MEASUREMENT
/begin MEASUREMENT sint8_02.E_sint8.R15 "" SBYTE ident 1 100 -128 127 ECU_ADDRESS 0x822EB9 /end MEASUREMENT
/begin MEASUREMENT sint8_02.E_sint8.R16 "" SBYTE ident 1 100 -128 127 ECU_ADDRESS 0x822ED9 /end MEASUREMENT
/begin MEASUREMENT sint8_02.E_sint8_1.R01_8bit "" SBYTE ident 1 100 -128 127 ECU_ADDRESS 0x822939 /end MEASUREMENT
/begin MEASUREMENT sint8_02.E_sint8_2.R01_8bit "" SBYTE ident 1 100 -128 127 ECU_ADDRESS 0x822941 /end MEASUREMENT
/begin MEASUREMENT sint8_02.E_sint8_3.R01_8bit "" SBYTE ident 1 100 -128 127 ECU_ADDRESS 0x822949 /end MEASUREMENT
/begin MEASUREMENT sint8_02.E_sint8_4.R01_8bit "" SBYTE ident 1 100 -128 127 ECU_ADDRESS 0x822951 /end MEASUREMENT
/begin MEASUREMENT sint8_02.E_sint8_5.R01_8bit "" SBYTE ident 1 100 -128 127 ECU_ADDRESS 0x822959 /end MEASUREMENT
/begin MEASUREMENT sint8_02.E_sint8_6.R01_8bit "" SBYTE ident 1 100 -128 127 ECU_ADDRESS 0x822961 /end MEASUREMENT
/begin MEASUREMENT sint8_02.E_sint8_7.R01_8bit "" SBYTE ident 1 100 -128 127 ECU_ADDRESS 0x822969 /end MEASUREMENT
/begin MEASUREMENT sint8_02.E_sint8_8.R01_8bit "" SBYTE ident 1 100 -128 127 ECU_ADDRESS 0x822971 /end MEASUREMENT
/begin MEASUREMENT sint8_03.E_sint8.R01 "" SBYTE ident 1 100 -128 127 ECU_ADDRESS 0x82289A DISPLAY_IDENTIFIER sint8_03.E_sint8.R01_DISP_ID_R01 /end MEASUREMENT
/begin MEASUREMENT sint8_03.E_sint8.R02 "" SBYTE ident 1 100 -128 127 ECU_ADDRESS 0x822A6A DISPLAY_IDENTIFIER sint8_03.E_sint8.R02_DISP_ID_R02 /end MEASUREMENT
/begin MEASUREMENT sint8_03.E_sint8.R03 "" SBYTE ident 1 100 -128 127 ECU_ADDRESS 0x822B3A DISPLAY_IDENTIFIER sint8_03.E_sint8.R03_DISP_ID_R03 /end MEASUREMENT
/begin MEASUREMENT sint8_03.E_sint8.R04 "" SBYTE ident 1 100 -128 127 ECU_ADDRESS 0x822C0A /end MEASUREMENT
/begin MEASUREMENT sint8_03.E_sint8.R05 "" SBYTE ident 1 100 -128 127 ECU_ADDRESS 0x822CDA /end MEASUREMENT
/begin MEASUREMENT sint8_03.E_sint8.R06 "" SBYTE ident 1 100 -128 127 ECU_ADDRESS 0x822D0A /end MEASUREMENT
/begin MEASUREMENT sint8_03.E_sint8.R07 "" SBYTE ident 1 100 -128 127 ECU_ADDRESS 0x822D3A /end MEASUREMENT
/begin MEASUREMENT sint8_03.E_sint8.R08 "" SBYTE ident 1 100 -128 127 ECU_ADDRESS 0x822D6A /end MEASUREMENT
/begin MEASUREMENT sint8_03.E_sint8.R09 "" SBYTE ident 1 100 -128 127 ECU_ADDRESS 0x822D9A /end MEASUREMENT
/begin MEASUREMENT sint8_03.E_sint8.R10 "" SBYTE ident 1 100 -128 127 ECU_ADDRESS 0x822DCA /end MEASUREMENT
/begin MEASUREMENT sint8_03.E_sint8.R11 "" SBYTE ident 1 100 -128 127 ECU_ADDRESS 0x822DFA /end MEASUREMENT
/begin MEASUREMENT sint8_03.E_sint8.R12 "" SBYTE ident 1 100 -128 127 ECU_ADDRESS 0x822E2A /end MEASUREMENT
/begin MEASUREMENT sint8_03.E_sint8.R13 "" SBYTE ident 1 100 -128 127 ECU_ADDRESS 0x822E5A /end MEASUREMENT
/begin MEASUREMENT sint8_03.E_sint8.R14 "" SBYTE ident 1 100 -128 127 ECU_ADDRESS 0x822E8A /end MEASUREMENT
/begin MEASUREMENT sint8_03.E_sint8.R15 "" SBYTE ident 1 100 -128 127 ECU_ADDRESS 0x822EBA /end MEASUREMENT
/begin MEASUREMENT sint8_03.E_sint8.R16 "" SBYTE ident 1 100 -128 127 ECU_ADDRESS 0x822EDA /end MEASUREMENT
/begin MEASUREMENT sint8_03.E_sint8_1.R01_8bit "" SBYTE ident 1 100 -128 127 ECU_ADDRESS 0x82293A /end MEASUREMENT
/begin MEASUREMENT sint8_03.E_sint8_2.R01_8bit "" SBYTE ident 1 100 -128 127 ECU_ADDRESS 0x822942 /end MEASUREMENT
/begin MEASUREMENT sint8_03.E_sint8_3.R01_8bit "" SBYTE ident 1 100 -128 127 ECU_ADDRESS 0x82294A /end MEASUREMENT
/begin MEASUREMENT sint8_03.E_sint8_4.R01_8bit "" SBYTE ident 1 100 -128 127 ECU_ADDRESS 0x822952 /end MEASUREMENT
/begin MEASUREMENT sint8_03.E_sint8_5.R01_8bit "" SBYTE ident 1 100 -128 127 ECU_ADDRESS 0x82295A /end MEASUREMENT
/begin MEASUREMENT sint8_03.E_sint8_6.R01_8bit "" SBYTE ident 1 100 -128 127 ECU_ADDRESS 0x822962 /end MEASUREMENT
/begin MEASUREMENT sint8_03.E_sint8_7.R01_8bit "" SBYTE ident 1 100 -128 127 ECU_ADDRESS 0x82296A /end MEASUREMENT
/begin MEASUREMENT sint8_03.E_sint8_8.R01_8bit "" SBYTE ident 1 100 -128 127 ECU_ADDRESS 0x822972 /end MEASUREMENT
/begin MEASUREMENT sint8_04.E_sint8.R01 "" SBYTE ident 1 100 -128 127 ECU_ADDRESS 0x82289B DISPLAY_IDENTIFIER sint8_04.E_sint8.R01_DISP_ID_R01 /end MEASUREMENT
/begin MEASUREMENT sint8_04.E_sint8.R02 "" SBYTE ident 1 100 -128 127 ECU_ADDRESS 0x822A6B DISPLAY_IDENTIFIER sint8_04.E_sint8.R02_DISP_ID_R02 /end MEASUREMENT
/begin MEASUREMENT sint8_04.E_sint8.R03 "" SBYTE ident 1 100 -128 127 ECU_ADDRESS 0x822B3B DISPLAY_IDENTIFIER sint8_04.E_sint8.R03_DISP_ID_R03 /end MEASUREMENT
/begin MEASUREMENT sint8_04.E_sint8.R04 "" SBYTE ident 1 100 -128 127 ECU_ADDRESS 0x822C0B /end MEASUREMENT
/begin MEASUREMENT sint8_04.E_sint8.R05 "" SBYTE ident 1 100 -128 127 ECU_ADDRESS 0x822CDB /end MEASUREMENT
/begin MEASUREMENT sint8_04.E_sint8.R06 "" SBYTE ident 1 100 -128 127 ECU_ADDRESS 0x822D0B /end MEASUREMENT
/begin MEASUREMENT sint8_04.E_sint8.R07 "" SBYTE ident 1 100 -128 127 ECU_ADDRESS 0x822D3B /end MEASUREMENT
/begin MEASUREMENT sint8_04.E_sint8.R08 "" SBYTE ident 1 100 -128 127 ECU_ADDRESS 0x822D6B /end MEASUREMENT
/begin MEASUREMENT sint8_04.E_sint8.R09 "" SBYTE ident 1 100 -128 127 ECU_ADDRESS 0x822D9B /end MEASUREMENT
/begin MEASUREMENT sint8_04.E_sint8.R10 "" SBYTE ident 1 100 -128 127 ECU_ADDRESS 0x822DCB /end MEASUREMENT
/begin MEASUREMENT sint8_04.E_sint8.R11 "" SBYTE ident 1 100 -128 127 ECU_ADDRESS 0x822DFB /end MEASUREMENT
/begin MEASUREMENT sint8_04.E_sint8.R12 "" SBYTE ident 1 100 -128 127 ECU_ADDRESS 0x822E2B /end MEASUREMENT
/begin MEASUREMENT sint8_04.E_sint8.R13 "" SBYTE ident 1 100 -128 127 ECU_ADDRESS 0x822E5B /end MEASUREMENT
/begin MEASUREMENT sint8_04.E_sint8.R14 "" SBYTE ident 1 100 -128 127 ECU_ADDRESS 0x822E8B /end MEASUREMENT
/begin MEASUREMENT sint8_04.E_sint8.R15 "" SBYTE ident 1 100 -128 127 ECU_ADDRESS 0x822EBB /end MEASUREMENT
/begin MEASUREMENT sint8_04.E_sint8.R16 "" SBYTE ident 1 100 -128 127 ECU_ADDRESS 0x822EDB /end MEASUREMENT
/begin MEASUREMENT sint8_04.E_sint8_1.R01_8bit "" SBYTE ident 1 100 -128 127 ECU_ADDRESS 0x82293B /end MEASUREMENT
/begin MEASUREMENT sint8_04.E_sint8_2.R01_8bit "" SBYTE ident 1 100 -128 127 ECU_ADDRESS 0x822943 /end MEASUREMENT
/begin MEASUREMENT sint8_04.E_sint8_3.R01_8bit "" SBYTE ident 1 100 -128 127 ECU_ADDRESS 0x82294B /end MEASUREMENT
/begin MEASUREMENT sint8_04.E_sint8_4.R01_8bit "" SBYTE ident 1 100 -128 127 ECU_ADDRESS 0x822953 /end MEASUREMENT
/begin MEASUREMENT sint8_04.E_sint8_5.R01_8bit "" SBYTE ident 1 100 -128 127 ECU_ADDRESS 0x82295B /end MEASUREMENT
/begin MEASUREMENT sint8_04.E_sint8_6.R01_8bit "" SBYTE ident 1 100 -128 127 ECU_ADDRESS 0x822963 /end MEASUREMENT
/begin MEASUREMENT sint8_04.E_sint8_7.R01_8bit "" SBYTE ident 1 100 -128 127 ECU_ADDRESS 0x82296B /end MEASUREMENT
/begin MEASUREMENT sint8_04.E_sint8_8.R01_8bit "" SBYTE ident 1 100 -128 127 ECU_ADDRESS 0x822973 /end MEASUREMENT
/begin MEASUREMENT sint8_05.E_sint8.R01 "" SBYTE ident 1 100 -128 127 ECU_ADDRESS 0x82289C DISPLAY_IDENTIFIER sint8_05.E_sint8.R01_DISP_ID_R01 /end MEASUREMENT
/begin MEASUREMENT sint8_05.E_sint8.R02 "" SBYTE ident 1 100 -128 127 ECU_ADDRESS 0x822A6C DISPLAY_IDENTIFIER sint8_05.E_sint8.R02_DISP_ID_R02 /end MEASUREMENT
/begin MEASUREMENT sint8_05.E_sint8.R03 "" SBYTE ident 1 100 -128 127 ECU_ADDRESS 0x822B3C DISPLAY_IDENTIFIER sint8_05.E_sint8.R03_DISP_ID_R03 /end MEASUREMENT
/begin MEASUREMENT sint8_05.E_sint8.R04 "" SBYTE ident 1 100 -128 127 ECU_ADDRESS 0x822C0C /end MEASUREMENT
/begin MEASUREMENT sint8_05.E_sint8.R05 "" SBYTE ident 1 100 -128 127 ECU_ADDRESS 0x822CDC /end MEASUREMENT
/begin MEASUREMENT sint8_05.E_sint8.R06 "" SBYTE ident 1 100 -128 127 ECU_ADDRESS 0x822D0C /end MEASUREMENT
/begin MEASUREMENT sint8_05.E_sint8.R07 "" SBYTE ident 1 100 -128 127 ECU_ADDRESS 0x822D3C /end MEASUREMENT
/begin MEASUREMENT sint8_05.E_sint8.R08 "" SBYTE ident 1 100 -128 127 ECU_ADDRESS 0x822D6C /end MEASUREMENT
/begin MEASUREMENT sint8_05.E_sint8.R09 "" SBYTE ident 1 100 -128 127 ECU_ADDRESS 0x822D9C /end MEASUREMENT
/begin MEASUREMENT sint8_05.E_sint8.R10 "" SBYTE ident 1 100 -128 127 ECU_ADDRESS 0x822DCC /end MEASUREMENT
/begin MEASUREMENT sint8_05.E_sint8.R11 "" SBYTE ident 1 100 -128 127 ECU_ADDRESS 0x822DFC /end MEASUREMENT
/begin MEASUREMENT sint8_05.E_sint8.R12 "" SBYTE ident 1 100 -128 127 ECU_ADDRESS 0x822E2C /end MEASUREMENT
/begin MEASUREMENT sint8_05.E_sint8.R13 "" SBYTE ident 1 100 -128 127 ECU_ADDRESS 0x822E5C /end MEASUREMENT
/begin MEASUREMENT sint8_05.E_sint8.R14 "" SBYTE ident 1 100 -128 127 ECU_ADDRESS 0x822E8C /end MEASUREMENT
/begin MEASUREMENT sint8_05.E_sint8.R15 "" SBYTE ident 1 100 -128 127 ECU_ADDRESS 0x822EBC /end MEASUREMENT
/begin MEASUREMENT sint8_05.E_sint8.R16 "" SBYTE ident 1 100 -128 127 ECU_ADDRESS 0x822EDC /end MEASUREMENT
/begin MEASUREMENT sint8_05.E_sint8_1.R01_8bit "" SBYTE ident 1 100 -128 127 ECU_ADDRESS 0x82293C /end MEASUREMENT
/begin MEASUREMENT sint8_05.E_sint8_2.R01_8bit "" SBYTE ident 1 100 -128 127 ECU_ADDRESS 0x822944 /end MEASUREMENT
/begin MEASUREMENT sint8_05.E_sint8_3.R01_8bit "" SBYTE ident 1 100 -128 127 ECU_ADDRESS 0x82294C /end MEASUREMENT
/begin MEASUREMENT sint8_05.E_sint8_4.R01_8bit "" SBYTE ident 1 100 -128 127 ECU_ADDRESS 0x822954 /end MEASUREMENT
/begin MEASUREMENT sint8_05.E_sint8_5.R01_8bit "" SBYTE ident 1 100 -128 127 ECU_ADDRESS 0x82295C /end MEASUREMENT
/begin MEASUREMENT sint8_05.E_sint8_6.R01_8bit "" SBYTE ident 1 100 -128 127 ECU_ADDRESS 0x822964 /end MEASUREMENT
/begin MEASUREMENT sint8_05.E_sint8_7.R01_8bit "" SBYTE ident 1 100 -128 127 ECU_ADDRESS 0x82296C /end MEASUREMENT
/begin MEASUREMENT sint8_05.E_sint8_8.R01_8bit "" SBYTE ident 1 100 -128 127 ECU_ADDRESS 0x822974 /end MEASUREMENT
/begin MEASUREMENT sint8_06.E_sint8.R01 "" SBYTE ident 1 100 -128 127 ECU_ADDRESS 0x82289D DISPLAY_IDENTIFIER sint8_06.E_sint8.R01_DISP_ID_R01 /end MEASUREMENT
/begin MEASUREMENT sint8_06.E_sint8.R02 "" SBYTE ident 1 100 -128 127 ECU_ADDRESS 0x822A6D DISPLAY_IDENTIFIER sint8_06.E_sint8.R02_DISP_ID_R02 /end MEASUREMENT
/begin MEASUREMENT sint8_06.E_sint8.R03 "" SBYTE ident 1 100 -128 127 ECU_ADDRESS 0x822B3D DISPLAY_IDENTIFIER sint8_06.E_sint8.R03_DISP_ID_R03 /end MEASUREMENT
/begin MEASUREMENT sint8_06.E_sint8.R04 "" SBYTE ident 1 100 -128 127 ECU_ADDRESS 0x822C0D /end MEASUREMENT
/begin MEASUREMENT sint8_06.E_sint8.R05 "" SBYTE ident 1 100 -128 127 ECU_ADDRESS 0x822CDD /end MEASUREMENT
/begin MEASUREMENT sint8_06.E_sint8.R06 "" SBYTE ident 1 100 -128 127 ECU_ADDRESS 0x822D0D /end MEASUREMENT
/begin MEASUREMENT sint8_06.E_sint8.R07 "" SBYTE ident 1 100 -128 127 ECU_ADDRESS 0x822D3D /end MEASUREMENT
/begin MEASUREMENT sint8_06.E_sint8.R08 "" SBYTE ident 1 100 -128 127 ECU_ADDRESS 0x822D6D /end MEASUREMENT
/begin MEASUREMENT sint8_06.E_sint8.R09 "" SBYTE ident 1 100 -128 127 ECU_ADDRESS 0x822D9D /end MEASUREMENT
/begin MEASUREMENT sint8_06.E_sint8.R10 "" SBYTE ident 1 100 -128 127 ECU_ADDRESS 0x822DCD /end MEASUREMENT
/begin MEASUREMENT sint8_06.E_sint8.R11 "" SBYTE ident 1 100 -128 127 ECU_ADDRESS 0x822DFD /end MEASUREMENT
/begin MEASUREMENT sint8_06.E_sint8.R12 "" SBYTE ident 1 100 -128 127 ECU_ADDRESS 0x822E2D /end MEASUREMENT
/begin MEASUREMENT sint8_06.E_sint8.R13 "" SBYTE ident 1 100 -128 127 ECU_ADDRESS 0x822E5D /end MEASUREMENT
/begin MEASUREMENT sint8_06.E_sint8.R14 "" SBYTE ident 1 100 -128 127 ECU_ADDRESS 0x822E8D /end MEASUREMENT
/begin MEASUREMENT sint8_06.E_sint8.R15 "" SBYTE ident 1 100 -128 127 ECU_ADDRESS 0x822EBD /end MEASUREMENT
/begin MEASUREMENT sint8_06.E_sint8.R16 "" SBYTE ident 1 100 -128 127 ECU_ADDRESS 0x822EDD /end MEASUREMENT
/begin MEASUREMENT sint8_06.E_sint8_1.R01_8bit "" SBYTE ident 1 100 -128 127 ECU_ADDRESS 0x82293D /end MEASUREMENT
/begin MEASUREMENT sint8_06.E_sint8_2.R01_8bit "" SBYTE ident 1 100 -128 127 ECU_ADDRESS 0x822945 /end MEASUREMENT
/begin MEASUREMENT sint8_06.E_sint8_3.R01_8bit "" SBYTE ident 1 100 -128 127 ECU_ADDRESS 0x82294D /end MEASUREMENT
/begin MEASUREMENT sint8_06.E_sint8_4.R01_8bit "" SBYTE ident 1 100 -128 127 ECU_ADDRESS 0x822955 /end MEASUREMENT
/begin MEASUREMENT sint8_06.E_sint8_5.R01_8bit "" SBYTE ident 1 100 -128 127 ECU_ADDRESS 0x82295D /end MEASUREMENT
/begin MEASUREMENT sint8_06.E_sint8_6.R01_8bit "" SBYTE ident 1 100 -128 127 ECU_ADDRESS 0x822965 /end MEASUREMENT
/begin MEASUREMENT sint8_06.E_sint8_7.R01_8bit "" SBYTE ident 1 100 -128 127 ECU_ADDRESS 0x82296D /end MEASUREMENT
/begin MEASUREMENT sint8_06.E_sint8_8.R01_8bit "" SBYTE ident 1 100 -128 127 ECU_ADDRESS 0x822975 /end MEASUREMENT
/begin MEASUREMENT sint8_07.E_sint8.R01 "" SBYTE ident 1 100 -128 127 ECU_ADDRESS 0x82289E DISPLAY_IDENTIFIER sint8_07.E_sint8.R01_DISP_ID_R01 /end MEASUREMENT
/begin MEASUREMENT sint8_07.E_sint8.R02 "" SBYTE ident 1 100 -128 127 ECU_ADDRESS 0x822A6E DISPLAY_IDENTIFIER sint8_07.E_sint8.R02_DISP_ID_R02 /end MEASUREMENT
/begin MEASUREMENT sint8_07.E_sint8.R03 "" SBYTE ident 1 100 -128 127 ECU_ADDRESS 0x822B3E DISPLAY_IDENTIFIER sint8_07.E_sint8.R03_DISP_ID_R03 /end MEASUREMENT
/begin MEASUREMENT sint8_07.E_sint8.R04 "" SBYTE ident 1 100 -128 127 ECU_ADDRESS 0x822C0E /end MEASUREMENT
/begin MEASUREMENT sint8_07.E_sint8.R05 "" SBYTE ident 1 100 -128 127 ECU_ADDRESS 0x822CDE /end MEASUREMENT
/begin MEASUREMENT sint8_07.E_sint8.R06 "" SBYTE ident 1 100 -128 127 ECU_ADDRESS 0x822D0E /end MEASUREMENT
/begin MEASUREMENT sint8_07.E_sint8.R07 "" SBYTE ident 1 100 -128 127 ECU_ADDRESS 0x822D3E /end MEASUREMENT
/begin MEASUREMENT sint8_07.E_sint8.R08 "" SBYTE ident 1 100 -128 127 ECU_ADDRESS 0x822D6E /end MEASUREMENT
/begin MEASUREMENT sint8_07.E_sint8.R09 "" SBYTE ident 1 100 -128 127 ECU_ADDRESS 0x822D9E /end MEASUREMENT
/begin MEASUREMENT sint8_07.E_sint8.R10 "" SBYTE ident 1 100 -128 127 ECU_ADDRESS 0x822DCE /end MEASUREMENT
/begin MEASUREMENT sint8_07.E_sint8.R11 "" SBYTE ident 1 100 -128 127 ECU_ADDRESS 0x822DFE /end MEASUREMENT
/begin MEASUREMENT sint8_07.E_sint8.R12 "" SBYTE ident 1 100 -128 127 ECU_ADDRESS 0x822E2E /end MEASUREMENT
/begin MEASUREMENT sint8_07.E_sint8.R13 "" SBYTE ident 1 100 -128 127 ECU_ADDRESS 0x822E5E /end MEASUREMENT
/begin MEASUREMENT sint8_07.E_sint8.R14 "" SBYTE ident 1 100 -128 127 ECU_ADDRESS 0x822E8E /end MEASUREMENT
/begin MEASUREMENT sint8_07.E_sint8.R15 "" SBYTE ident 1 100 -128 127 ECU_ADDRESS 0x822EBE /end MEASUREMENT
/begin MEASUREMENT sint8_07.E_sint8.R16 "" SBYTE ident 1 100 -128 127 ECU_ADDRESS 0x822EDE /end MEASUREMENT
/begin MEASUREMENT sint8_07.E_sint8_1.R01_8bit "" SBYTE ident 1 100 -128 127 ECU_ADDRESS 0x82293E /end MEASUREMENT
/begin MEASUREMENT sint8_07.E_sint8_2.R01_8bit "" SBYTE ident 1 100 -128 127 ECU_ADDRESS 0x822946 /end MEASUREMENT
/begin MEASUREMENT sint8_07.E_sint8_3.R01_8bit "" SBYTE ident 1 100 -128 127 ECU_ADDRESS 0x82294E /end MEASUREMENT
/begin MEASUREMENT sint8_07.E_sint8_4.R01_8bit "" SBYTE ident 1 100 -128 127 ECU_ADDRESS 0x822956 /end MEASUREMENT
/begin MEASUREMENT sint8_07.E_sint8_5.R01_8bit "" SBYTE ident 1 100 -128 127 ECU_ADDRESS 0x82295E /end MEASUREMENT
/begin MEASUREMENT sint8_07.E_sint8_6.R01_8bit "" SBYTE ident 1 100 -128 127 ECU_ADDRESS 0x822966 /end MEASUREMENT
/begin MEASUREMENT sint8_07.E_sint8_7.R01_8bit "" SBYTE ident 1 100 -128 127 ECU_ADDRESS 0x82296E /end MEASUREMENT
/begin MEASUREMENT sint8_07.E_sint8_8.R01_8bit "" SBYTE ident 1 100 -128 127 ECU_ADDRESS 0x822976 /end MEASUREMENT
/begin MEASUREMENT sint8_08.E_sint8.R01 "" SBYTE ident 1 100 -128 127 ECU_ADDRESS 0x82289F DISPLAY_IDENTIFIER sint8_08.E_sint8.R01_DISP_ID_R01 /end MEASUREMENT
/begin MEASUREMENT sint8_08.E_sint8.R02 "" SBYTE ident 1 100 -128 127 ECU_ADDRESS 0x822A6F DISPLAY_IDENTIFIER sint8_08.E_sint8.R02_DISP_ID_R02 /end MEASUREMENT
/begin MEASUREMENT sint8_08.E_sint8.R03 "" SBYTE ident 1 100 -128 127 ECU_ADDRESS 0x822B3F DISPLAY_IDENTIFIER sint8_08.E_sint8.R03_DISP_ID_R03 /end MEASUREMENT
/begin MEASUREMENT sint8_08.E_sint8.R04 "" SBYTE ident 1 100 -128 127 ECU_ADDRESS 0x822C0F /end MEASUREMENT
/begin MEASUREMENT sint8_08.E_sint8.R05 "" SBYTE ident 1 100 -128 127 ECU_ADDRESS 0x822CDF /end MEASUREMENT
/begin MEASUREMENT sint8_08.E_sint8.R06 "" SBYTE ident 1 100 -128 127 ECU_ADDRESS 0x822D0F /end MEASUREMENT
/begin MEASUREMENT sint8_08.E_sint8.R07 "" SBYTE ident 1 100 -128 127 ECU_ADDRESS 0x822D3F /end MEASUREMENT
/begin MEASUREMENT sint8_08.E_sint8.R08 "" SBYTE ident 1 100 -128 127 ECU_ADDRESS 0x822D6F /end MEASUREMENT
/begin MEASUREMENT sint8_08.E_sint8.R09 "" SBYTE ident 1 100 -128 127 ECU_ADDRESS 0x822D9F /end MEASUREMENT
/begin MEASUREMENT sint8_08.E_sint8.R10 "" SBYTE ident 1 100 -128 127 ECU_ADDRESS 0x822DCF /end MEASUREMENT
/begin MEASUREMENT sint8_08.E_sint8.R11 "" SBYTE ident 1 100 -128 127 ECU_ADDRESS 0x822DFF /end MEASUREMENT
/begin MEASUREMENT sint8_08.E_sint8.R12 "" SBYTE ident 1 100 -128 127 ECU_ADDRESS 0x822E2F /end MEASUREMENT
/begin MEASUREMENT sint8_08.E_sint8.R13 "" SBYTE ident 1 100 -128 127 ECU_ADDRESS 0x822E5F /end MEASUREMENT
/begin MEASUREMENT sint8_08.E_sint8.R14 "" SBYTE ident 1 100 -128 127 ECU_ADDRESS 0x822E8F /end MEASUREMENT
/begin MEASUREMENT sint8_08.E_sint8.R15 "" SBYTE ident 1 100 -128 127 ECU_ADDRESS 0x822EBF /end MEASUREMENT
/begin MEASUREMENT sint8_08.E_sint8.R16 "" SBYTE ident 1 100 -128 127 ECU_ADDRESS 0x822EDF /end MEASUREMENT
/begin MEASUREMENT sint8_08.E_sint8_1.R01_8bit "" SBYTE ident 1 100 -128 127 ECU_ADDRESS 0x82293F /end MEASUREMENT
/begin MEASUREMENT sint8_08.E_sint8_2.R01_8bit "" SBYTE ident 1 100 -128 127 ECU_ADDRESS 0x822947 /end MEASUREMENT
/begin MEASUREMENT sint8_08.E_sint8_3.R01_8bit "" SBYTE ident 1 100 -128 127 ECU_ADDRESS 0x82294F /end MEASUREMENT
/begin MEASUREMENT sint8_08.E_sint8_4.R01_8bit "" SBYTE ident 1 100 -128 127 ECU_ADDRESS 0x822957 /end MEASUREMENT
/begin MEASUREMENT sint8_08.E_sint8_5.R01_8bit "" SBYTE ident 1 100 -128 127 ECU_ADDRESS 0x82295F /end MEASUREMENT
/begin MEASUREMENT sint8_08.E_sint8_6.R01_8bit "" SBYTE ident 1 100 -128 127 ECU_ADDRESS 0x822967 /end MEASUREMENT
/begin MEASUREMENT sint8_08.E_sint8_7.R01_8bit "" SBYTE ident 1 100 -128 127 ECU_ADDRESS 0x82296F /end MEASUREMENT
/begin MEASUREMENT sint8_08.E_sint8_8.R01_8bit "" SBYTE ident 1 100 -128 127 ECU_ADDRESS 0x822977 /end MEASUREMENT
/begin MEASUREMENT Time.MIN_MAX_Tick2Time.EV0_Roundtrip.XCP_SHELL "" ULONG TickType2ms 1 100 0.0 1227133.512857143 ECU_ADDRESS 0x7F939C /end MEASUREMENT
/begin MEASUREMENT Time.MIN_MAX_Tick2Time.EV0_Sample.XCP_SHELL "" ULONG TickType2ms 1 100 0.0 1227133.512857143 ECU_ADDRESS 0x7F93DC /end MEASUREMENT
/begin MEASUREMENT Time.MIN_MAX_Tick2Time.EV0_Stim.XCP_SHELL "" ULONG TickType2ms 1 100 0.0 1227133.512857143 ECU_ADDRESS 0x7F93F4 /end MEASUREMENT
/begin MEASUREMENT Time.Time.EV0_Rx.XCP_SHELL "" ULONG TickType2ms 1 100 0.0 1227133.512857143 ECU_ADDRESS 0x7F93B8 /end MEASUREMENT
/begin MEASUREMENT Time.Time.EV0_Tx.XCP_SHELL "" ULONG TickType2ms 1 100 0.0 1227133.512857143 ECU_ADDRESS 0x7F9410 /end MEASUREMENT
/begin MEASUREMENT Time.TimeSum.EV0_Rx.XCP_SHELL "" ULONG TickType2ms 1 100 0.0 1227133.512857143 ECU_ADDRESS 0x7F93C4 /end MEASUREMENT
/begin MEASUREMENT Time.TimeSum.EV0_Tx.XCP_SHELL "" ULONG TickType2ms 1 100 0.0 1227133.512857143 ECU_ADDRESS 0x7F941C /end MEASUREMENT
/begin MEASUREMENT uint16_01.E_uint16.R01 "" UWORD ident 1 100 0 65535 ECU_ADDRESS 0x8228A0 DISPLAY_IDENTIFIER uint16_01.E_uint16.R01_DISP_ID_R01 /end MEASUREMENT
/begin MEASUREMENT uint16_01.E_uint16.R02 "" UWORD ident 1 100 0 65535 ECU_ADDRESS 0x822A70 DISPLAY_IDENTIFIER uint16_01.E_uint16.R02_DISP_ID_R02 /end MEASUREMENT
/begin MEASUREMENT uint16_01.E_uint16.R03 "" UWORD ident 1 100 0 65535 ECU_ADDRESS 0x822B40 DISPLAY_IDENTIFIER uint16_01.E_uint16.R03_DISP_ID_R03 /end MEASUREMENT
/begin MEASUREMENT uint16_01.E_uint16.R04 "" UWORD ident 1 100 0 65535 ECU_ADDRESS 0x822C10 /end MEASUREMENT
/begin MEASUREMENT uint16_01.E_uint16.R05 "" UWORD ident 1 100 0 65535 ECU_ADDRESS 0x822CE0 /end MEASUREMENT
/begin MEASUREMENT uint16_01.E_uint16.R06 "" UWORD ident 1 100 0 65535 ECU_ADDRESS 0x822D10 /end MEASUREMENT
/begin MEASUREMENT uint16_01.E_uint16.R07 "" UWORD ident 1 100 0 65535 ECU_ADDRESS 0x822D40 /end MEASUREMENT
/begin MEASUREMENT uint16_01.E_uint16.R08 "" UWORD ident 1 100 0 65535 ECU_ADDRESS 0x822D70 /end MEASUREMENT
/begin MEASUREMENT uint16_01.E_uint16.R09 "" UWORD ident 1 100 0 65535 ECU_ADDRESS 0x822DA0 /end MEASUREMENT
/begin MEASUREMENT uint16_01.E_uint16.R10 "" UWORD ident 1 100 0 65535 ECU_ADDRESS 0x822DD0 /end MEASUREMENT
/begin MEASUREMENT uint16_01.E_uint16.R11 "" UWORD ident 1 100 0 65535 ECU_ADDRESS 0x822E00 /end MEASUREMENT
/begin MEASUREMENT uint16_01.E_uint16.R12 "" UWORD ident 1 100 0 65535 ECU_ADDRESS 0x822E30 /end MEASUREMENT
/begin MEASUREMENT uint16_01.E_uint16.R13 "" UWORD ident 1 100 0 65535 ECU_ADDRESS 0x822E60 /end MEASUREMENT
/begin MEASUREMENT uint16_01.E_uint16.R14 "" UWORD ident 1 100 0 65535 ECU_ADDRESS 0x822E90 /end MEASUREMENT
/begin MEASUREMENT uint16_01.E_uint16.R15 "" UWORD ident 1 100 0 65535 ECU_ADDRESS 0x822EC0 /end MEASUREMENT
/begin MEASUREMENT uint16_01.E_uint16_1.R01_16bit "" UWORD ident 1 100 0 65535 ECU_ADDRESS 0x8228F8 /end MEASUREMENT
/begin MEASUREMENT uint16_01.E_uint16_2.R01_16bit "" UWORD ident 1 100 0 65535 ECU_ADDRESS 0x822908 /end MEASUREMENT
/begin MEASUREMENT uint16_01.E_uint16_3.R01_16bit "" UWORD ident 1 100 0 65535 ECU_ADDRESS 0x822918 /end MEASUREMENT
/begin MEASUREMENT uint16_01.E_uint16_4.R01_16bit "" UWORD ident 1 100 0 65535 ECU_ADDRESS 0x822928 /end MEASUREMENT
/begin MEASUREMENT uint16_02.E_uint16.R01 "" UWORD ident 1 100 0 65535 ECU_ADDRESS 0x8228A2 DISPLAY_IDENTIFIER uint16_02.E_uint16.R01_DISP_ID_R01 /end MEASUREMENT
/begin MEASUREMENT uint16_02.E_uint16.R02 "" UWORD ident 1 100 0 65535 ECU_ADDRESS 0x822A72 DISPLAY_IDENTIFIER uint16_02.E_uint16.R02_DISP_ID_R02 /end MEASUREMENT
/begin MEASUREMENT uint16_02.E_uint16.R03 "" UWORD ident 1 100 0 65535 ECU_ADDRESS 0x822B42 DISPLAY_IDENTIFIER uint16_02.E_uint16.R03_DISP_ID_R03 /end MEASUREMENT
/begin MEASUREMENT uint16_02.E_uint16.R04 "" UWORD ident 1 100 0 65535 ECU_ADDRESS 0x822C12 /end MEASUREMENT
/begin MEASUREMENT uint16_02.E_uint16.R05 "" UWORD ident 1 100 0 65535 ECU_ADDRESS 0x822CE2 /end MEASUREMENT
/begin MEASUREMENT uint16_02.E_uint16.R06 "" UWORD ident 1 100 0 65535 ECU_ADDRESS 0x822D12 /end MEASUREMENT
/begin MEASUREMENT uint16_02.E_uint16.R07 "" UWORD ident 1 100 0 65535 ECU_ADDRESS 0x822D42 /end MEASUREMENT
/begin MEASUREMENT uint16_02.E_uint16.R08 "" UWORD ident 1 100 0 65535 ECU_ADDRESS 0x822D72 /end MEASUREMENT
/begin MEASUREMENT uint16_02.E_uint16.R09 "" UWORD ident 1 100 0 65535 ECU_ADDRESS 0x822DA2 /end MEASUREMENT
/begin MEASUREMENT uint16_02.E_uint16.R10 "" UWORD ident 1 100 0 65535 ECU_ADDRESS 0x822DD2 /end MEASUREMENT
/begin MEASUREMENT uint16_02.E_uint16.R11 "" UWORD ident 1 100 0 65535 ECU_ADDRESS 0x822E02 /end MEASUREMENT
/begin MEASUREMENT uint16_02.E_uint16.R12 "" UWORD ident 1 100 0 65535 ECU_ADDRESS 0x822E32 /end MEASUREMENT
/begin MEASUREMENT uint16_02.E_uint16.R13 "" UWORD ident 1 100 0 65535 ECU_ADDRESS 0x822E62 /end MEASUREMENT
/begin MEASUREMENT uint16_02.E_uint16.R14 "" UWORD ident 1 100 0 65535 ECU_ADDRESS 0x822E92 /end MEASUREMENT
/begin MEASUREMENT uint16_02.E_uint16.R15 "" UWORD ident 1 100 0 65535 ECU_ADDRESS 0x822EC2 /end MEASUREMENT
/begin MEASUREMENT uint16_02.E_uint16_1.R01_16bit "" UWORD ident 1 100 0 65535 ECU_ADDRESS 0x8228FA /end MEASUREMENT
/begin MEASUREMENT uint16_02.E_uint16_2.R01_16bit "" UWORD ident 1 100 0 65535 ECU_ADDRESS 0x82290A /end MEASUREMENT
/begin MEASUREMENT uint16_02.E_uint16_3.R01_16bit "" UWORD ident 1 100 0 65535 ECU_ADDRESS 0x82291A /end MEASUREMENT
/begin MEASUREMENT uint16_02.E_uint16_4.R01_16bit "" UWORD ident 1 100 0 65535 ECU_ADDRESS 0x82292A /end MEASUREMENT
/begin MEASUREMENT uint16_03.E_uint16.R01 "" UWORD ident 1 100 0 65535 ECU_ADDRESS 0x8228A4 DISPLAY_IDENTIFIER uint16_03.E_uint16.R01_DISP_ID_R01 /end MEASUREMENT
/begin MEASUREMENT uint16_03.E_uint16.R02 "" UWORD ident 1 100 0 65535 ECU_ADDRESS 0x822A74 DISPLAY_IDENTIFIER uint16_03.E_uint16.R02_DISP_ID_R02 /end MEASUREMENT
/begin MEASUREMENT uint16_03.E_uint16.R03 "" UWORD ident 1 100 0 65535 ECU_ADDRESS 0x822B44 DISPLAY_IDENTIFIER uint16_03.E_uint16.R03_DISP_ID_R03 /end MEASUREMENT
/begin MEASUREMENT uint16_03.E_uint16.R04 "" UWORD ident 1 100 0 65535 ECU_ADDRESS 0x822C14 /end MEASUREMENT
/begin MEASUREMENT uint16_03.E_uint16.R05 "" UWORD ident 1 100 0 65535 ECU_ADDRESS 0x822CE4 /end MEASUREMENT
/begin MEASUREMENT uint16_03.E_uint16.R06 "" UWORD ident 1 100 0 65535 ECU_ADDRESS 0x822D14 /end MEASUREMENT
/begin MEASUREMENT uint16_03.E_uint16.R07 "" UWORD ident 1 100 0 65535 ECU_ADDRESS 0x822D44 /end MEASUREMENT
/begin MEASUREMENT uint16_03.E_uint16.R08 "" UWORD ident 1 100 0 65535 ECU_ADDRESS 0x822D74 /end MEASUREMENT
/begin MEASUREMENT uint16_03.E_uint16.R09 "" UWORD ident 1 100 0 65535 ECU_ADDRESS 0x822DA4 /end MEASUREMENT
/begin MEASUREMENT uint16_03.E_uint16.R10 "" UWORD ident 1 100 0 65535 ECU_ADDRESS 0x822DD4 /end MEASUREMENT
/begin MEASUREMENT uint16_03.E_uint16.R11 "" UWORD ident 1 100 0 65535 ECU_ADDRESS 0x822E04 /end MEASUREMENT
/begin MEASUREMENT uint16_03.E_uint16.R12 "" UWORD ident 1 100 0 65535 ECU_ADDRESS 0x822E34 /end MEASUREMENT
/begin MEASUREMENT uint16_03.E_uint16.R13 "" UWORD ident 1 100 0 65535 ECU_ADDRESS 0x822E64 /end MEASUREMENT
/begin MEASUREMENT uint16_03.E_uint16.R14 "" UWORD ident 1 100 0 65535 ECU_ADDRESS 0x822E94 /end MEASUREMENT
/begin MEASUREMENT uint16_03.E_uint16.R15 "" UWORD ident 1 100 0 65535 ECU_ADDRESS 0x822EC4 /end MEASUREMENT
/begin MEASUREMENT uint16_03.E_uint16_1.R01_16bit "" UWORD ident 1 100 0 65535 ECU_ADDRESS 0x8228FC /end MEASUREMENT
/begin MEASUREMENT uint16_03.E_uint16_2.R01_16bit "" UWORD ident 1 100 0 65535 ECU_ADDRESS 0x82290C /end MEASUREMENT
/begin MEASUREMENT uint16_03.E_uint16_3.R01_16bit "" UWORD ident 1 100 0 65535 ECU_ADDRESS 0x82291C /end MEASUREMENT
/begin MEASUREMENT uint16_03.E_uint16_4.R01_16bit "" UWORD ident 1 100 0 65535 ECU_ADDRESS 0x82292C /end MEASUREMENT
/begin MEASUREMENT uint16_04.E_uint16.R01 "" UWORD ident 1 100 0 65535 ECU_ADDRESS 0x8228A6 DISPLAY_IDENTIFIER uint16_04.E_uint16.R01_DISP_ID_R01 /end MEASUREMENT
/begin MEASUREMENT uint16_04.E_uint16.R02 "" UWORD ident 1 100 0 65535 ECU_ADDRESS 0x822A76 DISPLAY_IDENTIFIER uint16_04.E_uint16.R02_DISP_ID_R02 /end MEASUREMENT
/begin MEASUREMENT uint16_04.E_uint16.R03 "" UWORD ident 1 100 0 65535 ECU_ADDRESS 0x822B46 DISPLAY_IDENTIFIER uint16_04.E_uint16.R03_DISP_ID_R03 /end MEASUREMENT
/begin MEASUREMENT uint16_04.E_uint16.R04 "" UWORD ident 1 100 0 65535 ECU_ADDRESS 0x822C16 /end MEASUREMENT
/begin MEASUREMENT uint16_04.E_uint16.R05 "" UWORD ident 1 100 0 65535 ECU_ADDRESS 0x822CE6 /end MEASUREMENT
/begin MEASUREMENT uint16_04.E_uint16.R06 "" UWORD ident 1 100 0 65535 ECU_ADDRESS 0x822D16 /end MEASUREMENT
/begin MEASUREMENT uint16_04.E_uint16.R07 "" UWORD ident 1 100 0 65535 ECU_ADDRESS 0x822D46 /end MEASUREMENT
/begin MEASUREMENT uint16_04.E_uint16.R08 "" UWORD ident 1 100 0 65535 ECU_ADDRESS 0x822D76 /end MEASUREMENT
/begin MEASUREMENT uint16_04.E_uint16.R09 "" UWORD ident 1 100 0 65535 ECU_ADDRESS 0x822DA6 /end MEASUREMENT
/begin MEASUREMENT uint16_04.E_uint16.R10 "" UWORD ident 1 100 0 65535 ECU_ADDRESS 0x822DD6 /end MEASUREMENT
/begin MEASUREMENT uint16_04.E_uint16.R11 "" UWORD ident 1 100 0 65535 ECU_ADDRESS 0x822E06 /end MEASUREMENT
/begin MEASUREMENT uint16_04.E_uint16.R12 "" UWORD ident 1 100 0 65535 ECU_ADDRESS 0x822E36 /end MEASUREMENT
/begin MEASUREMENT uint16_04.E_uint16.R13 "" UWORD ident 1 100 0 65535 ECU_ADDRESS 0x822E66 /end MEASUREMENT
/begin MEASUREMENT uint16_04.E_uint16.R14 "" UWORD ident 1 100 0 65535 ECU_ADDRESS 0x822E96 /end MEASUREMENT
/begin MEASUREMENT uint16_04.E_uint16.R15 "" UWORD ident 1 100 0 65535 ECU_ADDRESS 0x822EC6 /end MEASUREMENT
/begin MEASUREMENT uint16_04.E_uint16_1.R01_16bit "" UWORD ident 1 100 0 65535 ECU_ADDRESS 0x8228FE /end MEASUREMENT
/begin MEASUREMENT uint16_04.E_uint16_2.R01_16bit "" UWORD ident 1 100 0 65535 ECU_ADDRESS 0x82290E /end MEASUREMENT
/begin MEASUREMENT uint16_04.E_uint16_3.R01_16bit "" UWORD ident 1 100 0 65535 ECU_ADDRESS 0x82291E /end MEASUREMENT
/begin MEASUREMENT uint16_04.E_uint16_4.R01_16bit "" UWORD ident 1 100 0 65535 ECU_ADDRESS 0x82292E /end MEASUREMENT
/begin MEASUREMENT uint16_05.E_uint16.R01 "" UWORD ident 1 100 0 65535 ECU_ADDRESS 0x8228A8 DISPLAY_IDENTIFIER uint16_05.E_uint16.R01_DISP_ID_R01 /end MEASUREMENT
/begin MEASUREMENT uint16_05.E_uint16.R02 "" UWORD ident 1 100 0 65535 ECU_ADDRESS 0x822A78 DISPLAY_IDENTIFIER uint16_05.E_uint16.R02_DISP_ID_R02 /end MEASUREMENT
/begin MEASUREMENT uint16_05.E_uint16.R03 "" UWORD ident 1 100 0 65535 ECU_ADDRESS 0x822B48 DISPLAY_IDENTIFIER uint16_05.E_uint16.R03_DISP_ID_R03 /end MEASUREMENT
/begin MEASUREMENT uint16_05.E_uint16.R04 "" UWORD ident 1 100 0 65535 ECU_ADDRESS 0x822C18 /end MEASUREMENT
/begin MEASUREMENT uint16_05.E_uint16.R05 "" UWORD ident 1 100 0 65535 ECU_ADDRESS 0x822CE8 /end MEASUREMENT
/begin MEASUREMENT uint16_05.E_uint16.R06 "" UWORD ident 1 100 0 65535 ECU_ADDRESS 0x822D18 /end MEASUREMENT
/begin MEASUREMENT uint16_05.E_uint16.R07 "" UWORD ident 1 100 0 65535 ECU_ADDRESS 0x822D48 /end MEASUREMENT
/begin MEASUREMENT uint16_05.E_uint16.R08 "" UWORD ident 1 100 0 65535 ECU_ADDRESS 0x822D78 /end MEASUREMENT
/begin MEASUREMENT uint16_05.E_uint16.R09 "" UWORD ident 1 100 0 65535 ECU_ADDRESS 0x822DA8 /end MEASUREMENT
/begin MEASUREMENT uint16_05.E_uint16.R10 "" UWORD ident 1 100 0 65535 ECU_ADDRESS 0x822DD8 /end MEASUREMENT
/begin MEASUREMENT uint16_05.E_uint16.R11 "" UWORD ident 1 100 0 65535 ECU_ADDRESS 0x822E08 /end MEASUREMENT
/begin MEASUREMENT uint16_05.E_uint16.R12 "" UWORD ident 1 100 0 65535 ECU_ADDRESS 0x822E38 /end MEASUREMENT
/begin MEASUREMENT uint16_05.E_uint16.R13 "" UWORD ident 1 100 0 65535 ECU_ADDRESS 0x822E68 /end MEASUREMENT
/begin MEASUREMENT uint16_05.E_uint16.R14 "" UWORD ident 1 100 0 65535 ECU_ADDRESS 0x822E98 /end MEASUREMENT
/begin MEASUREMENT uint16_05.E_uint16.R15 "" UWORD ident 1 100 0 65535 ECU_ADDRESS 0x822EC8 /end MEASUREMENT
/begin MEASUREMENT uint16_05.E_uint16_1.R01_16bit "" UWORD ident 1 100 0 65535 ECU_ADDRESS 0x822900 /end MEASUREMENT
/begin MEASUREMENT uint16_05.E_uint16_2.R01_16bit "" UWORD ident 1 100 0 65535 ECU_ADDRESS 0x822910 /end MEASUREMENT
/begin MEASUREMENT uint16_05.E_uint16_3.R01_16bit "" UWORD ident 1 100 0 65535 ECU_ADDRESS 0x822920 /end MEASUREMENT
/begin MEASUREMENT uint16_05.E_uint16_4.R01_16bit "" UWORD ident 1 100 0 65535 ECU_ADDRESS 0x822930 /end MEASUREMENT
/begin MEASUREMENT uint16_06.E_uint16.R01 "" UWORD ident 1 100 0 65535 ECU_ADDRESS 0x8228AA DISPLAY_IDENTIFIER uint16_06.E_uint16.R01_DISP_ID_R01 /end MEASUREMENT
/begin MEASUREMENT uint16_06.E_uint16.R02 "" UWORD ident 1 100 0 65535 ECU_ADDRESS 0x822A7A DISPLAY_IDENTIFIER uint16_06.E_uint16.R02_DISP_ID_R02 /end MEASUREMENT
/begin MEASUREMENT uint16_06.E_uint16.R03 "" UWORD ident 1 100 0 65535 ECU_ADDRESS 0x822B4A DISPLAY_IDENTIFIER uint16_06.E_uint16.R03_DISP_ID_R03 /end MEASUREMENT
/begin MEASUREMENT uint16_06.E_uint16.R04 "" UWORD ident 1 100 0 65535 ECU_ADDRESS 0x822C1A /end MEASUREMENT
/begin MEASUREMENT uint16_06.E_uint16.R05 "" UWORD ident 1 100 0 65535 ECU_ADDRESS 0x822CEA /end MEASUREMENT
/begin MEASUREMENT uint16_06.E_uint16.R06 "" UWORD ident 1 100 0 65535 ECU_ADDRESS 0x822D1A /end MEASUREMENT
/begin MEASUREMENT uint16_06.E_uint16.R07 "" UWORD ident 1 100 0 65535 ECU_ADDRESS 0x822D4A /end MEASUREMENT
/begin MEASUREMENT uint16_06.E_uint16.R08 "" UWORD ident 1 100 0 65535 ECU_ADDRESS 0x822D7A /end MEASUREMENT
/begin MEASUREMENT uint16_06.E_uint16.R09 "" UWORD ident 1 100 0 65535 ECU_ADDRESS 0x822DAA /end MEASUREMENT
/begin MEASUREMENT uint16_06.E_uint16.R10 "" UWORD ident 1 100 0 65535 ECU_ADDRESS 0x822DDA /end MEASUREMENT
/begin MEASUREMENT uint16_06.E_uint16.R11 "" UWORD ident 1 100 0 65535 ECU_ADDRESS 0x822E0A /end MEASUREMENT
/begin MEASUREMENT uint16_06.E_uint16.R12 "" UWORD ident 1 100 0 65535 ECU_ADDRESS 0x822E3A /end MEASUREMENT
/begin MEASUREMENT uint16_06.E_uint16.R13 "" UWORD ident 1 100 0 65535 ECU_ADDRESS 0x822E6A /end MEASUREMENT
/begin MEASUREMENT uint16_06.E_uint16.R14 "" UWORD ident 1 100 0 65535 ECU_ADDRESS 0x822E9A /end MEASUREMENT
/begin MEASUREMENT uint16_06.E_uint16.R15 "" UWORD ident 1 100 0 65535 ECU_ADDRESS 0x822ECA /end MEASUREMENT
/begin MEASUREMENT uint16_06.E_uint16_1.R01_16bit "" UWORD ident 1 100 0 65535 ECU_ADDRESS 0x822902 /end MEASUREMENT
/begin MEASUREMENT uint16_06.E_uint16_2.R01_16bit "" UWORD ident 1 100 0 65535 ECU_ADDRESS 0x822912 /end MEASUREMENT
/begin MEASUREMENT uint16_06.E_uint16_3.R01_16bit "" UWORD ident 1 100 0 65535 ECU_ADDRESS 0x822922 /end MEASUREMENT
/begin MEASUREMENT uint16_06.E_uint16_4.R01_16bit "" UWORD ident 1 100 0 65535 ECU_ADDRESS 0x822932 /end MEASUREMENT
/begin MEASUREMENT uint16_07.E_uint16.R01 "" UWORD ident 1 100 0 65535 ECU_ADDRESS 0x8228AC DISPLAY_IDENTIFIER uint16_07.E_uint16.R01_DISP_ID_R01 /end MEASUREMENT
/begin MEASUREMENT uint16_07.E_uint16.R02 "" UWORD ident 1 100 0 65535 ECU_ADDRESS 0x822A7C DISPLAY_IDENTIFIER uint16_07.E_uint16.R02_DISP_ID_R02 /end MEASUREMENT
/begin MEASUREMENT uint16_07.E_uint16.R03 "" UWORD ident 1 100 0 65535 ECU_ADDRESS 0x822B4C DISPLAY_IDENTIFIER uint16_07.E_uint16.R03_DISP_ID_R03 /end MEASUREMENT
/begin MEASUREMENT uint16_07.E_uint16.R04 "" UWORD ident 1 100 0 65535 ECU_ADDRESS 0x822C1C /end MEASUREMENT
/begin MEASUREMENT uint16_07.E_uint16.R05 "" UWORD ident 1 100 0 65535 ECU_ADDRESS 0x822CEC /end MEASUREMENT
/begin MEASUREMENT uint16_07.E_uint16.R06 "" UWORD ident 1 100 0 65535 ECU_ADDRESS 0x822D1C /end MEASUREMENT
/begin MEASUREMENT uint16_07.E_uint16.R07 "" UWORD ident 1 100 0 65535 ECU_ADDRESS 0x822D4C /end MEASUREMENT
/begin MEASUREMENT uint16_07.E_uint16.R08 "" UWORD ident 1 100 0 65535 ECU_ADDRESS 0x822D7C /end MEASUREMENT
/begin MEASUREMENT uint16_07.E_uint16.R09 "" UWORD ident 1 100 0 65535 ECU_ADDRESS 0x822DAC /end MEASUREMENT
/begin MEASUREMENT uint16_07.E_uint16.R10 "" UWORD ident 1 100 0 65535 ECU_ADDRESS 0x822DDC /end MEASUREMENT
/begin MEASUREMENT uint16_07.E_uint16.R11 "" UWORD ident 1 100 0 65535 ECU_ADDRESS 0x822E0C /end MEASUREMENT
/begin MEASUREMENT uint16_07.E_uint16.R12 "" UWORD ident 1 100 0 65535 ECU_ADDRESS 0x822E3C /end MEASUREMENT
/begin MEASUREMENT uint16_07.E_uint16.R13 "" UWORD ident 1 100 0 65535 ECU_ADDRESS 0x822E6C /end MEASUREMENT
/begin MEASUREMENT uint16_07.E_uint16.R14 "" UWORD ident 1 100 0 65535 ECU_ADDRESS 0x822E9C /end MEASUREMENT
/begin MEASUREMENT uint16_07.E_uint16.R15 "" UWORD ident 1 100 0 65535 ECU_ADDRESS 0x822ECC /end MEASUREMENT
/begin MEASUREMENT uint16_07.E_uint16_1.R01_16bit "" UWORD ident 1 100 0 65535 ECU_ADDRESS 0x822904 /end MEASUREMENT
/begin MEASUREMENT uint16_07.E_uint16_2.R01_16bit "" UWORD ident 1 100 0 65535 ECU_ADDRESS 0x822914 /end MEASUREMENT
/begin MEASUREMENT uint16_07.E_uint16_3.R01_16bit "" UWORD ident 1 100 0 65535 ECU_ADDRESS 0x822924 /end MEASUREMENT
/begin MEASUREMENT uint16_07.E_uint16_4.R01_16bit "" UWORD ident 1 100 0 65535 ECU_ADDRESS 0x822934 /end MEASUREMENT
/begin MEASUREMENT uint16_08.E_uint16.R01 "" UWORD ident 1 100 0 65535 ECU_ADDRESS 0x8228AE DISPLAY_IDENTIFIER uint16_08.E_uint16.R01_DISP_ID_R01 /end MEASUREMENT
/begin MEASUREMENT uint16_08.E_uint16.R02 "" UWORD ident 1 100 0 65535 ECU_ADDRESS 0x822A7E DISPLAY_IDENTIFIER uint16_08.E_uint16.R02_DISP_ID_R02 /end MEASUREMENT
/begin MEASUREMENT uint16_08.E_uint16.R03 "" UWORD ident 1 100 0 65535 ECU_ADDRESS 0x822B4E DISPLAY_IDENTIFIER uint16_08.E_uint16.R03_DISP_ID_R03 /end MEASUREMENT
/begin MEASUREMENT uint16_08.E_uint16.R04 "" UWORD ident 1 100 0 65535 ECU_ADDRESS 0x822C1E /end MEASUREMENT
/begin MEASUREMENT uint16_08.E_uint16.R05 "" UWORD ident 1 100 0 65535 ECU_ADDRESS 0x822CEE /end MEASUREMENT
/begin MEASUREMENT uint16_08.E_uint16.R06 "" UWORD ident 1 100 0 65535 ECU_ADDRESS 0x822D1E /end MEASUREMENT
/begin MEASUREMENT uint16_08.E_uint16.R07 "" UWORD ident 1 100 0 65535 ECU_ADDRESS 0x822D4E /end MEASUREMENT
/begin MEASUREMENT uint16_08.E_uint16.R08 "" UWORD ident 1 100 0 65535 ECU_ADDRESS 0x822D7E /end MEASUREMENT
/begin MEASUREMENT uint16_08.E_uint16.R09 "" UWORD ident 1 100 0 65535 ECU_ADDRESS 0x822DAE /end MEASUREMENT
/begin MEASUREMENT uint16_08.E_uint16.R10 "" UWORD ident 1 100 0 65535 ECU_ADDRESS 0x822DDE /end MEASUREMENT
/begin MEASUREMENT uint16_08.E_uint16.R11 "" UWORD ident 1 100 0 65535 ECU_ADDRESS 0x822E0E /end MEASUREMENT
/begin MEASUREMENT uint16_08.E_uint16.R12 "" UWORD ident 1 100 0 65535 ECU_ADDRESS 0x822E3E /end MEASUREMENT
/begin MEASUREMENT uint16_08.E_uint16.R13 "" UWORD ident 1 100 0 65535 ECU_ADDRESS 0x822E6E /end MEASUREMENT
/begin MEASUREMENT uint16_08.E_uint16.R14 "" UWORD ident 1 100 0 65535 ECU_ADDRESS 0x822E9E /end MEASUREMENT
/begin MEASUREMENT uint16_08.E_uint16.R15 "" UWORD ident 1 100 0 65535 ECU_ADDRESS 0x822ECE /end MEASUREMENT
/begin MEASUREMENT uint16_08.E_uint16_1.R01_16bit "" UWORD ident 1 100 0 65535 ECU_ADDRESS 0x822906 /end MEASUREMENT
/begin MEASUREMENT uint16_08.E_uint16_2.R01_16bit "" UWORD ident 1 100 0 65535 ECU_ADDRESS 0x822916 /end MEASUREMENT
/begin MEASUREMENT uint16_08.E_uint16_3.R01_16bit "" UWORD ident 1 100 0 65535 ECU_ADDRESS 0x822926 /end MEASUREMENT
/begin MEASUREMENT uint16_08.E_uint16_4.R01_16bit "" UWORD ident 1 100 0 65535 ECU_ADDRESS 0x822936 /end MEASUREMENT
/begin MEASUREMENT uint32_01.E_uint32.R01_B "" ULONG ident 1 100 0 4294967295 ECU_ADDRESS 0x822A38 /end MEASUREMENT
/begin MEASUREMENT uint32_01.E_uint32.R02_B "" ULONG ident 1 100 0 4294967295 ECU_ADDRESS 0x822B08 /end MEASUREMENT
/begin MEASUREMENT uint32_01.E_uint32.R03_B "" ULONG ident 1 100 0 4294967295 ECU_ADDRESS 0x822BD8 /end MEASUREMENT
/begin MEASUREMENT uint32_01.E_uint32.R04_B "" ULONG ident 1 100 0 4294967295 ECU_ADDRESS 0x822CA8 /end MEASUREMENT
/begin MEASUREMENT uint32_02.E_uint32.R01_B "" ULONG ident 1 100 0 4294967295 ECU_ADDRESS 0x822A3C /end MEASUREMENT
/begin MEASUREMENT uint32_02.E_uint32.R02_B "" ULONG ident 1 100 0 4294967295 ECU_ADDRESS 0x822B0C /end MEASUREMENT
/begin MEASUREMENT uint32_02.E_uint32.R03_B "" ULONG ident 1 100 0 4294967295 ECU_ADDRESS 0x822BDC /end MEASUREMENT
/begin MEASUREMENT uint32_02.E_uint32.R04_B "" ULONG ident 1 100 0 4294967295 ECU_ADDRESS 0x822CAC /end MEASUREMENT
/begin MEASUREMENT uint32_03.E_uint32.R01_B "" ULONG ident 1 100 0 4294967295 ECU_ADDRESS 0x822A40 /end MEASUREMENT
/begin MEASUREMENT uint32_03.E_uint32.R02_B "" ULONG ident 1 100 0 4294967295 ECU_ADDRESS 0x822B10 /end MEASUREMENT
/begin MEASUREMENT uint32_03.E_uint32.R03_B "" ULONG ident 1 100 0 4294967295 ECU_ADDRESS 0x822BE0 /end MEASUREMENT
/begin MEASUREMENT uint32_03.E_uint32.R04_B "" ULONG ident 1 100 0 4294967295 ECU_ADDRESS 0x822CB0 /end MEASUREMENT
/begin MEASUREMENT uint32_04.E_uint32.R01_B "" ULONG ident 1 100 0 4294967295 ECU_ADDRESS 0x822A44 /end MEASUREMENT
/begin MEASUREMENT uint32_04.E_uint32.R02_B "" ULONG ident 1 100 0 4294967295 ECU_ADDRESS 0x822B14 /end MEASUREMENT
/begin MEASUREMENT uint32_04.E_uint32.R03_B "" ULONG ident 1 100 0 4294967295 ECU_ADDRESS 0x822BE4 /end MEASUREMENT
/begin MEASUREMENT uint32_04.E_uint32.R04_B "" ULONG ident 1 100 0 4294967295 ECU_ADDRESS 0x822CB4 /end MEASUREMENT
/begin MEASUREMENT uint32_05.E_uint32.R01_B "" ULONG ident 1 100 0 4294967295 ECU_ADDRESS 0x822A48 /end MEASUREMENT
/begin MEASUREMENT uint32_05.E_uint32.R02_B "" ULONG ident 1 100 0 4294967295 ECU_ADDRESS 0x822B18 /end MEASUREMENT
/begin MEASUREMENT uint32_05.E_uint32.R03_B "" ULONG ident 1 100 0 4294967295 ECU_ADDRESS 0x822BE8 /end MEASUREMENT
/begin MEASUREMENT uint32_05.E_uint32.R04_B "" ULONG ident 1 100 0 4294967295 ECU_ADDRESS 0x822CB8 /end MEASUREMENT
/begin MEASUREMENT uint32_06.E_uint32.R01_B "" ULONG ident 1 100 0 4294967295 ECU_ADDRESS 0x822A4C /end MEASUREMENT
/begin MEASUREMENT uint32_06.E_uint32.R02_B "" ULONG ident 1 100 0 4294967295 ECU_ADDRESS 0x822B1C /end MEASUREMENT
/begin MEASUREMENT uint32_06.E_uint32.R03_B "" ULONG ident 1 100 0 4294967295 ECU_ADDRESS 0x822BEC /end MEASUREMENT
/begin MEASUREMENT uint32_06.E_uint32.R04_B "" ULONG ident 1 100 0 4294967295 ECU_ADDRESS 0x822CBC /end MEASUREMENT
/begin MEASUREMENT uint32_07.E_uint32.R01_B "" ULONG ident 1 100 0 4294967295 ECU_ADDRESS 0x822A50 /end MEASUREMENT
/begin MEASUREMENT uint32_07.E_uint32.R02_B "" ULONG ident 1 100 0 4294967295 ECU_ADDRESS 0x822B20 /end MEASUREMENT
/begin MEASUREMENT uint32_07.E_uint32.R03_B "" ULONG ident 1 100 0 4294967295 ECU_ADDRESS 0x822BF0 /end MEASUREMENT
/begin MEASUREMENT uint32_07.E_uint32.R04_B "" ULONG ident 1 100 0 4294967295 ECU_ADDRESS 0x822CC0 /end MEASUREMENT
/begin MEASUREMENT uint32_08.E_uint32.R01_B "" ULONG ident 1 100 0 4294967295 ECU_ADDRESS 0x822A54 /end MEASUREMENT
/begin MEASUREMENT uint32_08.E_uint32.R02_B "" ULONG ident 1 100 0 4294967295 ECU_ADDRESS 0x822B24 /end MEASUREMENT
/begin MEASUREMENT uint32_08.E_uint32.R03_B "" ULONG ident 1 100 0 4294967295 ECU_ADDRESS 0x822BF4 /end MEASUREMENT
/begin MEASUREMENT uint32_08.E_uint32.R04_B "" ULONG ident 1 100 0 4294967295 ECU_ADDRESS 0x822CC4 /end MEASUREMENT
/begin MEASUREMENT uint8_01.E_uint8.counter_send_fast "" UBYTE ident 1 100 0 255 ECU_ADDRESS 0x822747 /end MEASUREMENT
/begin MEASUREMENT uint8_01.E_uint8.R01 "" UBYTE ident 1 100 0 255 ECU_ADDRESS 0x8228B0 DISPLAY_IDENTIFIER uint8_01.E_uint8.R01_DISP_ID_R01 /end MEASUREMENT
/begin MEASUREMENT uint8_01.E_uint8.R02 "" UBYTE ident 1 100 0 255 ECU_ADDRESS 0x822A80 DISPLAY_IDENTIFIER uint8_01.E_uint8.R02_DISP_ID_R02 /end MEASUREMENT
/begin MEASUREMENT uint8_01.E_uint8.R03 "" UBYTE ident 1 100 0 255 ECU_ADDRESS 0x822B50 DISPLAY_IDENTIFIER uint8_01.E_uint8.R03_DISP_ID_R03 /end MEASUREMENT
/begin MEASUREMENT uint8_01.E_uint8.R04 "" UBYTE ident 1 100 0 255 ECU_ADDRESS 0x822C20 /end MEASUREMENT
/begin MEASUREMENT uint8_01.E_uint8.R05 "" UBYTE ident 1 100 0 255 ECU_ADDRESS 0x822CF0 /end MEASUREMENT
/begin MEASUREMENT uint8_01.E_uint8.R06 "" UBYTE ident 1 100 0 255 ECU_ADDRESS 0x822D20 /end MEASUREMENT
/begin MEASUREMENT uint8_01.E_uint8.R07 "" UBYTE ident 1 100 0 255 ECU_ADDRESS 0x822D50 /end MEASUREMENT
/begin MEASUREMENT uint8_01.E_uint8.R08 "" UBYTE ident 1 100 0 255 ECU_ADDRESS 0x822D80 /end MEASUREMENT
/begin MEASUREMENT uint8_01.E_uint8.R09 "" UBYTE ident 1 100 0 255 ECU_ADDRESS 0x822DB0 /end MEASUREMENT
/begin MEASUREMENT uint8_01.E_uint8.R10 "" UBYTE ident 1 100 0 255 ECU_ADDRESS 0x822DE0 /end MEASUREMENT
/begin MEASUREMENT uint8_01.E_uint8.R11 "" UBYTE ident 1 100 0 255 ECU_ADDRESS 0x822E10 /end MEASUREMENT
/begin MEASUREMENT uint8_01.E_uint8.R12 "" UBYTE ident 1 100 0 255 ECU_ADDRESS 0x822E40 /end MEASUREMENT
/begin MEASUREMENT uint8_01.E_uint8.R13 "" UBYTE ident 1 100 0 255 ECU_ADDRESS 0x822E70 /end MEASUREMENT
/begin MEASUREMENT uint8_01.E_uint8.R14 "" UBYTE ident 1 100 0 255 ECU_ADDRESS 0x822EA0 /end MEASUREMENT
/begin MEASUREMENT uint8_01.E_uint8.R15 "" UBYTE ident 1 100 0 255 ECU_ADDRESS 0x822ED0 /end MEASUREMENT
/begin MEASUREMENT uint8_01.E_uint8.R16 "" UBYTE ident 1 100 0 255 ECU_ADDRESS 0x822EE0 /end MEASUREMENT
/begin MEASUREMENT uint8_01.E_uint8_1.R01_8bit "" UBYTE ident 1 100 0 255 ECU_ADDRESS 0x822978 /end MEASUREMENT
/begin MEASUREMENT uint8_01.E_uint8_2.R01_8bit "" UBYTE ident 1 100 0 255 ECU_ADDRESS 0x822980 /end MEASUREMENT
/begin MEASUREMENT uint8_01.E_uint8_3.R01_8bit "" UBYTE ident 1 100 0 255 ECU_ADDRESS 0x822988 /end MEASUREMENT
/begin MEASUREMENT uint8_01.E_uint8_4.R01_8bit "" UBYTE ident 1 100 0 255 ECU_ADDRESS 0x822990 /end MEASUREMENT
/begin MEASUREMENT uint8_01.E_uint8_5.R01_8bit "" UBYTE ident 1 100 0 255 ECU_ADDRESS 0x822998 /end MEASUREMENT
/begin MEASUREMENT uint8_01.E_uint8_6.R01_8bit "" UBYTE ident 1 100 0 255 ECU_ADDRESS 0x8229A0 /end MEASUREMENT
/begin MEASUREMENT uint8_01.E_uint8_7.R01_8bit "" UBYTE ident 1 100 0 255 ECU_ADDRESS 0x8229A8 /end MEASUREMENT
/begin MEASUREMENT uint8_01.E_uint8_8.R01_8bit "" UBYTE ident 1 100 0 255 ECU_ADDRESS 0x8229B0 /end MEASUREMENT
/begin MEASUREMENT uint8_02.E_uint8.counter_send_fast "" UBYTE ident 1 100 0 255 ECU_ADDRESS 0x822748 /end MEASUREMENT
/begin MEASUREMENT uint8_02.E_uint8.R01 "" UBYTE ident 1 100 0 255 ECU_ADDRESS 0x8228B1 DISPLAY_IDENTIFIER uint8_02.E_uint8.R01_DISP_ID_R01 /end MEASUREMENT
/begin MEASUREMENT uint8_02.E_uint8.R02 "" UBYTE ident 1 100 0 255 ECU_ADDRESS 0x822A81 DISPLAY_IDENTIFIER uint8_02.E_uint8.R02_DISP_ID_R02 /end MEASUREMENT
/begin MEASUREMENT uint8_02.E_uint8.R03 "" UBYTE ident 1 100 0 255 ECU_ADDRESS 0x822B51 DISPLAY_IDENTIFIER uint8_02.E_uint8.R03_DISP_ID_R03 /end MEASUREMENT
/begin MEASUREMENT uint8_02.E_uint8.R04 "" UBYTE ident 1 100 0 255 ECU_ADDRESS 0x822C21 /end MEASUREMENT
/begin MEASUREMENT uint8_02.E_uint8.R05 "" UBYTE ident 1 100 0 255 ECU_ADDRESS 0x822CF1 /end MEASUREMENT
/begin MEASUREMENT uint8_02.E_uint8.R06 "" UBYTE ident 1 100 0 255 ECU_ADDRESS 0x822D21 /end MEASUREMENT
/begin MEASUREMENT uint8_02.E_uint8.R07 "" UBYTE ident 1 100 0 255 ECU_ADDRESS 0x822D51 /end MEASUREMENT
/begin MEASUREMENT uint8_02.E_uint8.R08 "" UBYTE ident 1 100 0 255 ECU_ADDRESS 0x822D81 /end MEASUREMENT
/begin MEASUREMENT uint8_02.E_uint8.R09 "" UBYTE ident 1 100 0 255 ECU_ADDRESS 0x822DB1 /end MEASUREMENT
/begin MEASUREMENT uint8_02.E_uint8.R10 "" UBYTE ident 1 100 0 255 ECU_ADDRESS 0x822DE1 /end MEASUREMENT
/begin MEASUREMENT uint8_02.E_uint8.R11 "" UBYTE ident 1 100 0 255 ECU_ADDRESS 0x822E11 /end MEASUREMENT
/begin MEASUREMENT uint8_02.E_uint8.R12 "" UBYTE ident 1 100 0 255 ECU_ADDRESS 0x822E41 /end MEASUREMENT
/begin MEASUREMENT uint8_02.E_uint8.R13 "" UBYTE ident 1 100 0 255 ECU_ADDRESS 0x822E71 /end MEASUREMENT
/begin MEASUREMENT uint8_02.E_uint8.R14 "" UBYTE ident 1 100 0 255 ECU_ADDRESS 0x822EA1 /end MEASUREMENT
/begin MEASUREMENT uint8_02.E_uint8.R15 "" UBYTE ident 1 100 0 255 ECU_ADDRESS 0x822ED1 /end MEASUREMENT
/begin MEASUREMENT uint8_02.E_uint8.R16 "" UBYTE ident 1 100 0 255 ECU_ADDRESS 0x822EE1 /end MEASUREMENT
/begin MEASUREMENT uint8_02.E_uint8_1.R01_8bit "" UBYTE ident 1 100 0 255 ECU_ADDRESS 0x822979 /end MEASUREMENT
/begin MEASUREMENT uint8_02.E_uint8_2.R01_8bit "" UBYTE ident 1 100 0 255 ECU_ADDRESS 0x822981 /end MEASUREMENT
/begin MEASUREMENT uint8_02.E_uint8_3.R01_8bit "" UBYTE ident 1 100 0 255 ECU_ADDRESS 0x822989 /end MEASUREMENT
/begin MEASUREMENT uint8_02.E_uint8_4.R01_8bit "" UBYTE ident 1 100 0 255 ECU_ADDRESS 0x822991 /end MEASUREMENT
/begin MEASUREMENT uint8_02.E_uint8_5.R01_8bit "" UBYTE ident 1 100 0 255 ECU_ADDRESS 0x822999 /end MEASUREMENT
/begin MEASUREMENT uint8_02.E_uint8_6.R01_8bit "" UBYTE ident 1 100 0 255 ECU_ADDRESS 0x8229A1 /end MEASUREMENT
/begin MEASUREMENT uint8_02.E_uint8_7.R01_8bit "" UBYTE ident 1 100 0 255 ECU_ADDRESS 0x8229A9 /end MEASUREMENT
/begin MEASUREMENT uint8_02.E_uint8_8.R01_8bit "" UBYTE ident 1 100 0 255 ECU_ADDRESS 0x8229B1 /end MEASUREMENT
/begin MEASUREMENT uint8_03.E_uint8.counter_send_fast "" UBYTE ident 1 100 0 255 ECU_ADDRESS 0x822749 /end MEASUREMENT
/begin MEASUREMENT uint8_03.E_uint8.R01 "" UBYTE ident 1 100 0 255 ECU_ADDRESS 0x8228B2 DISPLAY_IDENTIFIER uint8_03.E_uint8.R01_DISP_ID_R01 /end MEASUREMENT
/begin MEASUREMENT uint8_03.E_uint8.R02 "" UBYTE ident 1 100 0 255 ECU_ADDRESS 0x822A82 DISPLAY_IDENTIFIER uint8_03.E_uint8.R02_DISP_ID_R02 /end MEASUREMENT
/begin MEASUREMENT uint8_03.E_uint8.R03 "" UBYTE ident 1 100 0 255 ECU_ADDRESS 0x822B52 DISPLAY_IDENTIFIER uint8_03.E_uint8.R03_DISP_ID_R03 /end MEASUREMENT
/begin MEASUREMENT uint8_03.E_uint8.R04 "" UBYTE ident 1 100 0 255 ECU_ADDRESS 0x822C22 /end MEASUREMENT
/begin MEASUREMENT uint8_03.E_uint8.R05 "" UBYTE ident 1 100 0 255 ECU_ADDRESS 0x822CF2 /end MEASUREMENT
/begin MEASUREMENT uint8_03.E_uint8.R06 "" UBYTE ident 1 100 0 255 ECU_ADDRESS 0x822D22 /end MEASUREMENT
/begin MEASUREMENT uint8_03.E_uint8.R07 "" UBYTE ident 1 100 0 255 ECU_ADDRESS 0x822D52 /end MEASUREMENT
/begin MEASUREMENT uint8_03.E_uint8.R08 "" UBYTE ident 1 100 0 255 ECU_ADDRESS 0x822D82 /end MEASUREMENT
/begin MEASUREMENT uint8_03.E_uint8.R09 "" UBYTE ident 1 100 0 255 ECU_ADDRESS 0x822DB2 /end MEASUREMENT
/begin MEASUREMENT uint8_03.E_uint8.R10 "" UBYTE ident 1 100 0 255 ECU_ADDRESS 0x822DE2 /end MEASUREMENT
/begin MEASUREMENT uint8_03.E_uint8.R11 "" UBYTE ident 1 100 0 255 ECU_ADDRESS 0x822E12 /end MEASUREMENT
/begin MEASUREMENT uint8_03.E_uint8.R12 "" UBYTE ident 1 100 0 255 ECU_ADDRESS 0x822E42 /end MEASUREMENT
/begin MEASUREMENT uint8_03.E_uint8.R13 "" UBYTE ident 1 100 0 255 ECU_ADDRESS 0x822E72 /end MEASUREMENT
/begin MEASUREMENT uint8_03.E_uint8.R14 "" UBYTE ident 1 100 0 255 ECU_ADDRESS 0x822EA2 /end MEASUREMENT
/begin MEASUREMENT uint8_03.E_uint8.R15 "" UBYTE ident 1 100 0 255 ECU_ADDRESS 0x822ED2 /end MEASUREMENT
/begin MEASUREMENT uint8_03.E_uint8.R16 "" UBYTE ident 1 100 0 255 ECU_ADDRESS 0x822EE2 /end MEASUREMENT
/begin MEASUREMENT uint8_03.E_uint8_1.R01_8bit "" UBYTE ident 1 100 0 255 ECU_ADDRESS 0x82297A /end MEASUREMENT
/begin MEASUREMENT uint8_03.E_uint8_2.R01_8bit "" UBYTE ident 1 100 0 255 ECU_ADDRESS 0x822982 /end MEASUREMENT
/begin MEASUREMENT uint8_03.E_uint8_3.R01_8bit "" UBYTE ident 1 100 0 255 ECU_ADDRESS 0x82298A /end MEASUREMENT
/begin MEASUREMENT uint8_03.E_uint8_4.R01_8bit "" UBYTE ident 1 100 0 255 ECU_ADDRESS 0x822992 /end MEASUREMENT
/begin MEASUREMENT uint8_03.E_uint8_5.R01_8bit "" UBYTE ident 1 100 0 255 ECU_ADDRESS 0x82299A /end MEASUREMENT
/begin MEASUREMENT uint8_03.E_uint8_6.R01_8bit "" UBYTE ident 1 100 0 255 ECU_ADDRESS 0x8229A2 /end MEASUREMENT
/begin MEASUREMENT uint8_03.E_uint8_7.R01_8bit "" UBYTE ident 1 100 0 255 ECU_ADDRESS 0x8229AA /end MEASUREMENT
/begin MEASUREMENT uint8_03.E_uint8_8.R01_8bit "" UBYTE ident 1 100 0 255 ECU_ADDRESS 0x8229B2 /end MEASUREMENT
/begin MEASUREMENT uint8_04.E_uint8.counter_send_fast "" UBYTE ident 1 100 0 255 ECU_ADDRESS 0x82274A /end MEASUREMENT
/begin MEASUREMENT uint8_04.E_uint8.R01 "" UBYTE ident 1 100 0 255 ECU_ADDRESS 0x8228B3 DISPLAY_IDENTIFIER uint8_04.E_uint8.R01_DISP_ID_R01 /end MEASUREMENT
/begin MEASUREMENT uint8_04.E_uint8.R02 "" UBYTE ident 1 100 0 255 ECU_ADDRESS 0x822A83 DISPLAY_IDENTIFIER uint8_04.E_uint8.R02_DISP_ID_R02 /end MEASUREMENT
/begin MEASUREMENT uint8_04.E_uint8.R03 "" UBYTE ident 1 100 0 255 ECU_ADDRESS 0x822B53 DISPLAY_IDENTIFIER uint8_04.E_uint8.R03_DISP_ID_R03 /end MEASUREMENT
/begin MEASUREMENT uint8_04.E_uint8.R04 "" UBYTE ident 1 100 0 255 ECU_ADDRESS 0x822C23 /end MEASUREMENT
/begin MEASUREMENT uint8_04.E_uint8.R05 "" UBYTE ident 1 100 0 255 ECU_ADDRESS 0x822CF3 /end MEASUREMENT
/begin MEASUREMENT uint8_04.E_uint8.R06 "" UBYTE ident 1 100 0 255 ECU_ADDRESS 0x822D23 /end MEASUREMENT
/begin MEASUREMENT uint8_04.E_uint8.R07 "" UBYTE ident 1 100 0 255 ECU_ADDRESS 0x822D53 /end MEASUREMENT
/begin MEASUREMENT uint8_04.E_uint8.R08 "" UBYTE ident 1 100 0 255 ECU_ADDRESS 0x822D83 /end MEASUREMENT
/begin MEASUREMENT uint8_04.E_uint8.R09 "" UBYTE ident 1 100 0 255 ECU_ADDRESS 0x822DB3 /end MEASUREMENT
/begin MEASUREMENT uint8_04.E_uint8.R10 "" UBYTE ident 1 100 0 255 ECU_ADDRESS 0x822DE3 /end MEASUREMENT
/begin MEASUREMENT uint8_04.E_uint8.R11 "" UBYTE ident 1 100 0 255 ECU_ADDRESS 0x822E13 /end MEASUREMENT
/begin MEASUREMENT uint8_04.E_uint8.R12 "" UBYTE ident 1 100 0 255 ECU_ADDRESS 0x822E43 /end MEASUREMENT
/begin MEASUREMENT uint8_04.E_uint8.R13 "" UBYTE ident 1 100 0 255 ECU_ADDRESS 0x822E73 /end MEASUREMENT
/begin MEASUREMENT uint8_04.E_uint8.R14 "" UBYTE ident 1 100 0 255 ECU_ADDRESS 0x822EA3 /end MEASUREMENT
/begin MEASUREMENT uint8_04.E_uint8.R15 "" UBYTE ident 1 100 0 255 ECU_ADDRESS 0x822ED3 /end MEASUREMENT
/begin MEASUREMENT uint8_04.E_uint8.R16 "" UBYTE ident 1 100 0 255 ECU_ADDRESS 0x822EE3 /end MEASUREMENT
/begin MEASUREMENT uint8_04.E_uint8_1.R01_8bit "" UBYTE ident 1 100 0 255 ECU_ADDRESS 0x82297B /end MEASUREMENT
/begin MEASUREMENT uint8_04.E_uint8_2.R01_8bit "" UBYTE ident 1 100 0 255 ECU_ADDRESS 0x822983 /end MEASUREMENT
/begin MEASUREMENT uint8_04.E_uint8_3.R01_8bit "" UBYTE ident 1 100 0 255 ECU_ADDRESS 0x82298B /end MEASUREMENT
/begin MEASUREMENT uint8_04.E_uint8_4.R01_8bit "" UBYTE ident 1 100 0 255 ECU_ADDRESS 0x822993 /end MEASUREMENT
/begin MEASUREMENT uint8_04.E_uint8_5.R01_8bit "" UBYTE ident 1 100 0 255 ECU_ADDRESS 0x82299B /end MEASUREMENT
/begin MEASUREMENT uint8_04.E_uint8_6.R01_8bit "" UBYTE ident 1 100 0 255 ECU_ADDRESS 0x8229A3 /end MEASUREMENT
/begin MEASUREMENT uint8_04.E_uint8_7.R01_8bit "" UBYTE ident 1 100 0 255 ECU_ADDRESS 0x8229AB /end MEASUREMENT
/begin MEASUREMENT uint8_04.E_uint8_8.R01_8bit "" UBYTE ident 1 100 0 255 ECU_ADDRESS 0x8229B3 /end MEASUREMENT
/begin MEASUREMENT uint8_05.E_uint8.counter_send_fast "" UBYTE ident 1 100 0 255 ECU_ADDRESS 0x82274B /end MEASUREMENT
/begin MEASUREMENT uint8_05.E_uint8.R01 "" UBYTE ident 1 100 0 255 ECU_ADDRESS 0x8228B4 DISPLAY_IDENTIFIER uint8_05.E_uint8.R01_DISP_ID_R01 /end MEASUREMENT
/begin MEASUREMENT uint8_05.E_uint8.R02 "" UBYTE ident 1 100 0 255 ECU_ADDRESS 0x822A84 DISPLAY_IDENTIFIER uint8_05.E_uint8.R02_DISP_ID_R02 /end MEASUREMENT
/begin MEASUREMENT uint8_05.E_uint8.R03 "" UBYTE ident 1 100 0 255 ECU_ADDRESS 0x822B54 DISPLAY_IDENTIFIER uint8_05.E_uint8.R03_DISP_ID_R03 /end MEASUREMENT
/begin MEASUREMENT uint8_05.E_uint8.R04 "" UBYTE ident 1 100 0 255 ECU_ADDRESS 0x822C24 /end MEASUREMENT
/begin MEASUREMENT uint8_05.E_uint8.R05 "" UBYTE ident 1 100 0 255 ECU_ADDRESS 0x822CF4 /end MEASUREMENT
/begin MEASUREMENT uint8_05.E_uint8.R06 "" UBYTE ident 1 100 0 255 ECU_ADDRESS 0x822D24 /end MEASUREMENT
/begin MEASUREMENT uint8_05.E_uint8.R07 "" UBYTE ident 1 100 0 255 ECU_ADDRESS 0x822D54 /end MEASUREMENT
/begin MEASUREMENT uint8_05.E_uint8.R08 "" UBYTE ident 1 100 0 255 ECU_ADDRESS 0x822D84 /end MEASUREMENT
/begin MEASUREMENT uint8_05.E_uint8.R09 "" UBYTE ident 1 100 0 255 ECU_ADDRESS 0x822DB4 /end MEASUREMENT
/begin MEASUREMENT uint8_05.E_uint8.R10 "" UBYTE ident 1 100 0 255 ECU_ADDRESS 0x822DE4 /end MEASUREMENT
/begin MEASUREMENT uint8_05.E_uint8.R11 "" UBYTE ident 1 100 0 255 ECU_ADDRESS 0x822E14 /end MEASUREMENT
/begin MEASUREMENT uint8_05.E_uint8.R12 "" UBYTE ident 1 100 0 255 ECU_ADDRESS 0x822E44 /end MEASUREMENT
/begin MEASUREMENT uint8_05.E_uint8.R13 "" UBYTE ident 1 100 0 255 ECU_ADDRESS 0x822E74 /end MEASUREMENT
/begin MEASUREMENT uint8_05.E_uint8.R14 "" UBYTE ident 1 100 0 255 ECU_ADDRESS 0x822EA4 /end MEASUREMENT
/begin MEASUREMENT uint8_05.E_uint8.R15 "" UBYTE ident 1 100 0 255 ECU_ADDRESS 0x822ED4 /end MEASUREMENT
/begin MEASUREMENT uint8_05.E_uint8.R16 "" UBYTE ident 1 100 0 255 ECU_ADDRESS 0x822EE4 /end MEASUREMENT
/begin MEASUREMENT uint8_05.E_uint8_1.R01_8bit "" UBYTE ident 1 100 0 255 ECU_ADDRESS 0x82297C /end MEASUREMENT
/begin MEASUREMENT uint8_05.E_uint8_2.R01_8bit "" UBYTE ident 1 100 0 255 ECU_ADDRESS 0x822984 /end MEASUREMENT
/begin MEASUREMENT uint8_05.E_uint8_3.R01_8bit "" UBYTE ident 1 100 0 255 ECU_ADDRESS 0x82298C /end MEASUREMENT
/begin MEASUREMENT uint8_05.E_uint8_4.R01_8bit "" UBYTE ident 1 100 0 255 ECU_ADDRESS 0x822994 /end MEASUREMENT
/begin MEASUREMENT uint8_05.E_uint8_5.R01_8bit "" UBYTE ident 1 100 0 255 ECU_ADDRESS 0x82299C /end MEASUREMENT
/begin MEASUREMENT uint8_05.E_uint8_6.R01_8bit "" UBYTE ident 1 100 0 255 ECU_ADDRESS 0x8229A4 /end MEASUREMENT
/begin MEASUREMENT uint8_05.E_uint8_7.R01_8bit "" UBYTE ident 1 100 0 255 ECU_ADDRESS 0x8229AC /end MEASUREMENT
/begin MEASUREMENT uint8_05.E_uint8_8.R01_8bit "" UBYTE ident 1 100 0 255 ECU_ADDRESS 0x8229B4 /end MEASUREMENT
/begin MEASUREMENT uint8_06.E_uint8.counter_send_fast "" UBYTE ident 1 100 0 255 ECU_ADDRESS 0x82274C /end MEASUREMENT
/begin MEASUREMENT uint8_06.E_uint8.R01 "" UBYTE ident 1 100 0 255 ECU_ADDRESS 0x8228B5 DISPLAY_IDENTIFIER uint8_06.E_uint8.R01_DISP_ID_R01 /end MEASUREMENT
/begin MEASUREMENT uint8_06.E_uint8.R02 "" UBYTE ident 1 100 0 255 ECU_ADDRESS 0x822A85 DISPLAY_IDENTIFIER uint8_06.E_uint8.R02_DISP_ID_R02 /end MEASUREMENT
/begin MEASUREMENT uint8_06.E_uint8.R03 "" UBYTE ident 1 100 0 255 ECU_ADDRESS 0x822B55 DISPLAY_IDENTIFIER uint8_06.E_uint8.R03_DISP_ID_R03 /end MEASUREMENT
/begin MEASUREMENT uint8_06.E_uint8.R04 "" UBYTE ident 1 100 0 255 ECU_ADDRESS 0x822C25 /end MEASUREMENT
/begin MEASUREMENT uint8_06.E_uint8.R05 "" UBYTE ident 1 100 0 255 ECU_ADDRESS 0x822CF5 /end MEASUREMENT
/begin MEASUREMENT uint8_06.E_uint8.R06 "" UBYTE ident 1 100 0 255 ECU_ADDRESS 0x822D25 /end MEASUREMENT
/begin MEASUREMENT uint8_06.E_uint8.R07 "" UBYTE ident 1 100 0 255 ECU_ADDRESS 0x822D55 /end MEASUREMENT
/begin MEASUREMENT uint8_06.E_uint8.R08 "" UBYTE ident 1 100 0 255 ECU_ADDRESS 0x822D85 /end MEASUREMENT
/begin MEASUREMENT uint8_06.E_uint8.R09 "" UBYTE ident 1 100 0 255 ECU_ADDRESS 0x822DB5 /end MEASUREMENT
/begin MEASUREMENT uint8_06.E_uint8.R10 "" UBYTE ident 1 100 0 255 ECU_ADDRESS 0x822DE5 /end MEASUREMENT
/begin MEASUREMENT uint8_06.E_uint8.R11 "" UBYTE ident 1 100 0 255 ECU_ADDRESS 0x822E15 /end MEASUREMENT
/begin MEASUREMENT uint8_06.E_uint8.R12 "" UBYTE ident 1 100 0 255 ECU_ADDRESS 0x822E45 /end MEASUREMENT
/begin MEASUREMENT uint8_06.E_uint8.R13 "" UBYTE ident 1 100 0 255 ECU_ADDRESS 0x822E75 /end MEASUREMENT
/begin MEASUREMENT uint8_06.E_uint8.R14 "" UBYTE ident 1 100 0 255 ECU_ADDRESS 0x822EA5 /end MEASUREMENT
/begin MEASUREMENT uint8_06.E_uint8.R15 "" UBYTE ident 1 100 0 255 ECU_ADDRESS 0x822ED5 /end MEASUREMENT
/begin MEASUREMENT uint8_06.E_uint8.R16 "" UBYTE ident 1 100 0 255 ECU_ADDRESS 0x822EE5 /end MEASUREMENT
/begin MEASUREMENT uint8_06.E_uint8_1.R01_8bit "" UBYTE ident 1 100 0 255 ECU_ADDRESS 0x82297D /end MEASUREMENT
/begin MEASUREMENT uint8_06.E_uint8_2.R01_8bit "" UBYTE ident 1 100 0 255 ECU_ADDRESS 0x822985 /end MEASUREMENT
/begin MEASUREMENT uint8_06.E_uint8_3.R01_8bit "" UBYTE ident 1 100 0 255 ECU_ADDRESS 0x82298D /end MEASUREMENT
/begin MEASUREMENT uint8_06.E_uint8_4.R01_8bit "" UBYTE ident 1 100 0 255 ECU_ADDRESS 0x822995 /end MEASUREMENT
/begin MEASUREMENT uint8_06.E_uint8_5.R01_8bit "" UBYTE ident 1 100 0 255 ECU_ADDRESS 0x82299D /end MEASUREMENT
/begin MEASUREMENT uint8_06.E_uint8_6.R01_8bit "" UBYTE ident 1 100 0 255 ECU_ADDRESS 0x8229A5 /end MEASUREMENT
/begin MEASUREMENT uint8_06.E_uint8_7.R01_8bit "" UBYTE ident 1 100 0 255 ECU_ADDRESS 0x8229AD /end MEASUREMENT
/begin MEASUREMENT uint8_06.E_uint8_8.R01_8bit "" UBYTE ident 1 100 0 255 ECU_ADDRESS 0x8229B5 /end MEASUREMENT
/begin MEASUREMENT uint8_07.E_uint8.counter_send_fast "" UBYTE ident 1 100 0 255 ECU_ADDRESS 0x82274D /end MEASUREMENT
/begin MEASUREMENT uint8_07.E_uint8.R01 "" UBYTE ident 1 100 0 255 ECU_ADDRESS 0x8228B6 DISPLAY_IDENTIFIER uint8_07.E_uint8.R01_DISP_ID_R01 /end MEASUREMENT
/begin MEASUREMENT uint8_07.E_uint8.R02 "" UBYTE ident 1 100 0 255 ECU_ADDRESS 0x822A86 DISPLAY_IDENTIFIER uint8_07.E_uint8.R02_DISP_ID_R02 /end MEASUREMENT
/begin MEASUREMENT uint8_07.E_uint8.R03 "" UBYTE ident 1 100 0 255 ECU_ADDRESS 0x822B56 DISPLAY_IDENTIFIER uint8_07.E_uint8.R03_DISP_ID_R03 /end MEASUREMENT
/begin MEASUREMENT uint8_07.E_uint8.R04 "" UBYTE ident 1 100 0 255 ECU_ADDRESS 0x822C26 /end MEASUREMENT
/begin MEASUREMENT uint8_07.E_uint8.R05 "" UBYTE ident 1 100 0 255 ECU_ADDRESS 0x822CF6 /end MEASUREMENT
/begin MEASUREMENT uint8_07.E_uint8.R06 "" UBYTE ident 1 100 0 255 ECU_ADDRESS 0x822D26 /end MEASUREMENT
/begin MEASUREMENT uint8_07.E_uint8.R07 "" UBYTE ident 1 100 0 255 ECU_ADDRESS 0x822D56 /end MEASUREMENT
/begin MEASUREMENT uint8_07.E_uint8.R08 "" UBYTE ident 1 100 0 255 ECU_ADDRESS 0x822D86 /end MEASUREMENT
/begin MEASUREMENT uint8_07.E_uint8.R09 "" UBYTE ident 1 100 0 255 ECU_ADDRESS 0x822DB6 /end MEASUREMENT
/begin MEASUREMENT uint8_07.E_uint8.R10 "" UBYTE ident 1 100 0 255 ECU_ADDRESS 0x822DE6 /end MEASUREMENT
/begin MEASUREMENT uint8_07.E_uint8.R11 "" UBYTE ident 1 100 0 255 ECU_ADDRESS 0x822E16 /end MEASUREMENT
/begin MEASUREMENT uint8_07.E_uint8.R12 "" UBYTE ident 1 100 0 255 ECU_ADDRESS 0x822E46 /end MEASUREMENT
/begin MEASUREMENT uint8_07.E_uint8.R13 "" UBYTE ident 1 100 0 255 ECU_ADDRESS 0x822E76 /end MEASUREMENT
/begin MEASUREMENT uint8_07.E_uint8.R14 "" UBYTE ident 1 100 0 255 ECU_ADDRESS 0x822EA6 /end MEASUREMENT
/begin MEASUREMENT uint8_07.E_uint8.R15 "" UBYTE ident 1 100 0 255 ECU_ADDRESS 0x822ED6 /end MEASUREMENT
/begin MEASUREMENT uint8_07.E_uint8.R16 "" UBYTE ident 1 100 0 255 ECU_ADDRESS 0x822EE6 /end MEASUREMENT
/begin MEASUREMENT uint8_07.E_uint8_1.R01_8bit "" UBYTE ident 1 100 0 255 ECU_ADDRESS 0x82297E /end MEASUREMENT
/begin MEASUREMENT uint8_07.E_uint8_2.R01_8bit "" UBYTE ident 1 100 0 255 ECU_ADDRESS 0x822986 /end MEASUREMENT
/begin MEASUREMENT uint8_07.E_uint8_3.R01_8bit "" UBYTE ident 1 100 0 255 ECU_ADDRESS 0x82298E /end MEASUREMENT
/begin MEASUREMENT uint8_07.E_uint8_4.R01_8bit "" UBYTE ident 1 100 0 255 ECU_ADDRESS 0x822996 /end MEASUREMENT
/begin MEASUREMENT uint8_07.E_uint8_5.R01_8bit "" UBYTE ident 1 100 0 255 ECU_ADDRESS 0x82299E /end MEASUREMENT
/begin MEASUREMENT uint8_07.E_uint8_6.R01_8bit "" UBYTE ident 1 100 0 255 ECU_ADDRESS 0x8229A6 /end MEASUREMENT
/begin MEASUREMENT uint8_07.E_uint8_7.R01_8bit "" UBYTE ident 1 100 0 255 ECU_ADDRESS 0x8229AE /end MEASUREMENT
/begin MEASUREMENT uint8_07.E_uint8_8.R01_8bit "" UBYTE ident 1 100 0 255 ECU_ADDRESS 0x8229B6 /end MEASUREMENT
/begin MEASUREMENT uint8_08.E_uint8.counter_send_fast "" UBYTE ident 1 100 0 255 ECU_ADDRESS 0x82274E /end MEASUREMENT
/begin MEASUREMENT uint8_08.E_uint8.R01 "" UBYTE ident 1 100 0 255 ECU_ADDRESS 0x8228B7 DISPLAY_IDENTIFIER uint8_08.E_uint8.R01_DISP_ID_R01 /end MEASUREMENT
/begin MEASUREMENT uint8_08.E_uint8.R02 "" UBYTE ident 1 100 0 255 ECU_ADDRESS 0x822A87 DISPLAY_IDENTIFIER uint8_08.E_uint8.R02_DISP_ID_R02 /end MEASUREMENT
/begin MEASUREMENT uint8_08.E_uint8.R03 "" UBYTE ident 1 100 0 255 ECU_ADDRESS 0x822B57 DISPLAY_IDENTIFIER uint8_08.E_uint8.R03_DISP_ID_R03 /end MEASUREMENT
/begin MEASUREMENT uint8_08.E_uint8.R04 "" UBYTE ident 1 100 0 255 ECU_ADDRESS 0x822C27 /end MEASUREMENT
/begin MEASUREMENT uint8_08.E_uint8.R05 "" UBYTE ident 1 100 0 255 ECU_ADDRESS 0x822CF7 /end MEASUREMENT
/begin MEASUREMENT uint8_08.E_uint8.R06 "" UBYTE ident 1 100 0 255 ECU_ADDRESS 0x822D27 /end MEASUREMENT
/begin MEASUREMENT uint8_08.E_uint8.R07 "" UBYTE ident 1 100 0 255 ECU_ADDRESS 0x822D57 /end MEASUREMENT
/begin MEASUREMENT uint8_08.E_uint8.R08 "" UBYTE ident 1 100 0 255 ECU_ADDRESS 0x822D87 /end MEASUREMENT
/begin MEASUREMENT uint8_08.E_uint8.R09 "" UBYTE ident 1 100 0 255 ECU_ADDRESS 0x822DB7 /end MEASUREMENT
/begin MEASUREMENT uint8_08.E_uint8.R10 "" UBYTE ident 1 100 0 255 ECU_ADDRESS 0x822DE7 /end MEASUREMENT
/begin MEASUREMENT uint8_08.E_uint8.R11 "" UBYTE ident 1 100 0 255 ECU_ADDRESS 0x822E17 /end MEASUREMENT
/begin MEASUREMENT uint8_08.E_uint8.R12 "" UBYTE ident 1 100 0 255 ECU_ADDRESS 0x822E47 /end MEASUREMENT
/begin MEASUREMENT uint8_08.E_uint8.R13 "" UBYTE ident 1 100 0 255 ECU_ADDRESS 0x822E77 /end MEASUREMENT
/begin MEASUREMENT uint8_08.E_uint8.R14 "" UBYTE ident 1 100 0 255 ECU_ADDRESS 0x822EA7 /end MEASUREMENT
/begin MEASUREMENT uint8_08.E_uint8.R15 "" UBYTE ident 1 100 0 255 ECU_ADDRESS 0x822ED7 /end MEASUREMENT
/begin MEASUREMENT uint8_08.E_uint8.R16 "" UBYTE ident 1 100 0 255 ECU_ADDRESS 0x822EE7 /end MEASUREMENT
/begin MEASUREMENT uint8_08.E_uint8_1.R01_8bit "" UBYTE ident 1 100 0 255 ECU_ADDRESS 0x82297F /end MEASUREMENT
/begin MEASUREMENT uint8_08.E_uint8_2.R01_8bit "" UBYTE ident 1 100 0 255 ECU_ADDRESS 0x822987 /end MEASUREMENT
/begin MEASUREMENT uint8_08.E_uint8_3.R01_8bit "" UBYTE ident 1 100 0 255 ECU_ADDRESS 0x82298F /end MEASUREMENT
/begin MEASUREMENT uint8_08.E_uint8_4.R01_8bit "" UBYTE ident 1 100 0 255 ECU_ADDRESS 0x822997 /end MEASUREMENT
/begin MEASUREMENT uint8_08.E_uint8_5.R01_8bit "" UBYTE ident 1 100 0 255 ECU_ADDRESS 0x82299F /end MEASUREMENT
/begin MEASUREMENT uint8_08.E_uint8_6.R01_8bit "" UBYTE ident 1 100 0 255 ECU_ADDRESS 0x8229A7 /end MEASUREMENT
/begin MEASUREMENT uint8_08.E_uint8_7.R01_8bit "" UBYTE ident 1 100 0 255 ECU_ADDRESS 0x8229AF /end MEASUREMENT
/begin MEASUREMENT uint8_08.E_uint8_8.R01_8bit "" UBYTE ident 1 100 0 255 ECU_ADDRESS 0x8229B7 /end MEASUREMENT
/begin COMPU_METHOD DASM_Ti "" RAT_FUNC "%12.4" "ms" COEFFS 0 10 0 0 0 1 /end COMPU_METHOD
/begin COMPU_METHOD ident "" RAT_FUNC "%12.4" "" COEFFS 0 1 0 0 0 1 /end COMPU_METHOD
/begin COMPU_METHOD qx100ms_Ticks_to_Sec "" RAT_FUNC "%12.4" "[s]" COEFFS 0 10.0 0 0 0 1 /end COMPU_METHOD
/begin COMPU_METHOD TickType2ms "" RAT_FUNC "%12.4" "ms" COEFFS 0 3500.0 0 0 0 1 /end COMPU_METHOD
/begin COMPU_METHOD TPU_Dcyc "" RAT_FUNC "%12.4" "%" COEFFS 0 100 0 0 0 1 /end COMPU_METHOD
/begin GROUP Distab13_12T "" ROOT
 /begin REF_MEASUREMENT FSW_OIC01_Dcyc.Distab13_12T FSW_OIC02_Dcyc.Distab13_12T FSW_OPI01_Dcyc.Distab13_12T FSW_OPI02_Dcyc.Distab13_12T FSW_OPI03_Dcyc.Distab13_12T FSW_OPI04_Dcyc.Distab13_12T FSW_OPI05_Dcyc.Distab13_12T FSW_OPI06_Dcyc.Distab13_12T FSW_OPI07_Dcyc.Distab13_12T FSW_OPI08_Dcyc.Distab13_12T FSW_OPI09_Dcyc.Distab13_12T FSW_OPI10_Dcyc.Distab13_12T FSW_OPI11_Dcyc.Distab13_12T FSW_OS01_En.Distab13_12T FSW_OS01_S_Dcyc.Distab13_12T FSW_OS01_V.Distab13_12T FSW_OS02_En.Distab13_12T FSW_OS02_S_Dcyc.Distab13_12T FSW_OS02_V.Distab13_12T FSW_OS03.Distab13_12T FSW_OS04.Distab13_12T FSW_OS05a.Distab13_12T FSW_OS05b.Distab13_12T FSW_OS05c.Distab13_12T FSW_OS06.Distab13_12T FSW_OS07.Distab13_12T FSW_OS08.Distab13_12T FSW_OS09.Distab13_12T FSW_OS10.Distab13_12T FSW_OS11.Distab13_12T FSW_OS12.Distab13_12T FSW_OS13.Distab13_12T FSW_OS14.Distab13_12T FSW_OS15.Distab13_12T FSW_OS_MR.Distab13_12T /end REF_MEASUREMENT
 /begin REF_CHARACTERISTIC EBYP_BitOff_OS01_En.Distab13_12T EBYP_BitOff_OS01_V.Distab13_12T EBYP_BitOff_OS02_En.Distab13_12T EBYP_BitOff_OS02_V.Distab13_12T EBYP_BitOff_OS03.Distab13_12T EBYP_BitOff_OS04.Distab13_12T EBYP_BitOff_OS05a.Distab13_12T EBYP_BitOff_OS05b.Distab13_12T EBYP_BitOff_OS05c.Distab13_12T EBYP_BitOff_OS06.Distab13_12T EBYP_BitOff_OS07.Distab13_12T EBYP_BitOff_OS08.Distab13_12T EBYP_BitOff_OS09.Distab13_12T EBYP_BitOff_OS10.Distab13_12T EBYP_BitOff_OS11.Distab13_12T EBYP_BitOff_OS12.Distab13_12T EBYP_BitOff_OS13.Distab13_12T EBYP_BitOff_OS14.Distab13_12T EBYP_BitOff_OS15.Distab13_12T EBYP_BitOff_OSMR.Distab13_12T EBYP_Off_OIC01_Dcyc.Distab13_12T EBYP_Off_OIC02_Dcyc.Distab13_12T EBYP_Off_OPI01_Dcyc.Distab13_12T EBYP_Off_OPI02_Dcyc.Distab13_12T EBYP_Off_OPI03_Dcyc.Distab13_12T EBYP_Off_OPI04_Dcyc.Distab13_12T EBYP_Off_OPI05_Dcyc.Distab13_12T EBYP_Off_OPI06_Dcyc.Distab13_12T EBYP_Off_OPI07_Dcyc.Distab13_12T EBYP_Off_OS01_En.Distab13_12T EBYP_Off_OS01_S_Dcyc.Distab13_12T EBYP_Off_OS01_V.Distab13_12T EBYP_Off_OS02_En.Distab13_12T EBYP_Off_OS02_S_Dcyc.Distab13_12T EBYP_Off_OS02_V.Distab13_12T EBYP_Off_OS03.Distab13_12T EBYP_Off_OS04.Distab13_12T EBYP_Off_OS05a.Distab13_12T EBYP_Off_OS05b.Distab13_12T EBYP_Off_OS05c.Distab13_12T EBYP_Off_OS06.Distab13_12T EBYP_Off_OS07.Distab13_12T EBYP_Off_OS08.Distab13_12T EBYP_Off_OS09.Distab13_12T EBYP_Off_OS10.Distab13_12T EBYP_Off_OS11.Distab13_12T EBYP_Off_OS12.Distab13_12T EBYP_Off_OS13.Distab13_12T EBYP_Off_OS14.Distab13_12T EBYP_Off_OS15.Distab13_12T EBYP_Off_OSMR.Distab13_12T P_AML1_1_3P2R_Compatibility.Distab13_12T P_Byp_Roundtrip_Timeout_Time.Distab13_12T P_Do_TRG_Without_Distab.Distab13_12T P_Enable_ETK.Distab13_12T P_Wait_Bypass_Roundtrip.Distab13_12T TST_OIC01_Dcyc.Distab13_12T TST_OIC02_Dcyc.Distab13_12T TST_OPI01_Dcyc.Distab13_12T TST_OPI02_Dcyc.Distab13_12T TST_OPI03_Dcyc.Distab13_12T TST_OPI04_Dcyc.Distab13_12T TST_OPI05_Dcyc.Distab13_12T TST_OPI06_Dcyc.Distab13_12T TST_OPI07_Dcyc.Distab13_12T TST_OPI08_Dcyc.Distab13_12T TST_OPI09_Dcyc.Distab13_12T TST_OPI10_Dcyc.Distab13_12T TST_OPI11_Dcyc.Distab13_12T TST_OS01_En.Distab13_12T TST_OS01_S_Dcyc.Distab13_12T TST_OS01_V.Distab13_12T TST_OS02_En.Distab13_12T TST_OS02_S_Dcyc.Distab13_12T TST_OS02_V.Distab13_12T TST_OS03.Distab13_12T TST_OS04.Distab13_12T TST_OS05a.Distab13_12T TST_OS05b.Distab13_12T TST_OS05c.Distab13_12T TST_OS06.Distab13_12T TST_OS07.Distab13_12T TST_OS08.Distab13_12T TST_OS09.Distab13_12T TST_OS10.Distab13_12T TST_OS11.Distab13_12T TST_OS12.Distab13_12T TST_OS13.Distab13_12T TST_OS14.Distab13_12T TST_OS15.Distab13_12T TST_OS_MR.Distab13_12T /end REF_CHARACTERISTIC
 /begin SUB_GROUP Dist_B01.Distab13_12T Dist_B02.Distab13_12T Dist_B03.Distab13_12T Dist_B04.Distab13_12T Dist_R01.Distab13_12T Dist_R02.Distab13_12T Dist_R03.Distab13_12T Dist_R04.Distab13_12T Dist_R05.Distab13_12T Dist_R06.Distab13_12T Dist_R07.Distab13_12T Dist_R08.Distab13_12T Dist_R09.Distab13_12T Dist_R10.Distab13_12T Dist_R11.Distab13_12T Dist_R12.Distab13_12T /end SUB_GROUP
/end GROUP
/begin GROUP EV0_Roundtrip.XCP_SHELL ""
 /begin REF_MEASUREMENT Max.MIN_MAX_Tick2Time.EV0_Roundtrip.XCP_SHELL Min.MIN_MAX_Tick2Time.EV0_Roundtrip.XCP_SHELL Time.MIN_MAX_Tick2Time.EV0_Roundtrip.XCP_SHELL l_ResetTimer_b.EV0_Roundtrip.XCP_SHELL l_StartTicks_u32.EV0_Roundtrip.XCP_SHELL l_StopTicks_u32.EV0_Roundtrip.XCP_SHELL l_Timeout_b.EV0_Roundtrip.XCP_SHELL /end REF_MEASUREMENT
 /begin REF_CHARACTERISTIC p_ResetTimer_b.EV0_Roundtrip.XCP_SHELL /end REF_CHARACTERISTIC
 /begin SUB_GROUP MIN_MAX_Tick2Time.EV0_Roundtrip.XCP_SHELL /end SUB_GROUP
/end GROUP
/begin GROUP EV0_Rx.XCP_SHELL ""
 /begin REF_MEASUREMENT Max.Time.EV0_Rx.XCP_SHELL Max.TimeSum.EV0_Rx.XCP_SHELL Min.Time.EV0_Rx.XCP_SHELL Min.TimeSum.EV0_Rx.XCP_SHELL Time.Time.EV0_Rx.XCP_SHELL Time.TimeSum.EV0_Rx.XCP_SHELL l_ResetTimer_b.EV0_Rx.XCP_SHELL l_StartTicks_u32.EV0_Rx.XCP_SHELL l_StopTicks_u32.EV0_Rx.XCP_SHELL l_TimeSum_u32.EV0_Rx.XCP_SHELL l_Timeout_b.EV0_Rx.XCP_SHELL /end REF_MEASUREMENT
 /begin REF_CHARACTERISTIC p_ResetTimer_b.EV0_Rx.XCP_SHELL /end REF_CHARACTERISTIC
 /begin SUB_GROUP Time.EV0_Rx.XCP_SHELL TimeSum.EV0_Rx.XCP_SHELL /end SUB_GROUP
/end GROUP
/begin GROUP EV0_Sample.XCP_SHELL ""
 /begin REF_MEASUREMENT Max.MIN_MAX_Tick2Time.EV0_Sample.XCP_SHELL Min.MIN_MAX_Tick2Time.EV0_Sample.XCP_SHELL Time.MIN_MAX_Tick2Time.EV0_Sample.XCP_SHELL l_ResetTimer_b.EV0_Sample.XCP_SHELL l_StartTicks_u32.EV0_Sample.XCP_SHELL l_StopTicks_u32.EV0_Sample.XCP_SHELL l_Timeout_b.EV0_Sample.XCP_SHELL /end REF_MEASUREMENT
 /begin REF_CHARACTERISTIC p_ResetTimer_b.EV0_Sample.XCP_SHELL /end REF_CHARACTERISTIC
 /begin SUB_GROUP MIN_MAX_Tick2Time.EV0_Sample.XCP_SHELL /end SUB_GROUP
/end GROUP
/begin GROUP EV0_Stim.XCP_SHELL ""
 /begin REF_MEASUREMENT Max.MIN_MAX_Tick2Time.EV0_Stim.XCP_SHELL Min.MIN_MAX_Tick2Time.EV0_Stim.XCP_SHELL Time.MIN_MAX_Tick2Time.EV0_Stim.XCP_SHELL l_ResetTimer_b.EV0_Stim.XCP_SHELL l_StartTicks_u32.EV0_Stim.XCP_SHELL l_StopTicks_u32.EV0_Stim.XCP_SHELL l_Timeout_b.EV0_Stim.XCP_SHELL /end REF_MEASUREMENT
 /begin REF_CHARACTERISTIC p_ResetTimer_b.EV0_Stim.XCP_SHELL /end REF_CHARACTERISTIC
 /begin SUB_GROUP MIN_MAX_Tick2Time.EV0_Stim.XCP_SHELL /end SUB_GROUP
/end GROUP
/begin GROUP EV0_Tx.XCP_SHELL ""
 /begin REF_MEASUREMENT Max.Time.EV0_Tx.XCP_SHELL Max.TimeSum.EV0_Tx.XCP_SHELL Min.Time.EV0_Tx.XCP_SHELL Min.TimeSum.EV0_Tx.XCP_SHELL Time.Time.EV0_Tx.XCP_SHELL Time.TimeSum.EV0_Tx.XCP_SHELL l_ResetTimer_b.EV0_Tx.XCP_SHELL l_StartTicks_u32.EV0_Tx.XCP_SHELL l_StopTicks_u32.EV0_Tx.XCP_SHELL l_TimeSum_u32.EV0_Tx.XCP_SHELL l_Timeout_b.EV0_Tx.XCP_SHELL /end REF_MEASUREMENT
 /begin REF_CHARACTERISTIC p_ResetTimer_b.EV0_Tx.XCP_SHELL /end REF_CHARACTERISTIC
 /begin SUB_GROUP Time.EV0_Tx.XCP_SHELL TimeSum.EV0_Tx.XCP_SHELL /end SUB_GROUP
/end GROUP
/begin GROUP E_fl32.R01_B ""
 /begin REF_MEASUREMENT fl32_01.E_fl32.R01_B fl32_02.E_fl32.R01_B fl32_03.E_fl32.R01_B fl32_04.E_fl32.R01_B fl32_05.E_fl32.R01_B fl32_06.E_fl32.R01_B fl32_07.E_fl32.R01_B fl32_08.E_fl32.R01_B /end REF_MEASUREMENT
/end GROUP
/begin GROUP E_fl32.R02_B ""
 /begin REF_MEASUREMENT fl32_01.E_fl32.R02_B fl32_02.E_fl32.R02_B fl32_03.E_fl32.R02_B fl32_04.E_fl32.R02_B fl32_05.E_fl32.R02_B fl32_06.E_fl32.R02_B fl32_07.E_fl32.R02_B fl32_08.E_fl32.R02_B /end REF_MEASUREMENT
/end GROUP
/begin GROUP E_fl32.R03_B ""
 /begin REF_MEASUREMENT fl32_01.E_fl32.R03_B fl32_02.E_fl32.R03_B fl32_03.E_fl32.R03_B fl32_04.E_fl32.R03_B fl32_05.E_fl32.R03_B fl32_06.E_fl32.R03_B fl32_07.E_fl32.R03_B fl32_08.E_fl32.R03_B /end REF_MEASUREMENT
/end GROUP
/begin GROUP E_fl32.R04_B ""
 /begin REF_MEASUREMENT fl32_01.E_fl32.R04_B fl32_02.E_fl32.R04_B fl32_03.E_fl32.R04_B fl32_04.E_fl32.R04_B fl32_05.E_fl32.R04_B fl32_06.E_fl32.R04_B fl32_07.E_fl32.R04_B fl32_08.E_fl32.R04_B /end REF_MEASUREMENT
/end GROUP
/begin GROUP E_fl64.R01_B ""
 /begin REF_MEASUREMENT fl64_01.E_fl64.R01_B fl64_02.E_fl64.R01_B fl64_03.E_fl64.R01_B fl64_04.E_fl64.R01_B fl64_05.E_fl64.R01_B fl64_06.E_fl64.R01_B fl64_07.E_fl64.R01_B fl64_08.E_fl64.R01_B /end REF_MEASUREMENT
/end GROUP
/begin GROUP E_fl64.R02_B ""
 /begin REF_MEASUREMENT fl64_01.E_fl64.R02_B fl64_02.E_fl64.R02_B fl64_03.E_fl64.R02_B fl64_04.E_fl64.R02_B fl64_05.E_fl64.R02_B fl64_06.E_fl64.R02_B fl64_07.E_fl64.R02_B fl64_08.E_fl64.R02_B /end REF_MEASUREMENT
/end GROUP
/begin GROUP E_fl64.R03_B ""
 /begin REF_MEASUREMENT fl64_01.E_fl64.R03_B fl64_02.E_fl64.R03_B fl64_03.E_fl64.R03_B fl64_04.E_fl64.R03_B fl64_05.E_fl64.R03_B fl64_06.E_fl64.R03_B fl64_07.E_fl64.R03_B fl64_08.E_fl64.R03_B /end REF_MEASUREMENT
/end GROUP
/begin GROUP E_fl64.R04_B ""
 /begin REF_MEASUREMENT fl64_01.E_fl64.R04_B fl64_02.E_fl64.R04_B fl64_03.E_fl64.R04_B fl64_04.E_fl64.R04_B fl64_05.E_fl64.R04_B fl64_06.E_fl64.R04_B fl64_07.E_fl64.R04_B fl64_08.E_fl64.R04_B /end REF_MEASUREMENT
/end GROUP
/begin GROUP E_sint16.R01 ""
 /begin REF_MEASUREMENT sint16_01.E_sint16.R01 sint16_02.E_sint16.R01 sint16_03.E_sint16.R01 sint16_04.E_sint16.R01 sint16_05.E_sint16.R01 sint16_06.E_sint16.R01 sint16_07.E_sint16.R01 sint16_08.E_sint16.R01 /end REF_MEASUREMENT
/end GROUP
/begin GROUP E_sint16.R02 ""
 /begin REF_MEASUREMENT sint16_01.E_sint16.R02 sint16_02.E_sint16.R02 sint16_03.E_sint16.R02 sint16_04.E_sint16.R02 sint16_05.E_sint16.R02 sint16_06.E_sint16.R02 sint16_07.E_sint16.R02 sint16_08.E_sint16.R02 /end REF_MEASUREMENT
/end GROUP
/begin GROUP E_sint16.R03 ""
 /begin REF_MEASUREMENT sint16_01.E_sint16.R03 sint16_02.E_sint16.R03 sint16_03.E_sint16.R03 sint16_04.E_sint16.R03 sint16_05.E_sint16.R03 sint16_06.E_sint16.R03 sint16_07.E_sint16.R03 sint16_08.E_sint16.R03 /end REF_MEASUREMENT
/end GROUP
/begin GROUP E_sint16.R04 ""
 /begin REF_MEASUREMENT sint16_01.E_sint16.R04 sint16_02.E_sint16.R04 sint16_03.E_sint16.R04 sint16_04.E_sint16.R04 sint16_05.E_sint16.R04 sint16_06.E_sint16.R04 sint16_07.E_sint16.R04 sint16_08.E_sint16.R04 /end REF_MEASUREMENT
/end GROUP
/begin GROUP E_sint16.R05 ""
 /begin REF_MEASUREMENT sint16_01.E_sint16.R05 sint16_02.E_sint16.R05 sint16_03.E_sint16.R05 sint16_04.E_sint16.R05 sint16_05.E_sint16.R05 sint16_06.E_sint16.R05 sint16_07.E_sint16.R05 sint16_08.E_sint16.R05 /end REF_MEASUREMENT
/end GROUP
/begin GROUP E_sint16.R06 ""
 /begin REF_MEASUREMENT sint16_01.E_sint16.R06 sint16_02.E_sint16.R06 sint16_03.E_sint16.R06 sint16_04.E_sint16.R06 sint16_05.E_sint16.R06 sint16_06.E_sint16.R06 sint16_07.E_sint16.R06 sint16_08.E_sint16.R06 /end REF_MEASUREMENT
/end GROUP
/begin GROUP E_sint16.R07 ""
 /begin REF_MEASUREMENT sint16_01.E_sint16.R07 sint16_02.E_sint16.R07 sint16_03.E_sint16.R07 sint16_04.E_sint16.R07 sint16_05.E_sint16.R07 sint16_06.E_sint16.R07 sint16_07.E_sint16.R07 sint16_08.E_sint16.R07 /end REF_MEASUREMENT
/end GROUP
/begin GROUP E_sint16.R08 ""
 /begin REF_MEASUREMENT sint16_01.E_sint16.R08 sint16_02.E_sint16.R08 sint16_03.E_sint16.R08 sint16_04.E_sint16.R08 sint16_05.E_sint16.R08 sint16_06.E_sint16.R08 sint16_07.E_sint16.R08 sint16_08.E_sint16.R08 /end REF_MEASUREMENT
/end GROUP
/begin GROUP E_sint16.R09 ""
 /begin REF_MEASUREMENT sint16_01.E_sint16.R09 sint16_02.E_sint16.R09 sint16_03.E_sint16.R09 sint16_04.E_sint16.R09 sint16_05.E_sint16.R09 sint16_06.E_sint16.R09 sint16_07.E_sint16.R09 sint16_08.E_sint16.R09 /end REF_MEASUREMENT
/end GROUP
/begin GROUP E_sint16.R10 ""
 /begin REF_MEASUREMENT sint16_01.E_sint16.R10 sint16_02.E_sint16.R10 sint16_03.E_sint16.R10 sint16_04.E_sint16.R10 sint16_05.E_sint16.R10 sint16_06.E_sint16.R10 sint16_07.E_sint16.R10 sint16_08.E_sint16.R10 /end REF_MEASUREMENT
/end GROUP
/begin GROUP E_sint16.R11 ""
 /begin REF_MEASUREMENT sint16_01.E_sint16.R11 sint16_02.E_sint16.R11 sint16_03.E_sint16.R11 sint16_04.E_sint16.R11 sint16_05.E_sint16.R11 sint16_06.E_sint16.R11 sint16_07.E_sint16.R11 sint16_08.E_sint16.R11 /end REF_MEASUREMENT
/end GROUP
/begin GROUP E_sint16.R12 ""
 /begin REF_MEASUREMENT sint16_01.E_sint16.R12 sint16_02.E_sint16.R12 sint16_03.E_sint16.R12 sint16_04.E_sint16.R12 sint16_05.E_sint16.R12 sint16_06.E_sint16.R12 sint16_07.E_sint16.R12 sint16_08.E_sint16.R12 /end REF_MEASUREMENT
/end GROUP
/begin GROUP E_sint16.R13 ""
 /begin REF_MEASUREMENT sint16_01.E_sint16.R13 sint16_02.E_sint16.R13 sint16_03.E_sint16.R13 sint16_04.E_sint16.R13 sint16_05.E_sint16.R13 sint16_06.E_sint16.R13 sint16_07.E_sint16.R13 sint16_08.E_sint16.R13 /end REF_MEASUREMENT
/end GROUP
/begin GROUP E_sint16.R14 ""
 /begin REF_MEASUREMENT sint16_01.E_sint16.R14 sint16_02.E_sint16.R14 sint16_03.E_sint16.R14 sint16_04.E_sint16.R14 sint16_05.E_sint16.R14 sint16_06.E_sint16.R14 sint16_07.E_sint16.R14 sint16_08.E_sint16.R14 /end REF_MEASUREMENT
/end GROUP
/begin GROUP E_sint16.R15 ""
 /begin REF_MEASUREMENT sint16_01.E_sint16.R15 sint16_02.E_sint16.R15 sint16_03.E_sint16.R15 sint16_04.E_sint16.R15 sint16_05.E_sint16.R15 sint16_06.E_sint16.R15 sint16_07.E_sint16.R15 sint16_08.E_sint16.R15 /end REF_MEASUREMENT
/end GROUP
/begin GROUP E_sint16_1.R01_16bit ""
 /begin REF_MEASUREMENT sint16_01.E_sint16_1.R01_16bit sint16_02.E_sint16_1.R01_16bit sint16_03.E_sint16_1.R01_16bit sint16_04.E_sint16_1.R01_16bit sint16_05.E_sint16_1.R01_16bit sint16_06.E_sint16_1.R01_16bit sint16_07.E_sint16_1.R01_16bit sint16_08.E_sint16_1.R01_16bit /end REF_MEASUREMENT
/end GROUP
/begin GROUP E_sint16_2.R01_16bit ""
 /begin REF_MEASUREMENT sint16_01.E_sint16_2.R01_16bit sint16_02.E_sint16_2.R01_16bit sint16_03.E_sint16_2.R01_16bit sint16_04.E_sint16_2.R01_16bit sint16_05.E_sint16_2.R01_16bit sint16_06.E_sint16_2.R01_16bit sint16_07.E_sint16_2.R01_16bit sint16_08.E_sint16_2.R01_16bit /end REF_MEASUREMENT
/end GROUP
/begin GROUP E_sint16_3.R01_16bit ""
 /begin REF_MEASUREMENT sint16_01.E_sint16_3.R01_16bit sint16_02.E_sint16_3.R01_16bit sint16_03.E_sint16_3.R01_16bit sint16_04.E_sint16_3.R01_16bit sint16_05.E_sint16_3.R01_16bit sint16_06.E_sint16_3.R01_16bit sint16_07.E_sint16_3.R01_16bit sint16_08.E_sint16_3.R01_16bit /end REF_MEASUREMENT
/end GROUP
/begin GROUP E_sint16_4.R01_16bit ""
 /begin REF_MEASUREMENT sint16_01.E_sint16_4.R01_16bit sint16_02.E_sint16_4.R01_16bit sint16_03.E_sint16_4.R01_16bit sint16_04.E_sint16_4.R01_16bit sint16_05.E_sint16_4.R01_16bit sint16_06.E_sint16_4.R01_16bit sint16_07.E_sint16_4.R01_16bit sint16_08.E_sint16_4.R01_16bit /end REF_MEASUREMENT
/end GROUP
/begin GROUP E_sint32.R01_B ""
 /begin REF_MEASUREMENT sint32_01.E_sint32.R01_B sint32_02.E_sint32.R01_B sint32_03.E_sint32.R01_B sint32_04.E_sint32.R01_B sint32_05.E_sint32.R01_B sint32_06.E_sint32.R01_B sint32_07.E_sint32.R01_B sint32_08.E_sint32.R01_B /end REF_MEASUREMENT
/end GROUP
/begin GROUP E_sint32.R02_B ""
 /begin REF_MEASUREMENT sint32_01.E_sint32.R02_B sint32_02.E_sint32.R02_B sint32_03.E_sint32.R02_B sint32_04.E_sint32.R02_B sint32_05.E_sint32.R02_B sint32_06.E_sint32.R02_B sint32_07.E_sint32.R02_B sint32_08.E_sint32.R02_B /end REF_MEASUREMENT
/end GROUP
/begin GROUP E_sint32.R03_B ""
 /begin REF_MEASUREMENT sint32_01.E_sint32.R03_B sint32_02.E_sint32.R03_B sint32_03.E_sint32.R03_B sint32_04.E_sint32.R03_B sint32_05.E_sint32.R03_B sint32_06.E_sint32.R03_B sint32_07.E_sint32.R03_B sint32_08.E_sint32.R03_B /end REF_MEASUREMENT
/end GROUP
/begin GROUP E_sint32.R04_B ""
 /begin REF_MEASUREMENT sint32_01.E_sint32.R04_B sint32_02.E_sint32.R04_B sint32_03.E_sint32.R04_B sint32_04.E_sint32.R04_B sint32_05.E_sint32.R04_B sint32_06.E_sint32.R04_B sint32_07.E_sint32.R04_B sint32_08.E_sint32.R04_B /end REF_MEASUREMENT
/end GROUP
/begin GROUP E_sint8.R01 ""
 /begin REF_MEASUREMENT sint8_01.E_sint8.R01 sint8_02.E_sint8.R01 sint8_03.E_sint8.R01 sint8_04.E_sint8.R01 sint8_05.E_sint8.R01 sint8_06.E_sint8.R01 sint8_07.E_sint8.R01 sint8_08.E_sint8.R01 /end REF_MEASUREMENT
/end GROUP
/begin GROUP E_sint8.R02 ""
 /begin REF_MEASUREMENT sint8_01.E_sint8.R02 sint8_02.E_sint8.R02 sint8_03.E_sint8.R02 sint8_04.E_sint8.R02 sint8_05.E_sint8.R02 sint8_06.E_sint8.R02 sint8_07.E_sint8.R02 sint8_08.E_sint8.R02 /end REF_MEASUREMENT
/end GROUP
/begin GROUP E_sint8.R03 ""
 /begin REF_MEASUREMENT sint8_01.E_sint8.R03 sint8_02.E_sint8.R03 sint8_03.E_sint8.R03 sint8_04.E_sint8.R03 sint8_05.E_sint8.R03 sint8_06.E_sint8.R03 sint8_07.E_sint8.R03 sint8_08.E_sint8.R03 /end REF_MEASUREMENT
/end GROUP
/begin GROUP E_sint8.R04 ""
 /begin REF_MEASUREMENT sint8_01.E_sint8.R04 sint8_02.E_sint8.R04 sint8_03.E_sint8.R04 sint8_04.E_sint8.R04 sint8_05.E_sint8.R04 sint8_06.E_sint8.R04 sint8_07.E_sint8.R04 sint8_08.E_sint8.R04 /end REF_MEASUREMENT
/end GROUP
/begin GROUP E_sint8.R05 ""
 /begin REF_MEASUREMENT sint8_01.E_sint8.R05 sint8_02.E_sint8.R05 sint8_03.E_sint8.R05 sint8_04.E_sint8.R05 sint8_05.E_sint8.R05 sint8_06.E_sint8.R05 sint8_07.E_sint8.R05 sint8_08.E_sint8.R05 /end REF_MEASUREMENT
/end GROUP
/begin GROUP E_sint8.R06 ""
 /begin REF_MEASUREMENT sint8_01.E_sint8.R06 sint8_02.E_sint8.R06 sint8_03.E_sint8.R06 sint8_04.E_sint8.R06 sint8_05.E_sint8.R06 sint8_06.E_sint8.R06 sint8_07.E_sint8.R06 sint8_08.E_sint8.R06 /end REF_MEASUREMENT
/end GROUP
/begin GROUP E_sint8.R07 ""
 /begin REF_MEASUREMENT sint8_01.E_sint8.R07 sint8_02.E_sint8.R07 sint8_03.E_sint8.R07 sint8_04.E_sint8.R07 sint8_05.E_sint8.R07 sint8_06.E_sint8.R07 sint8_07.E_sint8.R07 sint8_08.E_sint8.R07 /end REF_MEASUREMENT
/end GROUP
/begin GROUP E_sint8.R08 ""
 /begin REF_MEASUREMENT sint8_01.E_sint8.R08 sint8_02.E_sint8.R08 sint8_03.E_sint8.R08 sint8_04.E_sint8.R08 sint8_05.E_sint8.R08 sint8_06.E_sint8.R08 sint8_07.E_sint8.R08 sint8_08.E_sint8.R08 /end REF_MEASUREMENT
/end GROUP
/begin GROUP E_sint8.R09 ""
 /begin REF_MEASUREMENT sint8_01.E_sint8.R09 sint8_02.E_sint8.R09 sint8_03.E_sint8.R09 sint8_04.E_sint8.R09 sint8_05.E_sint8.R09 sint8_06.E_sint8.R09 sint8_07.E_sint8.R09 sint8_08.E_sint8.R09 /end REF_MEASUREMENT
/end GROUP
/begin GROUP E_sint8.R10 ""
 /begin REF_MEASUREMENT sint8_01.E_sint8.R10 sint8_02.E_sint8.R10 sint8_03.E_sint8.R10 sint8_04.E_sint8.R10 sint8_05.E_sint8.R10 sint8_06.E_sint8.R10 sint8_07.E_sint8.R10 sint8_08.E_sint8.R10 /end REF_MEASUREMENT
/end GROUP
/begin GROUP E_sint8.R11 ""
 /begin REF_MEASUREMENT sint8_01.E_sint8.R11 sint8_02.E_sint8.R11 sint8_03.E_sint8.R11 sint8_04.E_sint8.R11 sint8_05.E_sint8.R11 sint8_06.E_sint8.R11 sint8_07.E_sint8.R11 sint8_08.E_sint8.R11 /end REF_MEASUREMENT
/end GROUP
/begin GROUP E_sint8.R12 ""
 /begin REF_MEASUREMENT sint8_01.E_sint8.R12 sint8_02.E_sint8.R12 sint8_03.E_sint8.R12 sint8_04.E_sint8.R12 sint8_05.E_sint8.R12 sint8_06.E_sint8.R12 sint8_07.E_sint8.R12 sint8_08.E_sint8.R12 /end REF_MEASUREMENT
/end GROUP
/begin GROUP E_sint8.R13 ""
 /begin REF_MEASUREMENT sint8_01.E_sint8.R13 sint8_02.E_sint8.R13 sint8_03.E_sint8.R13 sint8_04.E_sint8.R13 sint8_05.E_sint8.R13 sint8_06.E_sint8.R13 sint8_07.E_sint8.R13 sint8_08.E_sint8.R13 /end REF_MEASUREMENT
/end GROUP
/begin GROUP E_sint8.R14 ""
 /begin REF_MEASUREMENT sint8_01.E_sint8.R14 sint8_02.E_sint8.R14 sint8_03.E_sint8.R14 sint8_04.E_sint8.R14 sint8_05.E_sint8.R14 sint8_06.E_sint8.R14 sint8_07.E_sint8.R14 sint8_08.E_sint8.R14 /end REF_MEASUREMENT
/end GROUP
/begin GROUP E_sint8.R15 ""
 /begin REF_MEASUREMENT sint8_01.E_sint8.R15 sint8_02.E_sint8.R15 sint8_03.E_sint8.R15 sint8_04.E_sint8.R15 sint8_05.E_sint8.R15 sint8_06.E_sint8.R15 sint8_07.E_sint8.R15 sint8_08.E_sint8.R15 /end REF_MEASUREMENT
/end GROUP
/begin GROUP E_sint8.R16 ""
 /begin REF_MEASUREMENT sint8_01.E_sint8.R16 sint8_02.E_sint8.R16 sint8_03.E_sint8.R16 sint8_04.E_sint8.R16 sint8_05.E_sint8.R16 sint8_06.E_sint8.R16 sint8_07.E_sint8.R16 sint8_08.E_sint8.R16 /end REF_MEASUREMENT
/end GROUP
/begin GROUP E_sint8_1.R01_8bit ""
 /begin REF_MEASUREMENT sint8_01.E_sint8_1.R01_8bit sint8_02.E_sint8_1.R01_8bit sint8_03.E_sint8_1.R01_8bit sint8_04.E_sint8_1.R01_8bit sint8_05.E_sint8_1.R01_8bit sint8_06.E_sint8_1.R01_8bit sint8_07.E_sint8_1.R01_8bit sint8_08.E_sint8_1.R01_8bit /end REF_MEASUREMENT
/end GROUP
/begin GROUP E_sint8_2.R01_8bit ""
 /begin REF_MEASUREMENT sint8_01.E_sint8_2.R01_8bit sint8_02.E_sint8_2.R01_8bit sint8_03.E_sint8_2.R01_8bit sint8_04.E_sint8_2.R01_8bit sint8_05.E_sint8_2.R01_8bit sint8_06.E_sint8_2.R01_8bit sint8_07.E_sint8_2.R01_8bit sint8_08.E_sint8_2.R01_8bit /end REF_MEASUREMENT
/end GROUP
/begin GROUP E_sint8_3.R01_8bit ""
 /begin REF_MEASUREMENT sint8_01.E_sint8_3.R01_8bit sint8_02.E_sint8_3.R01_8bit sint8_03.E_sint8_3.R01_8bit sint8_04.E_sint8_3.R01_8bit sint8_05.E_sint8_3.R01_8bit sint8_06.E_sint8_3.R01_8bit sint8_07.E_sint8_3.R01_8bit sint8_08.E_sint8_3.R01_8bit /end REF_MEASUREMENT
/end GROUP
/begin GROUP E_sint8_4.R01_8bit ""
 /begin REF_MEASUREMENT sint8_01.E_sint8_4.R01_8bit sint8_02.E_sint8_4.R01_8bit sint8_03.E_sint8_4.R01_8bit sint8_04.E_sint8_4.R01_8bit sint8_05.E_sint8_4.R01_8bit sint8_06.E_sint8_4.R01_8bit sint8_07.E_sint8_4.R01_8bit sint8_08.E_sint8_4.R01_8bit /end REF_MEASUREMENT
/end GROUP
/begin GROUP E_sint8_5.R01_8bit ""
 /begin REF_MEASUREMENT sint8_01.E_sint8_5.R01_8bit sint8_02.E_sint8_5.R01_8bit sint8_03.E_sint8_5.R01_8bit sint8_04.E_sint8_5.R01_8bit sint8_05.E_sint8_5.R01_8bit sint8_06.E_sint8_5.R01_8bit sint8_07.E_sint8_5.R01_8bit sint8_08.E_sint8_5.R01_8bit /end REF_MEASUREMENT
/end GROUP
/begin GROUP E_sint8_6.R01_8bit ""
 /begin REF_MEASUREMENT sint8_01.E_sint8_6.R01_8bit sint8_02.E_sint8_6.R01_8bit sint8_03.E_sint8_6.R01_8bit sint8_04.E_sint8_6.R01_8bit sint8_05.E_sint8_6.R01_8bit sint8_06.E_sint8_6.R01_8bit sint8_07.E_sint8_6.R01_8bit sint8_08.E_sint8_6.R01_8bit /end REF_MEASUREMENT
/end GROUP
/begin GROUP E_sint8_7.R01_8bit ""
 /begin REF_MEASUREMENT sint8_01.E_sint8_7.R01_8bit sint8_02.E_sint8_7.R01_8bit sint8_03.E_sint8_7.R01_8bit sint8_04.E_sint8_7.R01_8bit sint8_05.E_sint8_7.R01_8bit sint8_06.E_sint8_7.R01_8bit sint8_07.E_sint8_7.R01_8bit sint8_08.E_sint8_7.R01_8bit /end REF_MEASUREMENT
/end GROUP
/begin GROUP E_sint8_8.R01_8bit ""
 /begin REF_MEASUREMENT sint8_01.E_sint8_8.R01_8bit sint8_02.E_sint8_8.R01_8bit sint8_03.E_sint8_8.R01_8bit sint8_04.E_sint8_8.R01_8bit sint8_05.E_sint8_8.R01_8bit sint8_06.E_sint8_8.R01_8bit sint8_07.E_sint8_8.R01_8bit sint8_08.E_sint8_8.R01_8bit /end REF_MEASUREMENT
/end GROUP
/begin GROUP E_uint16.R01 ""
 /begin REF_MEASUREMENT uint16_01.E_uint16.R01 uint16_02.E_uint16.R01 uint16_03.E_uint16.R01 uint16_04.E_uint16.R01 uint16_05.E_uint16.R01 uint16_06.E_uint16.R01 uint16_07.E_uint16.R01 uint16_08.E_uint16.R01 /end REF_MEASUREMENT
/end GROUP
/begin GROUP E_uint16.R02 ""
 /begin REF_MEASUREMENT uint16_01.E_uint16.R02 uint16_02.E_uint16.R02 uint16_03.E_uint16.R02 uint16_04.E_uint16.R02 uint16_05.E_uint16.R02 uint16_06.E_uint16.R02 uint16_07.E_uint16.R02 uint16_08.E_uint16.R02 /end REF_MEASUREMENT
/end GROUP
/begin GROUP E_uint16.R03 ""
 /begin REF_MEASUREMENT uint16_01.E_uint16.R03 uint16_02.E_uint16.R03 uint16_03.E_uint16.R03 uint16_04.E_uint16.R03 uint16_05.E_uint16.R03 uint16_06.E_uint16.R03 uint16_07.E_uint16.R03 uint16_08.E_uint16.R03 /end REF_MEASUREMENT
/end GROUP
/begin GROUP E_uint16.R04 ""
 /begin REF_MEASUREMENT uint16_01.E_uint16.R04 uint16_02.E_uint16.R04 uint16_03.E_uint16.R04 uint16_04.E_uint16.R04 uint16_05.E_uint16.R04 uint16_06.E_uint16.R04 uint16_07.E_uint16.R04 uint16_08.E_uint16.R04 /end REF_MEASUREMENT
/end GROUP
/begin GROUP E_uint16.R05 ""
 /begin REF_MEASUREMENT uint16_01.E_uint16.R05 uint16_02.E_uint16.R05 uint16_03.E_uint16.R05 uint16_04.E_uint16.R05 uint16_05.E_uint16.R05 uint16_06.E_uint16.R05 uint16_07.E_uint16.R05 uint16_08.E_uint16.R05 /end REF_MEASUREMENT
/end GROUP
/begin GROUP E_uint16.R06 ""
 /begin REF_MEASUREMENT uint16_01.E_uint16.R06 uint16_02.E_uint16.R06 uint16_03.E_uint16.R06 uint16_04.E_uint16.R06 uint16_05.E_uint16.R06 uint16_06.E_uint16.R06 uint16_07.E_uint16.R06 uint16_08.E_uint16.R06 /end REF_MEASUREMENT
/end GROUP
/begin GROUP E_uint16.R07 ""
 /begin REF_MEASUREMENT uint16_01.E_uint16.R07 uint16_02.E_uint16.R07 uint16_03.E_uint16.R07 uint16_04.E_uint16.R07 uint16_05.E_uint16.R07 uint16_06.E_uint16.R07 uint16_07.E_uint16.R07 uint16_08.E_uint16.R07 /end REF_MEASUREMENT
/end GROUP
/begin GROUP E_uint16.R08 ""
 /begin REF_MEASUREMENT uint16_01.E_uint16.R08 uint16_02.E_uint16.R08 uint16_03.E_uint16.R08 uint16_04.E_uint16.R08 uint16_05.E_uint16.R08 uint16_06.E_uint16.R08 uint16_07.E_uint16.R08 uint16_08.E_uint16.R08 /end REF_MEASUREMENT
/end GROUP
/begin GROUP E_uint16.R09 ""
 /begin REF_MEASUREMENT uint16_01.E_uint16.R09 uint16_02.E_uint16.R09 uint16_03.E_uint16.R09 uint16_04.E_uint16.R09 uint16_05.E_uint16.R09 uint16_06.E_uint16.R09 uint16_07.E_uint16.R09 uint16_08.E_uint16.R09 /end REF_MEASUREMENT
/end GROUP
/begin GROUP E_uint16.R10 ""
 /begin REF_MEASUREMENT uint16_01.E_uint16.R10 uint16_02.E_uint16.R10 uint16_03.E_uint16.R10 uint16_04.E_uint16.R10 uint16_05.E_uint16.R10 uint16_06.E_uint16.R10 uint16_07.E_uint16.R10 uint16_08.E_uint16.R10 /end REF_MEASUREMENT
/end GROUP
/begin GROUP E_uint16.R11 ""
 /begin REF_MEASUREMENT uint16_01.E_uint16.R11 uint16_02.E_uint16.R11 uint16_03.E_uint16.R11 uint16_04.E_uint16.R11 uint16_05.E_uint16.R11 uint16_06.E_uint16.R11 uint16_07.E_uint16.R11 uint16_08.E_uint16.R11 /end REF_MEASUREMENT
/end GROUP
/begin GROUP E_uint16.R12 ""
 /begin REF_MEASUREMENT uint16_01.E_uint16.R12 uint16_02.E_uint16.R12 uint16_03.E_uint16.R12 uint16_04.E_uint16.R12 uint16_05.E_uint16.R12 uint16_06.E_uint16.R12 uint16_07.E_uint16.R12 uint16_08.E_uint16.R12 /end REF_MEASUREMENT
/end GROUP
/begin GROUP E_uint16.R13 ""
 /begin REF_MEASUREMENT uint16_01.E_uint16.R13 uint16_02.E_uint16.R13 uint16_03.E_uint16.R13 uint16_04.E_uint16.R13 uint16_05.E_uint16.R13 uint16_06.E_uint16.R13 uint16_07.E_uint16.R13 uint16_08.E_uint16.R13 /end REF_MEASUREMENT
/end GROUP
/begin GROUP E_uint16.R14 ""
 /begin REF_MEASUREMENT uint16_01.E_uint16.R14 uint16_02.E_uint16.R14 uint16_03.E_uint16.R14 uint16_04.E_uint16.R14 uint16_05.E_uint16.R14 uint16_06.E_uint16.R14 uint16_07.E_uint16.R14 uint16_08.E_uint16.R14 /end REF_MEASUREMENT
/end GROUP
/begin GROUP E_uint16.R15 ""
 /begin REF_MEASUREMENT uint16_01.E_uint16.R15 uint16_02.E_uint16.R15 uint16_03.E_uint16.R15 uint16_04.E_uint16.R15 uint16_05.E_uint16.R15 uint16_06.E_uint16.R15 uint16_07.E_uint16.R15 uint16_08.E_uint16.R15 /end REF_MEASUREMENT
/end GROUP
/begin GROUP E_uint16_1.R01_16bit ""
 /begin REF_MEASUREMENT uint16_01.E_uint16_1.R01_16bit uint16_02.E_uint16_1.R01_16bit uint16_03.E_uint16_1.R01_16bit uint16_04.E_uint16_1.R01_16bit uint16_05.E_uint16_1.R01_16bit uint16_06.E_uint16_1.R01_16bit uint16_07.E_uint16_1.R01_16bit uint16_08.E_uint16_1.R01_16bit /end REF_MEASUREMENT
/end GROUP
/begin GROUP E_uint16_2.R01_16bit ""
 /begin REF_MEASUREMENT uint16_01.E_uint16_2.R01_16bit uint16_02.E_uint16_2.R01_16bit uint16_03.E_uint16_2.R01_16bit uint16_04.E_uint16_2.R01_16bit uint16_05.E_uint16_2.R01_16bit uint16_06.E_uint16_2.R01_16bit uint16_07.E_uint16_2.R01_16bit uint16_08.E_uint16_2.R01_16bit /end REF_MEASUREMENT
/end GROUP
/begin GROUP E_uint16_3.R01_16bit ""
 /begin REF_MEASUREMENT uint16_01.E_uint16_3.R01_16bit uint16_02.E_uint16_3.R01_16bit uint16_03.E_uint16_3.R01_16bit uint16_04.E_uint16_3.R01_16bit uint16_05.E_uint16_3.R01_16bit uint16_06.E_uint16_3.R01_16bit uint16_07.E_uint16_3.R01_16bit uint16_08.E_uint16_3.R01_16bit /end REF_MEASUREMENT
/end GROUP
/begin GROUP E_uint16_4.R01_16bit ""
 /begin REF_MEASUREMENT uint16_01.E_uint16_4.R01_16bit uint16_02.E_uint16_4.R01_16bit uint16_03.E_uint16_4.R01_16bit uint16_04.E_uint16_4.R01_16bit uint16_05.E_uint16_4.R01_16bit uint16_06.E_uint16_4.R01_16bit uint16_07.E_uint16_4.R01_16bit uint16_08.E_uint16_4.R01_16bit /end REF_MEASUREMENT
/end GROUP
/begin GROUP E_uint32.R01_B ""
 /begin REF_MEASUREMENT uint32_01.E_uint32.R01_B uint32_02.E_uint32.R01_B uint32_03.E_uint32.R01_B uint32_04.E_uint32.R01_B uint32_05.E_uint32.R01_B uint32_06.E_uint32.R01_B uint32_07.E_uint32.R01_B uint32_08.E_uint32.R01_B /end REF_MEASUREMENT
/end GROUP
/begin GROUP E_uint32.R02_B ""
 /begin REF_MEASUREMENT uint32_01.E_uint32.R02_B uint32_02.E_uint32.R02_B uint32_03.E_uint32.R02_B uint32_04.E_uint32.R02_B uint32_05.E_uint32.R02_B uint32_06.E_uint32.R02_B uint32_07.E_uint32.R02_B uint32_08.E_uint32.R02_B /end REF_MEASUREMENT
/end GROUP
/begin GROUP E_uint32.R03_B ""
 /begin REF_MEASUREMENT uint32_01.E_uint32.R03_B uint32_02.E_uint32.R03_B uint32_03.E_uint32.R03_B uint32_04.E_uint32.R03_B uint32_05.E_uint32.R03_B uint32_06.E_uint32.R03_B uint32_07.E_uint32.R03_B uint32_08.E_uint32.R03_B /end REF_MEASUREMENT
/end GROUP
/begin GROUP E_uint32.R04_B ""
 /begin REF_MEASUREMENT uint32_01.E_uint32.R04_B uint32_02.E_uint32.R04_B uint32_03.E_uint32.R04_B uint32_04.E_uint32.R04_B uint32_05.E_uint32.R04_B uint32_06.E_uint32.R04_B uint32_07.E_uint32.R04_B uint32_08.E_uint32.R04_B /end REF_MEASUREMENT
/end GROUP
/begin GROUP E_uint8.R01 ""
 /begin REF_MEASUREMENT uint8_01.E_uint8.R01 uint8_02.E_uint8.R01 uint8_03.E_uint8.R01 uint8_04.E_uint8.R01 uint8_05.E_uint8.R01 uint8_06.E_uint8.R01 uint8_07.E_uint8.R01 uint8_08.E_uint8.R01 /end REF_MEASUREMENT
/end GROUP
/begin GROUP E_uint8.R02 ""
 /begin REF_MEASUREMENT uint8_01.E_uint8.R02 uint8_02.E_uint8.R02 uint8_03.E_uint8.R02 uint8_04.E_uint8.R02 uint8_05.E_uint8.R02 uint8_06.E_uint8.R02 uint8_07.E_uint8.R02 uint8_08.E_uint8.R02 /end REF_MEASUREMENT
/end GROUP
/begin GROUP E_uint8.R03 ""
 /begin REF_MEASUREMENT uint8_01.E_uint8.R03 uint8_02.E_uint8.R03 uint8_03.E_uint8.R03 uint8_04.E_uint8.R03 uint8_05.E_uint8.R03 uint8_06.E_uint8.R03 uint8_07.E_uint8.R03 uint8_08.E_uint8.R03 /end REF_MEASUREMENT
/end GROUP
/begin GROUP E_uint8.R04 ""
 /begin REF_MEASUREMENT uint8_01.E_uint8.R04 uint8_02.E_uint8.R04 uint8_03.E_uint8.R04 uint8_04.E_uint8.R04 uint8_05.E_uint8.R04 uint8_06.E_uint8.R04 uint8_07.E_uint8.R04 uint8_08.E_uint8.R04 /end REF_MEASUREMENT
/end GROUP
/begin GROUP E_uint8.R05 ""
 /begin REF_MEASUREMENT uint8_01.E_uint8.R05 uint8_02.E_uint8.R05 uint8_03.E_uint8.R05 uint8_04.E_uint8.R05 uint8_05.E_uint8.R05 uint8_06.E_uint8.R05 uint8_07.E_uint8.R05 uint8_08.E_uint8.R05 /end REF_MEASUREMENT
/end GROUP
/begin GROUP E_uint8.R06 ""
 /begin REF_MEASUREMENT uint8_01.E_uint8.R06 uint8_02.E_uint8.R06 uint8_03.E_uint8.R06 uint8_04.E_uint8.R06 uint8_05.E_uint8.R06 uint8_06.E_uint8.R06 uint8_07.E_uint8.R06 uint8_08.E_uint8.R06 /end REF_MEASUREMENT
/end GROUP
/begin GROUP E_uint8.R07 ""
 /begin REF_MEASUREMENT uint8_01.E_uint8.R07 uint8_02.E_uint8.R07 uint8_03.E_uint8.R07 uint8_04.E_uint8.R07 uint8_05.E_uint8.R07 uint8_06.E_uint8.R07 uint8_07.E_uint8.R07 uint8_08.E_uint8.R07 /end REF_MEASUREMENT
/end GROUP
/begin GROUP E_uint8.R08 ""
 /begin REF_MEASUREMENT uint8_01.E_uint8.R08 uint8_02.E_uint8.R08 uint8_03.E_uint8.R08 uint8_04.E_uint8.R08 uint8_05.E_uint8.R08 uint8_06.E_uint8.R08 uint8_07.E_uint8.R08 uint8_08.E_uint8.R08 /end REF_MEASUREMENT
/end GROUP
/begin GROUP E_uint8.R09 ""
 /begin REF_MEASUREMENT uint8_01.E_uint8.R09 uint8_02.E_uint8.R09 uint8_03.E_uint8.R09 uint8_04.E_uint8.R09 uint8_05.E_uint8.R09 uint8_06.E_uint8.R09 uint8_07.E_uint8.R09 uint8_08.E_uint8.R09 /end REF_MEASUREMENT
/end GROUP
/begin GROUP E_uint8.R10 ""
 /begin REF_MEASUREMENT uint8_01.E_uint8.R10 uint8_02.E_uint8.R10 uint8_03.E_uint8.R10 uint8_04.E_uint8.R10 uint8_05.E_uint8.R10 uint8_06.E_uint8.R10 uint8_07.E_uint8.R10 uint8_08.E_uint8.R10 /end REF_MEASUREMENT
/end GROUP
/begin GROUP E_uint8.R11 ""
 /begin REF_MEASUREMENT uint8_01.E_uint8.R11 uint8_02.E_uint8.R11 uint8_03.E_uint8.R11 uint8_04.E_uint8.R11 uint8_05.E_uint8.R11 uint8_06.E_uint8.R11 uint8_07.E_uint8.R11 uint8_08.E_uint8.R11 /end REF_MEASUREMENT
/end GROUP
/begin GROUP E_uint8.R12 ""
 /begin REF_MEASUREMENT uint8_01.E_uint8.R12 uint8_02.E_uint8.R12 uint8_03.E_uint8.R12 uint8_04.E_uint8.R12 uint8_05.E_uint8.R12 uint8_06.E_uint8.R12 uint8_07.E_uint8.R12 uint8_08.E_uint8.R12 /end REF_MEASUREMENT
/end GROUP
/begin GROUP E_uint8.R13 ""
 /begin REF_MEASUREMENT uint8_01.E_uint8.R13 uint8_02.E_uint8.R13 uint8_03.E_uint8.R13 uint8_04.E_uint8.R13 uint8_05.E_uint8.R13 uint8_06.E_uint8.R13 uint8_07.E_uint8.R13 uint8_08.E_uint8.R13 /end REF_MEASUREMENT
/end GROUP
/begin GROUP E_uint8.R14 ""
 /begin REF_MEASUREMENT uint8_01.E_uint8.R14 uint8_02.E_uint8.R14 uint8_03.E_uint8.R14 uint8_04.E_uint8.R14 uint8_05.E_uint8.R14 uint8_06.E_uint8.R14 uint8_07.E_uint8.R14 uint8_08.E_uint8.R14 /end REF_MEASUREMENT
/end GROUP
/begin GROUP E_uint8.R15 ""
 /begin REF_MEASUREMENT uint8_01.E_uint8.R15 uint8_02.E_uint8.R15 uint8_03.E_uint8.R15 uint8_04.E_uint8.R15 uint8_05.E_uint8.R15 uint8_06.E_uint8.R15 uint8_07.E_uint8.R15 uint8_08.E_uint8.R15 /end REF_MEASUREMENT
/end GROUP
/begin GROUP E_uint8.R16 ""
 /begin REF_MEASUREMENT uint8_01.E_uint8.R16 uint8_02.E_uint8.R16 uint8_03.E_uint8.R16 uint8_04.E_uint8.R16 uint8_05.E_uint8.R16 uint8_06.E_uint8.R16 uint8_07.E_uint8.R16 uint8_08.E_uint8.R16 /end REF_MEASUREMENT
/end GROUP
/begin GROUP E_uint8.counter_send_fast ""
 /begin REF_MEASUREMENT uint8_01.E_uint8.counter_send_fast uint8_02.E_uint8.counter_send_fast uint8_03.E_uint8.counter_send_fast uint8_04.E_uint8.counter_send_fast uint8_05.E_uint8.counter_send_fast uint8_06.E_uint8.counter_send_fast uint8_07.E_uint8.counter_send_fast uint8_08.E_uint8.counter_send_fast /end REF_MEASUREMENT
/end GROUP
/begin GROUP E_uint8_1.R01_8bit ""
 /begin REF_MEASUREMENT uint8_01.E_uint8_1.R01_8bit uint8_02.E_uint8_1.R01_8bit uint8_03.E_uint8_1.R01_8bit uint8_04.E_uint8_1.R01_8bit uint8_05.E_uint8_1.R01_8bit uint8_06.E_uint8_1.R01_8bit uint8_07.E_uint8_1.R01_8bit uint8_08.E_uint8_1.R01_8bit /end REF_MEASUREMENT
/end GROUP
/begin GROUP E_uint8_2.R01_8bit ""
 /begin REF_MEASUREMENT uint8_01.E_uint8_2.R01_8bit uint8_02.E_uint8_2.R01_8bit uint8_03.E_uint8_2.R01_8bit uint8_04.E_uint8_2.R01_8bit uint8_05.E_uint8_2.R01_8bit uint8_06.E_uint8_2.R01_8bit uint8_07.E_uint8_2.R01_8bit uint8_08.E_uint8_2.R01_8bit /end REF_MEASUREMENT
/end GROUP
/begin GROUP E_uint8_3.R01_8bit ""
 /begin REF_MEASUREMENT uint8_01.E_uint8_3.R01_8bit uint8_02.E_uint8_3.R01_8bit uint8_03.E_uint8_3.R01_8bit uint8_04.E_uint8_3.R01_8bit uint8_05.E_uint8_3.R01_8bit uint8_06.E_uint8_3.R01_8bit uint8_07.E_uint8_3.R01_8bit uint8_08.E_uint8_3.R01_8bit /end REF_MEASUREMENT
/end GROUP
/begin GROUP E_uint8_4.R01_8bit ""
 /begin REF_MEASUREMENT uint8_01.E_uint8_4.R01_8bit uint8_02.E_uint8_4.R01_8bit uint8_03.E_uint8_4.R01_8bit uint8_04.E_uint8_4.R01_8bit uint8_05.E_uint8_4.R01_8bit uint8_06.E_uint8_4.R01_8bit uint8_07.E_uint8_4.R01_8bit uint8_08.E_uint8_4.R01_8bit /end REF_MEASUREMENT
/end GROUP
/begin GROUP E_uint8_5.R01_8bit ""
 /begin REF_MEASUREMENT uint8_01.E_uint8_5.R01_8bit uint8_02.E_uint8_5.R01_8bit uint8_03.E_uint8_5.R01_8bit uint8_04.E_uint8_5.R01_8bit uint8_05.E_uint8_5.R01_8bit uint8_06.E_uint8_5.R01_8bit uint8_07.E_uint8_5.R01_8bit uint8_08.E_uint8_5.R01_8bit /end REF_MEASUREMENT
/end GROUP
/begin GROUP E_uint8_6.R01_8bit ""
 /begin REF_MEASUREMENT uint8_01.E_uint8_6.R01_8bit uint8_02.E_uint8_6.R01_8bit uint8_03.E_uint8_6.R01_8bit uint8_04.E_uint8_6.R01_8bit uint8_05.E_uint8_6.R01_8bit uint8_06.E_uint8_6.R01_8bit uint8_07.E_uint8_6.R01_8bit uint8_08.E_uint8_6.R01_8bit /end REF_MEASUREMENT
/end GROUP
/begin GROUP E_uint8_7.R01_8bit ""
 /begin REF_MEASUREMENT uint8_01.E_uint8_7.R01_8bit uint8_02.E_uint8_7.R01_8bit uint8_03.E_uint8_7.R01_8bit uint8_04.E_uint8_7.R01_8bit uint8_05.E_uint8_7.R01_8bit uint8_06.E_uint8_7.R01_8bit uint8_07.E_uint8_7.R01_8bit uint8_08.E_uint8_7.R01_8bit /end REF_MEASUREMENT
/end GROUP
/begin GROUP E_uint8_8.R01_8bit ""
 /begin REF_MEASUREMENT uint8_01.E_uint8_8.R01_8bit uint8_02.E_uint8_8.R01_8bit uint8_03.E_uint8_8.R01_8bit uint8_04.E_uint8_8.R01_8bit uint8_05.E_uint8_8.R01_8bit uint8_06.E_uint8_8.R01_8bit uint8_07.E_uint8_8.R01_8bit uint8_08.E_uint8_8.R01_8bit /end REF_MEASUREMENT
/end GROUP
/begin GROUP MIN_MAX_Tick2Time.EV0_Roundtrip.XCP_SHELL ""
 /begin REF_MEASUREMENT Max.MIN_MAX_Tick2Time.EV0_Roundtrip.XCP_SHELL Min.MIN_MAX_Tick2Time.EV0_Roundtrip.XCP_SHELL Time.MIN_MAX_Tick2Time.EV0_Roundtrip.XCP_SHELL /end REF_MEASUREMENT
/end GROUP
/begin GROUP MIN_MAX_Tick2Time.EV0_Sample.XCP_SHELL ""
 /begin REF_MEASUREMENT Max.MIN_MAX_Tick2Time.EV0_Sample.XCP_SHELL Min.MIN_MAX_Tick2Time.EV0_Sample.XCP_SHELL Time.MIN_MAX_Tick2Time.EV0_Sample.XCP_SHELL /end REF_MEASUREMENT
/end GROUP
/begin GROUP MIN_MAX_Tick2Time.EV0_Stim.XCP_SHELL ""
 /begin REF_MEASUREMENT Max.MIN_MAX_Tick2Time.EV0_Stim.XCP_SHELL Min.MIN_MAX_Tick2Time.EV0_Stim.XCP_SHELL Time.MIN_MAX_Tick2Time.EV0_Stim.XCP_SHELL /end REF_MEASUREMENT
/end GROUP
/begin GROUP R01 "" ROOT
 /begin REF_MEASUREMENT sint16_01.E_sint16.R01 sint16_02.E_sint16.R01 sint16_03.E_sint16.R01 sint16_04.E_sint16.R01 sint16_05.E_sint16.R01 sint16_06.E_sint16.R01 sint16_07.E_sint16.R01 sint16_08.E_sint16.R01 sint8_01.E_sint8.R01 sint8_02.E_sint8.R01 sint8_03.E_sint8.R01 sint8_04.E_sint8.R01 sint8_05.E_sint8.R01 sint8_06.E_sint8.R01 sint8_07.E_sint8.R01 sint8_08.E_sint8.R01 uint16_01.E_uint16.R01 uint16_02.E_uint16.R01 uint16_03.E_uint16.R01 uint16_04.E_uint16.R01 uint16_05.E_uint16.R01 uint16_06.E_uint16.R01 uint16_07.E_uint16.R01 uint16_08.E_uint16.R01 uint8_01.E_uint8.R01 uint8_02.E_uint8.R01 uint8_03.E_uint8.R01 uint8_04.E_uint8.R01 uint8_05.E_uint8.R01 uint8_06.E_uint8.R01 uint8_07.E_uint8.R01 uint8_08.E_uint8.R01 /end REF_MEASUREMENT
/end GROUP
/begin GROUP R01_16bit "" ROOT
 /begin REF_MEASUREMENT sint16_01.E_sint16_1.R01_16bit sint16_01.E_sint16_2.R01_16bit sint16_01.E_sint16_3.R01_16bit sint16_01.E_sint16_4.R01_16bit sint16_02.E_sint16_1.R01_16bit sint16_02.E_sint16_2.R01_16bit sint16_02.E_sint16_3.R01_16bit sint16_02.E_sint16_4.R01_16bit sint16_03.E_sint16_1.R01_16bit sint16_03.E_sint16_2.R01_16bit sint16_03.E_sint16_3.R01_16bit sint16_03.E_sint16_4.R01_16bit sint16_04.E_sint16_1.R01_16bit sint16_04.E_sint16_2.R01_16bit sint16_04.E_sint16_3.R01_16bit sint16_04.E_sint16_4.R01_16bit sint16_05.E_sint16_1.R01_16bit sint16_05.E_sint16_2.R01_16bit sint16_05.E_sint16_3.R01_16bit sint16_05.E_sint16_4.R01_16bit sint16_06.E_sint16_1.R01_16bit sint16_06.E_sint16_2.R01_16bit sint16_06.E_sint16_3.R01_16bit sint16_06.E_sint16_4.R01_16bit sint16_07.E_sint16_1.R01_16bit sint16_07.E_sint16_2.R01_16bit sint16_07.E_sint16_3.R01_16bit sint16_07.E_sint16_4.R01_16bit sint16_08.E_sint16_1.R01_16bit sint16_08.E_sint16_2.R01_16bit sint16_08.E_sint16_3.R01_16bit sint16_08.E_sint16_4.R01_16bit uint16_01.E_uint16_1.R01_16bit uint16_01.E_uint16_2.R01_16bit uint16_01.E_uint16_3.R01_16bit uint16_01.E_uint16_4.R01_16bit uint16_02.E_uint16_1.R01_16bit uint16_02.E_uint16_2.R01_16bit uint16_02.E_uint16_3.R01_16bit uint16_02.E_uint16_4.R01_16bit uint16_03.E_uint16_1.R01_16bit uint16_03.E_uint16_2.R01_16bit uint16_03.E_uint16_3.R01_16bit uint16_03.E_uint16_4.R01_16bit uint16_04.E_uint16_1.R01_16bit uint16_04.E_uint16_2.R01_16bit uint16_04.E_uint16_3.R01_16bit uint16_04.E_uint16_4.R01_16bit uint16_05.E_uint16_1.R01_16bit uint16_05.E_uint16_2.R01_16bit uint16_05.E_uint16_3.R01_16bit uint16_05.E_uint16_4.R01_16bit uint16_06.E_uint16_1.R01_16bit uint16_06.E_uint16_2.R01_16bit uint16_06.E_uint16_3.R01_16bit uint16_06.E_uint16_4.R01_16bit uint16_07.E_uint16_1.R01_16bit uint16_07.E_uint16_2.R01_16bit uint16_07.E_uint16_3.R01_16bit uint16_07.E_uint16_4.R01_16bit uint16_08.E_uint16_1.R01_16bit uint16_08.E_uint16_2.R01_16bit uint16_08.E_uint16_3.R01_16bit uint16_08.E_uint16_4.R01_16bit /end REF_MEASUREMENT
/end GROUP
/begin GROUP R01_8bit "" ROOT
 /begin REF_MEASUREMENT sint8_01.E_sint8_1.R01_8bit sint8_01.E_sint8_2.R01_8bit sint8_01.E_sint8_3.R01_8bit sint8_01.E_sint8_4.R01_8bit sint8_01.E_sint8_5.R01_8bit sint8_01.E_sint8_6.R01_8bit sint8_01.E_sint8_7.R01_8bit sint8_01.E_sint8_8.R01_8bit sint8_02.E_sint8_1.R01_8bit sint8_02.E_sint8_2.R01_8bit sint8_02.E_sint8_3.R01_8bit sint8_02.E_sint8_4.R01_8bit sint8_02.E_sint8_5.R01_8bit sint8_02.E_sint8_6.R01_8bit sint8_02.E_sint8_7.R01_8bit sint8_02.E_sint8_8.R01_8bit sint8_03.E_sint8_1.R01_8bit sint8_03.E_sint8_2.R01_8bit sint8_03.E_sint8_3.R01_8bit sint8_03.E_sint8_4.R01_8bit sint8_03.E_sint8_5.R01_8bit sint8_03.E_sint8_6.R01_8bit sint8_03.E_sint8_7.R01_8bit sint8_03.E_sint8_8.R01_8bit sint8_04.E_sint8_1.R01_8bit sint8_04.E_sint8_2.R01_8bit sint8_04.E_sint8_3.R01_8bit sint8_04.E_sint8_4.R01_8bit sint8_04.E_sint8_5.R01_8bit sint8_04.E_sint8_6.R01_8bit sint8_04.E_sint8_7.R01_8bit sint8_04.E_sint8_8.R01_8bit sint8_05.E_sint8_1.R01_8bit sint8_05.E_sint8_2.R01_8bit sint8_05.E_sint8_3.R01_8bit sint8_05.E_sint8_4.R01_8bit sint8_05.E_sint8_5.R01_8bit sint8_05.E_sint8_6.R01_8bit sint8_05.E_sint8_7.R01_8bit sint8_05.E_sint8_8.R01_8bit sint8_06.E_sint8_1.R01_8bit sint8_06.E_sint8_2.R01_8bit sint8_06.E_sint8_3.R01_8bit sint8_06.E_sint8_4.R01_8bit sint8_06.E_sint8_5.R01_8bit sint8_06.E_sint8_6.R01_8bit sint8_06.E_sint8_7.R01_8bit sint8_06.E_sint8_8.R01_8bit sint8_07.E_sint8_1.R01_8bit sint8_07.E_sint8_2.R01_8bit sint8_07.E_sint8_3.R01_8bit sint8_07.E_sint8_4.R01_8bit sint8_07.E_sint8_5.R01_8bit sint8_07.E_sint8_6.R01_8bit sint8_07.E_sint8_7.R01_8bit sint8_07.E_sint8_8.R01_8bit sint8_08.E_sint8_1.R01_8bit sint8_08.E_sint8_2.R01_8bit sint8_08.E_sint8_3.R01_8bit sint8_08.E_sint8_4.R01_8bit sint8_08.E_sint8_5.R01_8bit sint8_08.E_sint8_6.R01_8bit sint8_08.E_sint8_7.R01_8bit sint8_08.E_sint8_8.R01_8bit uint8_01.E_uint8_1.R01_8bit uint8_01.E_uint8_2.R01_8bit uint8_01.E_uint8_3.R01_8bit uint8_01.E_uint8_4.R01_8bit uint8_01.E_uint8_5.R01_8bit uint8_01.E_uint8_6.R01_8bit uint8_01.E_uint8_7.R01_8bit uint8_01.E_uint8_8.R01_8bit uint8_02.E_uint8_1.R01_8bit uint8_02.E_uint8_2.R01_8bit uint8_02.E_uint8_3.R01_8bit uint8_02.E_uint8_4.R01_8bit uint8_02.E_uint8_5.R01_8bit uint8_02.E_uint8_6.R01_8bit uint8_02.E_uint8_7.R01_8bit uint8_02.E_uint8_8.R01_8bit uint8_03.E_uint8_1.R01_8bit uint8_03.E_uint8_2.R01_8bit uint8_03.E_uint8_3.R01_8bit uint8_03.E_uint8_4.R01_8bit uint8_03.E_uint8_5.R01_8bit uint8_03.E_uint8_6.R01_8bit uint8_03.E_uint8_7.R01_8bit uint8_03.E_uint8_8.R01_8bit uint8_04.E_uint8_1.R01_8bit uint8_04.E_uint8_2.R01_8bit uint8_04.E_uint8_3.R01_8bit uint8_04.E_uint8_4.R01_8bit uint8_04.E_uint8_5.R01_8bit uint8_04.E_uint8_6.R01_8bit uint8_04.E_uint8_7.R01_8bit uint8_04.E_uint8_8.R01_8bit uint8_05.E_uint8_1.R01_8bit uint8_05.E_uint8_2.R01_8bit uint8_05.E_uint8_3.R01_8bit uint8_05.E_uint8_4.R01_8bit uint8_05.E_uint8_5.R01_8bit uint8_05.E_uint8_6.R01_8bit uint8_05.E_uint8_7.R01_8bit uint8_05.E_uint8_8.R01_8bit uint8_06.E_uint8_1.R01_8bit uint8_06.E_uint8_2.R01_8bit uint8_06.E_uint8_3.R01_8bit uint8_06.E_uint8_4.R01_8bit uint8_06.E_uint8_5.R01_8bit uint8_06.E_uint8_6.R01_8bit uint8_06.E_uint8_7.R01_8bit uint8_06.E_uint8_8.R01_8bit uint8_07.E_uint8_1.R01_8bit uint8_07.E_uint8_2.R01_8bit uint8_07.E_uint8_3.R01_8bit uint8_07.E_uint8_4.R01_8bit uint8_07.E_uint8_5.R01_8bit uint8_07.E_uint8_6.R01_8bit uint8_07.E_uint8_7.R01_8bit uint8_07.E_uint8_8.R01_8bit uint8_08.E_uint8_1.R01_8bit uint8_08.E_uint8_2.R01_8bit uint8_08.E_uint8_3.R01_8bit uint8_08.E_uint8_4.R01_8bit uint8_08.E_uint8_5.R01_8bit uint8_08.E_uint8_6.R01_8bit uint8_08.E_uint8_7.R01_8bit uint8_08.E_uint8_8.R01_8bit /end REF_MEASUREMENT
/end GROUP
/begin GROUP R01_B "" ROOT
 /begin REF_MEASUREMENT fl32_01.E_fl32.R01_B fl32_02.E_fl32.R01_B fl32_03.E_fl32.R01_B fl32_04.E_fl32.R01_B fl32_05.E_fl32.R01_B fl32_06.E_fl32.R01_B fl32_07.E_fl32.R01_B fl32_08.E_fl32.R01_B fl64_01.E_fl64.R01_B fl64_02.E_fl64.R01_B fl64_03.E_fl64.R01_B fl64_04.E_fl64.R01_B fl64_05.E_fl64.R01_B fl64_06.E_fl64.R01_B fl64_07.E_fl64.R01_B fl64_08.E_fl64.R01_B sint32_01.E_sint32.R01_B sint32_02.E_sint32.R01_B sint32_03.E_sint32.R01_B sint32_04.E_sint32.R01_B sint32_05.E_sint32.R01_B sint32_06.E_sint32.R01_B sint32_07.E_sint32.R01_B sint32_08.E_sint32.R01_B uint32_01.E_uint32.R01_B uint32_02.E_uint32.R01_B uint32_03.E_uint32.R01_B uint32_04.E_uint32.R01_B uint32_05.E_uint32.R01_B uint32_06.E_uint32.R01_B uint32_07.E_uint32.R01_B uint32_08.E_uint32.R01_B /end REF_MEASUREMENT
/end GROUP
/begin GROUP R02 "" ROOT
 /begin REF_MEASUREMENT sint16_01.E_sint16.R02 sint16_02.E_sint16.R02 sint16_03.E_sint16.R02 sint16_04.E_sint16.R02 sint16_05.E_sint16.R02 sint16_06.E_sint16.R02 sint16_07.E_sint16.R02 sint16_08.E_sint16.R02 sint8_01.E_sint8.R02 sint8_02.E_sint8.R02 sint8_03.E_sint8.R02 sint8_04.E_sint8.R02 sint8_05.E_sint8.R02 sint8_06.E_sint8.R02 sint8_07.E_sint8.R02 sint8_08.E_sint8.R02 uint16_01.E_uint16.R02 uint16_02.E_uint16.R02 uint16_03.E_uint16.R02 uint16_04.E_uint16.R02 uint16_05.E_uint16.R02 uint16_06.E_uint16.R02 uint16_07.E_uint16.R02 uint16_08.E_uint16.R02 uint8_01.E_uint8.R02 uint8_02.E_uint8.R02 uint8_03.E_uint8.R02 uint8_04.E_uint8.R02 uint8_05.E_uint8.R02 uint8_06.E_uint8.R02 uint8_07.E_uint8.R02 uint8_08.E_uint8.R02 /end REF_MEASUREMENT
/end GROUP
/begin GROUP R02_B "" ROOT
 /begin REF_MEASUREMENT fl32_01.E_fl32.R02_B fl32_02.E_fl32.R02_B fl32_03.E_fl32.R02_B fl32_04.E_fl32.R02_B fl32_05.E_fl32.R02_B fl32_06.E_fl32.R02_B fl32_07.E_fl32.R02_B fl32_08.E_fl32.R02_B fl64_01.E_fl64.R02_B fl64_02.E_fl64.R02_B fl64_03.E_fl64.R02_B fl64_04.E_fl64.R02_B fl64_05.E_fl64.R02_B fl64_06.E_fl64.R02_B fl64_07.E_fl64.R02_B fl64_08.E_fl64.R02_B sint32_01.E_sint32.R02_B sint32_02.E_sint32.R02_B sint32_03.E_sint32.R02_B sint32_04.E_sint32.R02_B sint32_05.E_sint32.R02_B sint32_06.E_sint32.R02_B sint32_07.E_sint32.R02_B sint32_08.E_sint32.R02_B uint32_01.E_uint32.R02_B uint32_02.E_uint32.R02_B uint32_03.E_uint32.R02_B uint32_04.E_uint32.R02_B uint32_05.E_uint32.R02_B uint32_06.E_uint32.R02_B uint32_07.E_uint32.R02_B uint32_08.E_uint32.R02_B /end REF_MEASUREMENT
/end GROUP
/begin GROUP R03 "" ROOT
 /begin REF_MEASUREMENT sint16_01.E_sint16.R03 sint16_02.E_sint16.R03 sint16_03.E_sint16.R03 sint16_04.E_sint16.R03 sint16_05.E_sint16.R03 sint16_06.E_sint16.R03 sint16_07.E_sint16.R03 sint16_08.E_sint16.R03 sint8_01.E_sint8.R03 sint8_02.E_sint8.R03 sint8_03.E_sint8.R03 sint8_04.E_sint8.R03 sint8_05.E_sint8.R03 sint8_06.E_sint8.R03 sint8_07.E_sint8.R03 sint8_08.E_sint8.R03 uint16_01.E_uint16.R03 uint16_02.E_uint16.R03 uint16_03.E_uint16.R03 uint16_04.E_uint16.R03 uint16_05.E_uint16.R03 uint16_06.E_uint16.R03 uint16_07.E_uint16.R03 uint16_08.E_uint16.R03 uint8_01.E_uint8.R03 uint8_02.E_uint8.R03 uint8_03.E_uint8.R03 uint8_04.E_uint8.R03 uint8_05.E_uint8.R03 uint8_06.E_uint8.R03 uint8_07.E_uint8.R03 uint8_08.E_uint8.R03 /end REF_MEASUREMENT
/end GROUP
/begin GROUP R03_B "" ROOT
 /begin REF_MEASUREMENT fl32_01.E_fl32.R03_B fl32_02.E_fl32.R03_B fl32_03.E_fl32.R03_B fl32_04.E_fl32.R03_B fl32_05.E_fl32.R03_B fl32_06.E_fl32.R03_B fl32_07.E_fl32.R03_B fl32_08.E_fl32.R03_B fl64_01.E_fl64.R03_B fl64_02.E_fl64.R03_B fl64_03.E_fl64.R03_B fl64_04.E_fl64.R03_B fl64_05.E_fl64.R03_B fl64_06.E_fl64.R03_B fl64_07.E_fl64.R03_B fl64_08.E_fl64.R03_B sint32_01.E_sint32.R03_B sint32_02.E_sint32.R03_B sint32_03.E_sint32.R03_B sint32_04.E_sint32.R03_B sint32_05.E_sint32.R03_B sint32_06.E_sint32.R03_B sint32_07.E_sint32.R03_B sint32_08.E_sint32.R03_B uint32_01.E_uint32.R03_B uint32_02.E_uint32.R03_B uint32_03.E_uint32.R03_B uint32_04.E_uint32.R03_B uint32_05.E_uint32.R03_B uint32_06.E_uint32.R03_B uint32_07.E_uint32.R03_B uint32_08.E_uint32.R03_B /end REF_MEASUREMENT
/end GROUP
/begin GROUP R04 "" ROOT
 /begin REF_MEASUREMENT sint16_01.E_sint16.R04 sint16_02.E_sint16.R04 sint16_03.E_sint16.R04 sint16_04.E_sint16.R04 sint16_05.E_sint16.R04 sint16_06.E_sint16.R04 sint16_07.E_sint16.R04 sint16_08.E_sint16.R04 sint8_01.E_sint8.R04 sint8_02.E_sint8.R04 sint8_03.E_sint8.R04 sint8_04.E_sint8.R04 sint8_05.E_sint8.R04 sint8_06.E_sint8.R04 sint8_07.E_sint8.R04 sint8_08.E_sint8.R04 uint16_01.E_uint16.R04 uint16_02.E_uint16.R04 uint16_03.E_uint16.R04 uint16_04.E_uint16.R04 uint16_05.E_uint16.R04 uint16_06.E_uint16.R04 uint16_07.E_uint16.R04 uint16_08.E_uint16.R04 uint8_01.E_uint8.R04 uint8_02.E_uint8.R04 uint8_03.E_uint8.R04 uint8_04.E_uint8.R04 uint8_05.E_uint8.R04 uint8_06.E_uint8.R04 uint8_07.E_uint8.R04 uint8_08.E_uint8.R04 /end REF_MEASUREMENT
/end GROUP
/begin GROUP R04_B "" ROOT
 /begin REF_MEASUREMENT fl32_01.E_fl32.R04_B fl32_02.E_fl32.R04_B fl32_03.E_fl32.R04_B fl32_04.E_fl32.R04_B fl32_05.E_fl32.R04_B fl32_06.E_fl32.R04_B fl32_07.E_fl32.R04_B fl32_08.E_fl32.R04_B fl64_01.E_fl64.R04_B fl64_02.E_fl64.R04_B fl64_03.E_fl64.R04_B fl64_04.E_fl64.R04_B fl64_05.E_fl64.R04_B fl64_06.E_fl64.R04_B fl64_07.E_fl64.R04_B fl64_08.E_fl64.R04_B sint32_01.E_sint32.R04_B sint32_02.E_sint32.R04_B sint32_03.E_sint32.R04_B sint32_04.E_sint32.R04_B sint32_05.E_sint32.R04_B sint32_06.E_sint32.R04_B sint32_07.E_sint32.R04_B sint32_08.E_sint32.R04_B uint32_01.E_uint32.R04_B uint32_02.E_uint32.R04_B uint32_03.E_uint32.R04_B uint32_04.E_uint32.R04_B uint32_05.E_uint32.R04_B uint32_06.E_uint32.R04_B uint32_07.E_uint32.R04_B uint32_08.E_uint32.R04_B /end REF_MEASUREMENT
/end GROUP
/begin GROUP R05 "" ROOT
 /begin REF_MEASUREMENT sint16_01.E_sint16.R05 sint16_02.E_sint16.R05 sint16_03.E_sint16.R05 sint16_04.E_sint16.R05 sint16_05.E_sint16.R05 sint16_06.E_sint16.R05 sint16_07.E_sint16.R05 sint16_08.E_sint16.R05 sint8_01.E_sint8.R05 sint8_02.E_sint8.R05 sint8_03.E_sint8.R05 sint8_04.E_sint8.R05 sint8_05.E_sint8.R05 sint8_06.E_sint8.R05 sint8_07.E_sint8.R05 sint8_08.E_sint8.R05 uint16_01.E_uint16.R05 uint16_02.E_uint16.R05 uint16_03.E_uint16.R05 uint16_04.E_uint16.R05 uint16_05.E_uint16.R05 uint16_06.E_uint16.R05 uint16_07.E_uint16.R05 uint16_08.E_uint16.R05 uint8_01.E_uint8.R05 uint8_02.E_uint8.R05 uint8_03.E_uint8.R05 uint8_04.E_uint8.R05 uint8_05.E_uint8.R05 uint8_06.E_uint8.R05 uint8_07.E_uint8.R05 uint8_08.E_uint8.R05 /end REF_MEASUREMENT
/end GROUP
/begin GROUP R06 "" ROOT
 /begin REF_MEASUREMENT sint16_01.E_sint16.R06 sint16_02.E_sint16.R06 sint16_03.E_sint16.R06 sint16_04.E_sint16.R06 sint16_05.E_sint16.R06 sint16_06.E_sint16.R06 sint16_07.E_sint16.R06 sint16_08.E_sint16.R06 sint8_01.E_sint8.R06 sint8_02.E_sint8.R06 sint8_03.E_sint8.R06 sint8_04.E_sint8.R06 sint8_05.E_sint8.R06 sint8_06.E_sint8.R06 sint8_07.E_sint8.R06 sint8_08.E_sint8.R06 uint16_01.E_uint16.R06 uint16_02.E_uint16.R06 uint16_03.E_uint16.R06 uint16_04.E_uint16.R06 uint16_05.E_uint16.R06 uint16_06.E_uint16.R06 uint16_07.E_uint16.R06 uint16_08.E_uint16.R06 uint8_01.E_uint8.R06 uint8_02.E_uint8.R06 uint8_03.E_uint8.R06 uint8_04.E_uint8.R06 uint8_05.E_uint8.R06 uint8_06.E_uint8.R06 uint8_07.E_uint8.R06 uint8_08.E_uint8.R06 /end REF_MEASUREMENT
/end GROUP
/begin GROUP R07 "" ROOT
 /begin REF_MEASUREMENT sint16_01.E_sint16.R07 sint16_02.E_sint16.R07 sint16_03.E_sint16.R07 sint16_04.E_sint16.R07 sint16_05.E_sint16.R07 sint16_06.E_sint16.R07 sint16_07.E_sint16.R07 sint16_08.E_sint16.R07 sint8_01.E_sint8.R07 sint8_02.E_sint8.R07 sint8_03.E_sint8.R07 sint8_04.E_sint8.R07 sint8_05.E_sint8.R07 sint8_06.E_sint8.R07 sint8_07.E_sint8.R07 sint8_08.E_sint8.R07 uint16_01.E_uint16.R07 uint16_02.E_uint16.R07 uint16_03.E_uint16.R07 uint16_04.E_uint16.R07 uint16_05.E_uint16.R07 uint16_06.E_uint16.R07 uint16_07.E_uint16.R07 uint16_08.E_uint16.R07 uint8_01.E_uint8.R07 uint8_02.E_uint8.R07 uint8_03.E_uint8.R07 uint8_04.E_uint8.R07 uint8_05.E_uint8.R07 uint8_06.E_uint8.R07 uint8_07.E_uint8.R07 uint8_08.E_uint8.R07 /end REF_MEASUREMENT
/end GROUP
/begin GROUP R08 "" ROOT
 /begin REF_MEASUREMENT sint16_01.E_sint16.R08 sint16_02.E_sint16.R08 sint16_03.E_sint16.R08 sint16_04.E_sint16.R08 sint16_05.E_sint16.R08 sint16_06.E_sint16.R08 sint16_07.E_sint16.R08 sint16_08.E_sint16.R08 sint8_01.E_sint8.R08 sint8_02.E_sint8.R08 sint8_03.E_sint8.R08 sint8_04.E_sint8.R08 sint8_05.E_sint8.R08 sint8_06.E_sint8.R08 sint8_07.E_sint8.R08 sint8_08.E_sint8.R08 uint16_01.E_uint16.R08 uint16_02.E_uint16.R08 uint16_03.E_uint16.R08 uint16_04.E_uint16.R08 uint16_05.E_uint16.R08 uint16_06.E_uint16.R08 uint16_07.E_uint16.R08 uint16_08.E_uint16.R08 uint8_01.E_uint8.R08 uint8_02.E_uint8.R08 uint8_03.E_uint8.R08 uint8_04.E_uint8.R08 uint8_05.E_uint8.R08 uint8_06.E_uint8.R08 uint8_07.E_uint8.R08 uint8_08.E_uint8.R08 /end REF_MEASUREMENT
/end GROUP
/begin GROUP R09 "" ROOT
 /begin REF_MEASUREMENT sint16_01.E_sint16.R09 sint16_02.E_sint16.R09 sint16_03.E_sint16.R09 sint16_04.E_sint16.R09 sint16_05.E_sint16.R09 sint16_06.E_sint16.R09 sint16_07.E_sint16.R09 sint16_08.E_sint16.R09 sint8_01.E_sint8.R09 sint8_02.E_sint8.R09 sint8_03.E_sint8.R09 sint8_04.E_sint8.R09 sint8_05.E_sint8.R09 sint8_06.E_sint8.R09 sint8_07.E_sint8.R09 sint8_08.E_sint8.R09 uint16_01.E_uint16.R09 uint16_02.E_uint16.R09 uint16_03.E_uint16.R09 uint16_04.E_uint16.R09 uint16_05.E_uint16.R09 uint16_06.E_uint16.R09 uint16_07.E_uint16.R09 uint16_08.E_uint16.R09 uint8_01.E_uint8.R09 uint8_02.E_uint8.R09 uint8_03.E_uint8.R09 uint8_04.E_uint8.R09 uint8_05.E_uint8.R09 uint8_06.E_uint8.R09 uint8_07.E_uint8.R09 uint8_08.E_uint8.R09 /end REF_MEASUREMENT
/end GROUP
/begin GROUP R10 "" ROOT
 /begin REF_MEASUREMENT sint16_01.E_sint16.R10 sint16_02.E_sint16.R10 sint16_03.E_sint16.R10 sint16_04.E_sint16.R10 sint16_05.E_sint16.R10 sint16_06.E_sint16.R10 sint16_07.E_sint16.R10 sint16_08.E_sint16.R10 sint8_01.E_sint8.R10 sint8_02.E_sint8.R10 sint8_03.E_sint8.R10 sint8_04.E_sint8.R10 sint8_05.E_sint8.R10 sint8_06.E_sint8.R10 sint8_07.E_sint8.R10 sint8_08.E_sint8.R10 uint16_01.E_uint16.R10 uint16_02.E_uint16.R10 uint16_03.E_uint16.R10 uint16_04.E_uint16.R10 uint16_05.E_uint16.R10 uint16_06.E_uint16.R10 uint16_07.E_uint16.R10 uint16_08.E_uint16.R10 uint8_01.E_uint8.R10 uint8_02.E_uint8.R10 uint8_03.E_uint8.R10 uint8_04.E_uint8.R10 uint8_05.E_uint8.R10 uint8_06.E_uint8.R10 uint8_07.E_uint8.R10 uint8_08.E_uint8.R10 /end REF_MEASUREMENT
/end GROUP
/begin GROUP R11 "" ROOT
 /begin REF_MEASUREMENT sint16_01.E_sint16.R11 sint16_02.E_sint16.R11 sint16_03.E_sint16.R11 sint16_04.E_sint16.R11 sint16_05.E_sint16.R11 sint16_06.E_sint16.R11 sint16_07.E_sint16.R11 sint16_08.E_sint16.R11 sint8_01.E_sint8.R11 sint8_02.E_sint8.R11 sint8_03.E_sint8.R11 sint8_04.E_sint8.R11 sint8_05.E_sint8.R11 sint8_06.E_sint8.R11 sint8_07.E_sint8.R11 sint8_08.E_sint8.R11 uint16_01.E_uint16.R11 uint16_02.E_uint16.R11 uint16_03.E_uint16.R11 uint16_04.E_uint16.R11 uint16_05.E_uint16.R11 uint16_06.E_uint16.R11 uint16_07.E_uint16.R11 uint16_08.E_uint16.R11 uint8_01.E_uint8.R11 uint8_02.E_uint8.R11 uint8_03.E_uint8.R11 uint8_04.E_uint8.R11 uint8_05.E_uint8.R11 uint8_06.E_uint8.R11 uint8_07.E_uint8.R11 uint8_08.E_uint8.R11 /end REF_MEASUREMENT
/end GROUP
/begin GROUP R12 "" ROOT
 /begin REF_MEASUREMENT sint16_01.E_sint16.R12 sint16_02.E_sint16.R12 sint16_03.E_sint16.R12 sint16_04.E_sint16.R12 sint16_05.E_sint16.R12 sint16_06.E_sint16.R12 sint16_07.E_sint16.R12 sint16_08.E_sint16.R12 sint8_01.E_sint8.R12 sint8_02.E_sint8.R12 sint8_03.E_sint8.R12 sint8_04.E_sint8.R12 sint8_05.E_sint8.R12 sint8_06.E_sint8.R12 sint8_07.E_sint8.R12 sint8_08.E_sint8.R12 uint16_01.E_uint16.R12 uint16_02.E_uint16.R12 uint16_03.E_uint16.R12 uint16_04.E_uint16.R12 uint16_05.E_uint16.R12 uint16_06.E_uint16.R12 uint16_07.E_uint16.R12 uint16_08.E_uint16.R12 uint8_01.E_uint8.R12 uint8_02.E_uint8.R12 uint8_03.E_uint8.R12 uint8_04.E_uint8.R12 uint8_05.E_uint8.R12 uint8_06.E_uint8.R12 uint8_07.E_uint8.R12 uint8_08.E_uint8.R12 /end REF_MEASUREMENT
/end GROUP
/begin GROUP R13 "" ROOT
 /begin REF_MEASUREMENT sint16_01.E_sint16.R13 sint16_02.E_sint16.R13 sint16_03.E_sint16.R13 sint16_04.E_sint16.R13 sint16_05.E_sint16.R13 sint16_06.E_sint16.R13 sint16_07.E_sint16.R13 sint16_08.E_sint16.R13 sint8_01.E_sint8.R13 sint8_02.E_sint8.R13 sint8_03.E_sint8.R13 sint8_04.E_sint8.R13 sint8_05.E_sint8.R13 sint8_06.E_sint8.R13 sint8_07.E_sint8.R13 sint8_08.E_sint8.R13 uint16_01.E_uint16.R13 uint16_02.E_uint16.R13 uint16_03.E_uint16.R13 uint16_04.E_uint16.R13 uint16_05.E_uint16.R13 uint16_06.E_uint16.R13 uint16_07.E_uint16.R13 uint16_08.E_uint16.R13 uint8_01.E_uint8.R13 uint8_02.E_uint8.R13 uint8_03.E_uint8.R13 uint8_04.E_uint8.R13 uint8_05.E_uint8.R13 uint8_06.E_uint8.R13 uint8_07.E_uint8.R13 uint8_08.E_uint8.R13 /end REF_MEASUREMENT
/end GROUP
/begin GROUP R14 "" ROOT
 /begin REF_MEASUREMENT sint16_01.E_sint16.R14 sint16_02.E_sint16.R14 sint16_03.E_sint16.R14 sint16_04.E_sint16.R14 sint16_05.E_sint16.R14 sint16_06.E_sint16.R14 sint16_07.E_sint16.R14 sint16_08.E_sint16.R14 sint8_01.E_sint8.R14 sint8_02.E_sint8.R14 sint8_03.E_sint8.R14 sint8_04.E_sint8.R14 sint8_05.E_sint8.R14 sint8_06.E_sint8.R14 sint8_07.E_sint8.R14 sint8_08.E_sint8.R14 uint16_01.E_uint16.R14 uint16_02.E_uint16.R14 uint16_03.E_uint16.R14 uint16_04.E_uint16.R14 uint16_05.E_uint16.R14 uint16_06.E_uint16.R14 uint16_07.E_uint16.R14 uint16_08.E_uint16.R14 uint8_01.E_uint8.R14 uint8_02.E_uint8.R14 uint8_03.E_uint8.R14 uint8_04.E_uint8.R14 uint8_05.E_uint8.R14 uint8_06.E_uint8.R14 uint8_07.E_uint8.R14 uint8_08.E_uint8.R14 /end REF_MEASUREMENT
/end GROUP
/begin GROUP R15 "" ROOT
 /begin REF_MEASUREMENT sint16_01.E_sint16.R15 sint16_02.E_sint16.R15 sint16_03.E_sint16.R15 sint16_04.E_sint16.R15 sint16_05.E_sint16.R15 sint16_06.E_sint16.R15 sint16_07.E_sint16.R15 sint16_08.E_sint16.R15 sint8_01.E_sint8.R15 sint8_02.E_sint8.R15 sint8_03.E_sint8.R15 sint8_04.E_sint8.R15 sint8_05.E_sint8.R15 sint8_06.E_sint8.R15 sint8_07.E_sint8.R15 sint8_08.E_sint8.R15 uint16_01.E_uint16.R15 uint16_02.E_uint16.R15 uint16_03.E_uint16.R15 uint16_04.E_uint16.R15 uint16_05.E_uint16.R15 uint16_06.E_uint16.R15 uint16_07.E_uint16.R15 uint16_08.E_uint16.R15 uint8_01.E_uint8.R15 uint8_02.E_uint8.R15 uint8_03.E_uint8.R15 uint8_04.E_uint8.R15 uint8_05.E_uint8.R15 uint8_06.E_uint8.R15 uint8_07.E_uint8.R15 uint8_08.E_uint8.R15 /end REF_MEASUREMENT
/end GROUP
/begin GROUP R16 "" ROOT
 /begin REF_MEASUREMENT sint8_01.E_sint8.R16 sint8_02.E_sint8.R16 sint8_03.E_sint8.R16 sint8_04.E_sint8.R16 sint8_05.E_sint8.R16 sint8_06.E_sint8.R16 sint8_07.E_sint8.R16 sint8_08.E_sint8.R16 uint8_01.E_uint8.R16 uint8_02.E_uint8.R16 uint8_03.E_uint8.R16 uint8_04.E_uint8.R16 uint8_05.E_uint8.R16 uint8_06.E_uint8.R16 uint8_07.E_uint8.R16 uint8_08.E_uint8.R16 /end REF_MEASUREMENT
/end GROUP
/begin GROUP Time.EV0_Rx.XCP_SHELL ""
 /begin REF_MEASUREMENT Max.Time.EV0_Rx.XCP_SHELL Min.Time.EV0_Rx.XCP_SHELL Time.Time.EV0_Rx.XCP_SHELL /end REF_MEASUREMENT
/end GROUP
/begin GROUP Time.EV0_Tx.XCP_SHELL ""
 /begin REF_MEASUREMENT Max.Time.EV0_Tx.XCP_SHELL Min.Time.EV0_Tx.XCP_SHELL Time.Time.EV0_Tx.XCP_SHELL /end REF_MEASUREMENT
/end GROUP
/begin GROUP TimeSum.EV0_Rx.XCP_SHELL ""
 /begin REF_MEASUREMENT Max.TimeSum.EV0_Rx.XCP_SHELL Min.TimeSum.EV0_Rx.XCP_SHELL Time.TimeSum.EV0_Rx.XCP_SHELL /end REF_MEASUREMENT
/end GROUP
/begin GROUP TimeSum.EV0_Tx.XCP_SHELL ""
 /begin REF_MEASUREMENT Max.TimeSum.EV0_Tx.XCP_SHELL Min.TimeSum.EV0_Tx.XCP_SHELL Time.TimeSum.EV0_Tx.XCP_SHELL /end REF_MEASUREMENT
/end GROUP
/begin GROUP XCP_SHELL "" ROOT
 /begin REF_MEASUREMENT Max.MIN_MAX_Tick2Time.EV0_Roundtrip.XCP_SHELL Max.MIN_MAX_Tick2Time.EV0_Sample.XCP_SHELL Max.MIN_MAX_Tick2Time.EV0_Stim.XCP_SHELL Max.Time.EV0_Rx.XCP_SHELL Max.Time.EV0_Tx.XCP_SHELL Max.TimeSum.EV0_Rx.XCP_SHELL Max.TimeSum.EV0_Tx.XCP_SHELL Min.MIN_MAX_Tick2Time.EV0_Roundtrip.XCP_SHELL Min.MIN_MAX_Tick2Time.EV0_Sample.XCP_SHELL Min.MIN_MAX_Tick2Time.EV0_Stim.XCP_SHELL Min.Time.EV0_Rx.XCP_SHELL Min.Time.EV0_Tx.XCP_SHELL Min.TimeSum.EV0_Rx.XCP_SHELL Min.TimeSum.EV0_Tx.XCP_SHELL Time.MIN_MAX_Tick2Time.EV0_Roundtrip.XCP_SHELL Time.MIN_MAX_Tick2Time.EV0_Sample.XCP_SHELL Time.MIN_MAX_Tick2Time.EV0_Stim.XCP_SHELL Time.Time.EV0_Rx.XCP_SHELL Time.Time.EV0_Tx.XCP_SHELL Time.TimeSum.EV0_Rx.XCP_SHELL Time.TimeSum.EV0_Tx.XCP_SHELL l_ResetTimer_b.EV0_Roundtrip.XCP_SHELL l_ResetTimer_b.EV0_Rx.XCP_SHELL l_ResetTimer_b.EV0_Sample.XCP_SHELL l_ResetTimer_b.EV0_Stim.XCP_SHELL l_ResetTimer_b.EV0_Tx.XCP_SHELL l_StartTicks_u32.EV0_Roundtrip.XCP_SHELL l_StartTicks_u32.EV0_Rx.XCP_SHELL l_StartTicks_u32.EV0_Sample.XCP_SHELL l_StartTicks_u32.EV0_Stim.XCP_SHELL l_StartTicks_u32.EV0_Tx.XCP_SHELL l_StopTicks_u32.EV0_Roundtrip.XCP_SHELL l_StopTicks_u32.EV0_Rx.XCP_SHELL l_StopTicks_u32.EV0_Sample.XCP_SHELL l_StopTicks_u32.EV0_Stim.XCP_SHELL l_StopTicks_u32.EV0_Tx.XCP_SHELL l_TimeSum_u32.EV0_Rx.XCP_SHELL l_TimeSum_u32.EV0_Tx.XCP_SHELL l_Timeout_b.EV0_Roundtrip.XCP_SHELL l_Timeout_b.EV0_Rx.XCP_SHELL l_Timeout_b.EV0_Sample.XCP_SHELL l_Timeout_b.EV0_Stim.XCP_SHELL l_Timeout_b.EV0_Tx.XCP_SHELL /end REF_MEASUREMENT
 /begin REF_CHARACTERISTIC p_ResetTimer_b.EV0_Roundtrip.XCP_SHELL p_ResetTimer_b.EV0_Rx.XCP_SHELL p_ResetTimer_b.EV0_Sample.XCP_SHELL p_ResetTimer_b.EV0_Stim.XCP_SHELL p_ResetTimer_b.EV0_Tx.XCP_SHELL /end REF_CHARACTERISTIC
/end GROUP
/begin GROUP counter_send_fast "" ROOT
 /begin REF_MEASUREMENT uint8_01.E_uint8.counter_send_fast uint8_02.E_uint8.counter_send_fast uint8_03.E_uint8.counter_send_fast uint8_04.E_uint8.counter_send_fast uint8_05.E_uint8.counter_send_fast uint8_06.E_uint8.counter_send_fast uint8_07.E_uint8.counter_send_fast uint8_08.E_uint8.counter_send_fast /end REF_MEASUREMENT
/end GROUP
/begin RECORD_LAYOUT STANDARD_VALUE_U16 FNC_VALUES 1 UWORD COLUMN_DIR DIRECT /end RECORD_LAYOUT
/begin RECORD_LAYOUT STANDARD_VALUE_U32 FNC_VALUES 1 ULONG COLUMN_DIR DIRECT /end RECORD_LAYOUT
/begin RECORD_LAYOUT STANDARD_VALUE_U8 FNC_VALUES 1 UBYTE COLUMN_DIR DIRECT /end RECORD_LAYOUT
/end MODULE
/end PROJECT
