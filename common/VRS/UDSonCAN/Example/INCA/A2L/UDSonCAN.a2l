ASAP2_VERSION 1 61
/begin PROJECT HWA_UDSonCAN_ReferenceSystem "Modified for UDSonCAN Tests with new CalMeasure Mapping"
/begin HEADER "" VERSION "000" PROJECT_NO ASD /end HEADER
/begin MODULE HWA_UDSonCAN_ReferenceSystem "Modified for UDSonCAN Tests with new CalMeasure Mapping"
/begin MOD_COMMON "2013-05-06 09:52:20	create by ETASHexVirtualAddressTableHeaderV2" BYTE_ORDER MSB_FIRST ALIGNMENT_BYTE 1 ALIGNMENT_WORD 2 ALIGNMENT_LONG 4 ALIGNMENT_FLOAT32_IEEE 4 ALIGNMENT_FLOAT64_IEEE 8 /end MOD_COMMON
/begin CHARACTERISTIC _element_have_been_moved_to_ALL_PROT__SERAM_PageControl.CCP_Page "" VALUE 0x1D135C STANDARD_VALUE_U8 0.0 ident 0 1 BIT_MASK 0x1 /end CHARACTERISTIC
/begin CHARACTERISTIC HWE_CANA_OBD_TX_P7.SHELL.BASE "" VALUE 0x1DA864 STANDARD_VALUE_U32 0.0 ident 0 4294967295 /end CHARACTERISTIC
/begin CHARACTERISTIC HWE_CANA_StopDebTicks.SHELL.BASE "" VALUE 0x1DA8D0 STANDARD_VALUE_U32 0.0 ident 0 4294967295 /end CHARACTERISTIC
/begin CHARACTERISTIC HWE_CANA_UseBusOffTimer.SHELL.BASE "" VALUE 0x1DA898 STANDARD_VALUE_S8 0.0 ident 0 1 BIT_MASK 0x1 /end CHARACTERISTIC
/begin CHARACTERISTIC HWE_CANB_CCP_DAQ0_P4.SHELL.BASE "" VALUE 0x1DA874 STANDARD_VALUE_U32 0.0 ident 0 4294967295 /end CHARACTERISTIC
/begin CHARACTERISTIC HWE_CANB_CCP_DAQ1_P5.SHELL.BASE "" VALUE 0x1DA8DC STANDARD_VALUE_U32 0.0 ident 0 4294967295 /end CHARACTERISTIC
/begin CHARACTERISTIC HWE_CANB_CCP_DAQ2_P6.SHELL.BASE "" VALUE 0x1DA848 STANDARD_VALUE_U32 0.0 ident 0 4294967295 /end CHARACTERISTIC
/begin CHARACTERISTIC HWE_CANB_CCP_RX_P2.SHELL.BASE "" VALUE 0x1DA868 STANDARD_VALUE_U32 0.0 ident 0 4294967295 /end CHARACTERISTIC
/begin CHARACTERISTIC HWE_CANB_CCP_TX_P3.SHELL.BASE "" VALUE 0x1DA8BC STANDARD_VALUE_U32 0.0 ident 0 4294967295 /end CHARACTERISTIC
/begin CHARACTERISTIC HWE_CANB_MUX_ID5xx_P8.SHELL.BASE "" VALUE 0x1DA8A0 STANDARD_VALUE_U32 0.0 ident 0 4294967295 /end CHARACTERISTIC
/begin CHARACTERISTIC HWE_CANB_StopDebTicks.SHELL.BASE "" VALUE 0x1DA890 STANDARD_VALUE_U32 0.0 ident 0 4294967295 /end CHARACTERISTIC
/begin CHARACTERISTIC HWE_CANB_UseBusOffTimer.SHELL.BASE "" VALUE 0x1DA899 STANDARD_VALUE_S8 0.0 ident 0 1 BIT_MASK 0x1 /end CHARACTERISTIC
/begin CHARACTERISTIC HWE_CANB_XCP_CMD_RX_P4.SHELL.BASE "" VALUE 0x1DA894 STANDARD_VALUE_U32 0.0 ident 0 4294967295 /end CHARACTERISTIC
/begin CHARACTERISTIC HWE_CANB_XCP_DAQ0_P6.SHELL.BASE "" VALUE 0x1DA8CC STANDARD_VALUE_U32 0.0 ident 0 4294967295 /end CHARACTERISTIC
/begin CHARACTERISTIC HWE_CANB_XCP_RES_TX_P5.SHELL.BASE "" VALUE 0x1DA84C STANDARD_VALUE_U32 0.0 ident 0 4294967295 /end CHARACTERISTIC
/begin CHARACTERISTIC HWE_CANB_XCP_STIM0_P0.SHELL.BASE "" VALUE 0x1DA888 STANDARD_VALUE_U32 0.0 ident 0 4294967295 /end CHARACTERISTIC
/begin CHARACTERISTIC HWE_CANB_XCP_STIM1_P1.SHELL.BASE "" VALUE 0x1DA8AC STANDARD_VALUE_U32 0.0 ident 0 4294967295 /end CHARACTERISTIC
/begin CHARACTERISTIC HWE_CANB_XCP_STIM2_P2.SHELL.BASE "" VALUE 0x1DA870 STANDARD_VALUE_U32 0.0 ident 0 4294967295 /end CHARACTERISTIC
/begin CHARACTERISTIC HWE_CANB_XCP_STIM3_P3.SHELL.BASE "" VALUE 0x1DA880 STANDARD_VALUE_U32 0.0 ident 0 4294967295 /end CHARACTERISTIC
/begin CHARACTERISTIC HWE_CANC_StopDebTicks.SHELL.BASE "" VALUE 0x1DA8C0 STANDARD_VALUE_U32 0.0 ident 0 4294967295 /end CHARACTERISTIC
/begin CHARACTERISTIC HWE_CANC_UseBusOffTimer.SHELL.BASE "" VALUE 0x1DA87A STANDARD_VALUE_S8 0.0 ident 0 1 BIT_MASK 0x1 /end CHARACTERISTIC
/begin CHARACTERISTIC HWE_IP09_DcycMax.SHELL.BASE "" VALUE 0x1DA88C STANDARD_VALUE_S16 0.0 TPU_Dcyc 0.0 327.67 /end CHARACTERISTIC
/begin CHARACTERISTIC HWE_IP09_DcycMin.SHELL.BASE "" VALUE 0x1DA8C8 STANDARD_VALUE_S16 0.0 TPU_Dcyc 0.0 327.67 /end CHARACTERISTIC
/begin CHARACTERISTIC HWE_IP09_PerMax.SHELL.BASE "" VALUE 0x1DA86C STANDARD_VALUE_S16 0.0 TPU_Dcyc 0.0 327.67 /end CHARACTERISTIC
/begin CHARACTERISTIC HWE_IP09_PerMin.SHELL.BASE "" VALUE 0x1DA8A8 STANDARD_VALUE_S16 0.0 TPU_Dcyc 0.0 327.67 /end CHARACTERISTIC
/begin CHARACTERISTIC HWE_IP10_DcycMax.SHELL.BASE "" VALUE 0x1DA8B8 STANDARD_VALUE_S16 0.0 TPU_Dcyc 0.0 327.67 /end CHARACTERISTIC
/begin CHARACTERISTIC HWE_IP10_DcycMin.SHELL.BASE "" VALUE 0x1DA89A STANDARD_VALUE_S16 0.0 TPU_Dcyc 0.0 327.67 /end CHARACTERISTIC
/begin CHARACTERISTIC HWE_IP10_PerMax.SHELL.BASE "" VALUE 0x1DA87C STANDARD_VALUE_S16 0.0 TPU_Dcyc 0.0 327.67 /end CHARACTERISTIC
/begin CHARACTERISTIC HWE_IP10_PerMin.SHELL.BASE "" VALUE 0x1DA8D6 STANDARD_VALUE_S16 0.0 TPU_Dcyc 0.0 327.67 /end CHARACTERISTIC
/begin CHARACTERISTIC HWE_IP11_DcycMax.SHELL.BASE "" VALUE 0x1DA8D4 STANDARD_VALUE_S16 0.0 TPU_Dcyc 0.0 327.67 /end CHARACTERISTIC
/begin CHARACTERISTIC HWE_IP11_DcycMin.SHELL.BASE "" VALUE 0x1DA8B4 STANDARD_VALUE_S16 0.0 TPU_Dcyc 0.0 327.67 /end CHARACTERISTIC
/begin CHARACTERISTIC HWE_IP11_PerMax.SHELL.BASE "" VALUE 0x1DA860 STANDARD_VALUE_S16 0.0 TPU_Dcyc 0.0 327.67 /end CHARACTERISTIC
/begin CHARACTERISTIC HWE_IP11_PerMin.SHELL.BASE "" VALUE 0x1DA8C4 STANDARD_VALUE_S16 0.0 TPU_Dcyc 0.0 327.67 /end CHARACTERISTIC
/begin CHARACTERISTIC HWE_IP12_DcycMax.SHELL.BASE "" VALUE 0x1DA89C STANDARD_VALUE_S16 0.0 TPU_Dcyc 0.0 327.67 /end CHARACTERISTIC
/begin CHARACTERISTIC HWE_IP12_DcycMin.SHELL.BASE "" VALUE 0x1DA8B2 STANDARD_VALUE_S16 0.0 TPU_Dcyc 0.0 327.67 /end CHARACTERISTIC
/begin CHARACTERISTIC HWE_IP12_PerMax.SHELL.BASE "" VALUE 0x1DA85E STANDARD_VALUE_S16 0.0 TPU_Dcyc 0.0 327.67 /end CHARACTERISTIC
/begin CHARACTERISTIC HWE_IP12_PerMin.SHELL.BASE "" VALUE 0x1DA878 STANDARD_VALUE_S16 0.0 TPU_Dcyc 0.0 327.67 /end CHARACTERISTIC
/begin CHARACTERISTIC HWE_OIC01_Per.SHELL.BASE "" VALUE 0x1DA8AA STANDARD_VALUE_S16 0.0 TPU_PerOut 0.0 3276.7 /end CHARACTERISTIC
/begin CHARACTERISTIC HWE_OIC02_Per.SHELL.BASE "" VALUE 0x1DA8C6 STANDARD_VALUE_S16 0.0 TPU_PerOut 0.0 3276.7 /end CHARACTERISTIC
/begin CHARACTERISTIC HWE_OPI01_Per.SHELL.BASE "" VALUE 0x1DA844 STANDARD_VALUE_S16 0.0 TPU_PerOut 0.0 3276.7 /end CHARACTERISTIC
/begin CHARACTERISTIC HWE_OPI02_Per.SHELL.BASE "" VALUE 0x1DA846 STANDARD_VALUE_S16 0.0 TPU_PerOut 0.0 3276.7 /end CHARACTERISTIC
/begin CHARACTERISTIC HWE_OPI03_Per.SHELL.BASE "" VALUE 0x1DA85C STANDARD_VALUE_S16 0.0 TPU_PerOut 0.0 3276.7 /end CHARACTERISTIC
/begin CHARACTERISTIC HWE_OPI04_Per.SHELL.BASE "" VALUE 0x1DA850 STANDARD_VALUE_S16 0.0 TPU_PerOut 0.0 3276.7 /end CHARACTERISTIC
/begin CHARACTERISTIC HWE_OPI05_Per.SHELL.BASE "" VALUE 0x1DA85A STANDARD_VALUE_S16 0.0 TPU_PerOut 0.0 3276.7 /end CHARACTERISTIC
/begin CHARACTERISTIC HWE_OPI06_Per.SHELL.BASE "" VALUE 0x1DA856 STANDARD_VALUE_S16 0.0 TPU_PerOut 0.0 3276.7 /end CHARACTERISTIC
/begin CHARACTERISTIC HWE_OPI07_Per.SHELL.BASE "" VALUE 0x1DA852 STANDARD_VALUE_S16 0.0 TPU_PerOut 0.0 3276.7 /end CHARACTERISTIC
/begin CHARACTERISTIC HWE_OPI08_Per.SHELL.BASE "" VALUE 0x1DA854 STANDARD_VALUE_S16 0.0 TPU_PerOut 0.0 3276.7 /end CHARACTERISTIC
/begin CHARACTERISTIC HWE_OPI09_Per.SHELL.BASE "" VALUE 0x1DA858 STANDARD_VALUE_S16 0.0 TPU_PerOut 0.0 3276.7 /end CHARACTERISTIC
/begin CHARACTERISTIC HWE_OPI10_Per.SHELL.BASE "" VALUE 0x1DA8B0 STANDARD_VALUE_S16 0.0 TPU_PerOut 0.0 3276.7 /end CHARACTERISTIC
/begin CHARACTERISTIC HWE_OPI11_Per.SHELL.BASE "" VALUE 0x1DA8B6 STANDARD_VALUE_S16 0.0 TPU_PerOut 0.0 3276.7 /end CHARACTERISTIC
/begin CHARACTERISTIC HWE_OS01_S_Per.SHELL.BASE "" VALUE 0x1DA87E STANDARD_VALUE_U16 0.0 TPU_PerOut 0.0 6553.5 /end CHARACTERISTIC
/begin CHARACTERISTIC HWE_OS02_S_Per.SHELL.BASE "" VALUE 0x1DA8D8 STANDARD_VALUE_U16 0.0 TPU_PerOut 0.0 6553.5 /end CHARACTERISTIC
/begin CHARACTERISTIC HWE_Rtmo_adStart.SHELL.BASE "" VALUE 0x1DA8A4 STANDARD_VALUE_U32 0.0 ident 0 4294967295 /end CHARACTERISTIC
/begin CHARACTERISTIC HWE_Rtmo_stSampleTime.SHELL.BASE "" VALUE 0x1DA884 STANDARD_VALUE_U32 0.0 ident 0 4294967295 /end CHARACTERISTIC
/begin CHARACTERISTIC HWE_Rtmo_Tasks.HWE.BASE "" VALUE 0x1D26F0 STANDARD_VALUE_U8 0.0 enum_Tasks 0 4 /end CHARACTERISTIC
/begin CHARACTERISTIC iflag_mask.CCP_SHELL "" VAL_BLK 0x1D1364 STANDARD_VALUE_U8 0.0 ident 0 255 MATRIX_DIM 4 1 1 /end CHARACTERISTIC
/begin CHARACTERISTIC iflag_mask.HWE.BASE "" VAL_BLK 0x1D26E4 STANDARD_VALUE_U16 0.0 ident 0 65535 MATRIX_DIM 4 1 1 /end CHARACTERISTIC
/begin CHARACTERISTIC p_baudrate_e.HWE_CAN_A.SHELL.BASE "" VALUE 0x1DA824 STANDARD_VALUE_U8 0.0 enum_HWE_CAN_BAUDRATE_ENUM 0 6 /end CHARACTERISTIC
/begin CHARACTERISTIC p_baudrate_e.HWE_CAN_B.SHELL.BASE "" VALUE 0x1DA830 STANDARD_VALUE_U8 0.0 enum_HWE_CAN_BAUDRATE_ENUM 0 6 /end CHARACTERISTIC
/begin CHARACTERISTIC p_baudrate_e.HWE_CAN_C.SHELL.BASE "" VALUE 0x1DA83C STANDARD_VALUE_U8 0.0 enum_HWE_CAN_BAUDRATE_ENUM 0 6 /end CHARACTERISTIC
/begin CHARACTERISTIC P_Bit_Sint16.Extern_MEM.Bit_Test "" VALUE 0x1D0084 STANDARD_VALUE_S16 0.0 ident -32768 32767 /end CHARACTERISTIC
/begin CHARACTERISTIC P_Bit_Sint16.Intern_MEM.Bit_Test "" VALUE 0x1D0098 STANDARD_VALUE_S16 0.0 ident -32768 32767 /end CHARACTERISTIC
/begin CHARACTERISTIC P_Bit_Sint16_Bit_00.P_Bit.Bit_Test "" VALUE 0x1D0070 STANDARD_VALUE_S16 0.0 ident 0 1 BIT_MASK 0x0001 /end CHARACTERISTIC
/begin CHARACTERISTIC P_Bit_Sint16_Bit_01.P_Bit.Bit_Test "" VALUE 0x1D0070 STANDARD_VALUE_S16 0.0 ident 0 1 BIT_MASK 0x0002 /end CHARACTERISTIC
/begin CHARACTERISTIC P_Bit_Sint16_Bit_02.P_Bit.Bit_Test "" VALUE 0x1D0070 STANDARD_VALUE_S16 0.0 ident 0 1 BIT_MASK 0x0004 /end CHARACTERISTIC
/begin CHARACTERISTIC P_Bit_Sint16_Bit_03.P_Bit.Bit_Test "" VALUE 0x1D0070 STANDARD_VALUE_S16 0.0 ident 0 1 BIT_MASK 0x0008 /end CHARACTERISTIC
/begin CHARACTERISTIC P_Bit_Sint16_Bit_04.P_Bit.Bit_Test "" VALUE 0x1D0070 STANDARD_VALUE_S16 0.0 ident 0 1 BIT_MASK 0x0010 /end CHARACTERISTIC
/begin CHARACTERISTIC P_Bit_Sint16_Bit_05.P_Bit.Bit_Test "" VALUE 0x1D0070 STANDARD_VALUE_S16 0.0 ident 0 1 BIT_MASK 0x0020 /end CHARACTERISTIC
/begin CHARACTERISTIC P_Bit_Sint16_Bit_06.P_Bit.Bit_Test "" VALUE 0x1D0070 STANDARD_VALUE_S16 0.0 ident 0 1 BIT_MASK 0x0040 /end CHARACTERISTIC
/begin CHARACTERISTIC P_Bit_Sint16_Bit_07.P_Bit.Bit_Test "" VALUE 0x1D0070 STANDARD_VALUE_S16 0.0 ident 0 1 BIT_MASK 0x0080 /end CHARACTERISTIC
/begin CHARACTERISTIC P_Bit_Sint16_Bit_08.P_Bit.Bit_Test "" VALUE 0x1D0070 STANDARD_VALUE_S16 0.0 ident 0 1 BIT_MASK 0x0100 /end CHARACTERISTIC
/begin CHARACTERISTIC P_Bit_Sint16_Bit_09.P_Bit.Bit_Test "" VALUE 0x1D0070 STANDARD_VALUE_S16 0.0 ident 0 1 BIT_MASK 0x0200 /end CHARACTERISTIC
/begin CHARACTERISTIC P_Bit_Sint16_Bit_10.P_Bit.Bit_Test "" VALUE 0x1D0070 STANDARD_VALUE_S16 0.0 ident 0 1 BIT_MASK 0x0400 /end CHARACTERISTIC
/begin CHARACTERISTIC P_Bit_Sint16_Bit_11.P_Bit.Bit_Test "" VALUE 0x1D0070 STANDARD_VALUE_S16 0.0 ident 0 1 BIT_MASK 0x0800 /end CHARACTERISTIC
/begin CHARACTERISTIC P_Bit_Sint16_Bit_12.P_Bit.Bit_Test "" VALUE 0x1D0070 STANDARD_VALUE_S16 0.0 ident 0 1 BIT_MASK 0x1000 /end CHARACTERISTIC
/begin CHARACTERISTIC P_Bit_Sint16_Bit_13.P_Bit.Bit_Test "" VALUE 0x1D0070 STANDARD_VALUE_S16 0.0 ident 0 1 BIT_MASK 0x2000 /end CHARACTERISTIC
/begin CHARACTERISTIC P_Bit_Sint16_Bit_14.P_Bit.Bit_Test "" VALUE 0x1D0070 STANDARD_VALUE_S16 0.0 ident 0 1 BIT_MASK 0x4000 /end CHARACTERISTIC
/begin CHARACTERISTIC P_Bit_Sint16_Bit_15.P_Bit.Bit_Test "" VALUE 0x1D0070 STANDARD_VALUE_S16 0.0 ident 0 1 BIT_MASK 0x8000 /end CHARACTERISTIC
/begin CHARACTERISTIC P_Bit_Sint32.Extern_MEM.Bit_Test "" VALUE 0x1D007C STANDARD_VALUE_S32 0.0 ident -2147483648 2147483647 /end CHARACTERISTIC
/begin CHARACTERISTIC P_Bit_Sint32.Intern_MEM.Bit_Test "" VALUE 0x1D0090 STANDARD_VALUE_S32 0.0 ident -2147483648 2147483647 /end CHARACTERISTIC
/begin CHARACTERISTIC P_Bit_Sint32_Bit_00.P_Bit.Bit_Test "" VALUE 0x1D0068 STANDARD_VALUE_S32 0.0 ident 0 1 BIT_MASK 0x00000001 /end CHARACTERISTIC
/begin CHARACTERISTIC P_Bit_Sint32_Bit_01.P_Bit.Bit_Test "" VALUE 0x1D0068 STANDARD_VALUE_S32 0.0 ident 0 1 BIT_MASK 0x00000002 /end CHARACTERISTIC
/begin CHARACTERISTIC P_Bit_Sint32_Bit_02.P_Bit.Bit_Test "" VALUE 0x1D0068 STANDARD_VALUE_S32 0.0 ident 0 1 BIT_MASK 0x00000004 /end CHARACTERISTIC
/begin CHARACTERISTIC P_Bit_Sint32_Bit_03.P_Bit.Bit_Test "" VALUE 0x1D0068 STANDARD_VALUE_S32 0.0 ident 0 1 BIT_MASK 0x00000008 /end CHARACTERISTIC
/begin CHARACTERISTIC P_Bit_Sint32_Bit_04.P_Bit.Bit_Test "" VALUE 0x1D0068 STANDARD_VALUE_S32 0.0 ident 0 1 BIT_MASK 0x00000010 /end CHARACTERISTIC
/begin CHARACTERISTIC P_Bit_Sint32_Bit_05.P_Bit.Bit_Test "" VALUE 0x1D0068 STANDARD_VALUE_S32 0.0 ident 0 1 BIT_MASK 0x00000020 /end CHARACTERISTIC
/begin CHARACTERISTIC P_Bit_Sint32_Bit_06.P_Bit.Bit_Test "" VALUE 0x1D0068 STANDARD_VALUE_S32 0.0 ident 0 1 BIT_MASK 0x00000040 /end CHARACTERISTIC
/begin CHARACTERISTIC P_Bit_Sint32_Bit_07.P_Bit.Bit_Test "" VALUE 0x1D0068 STANDARD_VALUE_S32 0.0 ident 0 1 BIT_MASK 0x00000080 /end CHARACTERISTIC
/begin CHARACTERISTIC P_Bit_Sint32_Bit_08.P_Bit.Bit_Test "" VALUE 0x1D0068 STANDARD_VALUE_S32 0.0 ident 0 1 BIT_MASK 0x00000100 /end CHARACTERISTIC
/begin CHARACTERISTIC P_Bit_Sint32_Bit_09.P_Bit.Bit_Test "" VALUE 0x1D0068 STANDARD_VALUE_S32 0.0 ident 0 1 BIT_MASK 0x00000200 /end CHARACTERISTIC
/begin CHARACTERISTIC P_Bit_Sint32_Bit_10.P_Bit.Bit_Test "" VALUE 0x1D0068 STANDARD_VALUE_S32 0.0 ident 0 1 BIT_MASK 0x00000400 /end CHARACTERISTIC
/begin CHARACTERISTIC P_Bit_Sint32_Bit_11.P_Bit.Bit_Test "" VALUE 0x1D0068 STANDARD_VALUE_S32 0.0 ident 0 1 BIT_MASK 0x00000800 /end CHARACTERISTIC
/begin CHARACTERISTIC P_Bit_Sint32_Bit_12.P_Bit.Bit_Test "" VALUE 0x1D0068 STANDARD_VALUE_S32 0.0 ident 0 1 BIT_MASK 0x00001000 /end CHARACTERISTIC
/begin CHARACTERISTIC P_Bit_Sint32_Bit_13.P_Bit.Bit_Test "" VALUE 0x1D0068 STANDARD_VALUE_S32 0.0 ident 0 1 BIT_MASK 0x00002000 /end CHARACTERISTIC
/begin CHARACTERISTIC P_Bit_Sint32_Bit_14.P_Bit.Bit_Test "" VALUE 0x1D0068 STANDARD_VALUE_S32 0.0 ident 0 1 BIT_MASK 0x00004000 /end CHARACTERISTIC
/begin CHARACTERISTIC P_Bit_Sint32_Bit_15.P_Bit.Bit_Test "" VALUE 0x1D0068 STANDARD_VALUE_S32 0.0 ident 0 1 BIT_MASK 0x00008000 /end CHARACTERISTIC
/begin CHARACTERISTIC P_Bit_Sint32_Bit_16.P_Bit.Bit_Test "" VALUE 0x1D0068 STANDARD_VALUE_S32 0.0 ident 0 1 BIT_MASK 0x00010000 /end CHARACTERISTIC
/begin CHARACTERISTIC P_Bit_Sint32_Bit_17.P_Bit.Bit_Test "" VALUE 0x1D0068 STANDARD_VALUE_S32 0.0 ident 0 1 BIT_MASK 0x00020000 /end CHARACTERISTIC
/begin CHARACTERISTIC P_Bit_Sint32_Bit_18.P_Bit.Bit_Test "" VALUE 0x1D0068 STANDARD_VALUE_S32 0.0 ident 0 1 BIT_MASK 0x00040000 /end CHARACTERISTIC
/begin CHARACTERISTIC P_Bit_Sint32_Bit_19.P_Bit.Bit_Test "" VALUE 0x1D0068 STANDARD_VALUE_S32 0.0 ident 0 1 BIT_MASK 0x00080000 /end CHARACTERISTIC
/begin CHARACTERISTIC P_Bit_Sint32_Bit_20.P_Bit.Bit_Test "" VALUE 0x1D0068 STANDARD_VALUE_S32 0.0 ident 0 1 BIT_MASK 0x00100000 /end CHARACTERISTIC
/begin CHARACTERISTIC P_Bit_Sint32_Bit_21.P_Bit.Bit_Test "" VALUE 0x1D0068 STANDARD_VALUE_S32 0.0 ident 0 1 BIT_MASK 0x00200000 /end CHARACTERISTIC
/begin CHARACTERISTIC P_Bit_Sint32_Bit_22.P_Bit.Bit_Test "" VALUE 0x1D0068 STANDARD_VALUE_S32 0.0 ident 0 1 BIT_MASK 0x00400000 /end CHARACTERISTIC
/begin CHARACTERISTIC P_Bit_Sint32_Bit_23.P_Bit.Bit_Test "" VALUE 0x1D0068 STANDARD_VALUE_S32 0.0 ident 0 1 BIT_MASK 0x00800000 /end CHARACTERISTIC
/begin CHARACTERISTIC P_Bit_Sint32_Bit_24.P_Bit.Bit_Test "" VALUE 0x1D0068 STANDARD_VALUE_S32 0.0 ident 0 1 BIT_MASK 0x01000000 /end CHARACTERISTIC
/begin CHARACTERISTIC P_Bit_Sint32_Bit_25.P_Bit.Bit_Test "" VALUE 0x1D0068 STANDARD_VALUE_S32 0.0 ident 0 1 BIT_MASK 0x02000000 /end CHARACTERISTIC
/begin CHARACTERISTIC P_Bit_Sint32_Bit_26.P_Bit.Bit_Test "" VALUE 0x1D0068 STANDARD_VALUE_S32 0.0 ident 0 1 BIT_MASK 0x04000000 /end CHARACTERISTIC
/begin CHARACTERISTIC P_Bit_Sint32_Bit_27.P_Bit.Bit_Test "" VALUE 0x1D0068 STANDARD_VALUE_S32 0.0 ident 0 1 BIT_MASK 0x08000000 /end CHARACTERISTIC
/begin CHARACTERISTIC P_Bit_Sint32_Bit_28.P_Bit.Bit_Test "" VALUE 0x1D0068 STANDARD_VALUE_S32 0.0 ident 0 1 BIT_MASK 0x10000000 /end CHARACTERISTIC
/begin CHARACTERISTIC P_Bit_Sint32_Bit_29.P_Bit.Bit_Test "" VALUE 0x1D0068 STANDARD_VALUE_S32 0.0 ident 0 1 BIT_MASK 0x20000000 /end CHARACTERISTIC
/begin CHARACTERISTIC P_Bit_Sint32_Bit_30.P_Bit.Bit_Test "" VALUE 0x1D0068 STANDARD_VALUE_S32 0.0 ident 0 1 BIT_MASK 0x40000000 /end CHARACTERISTIC
/begin CHARACTERISTIC P_Bit_Sint32_Bit_31.P_Bit.Bit_Test "" VALUE 0x1D0068 STANDARD_VALUE_S32 0.0 ident 0 1 BIT_MASK 0x80000000 /end CHARACTERISTIC
/begin CHARACTERISTIC P_Bit_Sint8_Bit_0.P_Bit.Bit_Test "" VALUE 0x1D0074 STANDARD_VALUE_S8 0.0 ident 0 1 BIT_MASK 0x01 /end CHARACTERISTIC
/begin CHARACTERISTIC P_Bit_Sint8_Bit_1.P_Bit.Bit_Test "" VALUE 0x1D0074 STANDARD_VALUE_S8 0.0 ident 0 1 BIT_MASK 0x02 /end CHARACTERISTIC
/begin CHARACTERISTIC P_Bit_Sint8_Bit_2.P_Bit.Bit_Test "" VALUE 0x1D0074 STANDARD_VALUE_S8 0.0 ident 0 1 BIT_MASK 0x04 /end CHARACTERISTIC
/begin CHARACTERISTIC P_Bit_Sint8_Bit_3.P_Bit.Bit_Test "" VALUE 0x1D0074 STANDARD_VALUE_S8 0.0 ident 0 1 BIT_MASK 0x08 /end CHARACTERISTIC
/begin CHARACTERISTIC P_Bit_Sint8_Bit_4.P_Bit.Bit_Test "" VALUE 0x1D0074 STANDARD_VALUE_S8 0.0 ident 0 1 BIT_MASK 0x10 /end CHARACTERISTIC
/begin CHARACTERISTIC P_Bit_Sint8_Bit_5.P_Bit.Bit_Test "" VALUE 0x1D0074 STANDARD_VALUE_S8 0.0 ident 0 1 BIT_MASK 0x20 /end CHARACTERISTIC
/begin CHARACTERISTIC P_Bit_Sint8_Bit_6.P_Bit.Bit_Test "" VALUE 0x1D0074 STANDARD_VALUE_S8 0.0 ident 0 1 BIT_MASK 0x40 /end CHARACTERISTIC
/begin CHARACTERISTIC P_Bit_Sint8_Bit_7.P_Bit.Bit_Test "" VALUE 0x1D0074 STANDARD_VALUE_S8 0.0 ident 0 1 BIT_MASK 0x80 /end CHARACTERISTIC
/begin CHARACTERISTIC P_Bit_Sint8_E.Extern_MEM.Bit_Test "" VALUE 0x1D0088 STANDARD_VALUE_S8 0.0 ident -128 127 /end CHARACTERISTIC
/begin CHARACTERISTIC P_Bit_Sint8_E.Intern_MEM.Bit_Test "" VALUE 0x1D009C STANDARD_VALUE_S8 0.0 ident -128 127 /end CHARACTERISTIC
/begin CHARACTERISTIC P_Bit_Sint8_O.Extern_MEM.Bit_Test "" VALUE 0x1D0089 STANDARD_VALUE_S8 0.0 ident -128 127 /end CHARACTERISTIC
/begin CHARACTERISTIC P_Bit_Sint8_O.Intern_MEM.Bit_Test "" VALUE 0x1D009D STANDARD_VALUE_S8 0.0 ident -128 127 /end CHARACTERISTIC
/begin CHARACTERISTIC P_Bit_Uint16.Extern_MEM.Bit_Test "" VALUE 0x1D0086 STANDARD_VALUE_U16 0.0 ident 0 65535 /end CHARACTERISTIC
/begin CHARACTERISTIC P_Bit_Uint16.Intern_MEM.Bit_Test "" VALUE 0x1D009A STANDARD_VALUE_U16 0.0 ident 0 65535 /end CHARACTERISTIC
/begin CHARACTERISTIC P_Bit_Uint16_Bit_00.P_Bit.Bit_Test "" VALUE 0x1D0072 STANDARD_VALUE_U16 0.0 ident 0 65535 BIT_MASK 0x0001 /end CHARACTERISTIC
/begin CHARACTERISTIC P_Bit_Uint16_Bit_01.P_Bit.Bit_Test "" VALUE 0x1D0072 STANDARD_VALUE_U16 0.0 ident 0 65535 BIT_MASK 0x0002 /end CHARACTERISTIC
/begin CHARACTERISTIC P_Bit_Uint16_Bit_02.P_Bit.Bit_Test "" VALUE 0x1D0072 STANDARD_VALUE_U16 0.0 ident 0 65535 BIT_MASK 0x0004 /end CHARACTERISTIC
/begin CHARACTERISTIC P_Bit_Uint16_Bit_03.P_Bit.Bit_Test "" VALUE 0x1D0072 STANDARD_VALUE_U16 0.0 ident 0 65535 BIT_MASK 0x0008 /end CHARACTERISTIC
/begin CHARACTERISTIC P_Bit_Uint16_Bit_04.P_Bit.Bit_Test "" VALUE 0x1D0072 STANDARD_VALUE_U16 0.0 ident 0 65535 BIT_MASK 0x0010 /end CHARACTERISTIC
/begin CHARACTERISTIC P_Bit_Uint16_Bit_05.P_Bit.Bit_Test "" VALUE 0x1D0072 STANDARD_VALUE_U16 0.0 ident 0 65535 BIT_MASK 0x0020 /end CHARACTERISTIC
/begin CHARACTERISTIC P_Bit_Uint16_Bit_06.P_Bit.Bit_Test "" VALUE 0x1D0072 STANDARD_VALUE_U16 0.0 ident 0 65535 BIT_MASK 0x0040 /end CHARACTERISTIC
/begin CHARACTERISTIC P_Bit_Uint16_Bit_07.P_Bit.Bit_Test "" VALUE 0x1D0072 STANDARD_VALUE_U16 0.0 ident 0 65535 BIT_MASK 0x0080 /end CHARACTERISTIC
/begin CHARACTERISTIC P_Bit_Uint16_Bit_08.P_Bit.Bit_Test "" VALUE 0x1D0072 STANDARD_VALUE_U16 0.0 ident 0 65535 BIT_MASK 0x0100 /end CHARACTERISTIC
/begin CHARACTERISTIC P_Bit_Uint16_Bit_09.P_Bit.Bit_Test "" VALUE 0x1D0072 STANDARD_VALUE_U16 0.0 ident 0 65535 BIT_MASK 0x0200 /end CHARACTERISTIC
/begin CHARACTERISTIC P_Bit_Uint16_Bit_10.P_Bit.Bit_Test "" VALUE 0x1D0072 STANDARD_VALUE_U16 0.0 ident 0 65535 BIT_MASK 0x0400 /end CHARACTERISTIC
/begin CHARACTERISTIC P_Bit_Uint16_Bit_11.P_Bit.Bit_Test "" VALUE 0x1D0072 STANDARD_VALUE_U16 0.0 ident 0 65535 BIT_MASK 0x0800 /end CHARACTERISTIC
/begin CHARACTERISTIC P_Bit_Uint16_Bit_12.P_Bit.Bit_Test "" VALUE 0x1D0072 STANDARD_VALUE_U16 0.0 ident 0 65535 BIT_MASK 0x1000 /end CHARACTERISTIC
/begin CHARACTERISTIC P_Bit_Uint16_Bit_13.P_Bit.Bit_Test "" VALUE 0x1D0072 STANDARD_VALUE_U16 0.0 ident 0 65535 BIT_MASK 0x2000 /end CHARACTERISTIC
/begin CHARACTERISTIC P_Bit_Uint16_Bit_14.P_Bit.Bit_Test "" VALUE 0x1D0072 STANDARD_VALUE_U16 0.0 ident 0 65535 BIT_MASK 0x4000 /end CHARACTERISTIC
/begin CHARACTERISTIC P_Bit_Uint16_Bit_15.P_Bit.Bit_Test "" VALUE 0x1D0072 STANDARD_VALUE_U16 0.0 ident 0 65535 BIT_MASK 0x8000 /end CHARACTERISTIC
/begin CHARACTERISTIC P_Bit_Uint32.Extern_MEM.Bit_Test "" VALUE 0x1D0080 STANDARD_VALUE_U32 0.0 ident 0 4294967295 /end CHARACTERISTIC
/begin CHARACTERISTIC P_Bit_Uint32.Intern_MEM.Bit_Test "" VALUE 0x1D0094 STANDARD_VALUE_U32 0.0 ident 0 4294967295 /end CHARACTERISTIC
/begin CHARACTERISTIC P_Bit_Uint32_Bit_00.P_Bit.Bit_Test "" VALUE 0x1D006C STANDARD_VALUE_U32 0.0 ident 0 4294967295 BIT_MASK 0x00000001 /end CHARACTERISTIC
/begin CHARACTERISTIC P_Bit_Uint32_Bit_01.P_Bit.Bit_Test "" VALUE 0x1D006C STANDARD_VALUE_U32 0.0 ident 0 4294967295 BIT_MASK 0x00000002 /end CHARACTERISTIC
/begin CHARACTERISTIC P_Bit_Uint32_Bit_02.P_Bit.Bit_Test "" VALUE 0x1D006C STANDARD_VALUE_U32 0.0 ident 0 4294967295 BIT_MASK 0x00000004 /end CHARACTERISTIC
/begin CHARACTERISTIC P_Bit_Uint32_Bit_03.P_Bit.Bit_Test "" VALUE 0x1D006C STANDARD_VALUE_U32 0.0 ident 0 4294967295 BIT_MASK 0x00000008 /end CHARACTERISTIC
/begin CHARACTERISTIC P_Bit_Uint32_Bit_04.P_Bit.Bit_Test "" VALUE 0x1D006C STANDARD_VALUE_U32 0.0 ident 0 4294967295 BIT_MASK 0x00000010 /end CHARACTERISTIC
/begin CHARACTERISTIC P_Bit_Uint32_Bit_05.P_Bit.Bit_Test "" VALUE 0x1D006C STANDARD_VALUE_U32 0.0 ident 0 4294967295 BIT_MASK 0x00000020 /end CHARACTERISTIC
/begin CHARACTERISTIC P_Bit_Uint32_Bit_06.P_Bit.Bit_Test "" VALUE 0x1D006C STANDARD_VALUE_U32 0.0 ident 0 4294967295 BIT_MASK 0x00000040 /end CHARACTERISTIC
/begin CHARACTERISTIC P_Bit_Uint32_Bit_07.P_Bit.Bit_Test "" VALUE 0x1D006C STANDARD_VALUE_U32 0.0 ident 0 4294967295 BIT_MASK 0x00000080 /end CHARACTERISTIC
/begin CHARACTERISTIC P_Bit_Uint32_Bit_08.P_Bit.Bit_Test "" VALUE 0x1D006C STANDARD_VALUE_U32 0.0 ident 0 4294967295 BIT_MASK 0x00000100 /end CHARACTERISTIC
/begin CHARACTERISTIC P_Bit_Uint32_Bit_09.P_Bit.Bit_Test "" VALUE 0x1D006C STANDARD_VALUE_U32 0.0 ident 0 4294967295 BIT_MASK 0x00000200 /end CHARACTERISTIC
/begin CHARACTERISTIC P_Bit_Uint32_Bit_10.P_Bit.Bit_Test "" VALUE 0x1D006C STANDARD_VALUE_U32 0.0 ident 0 4294967295 BIT_MASK 0x00000400 /end CHARACTERISTIC
/begin CHARACTERISTIC P_Bit_Uint32_Bit_11.P_Bit.Bit_Test "" VALUE 0x1D006C STANDARD_VALUE_U32 0.0 ident 0 4294967295 BIT_MASK 0x00000800 /end CHARACTERISTIC
/begin CHARACTERISTIC P_Bit_Uint32_Bit_12.P_Bit.Bit_Test "" VALUE 0x1D006C STANDARD_VALUE_U32 0.0 ident 0 4294967295 BIT_MASK 0x00001000 /end CHARACTERISTIC
/begin CHARACTERISTIC P_Bit_Uint32_Bit_13.P_Bit.Bit_Test "" VALUE 0x1D006C STANDARD_VALUE_U32 0.0 ident 0 4294967295 BIT_MASK 0x00002000 /end CHARACTERISTIC
/begin CHARACTERISTIC P_Bit_Uint32_Bit_14.P_Bit.Bit_Test "" VALUE 0x1D006C STANDARD_VALUE_U32 0.0 ident 0 4294967295 BIT_MASK 0x00004000 /end CHARACTERISTIC
/begin CHARACTERISTIC P_Bit_Uint32_Bit_15.P_Bit.Bit_Test "" VALUE 0x1D006C STANDARD_VALUE_U32 0.0 ident 0 4294967295 BIT_MASK 0x00008000 /end CHARACTERISTIC
/begin CHARACTERISTIC P_Bit_Uint32_Bit_16.P_Bit.Bit_Test "" VALUE 0x1D006C STANDARD_VALUE_U32 0.0 ident 0 4294967295 BIT_MASK 0x00010000 /end CHARACTERISTIC
/begin CHARACTERISTIC P_Bit_Uint32_Bit_17.P_Bit.Bit_Test "" VALUE 0x1D006C STANDARD_VALUE_U32 0.0 ident 0 4294967295 BIT_MASK 0x00020000 /end CHARACTERISTIC
/begin CHARACTERISTIC P_Bit_Uint32_Bit_18.P_Bit.Bit_Test "" VALUE 0x1D006C STANDARD_VALUE_U32 0.0 ident 0 4294967295 BIT_MASK 0x00040000 /end CHARACTERISTIC
/begin CHARACTERISTIC P_Bit_Uint32_Bit_19.P_Bit.Bit_Test "" VALUE 0x1D006C STANDARD_VALUE_U32 0.0 ident 0 4294967295 BIT_MASK 0x00080000 /end CHARACTERISTIC
/begin CHARACTERISTIC P_Bit_Uint32_Bit_20.P_Bit.Bit_Test "" VALUE 0x1D006C STANDARD_VALUE_U32 0.0 ident 0 4294967295 BIT_MASK 0x00100000 /end CHARACTERISTIC
/begin CHARACTERISTIC P_Bit_Uint32_Bit_21.P_Bit.Bit_Test "" VALUE 0x1D006C STANDARD_VALUE_U32 0.0 ident 0 4294967295 BIT_MASK 0x00200000 /end CHARACTERISTIC
/begin CHARACTERISTIC P_Bit_Uint32_Bit_22.P_Bit.Bit_Test "" VALUE 0x1D006C STANDARD_VALUE_U32 0.0 ident 0 4294967295 BIT_MASK 0x00400000 /end CHARACTERISTIC
/begin CHARACTERISTIC P_Bit_Uint32_Bit_23.P_Bit.Bit_Test "" VALUE 0x1D006C STANDARD_VALUE_U32 0.0 ident 0 4294967295 BIT_MASK 0x00800000 /end CHARACTERISTIC
/begin CHARACTERISTIC P_Bit_Uint32_Bit_24.P_Bit.Bit_Test "" VALUE 0x1D006C STANDARD_VALUE_U32 0.0 ident 0 4294967295 BIT_MASK 0x01000000 /end CHARACTERISTIC
/begin CHARACTERISTIC P_Bit_Uint32_Bit_25.P_Bit.Bit_Test "" VALUE 0x1D006C STANDARD_VALUE_U32 0.0 ident 0 4294967295 BIT_MASK 0x02000000 /end CHARACTERISTIC
/begin CHARACTERISTIC P_Bit_Uint32_Bit_26.P_Bit.Bit_Test "" VALUE 0x1D006C STANDARD_VALUE_U32 0.0 ident 0 4294967295 BIT_MASK 0x04000000 /end CHARACTERISTIC
/begin CHARACTERISTIC P_Bit_Uint32_Bit_27.P_Bit.Bit_Test "" VALUE 0x1D006C STANDARD_VALUE_U32 0.0 ident 0 4294967295 BIT_MASK 0x08000000 /end CHARACTERISTIC
/begin CHARACTERISTIC P_Bit_Uint32_Bit_28.P_Bit.Bit_Test "" VALUE 0x1D006C STANDARD_VALUE_U32 0.0 ident 0 4294967295 BIT_MASK 0x10000000 /end CHARACTERISTIC
/begin CHARACTERISTIC P_Bit_Uint32_Bit_29.P_Bit.Bit_Test "" VALUE 0x1D006C STANDARD_VALUE_U32 0.0 ident 0 4294967295 BIT_MASK 0x20000000 /end CHARACTERISTIC
/begin CHARACTERISTIC P_Bit_Uint32_Bit_30.P_Bit.Bit_Test "" VALUE 0x1D006C STANDARD_VALUE_U32 0.0 ident 0 4294967295 BIT_MASK 0x40000000 /end CHARACTERISTIC
/begin CHARACTERISTIC P_Bit_Uint32_Bit_31.P_Bit.Bit_Test "" VALUE 0x1D006C STANDARD_VALUE_U32 0.0 ident 0 4294967295 BIT_MASK 0x80000000 /end CHARACTERISTIC
/begin CHARACTERISTIC P_Bit_Uint8_Bit_0.P_Bit.Bit_Test "" VALUE 0x1D0075 STANDARD_VALUE_U8 0.0 ident 0 255 BIT_MASK 0x01 /end CHARACTERISTIC
/begin CHARACTERISTIC P_Bit_Uint8_Bit_1.P_Bit.Bit_Test "" VALUE 0x1D0075 STANDARD_VALUE_U8 0.0 ident 0 255 BIT_MASK 0x02 /end CHARACTERISTIC
/begin CHARACTERISTIC P_Bit_Uint8_Bit_2.P_Bit.Bit_Test "" VALUE 0x1D0075 STANDARD_VALUE_U8 0.0 ident 0 255 BIT_MASK 0x04 /end CHARACTERISTIC
/begin CHARACTERISTIC P_Bit_Uint8_Bit_3.P_Bit.Bit_Test "" VALUE 0x1D0075 STANDARD_VALUE_U8 0.0 ident 0 255 BIT_MASK 0x08 /end CHARACTERISTIC
/begin CHARACTERISTIC P_Bit_Uint8_Bit_4.P_Bit.Bit_Test "" VALUE 0x1D0075 STANDARD_VALUE_U8 0.0 ident 0 255 BIT_MASK 0x10 /end CHARACTERISTIC
/begin CHARACTERISTIC P_Bit_Uint8_Bit_5.P_Bit.Bit_Test "" VALUE 0x1D0075 STANDARD_VALUE_U8 0.0 ident 0 255 BIT_MASK 0x20 /end CHARACTERISTIC
/begin CHARACTERISTIC P_Bit_Uint8_Bit_6.P_Bit.Bit_Test "" VALUE 0x1D0075 STANDARD_VALUE_U8 0.0 ident 0 255 BIT_MASK 0x40 /end CHARACTERISTIC
/begin CHARACTERISTIC P_Bit_Uint8_Bit_7.P_Bit.Bit_Test "" VALUE 0x1D0075 STANDARD_VALUE_U8 0.0 ident 0 255 BIT_MASK 0x80 /end CHARACTERISTIC
/begin CHARACTERISTIC P_Bit_Uint8_E.Extern_MEM.Bit_Test "" VALUE 0x1D008A STANDARD_VALUE_U8 0.0 ident 0 255 /end CHARACTERISTIC
/begin CHARACTERISTIC P_Bit_Uint8_E.Intern_MEM.Bit_Test "" VALUE 0x1D009E STANDARD_VALUE_U8 0.0 ident 0 255 /end CHARACTERISTIC
/begin CHARACTERISTIC P_Bit_Uint8_O.Extern_MEM.Bit_Test "" VALUE 0x1D008B STANDARD_VALUE_U8 0.0 ident 0 255 /end CHARACTERISTIC
/begin CHARACTERISTIC P_Bit_Uint8_O.Intern_MEM.Bit_Test "" VALUE 0x1D009F STANDARD_VALUE_U8 0.0 ident 0 255 /end CHARACTERISTIC
/begin CHARACTERISTIC p_CcpByteOrder_u8.CCP_SHELL "" VALUE 0x1D1386 STANDARD_VALUE_U8 0.0 enum_CCP_ByteOrder_e 0 1 /end CHARACTERISTIC
/begin CHARACTERISTIC p_CcpPower_u8.CCP_SHELL "" VALUE 0x1D1385 STANDARD_VALUE_U8 0.0 ident 0 255 /end CHARACTERISTIC
/begin CHARACTERISTIC p_CcpTrigResume_u8.CCP_SHELL "" VALUE 0x1D1384 STANDARD_VALUE_U8 0.0 ident 0 255 /end CHARACTERISTIC
/begin CHARACTERISTIC p_dBRP_u8.HWE_CAN_A.SHELL.BASE "" VALUE 0x1DA825 STANDARD_VALUE_U8 0.0 ident 1 64 /end CHARACTERISTIC
/begin CHARACTERISTIC p_dBRP_u8.HWE_CAN_B.SHELL.BASE "" VALUE 0x1DA831 STANDARD_VALUE_U8 0.0 ident 1 64 /end CHARACTERISTIC
/begin CHARACTERISTIC p_dBRP_u8.HWE_CAN_C.SHELL.BASE "" VALUE 0x1DA83D STANDARD_VALUE_U8 0.0 ident 1 64 /end CHARACTERISTIC
/begin CHARACTERISTIC p_dPropSeg_u8.HWE_CAN_A.SHELL.BASE "" VALUE 0x1DA828 STANDARD_VALUE_U8 0.0 ident 1 8 /end CHARACTERISTIC
/begin CHARACTERISTIC p_dPropSeg_u8.HWE_CAN_B.SHELL.BASE "" VALUE 0x1DA834 STANDARD_VALUE_U8 0.0 ident 1 8 /end CHARACTERISTIC
/begin CHARACTERISTIC p_dPropSeg_u8.HWE_CAN_C.SHELL.BASE "" VALUE 0x1DA840 STANDARD_VALUE_U8 0.0 ident 1 8 /end CHARACTERISTIC
/begin CHARACTERISTIC p_dPSeg1_u8.HWE_CAN_A.SHELL.BASE "" VALUE 0x1DA826 STANDARD_VALUE_U8 0.0 ident 1 8 /end CHARACTERISTIC
/begin CHARACTERISTIC p_dPSeg1_u8.HWE_CAN_B.SHELL.BASE "" VALUE 0x1DA832 STANDARD_VALUE_U8 0.0 ident 1 8 /end CHARACTERISTIC
/begin CHARACTERISTIC p_dPSeg1_u8.HWE_CAN_C.SHELL.BASE "" VALUE 0x1DA83E STANDARD_VALUE_U8 0.0 ident 1 8 /end CHARACTERISTIC
/begin CHARACTERISTIC p_dPSeg2_u8.HWE_CAN_A.SHELL.BASE "" VALUE 0x1DA827 STANDARD_VALUE_U8 0.0 ident 1 8 /end CHARACTERISTIC
/begin CHARACTERISTIC p_dPSeg2_u8.HWE_CAN_B.SHELL.BASE "" VALUE 0x1DA833 STANDARD_VALUE_U8 0.0 ident 1 8 /end CHARACTERISTIC
/begin CHARACTERISTIC p_dPSeg2_u8.HWE_CAN_C.SHELL.BASE "" VALUE 0x1DA83F STANDARD_VALUE_U8 0.0 ident 1 8 /end CHARACTERISTIC
/begin CHARACTERISTIC p_dSJW_u8.HWE_CAN_A.SHELL.BASE "" VALUE 0x1DA829 STANDARD_VALUE_U8 0.0 ident 1 4 /end CHARACTERISTIC
/begin CHARACTERISTIC p_dSJW_u8.HWE_CAN_B.SHELL.BASE "" VALUE 0x1DA835 STANDARD_VALUE_U8 0.0 ident 1 4 /end CHARACTERISTIC
/begin CHARACTERISTIC p_dSJW_u8.HWE_CAN_C.SHELL.BASE "" VALUE 0x1DA841 STANDARD_VALUE_U8 0.0 ident 1 4 /end CHARACTERISTIC
/begin CHARACTERISTIC P_PageSwitch_unused.CCP_Page "" VALUE 0x1c449A STANDARD_VALUE_U8 0.0 enum_CCP_Page_ENUM 0 2 /end CHARACTERISTIC
/begin CHARACTERISTIC p_ResetTimer_b.DAQ2_Sample.CCP_SHELL "" VALUE 0x1D136C STANDARD_VALUE_U8 0.0 ident 0 1 BIT_MASK 0x1 /end CHARACTERISTIC
/begin CHARACTERISTIC p_ResetTimer_b.DAQ2_Tx.CCP_SHELL "" VALUE 0x1D1378 STANDARD_VALUE_U8 0.0 ident 0 1 BIT_MASK 0x1 /end CHARACTERISTIC
/begin CHARACTERISTIC p_SeramCheckParamRange_u8_unused.CCP_Page "" VALUE 0x1D135D STANDARD_VALUE_U8 0.0 ident 0 255 /end CHARACTERISTIC
/begin CHARACTERISTIC p_UpdateBitTest_b.Bit_Test "" VALUE 0x1D00A0 STANDARD_VALUE_U8 0.0 ident 0 1 BIT_MASK 0x1 /end CHARACTERISTIC
/begin MEASUREMENT _HWE_CAN_A_BAUDRATE_V_unused.SHELL.BASE "" UBYTE enum_HWE_CAN_BAUDRATE_ENUM 1 100 0 6 ECU_ADDRESS 0x7FB92C /end MEASUREMENT
/begin MEASUREMENT _HWE_CAN_B_BAUDRATE_V_unused.SHELL.BASE "" UBYTE enum_HWE_CAN_BAUDRATE_ENUM 1 100 0 6 ECU_ADDRESS 0x7FB92D /end MEASUREMENT
/begin MEASUREMENT _HWE_CAN_C_BAUDRATE_V_unused.SHELL.BASE "" UBYTE enum_HWE_CAN_BAUDRATE_ENUM 1 100 0 6 ECU_ADDRESS 0x7FB92E /end MEASUREMENT
/begin MEASUREMENT Bit_Sint16.P_Bit.Bit_Test "" SWORD ident 1 100 -32768 32767 ECU_ADDRESS 0x6D0070 /end MEASUREMENT
/begin MEASUREMENT Bit_Sint16_Bit_x.Extern_MEM.Bit_Test "" SWORD ident 1 100 -32768 32767 ECU_ADDRESS 0x6D0084 /end MEASUREMENT
/begin MEASUREMENT Bit_Sint16_Bit_00.Extern_MEM.Bit_Test "" SWORD ident 1 100 -32768 32767 ECU_ADDRESS 0x6D0084 BIT_MASK 0x0001 /end MEASUREMENT
/begin MEASUREMENT Bit_Sint16_Bit_01.Extern_MEM.Bit_Test "" SWORD ident 1 100 -32768 32767 ECU_ADDRESS 0x6D0084 BIT_MASK 0x0002 /end MEASUREMENT
/begin MEASUREMENT Bit_Sint16_Bit_02.Extern_MEM.Bit_Test "" SWORD ident 1 100 -32768 32767 ECU_ADDRESS 0x6D0084 BIT_MASK 0x0004 /end MEASUREMENT
/begin MEASUREMENT Bit_Sint16_Bit_03.Extern_MEM.Bit_Test "" SWORD ident 1 100 -32768 32767 ECU_ADDRESS 0x6D0084 BIT_MASK 0x0008 /end MEASUREMENT
/begin MEASUREMENT Bit_Sint16_Bit_04.Extern_MEM.Bit_Test "" SWORD ident 1 100 -32768 32767 ECU_ADDRESS 0x6D0084 BIT_MASK 0x0010 /end MEASUREMENT
/begin MEASUREMENT Bit_Sint16_Bit_05.Extern_MEM.Bit_Test "" SWORD ident 1 100 -32768 32767 ECU_ADDRESS 0x6D0084 BIT_MASK 0x0020 /end MEASUREMENT
/begin MEASUREMENT Bit_Sint16_Bit_06.Extern_MEM.Bit_Test "" SWORD ident 1 100 -32768 32767 ECU_ADDRESS 0x6D0084 BIT_MASK 0x0040 /end MEASUREMENT
/begin MEASUREMENT Bit_Sint16_Bit_07.Extern_MEM.Bit_Test "" SWORD ident 1 100 -32768 32767 ECU_ADDRESS 0x6D0084 BIT_MASK 0x0080 /end MEASUREMENT
/begin MEASUREMENT Bit_Sint16_Bit_08.Extern_MEM.Bit_Test "" SWORD ident 1 100 -32768 32767 ECU_ADDRESS 0x6D0084 BIT_MASK 0x0100 /end MEASUREMENT
/begin MEASUREMENT Bit_Sint16_Bit_09.Extern_MEM.Bit_Test "" SWORD ident 1 100 -32768 32767 ECU_ADDRESS 0x6D0084 BIT_MASK 0x0200 /end MEASUREMENT
/begin MEASUREMENT Bit_Sint16_Bit_10.Extern_MEM.Bit_Test "" SWORD ident 1 100 -32768 32767 ECU_ADDRESS 0x6D0084 BIT_MASK 0x0400 /end MEASUREMENT
/begin MEASUREMENT Bit_Sint16_Bit_11.Extern_MEM.Bit_Test "" SWORD ident 1 100 -32768 32767 ECU_ADDRESS 0x6D0084 BIT_MASK 0x0800 /end MEASUREMENT
/begin MEASUREMENT Bit_Sint16_Bit_12.Extern_MEM.Bit_Test "" SWORD ident 1 100 -32768 32767 ECU_ADDRESS 0x6D0084 BIT_MASK 0x1000 /end MEASUREMENT
/begin MEASUREMENT Bit_Sint16_Bit_13.Extern_MEM.Bit_Test "" SWORD ident 1 100 -32768 32767 ECU_ADDRESS 0x6D0084 BIT_MASK 0x2000 /end MEASUREMENT
/begin MEASUREMENT Bit_Sint16_Bit_14.Extern_MEM.Bit_Test "" SWORD ident 1 100 -32768 32767 ECU_ADDRESS 0x6D0084 BIT_MASK 0x4000 /end MEASUREMENT
/begin MEASUREMENT Bit_Sint16_Bit_15.Extern_MEM.Bit_Test "" SWORD ident 1 100 -32768 32767 ECU_ADDRESS 0x6D0084 BIT_MASK 0x8000 /end MEASUREMENT
/begin MEASUREMENT Bit_Sint16_Bit_x.Intern_MEM.Bit_Test "" SWORD ident 1 100 -32768 32767 ECU_ADDRESS 0x6D0098 /end MEASUREMENT
/begin MEASUREMENT Bit_Sint16_Bit_00.Intern_MEM.Bit_Test "" SWORD ident 1 100 -32768 32767 ECU_ADDRESS 0x6D0098 BIT_MASK 0x0001 /end MEASUREMENT
/begin MEASUREMENT Bit_Sint16_Bit_01.Intern_MEM.Bit_Test "" SWORD ident 1 100 -32768 32767 ECU_ADDRESS 0x6D0098 BIT_MASK 0x0002 /end MEASUREMENT
/begin MEASUREMENT Bit_Sint16_Bit_02.Intern_MEM.Bit_Test "" SWORD ident 1 100 -32768 32767 ECU_ADDRESS 0x6D0098 BIT_MASK 0x0004 /end MEASUREMENT
/begin MEASUREMENT Bit_Sint16_Bit_03.Intern_MEM.Bit_Test "" SWORD ident 1 100 -32768 32767 ECU_ADDRESS 0x6D0098 BIT_MASK 0x0008 /end MEASUREMENT
/begin MEASUREMENT Bit_Sint16_Bit_04.Intern_MEM.Bit_Test "" SWORD ident 1 100 -32768 32767 ECU_ADDRESS 0x6D0098 BIT_MASK 0x0010 /end MEASUREMENT
/begin MEASUREMENT Bit_Sint16_Bit_05.Intern_MEM.Bit_Test "" SWORD ident 1 100 -32768 32767 ECU_ADDRESS 0x6D0098 BIT_MASK 0x0020 /end MEASUREMENT
/begin MEASUREMENT Bit_Sint16_Bit_06.Intern_MEM.Bit_Test "" SWORD ident 1 100 -32768 32767 ECU_ADDRESS 0x6D0098 BIT_MASK 0x0040 /end MEASUREMENT
/begin MEASUREMENT Bit_Sint16_Bit_07.Intern_MEM.Bit_Test "" SWORD ident 1 100 -32768 32767 ECU_ADDRESS 0x6D0098 BIT_MASK 0x0080 /end MEASUREMENT
/begin MEASUREMENT Bit_Sint16_Bit_08.Intern_MEM.Bit_Test "" SWORD ident 1 100 -32768 32767 ECU_ADDRESS 0x6D0098 BIT_MASK 0x0100 /end MEASUREMENT
/begin MEASUREMENT Bit_Sint16_Bit_09.Intern_MEM.Bit_Test "" SWORD ident 1 100 -32768 32767 ECU_ADDRESS 0x6D0098 BIT_MASK 0x0200 /end MEASUREMENT
/begin MEASUREMENT Bit_Sint16_Bit_10.Intern_MEM.Bit_Test "" SWORD ident 1 100 -32768 32767 ECU_ADDRESS 0x6D0098 BIT_MASK 0x0400 /end MEASUREMENT
/begin MEASUREMENT Bit_Sint16_Bit_11.Intern_MEM.Bit_Test "" SWORD ident 1 100 -32768 32767 ECU_ADDRESS 0x6D0098 BIT_MASK 0x0800 /end MEASUREMENT
/begin MEASUREMENT Bit_Sint16_Bit_12.Intern_MEM.Bit_Test "" SWORD ident 1 100 -32768 32767 ECU_ADDRESS 0x6D0098 BIT_MASK 0x1000 /end MEASUREMENT
/begin MEASUREMENT Bit_Sint16_Bit_13.Intern_MEM.Bit_Test "" SWORD ident 1 100 -32768 32767 ECU_ADDRESS 0x6D0098 BIT_MASK 0x2000 /end MEASUREMENT
/begin MEASUREMENT Bit_Sint16_Bit_14.Intern_MEM.Bit_Test "" SWORD ident 1 100 -32768 32767 ECU_ADDRESS 0x6D0098 BIT_MASK 0x4000 /end MEASUREMENT
/begin MEASUREMENT Bit_Sint16_Bit_15.Intern_MEM.Bit_Test "" SWORD ident 1 100 -32768 32767 ECU_ADDRESS 0x6D0098 BIT_MASK 0x8000 /end MEASUREMENT
/begin MEASUREMENT Bit_Sint32.P_Bit.Bit_Test "" SLONG ident 1 100 -2147483648 2147483647 ECU_ADDRESS 0x6D0068 /end MEASUREMENT
/begin MEASUREMENT Bit_Sint32_Bit_x.Extern_MEM.Bit_Test "" SLONG ident 1 100 -2147483648 2147483647 ECU_ADDRESS 0x6D007C /end MEASUREMENT
/begin MEASUREMENT Bit_Sint32_Bit_00.Extern_MEM.Bit_Test "" SLONG ident 1 100 -2147483648 2147483647 ECU_ADDRESS 0x6D007C BIT_MASK 0x00000001 /end MEASUREMENT
/begin MEASUREMENT Bit_Sint32_Bit_01.Extern_MEM.Bit_Test "" SLONG ident 1 100 -2147483648 2147483647 ECU_ADDRESS 0x6D007C BIT_MASK 0x00000002 /end MEASUREMENT
/begin MEASUREMENT Bit_Sint32_Bit_02.Extern_MEM.Bit_Test "" SLONG ident 1 100 -2147483648 2147483647 ECU_ADDRESS 0x6D007C BIT_MASK 0x00000004 /end MEASUREMENT
/begin MEASUREMENT Bit_Sint32_Bit_03.Extern_MEM.Bit_Test "" SLONG ident 1 100 -2147483648 2147483647 ECU_ADDRESS 0x6D007C BIT_MASK 0x00000008 /end MEASUREMENT
/begin MEASUREMENT Bit_Sint32_Bit_04.Extern_MEM.Bit_Test "" SLONG ident 1 100 -2147483648 2147483647 ECU_ADDRESS 0x6D007C BIT_MASK 0x00000010 /end MEASUREMENT
/begin MEASUREMENT Bit_Sint32_Bit_05.Extern_MEM.Bit_Test "" SLONG ident 1 100 -2147483648 2147483647 ECU_ADDRESS 0x6D007C BIT_MASK 0x00000020 /end MEASUREMENT
/begin MEASUREMENT Bit_Sint32_Bit_06.Extern_MEM.Bit_Test "" SLONG ident 1 100 -2147483648 2147483647 ECU_ADDRESS 0x6D007C BIT_MASK 0x00000040 /end MEASUREMENT
/begin MEASUREMENT Bit_Sint32_Bit_07.Extern_MEM.Bit_Test "" SLONG ident 1 100 -2147483648 2147483647 ECU_ADDRESS 0x6D007C BIT_MASK 0x00000080 /end MEASUREMENT
/begin MEASUREMENT Bit_Sint32_Bit_08.Extern_MEM.Bit_Test "" SLONG ident 1 100 -2147483648 2147483647 ECU_ADDRESS 0x6D007C BIT_MASK 0x00000100 /end MEASUREMENT
/begin MEASUREMENT Bit_Sint32_Bit_09.Extern_MEM.Bit_Test "" SLONG ident 1 100 -2147483648 2147483647 ECU_ADDRESS 0x6D007C BIT_MASK 0x00000200 /end MEASUREMENT
/begin MEASUREMENT Bit_Sint32_Bit_10.Extern_MEM.Bit_Test "" SLONG ident 1 100 -2147483648 2147483647 ECU_ADDRESS 0x6D007C BIT_MASK 0x00000400 /end MEASUREMENT
/begin MEASUREMENT Bit_Sint32_Bit_11.Extern_MEM.Bit_Test "" SLONG ident 1 100 -2147483648 2147483647 ECU_ADDRESS 0x6D007C BIT_MASK 0x00000800 /end MEASUREMENT
/begin MEASUREMENT Bit_Sint32_Bit_12.Extern_MEM.Bit_Test "" SLONG ident 1 100 -2147483648 2147483647 ECU_ADDRESS 0x6D007C BIT_MASK 0x00001000 /end MEASUREMENT
/begin MEASUREMENT Bit_Sint32_Bit_13.Extern_MEM.Bit_Test "" SLONG ident 1 100 -2147483648 2147483647 ECU_ADDRESS 0x6D007C BIT_MASK 0x00002000 /end MEASUREMENT
/begin MEASUREMENT Bit_Sint32_Bit_14.Extern_MEM.Bit_Test "" SLONG ident 1 100 -2147483648 2147483647 ECU_ADDRESS 0x6D007C BIT_MASK 0x00004000 /end MEASUREMENT
/begin MEASUREMENT Bit_Sint32_Bit_15.Extern_MEM.Bit_Test "" SLONG ident 1 100 -2147483648 2147483647 ECU_ADDRESS 0x6D007C BIT_MASK 0x00008000 /end MEASUREMENT
/begin MEASUREMENT Bit_Sint32_Bit_16.Extern_MEM.Bit_Test "" SLONG ident 1 100 -2147483648 2147483647 ECU_ADDRESS 0x6D007C BIT_MASK 0x00010000 /end MEASUREMENT
/begin MEASUREMENT Bit_Sint32_Bit_17.Extern_MEM.Bit_Test "" SLONG ident 1 100 -2147483648 2147483647 ECU_ADDRESS 0x6D007C BIT_MASK 0x00020000 /end MEASUREMENT
/begin MEASUREMENT Bit_Sint32_Bit_18.Extern_MEM.Bit_Test "" SLONG ident 1 100 -2147483648 2147483647 ECU_ADDRESS 0x6D007C BIT_MASK 0x00040000 /end MEASUREMENT
/begin MEASUREMENT Bit_Sint32_Bit_19.Extern_MEM.Bit_Test "" SLONG ident 1 100 -2147483648 2147483647 ECU_ADDRESS 0x6D007C BIT_MASK 0x00080000 /end MEASUREMENT
/begin MEASUREMENT Bit_Sint32_Bit_20.Extern_MEM.Bit_Test "" SLONG ident 1 100 -2147483648 2147483647 ECU_ADDRESS 0x6D007C BIT_MASK 0x00100000 /end MEASUREMENT
/begin MEASUREMENT Bit_Sint32_Bit_21.Extern_MEM.Bit_Test "" SLONG ident 1 100 -2147483648 2147483647 ECU_ADDRESS 0x6D007C BIT_MASK 0x00200000 /end MEASUREMENT
/begin MEASUREMENT Bit_Sint32_Bit_22.Extern_MEM.Bit_Test "" SLONG ident 1 100 -2147483648 2147483647 ECU_ADDRESS 0x6D007C BIT_MASK 0x00400000 /end MEASUREMENT
/begin MEASUREMENT Bit_Sint32_Bit_23.Extern_MEM.Bit_Test "" SLONG ident 1 100 -2147483648 2147483647 ECU_ADDRESS 0x6D007C BIT_MASK 0x00800000 /end MEASUREMENT
/begin MEASUREMENT Bit_Sint32_Bit_24.Extern_MEM.Bit_Test "" SLONG ident 1 100 -2147483648 2147483647 ECU_ADDRESS 0x6D007C BIT_MASK 0x01000000 /end MEASUREMENT
/begin MEASUREMENT Bit_Sint32_Bit_25.Extern_MEM.Bit_Test "" SLONG ident 1 100 -2147483648 2147483647 ECU_ADDRESS 0x6D007C BIT_MASK 0x02000000 /end MEASUREMENT
/begin MEASUREMENT Bit_Sint32_Bit_26.Extern_MEM.Bit_Test "" SLONG ident 1 100 -2147483648 2147483647 ECU_ADDRESS 0x6D007C BIT_MASK 0x04000000 /end MEASUREMENT
/begin MEASUREMENT Bit_Sint32_Bit_27.Extern_MEM.Bit_Test "" SLONG ident 1 100 -2147483648 2147483647 ECU_ADDRESS 0x6D007C BIT_MASK 0x08000000 /end MEASUREMENT
/begin MEASUREMENT Bit_Sint32_Bit_28.Extern_MEM.Bit_Test "" SLONG ident 1 100 -2147483648 2147483647 ECU_ADDRESS 0x6D007C BIT_MASK 0x10000000 /end MEASUREMENT
/begin MEASUREMENT Bit_Sint32_Bit_29.Extern_MEM.Bit_Test "" SLONG ident 1 100 -2147483648 2147483647 ECU_ADDRESS 0x6D007C BIT_MASK 0x20000000 /end MEASUREMENT
/begin MEASUREMENT Bit_Sint32_Bit_30.Extern_MEM.Bit_Test "" SLONG ident 1 100 -2147483648 2147483647 ECU_ADDRESS 0x6D007C BIT_MASK 0x40000000 /end MEASUREMENT
/begin MEASUREMENT Bit_Sint32_Bit_31.Extern_MEM.Bit_Test "" SLONG ident 1 100 -2147483648 2147483647 ECU_ADDRESS 0x6D007C BIT_MASK 0x80000000 /end MEASUREMENT
/begin MEASUREMENT Bit_Sint32_Bit_x.Intern_MEM.Bit_Test "" SLONG ident 1 100 -2147483648 2147483647 ECU_ADDRESS 0x6D0090 /end MEASUREMENT
/begin MEASUREMENT Bit_Sint32_Bit_00.Intern_MEM.Bit_Test "" SLONG ident 1 100 -2147483648 2147483647 ECU_ADDRESS 0x6D0090 BIT_MASK 0x00000001 /end MEASUREMENT
/begin MEASUREMENT Bit_Sint32_Bit_01.Intern_MEM.Bit_Test "" SLONG ident 1 100 -2147483648 2147483647 ECU_ADDRESS 0x6D0090 BIT_MASK 0x00000002 /end MEASUREMENT
/begin MEASUREMENT Bit_Sint32_Bit_02.Intern_MEM.Bit_Test "" SLONG ident 1 100 -2147483648 2147483647 ECU_ADDRESS 0x6D0090 BIT_MASK 0x00000004 /end MEASUREMENT
/begin MEASUREMENT Bit_Sint32_Bit_03.Intern_MEM.Bit_Test "" SLONG ident 1 100 -2147483648 2147483647 ECU_ADDRESS 0x6D0090 BIT_MASK 0x00000008 /end MEASUREMENT
/begin MEASUREMENT Bit_Sint32_Bit_04.Intern_MEM.Bit_Test "" SLONG ident 1 100 -2147483648 2147483647 ECU_ADDRESS 0x6D0090 BIT_MASK 0x00000010 /end MEASUREMENT
/begin MEASUREMENT Bit_Sint32_Bit_05.Intern_MEM.Bit_Test "" SLONG ident 1 100 -2147483648 2147483647 ECU_ADDRESS 0x6D0090 BIT_MASK 0x00000020 /end MEASUREMENT
/begin MEASUREMENT Bit_Sint32_Bit_06.Intern_MEM.Bit_Test "" SLONG ident 1 100 -2147483648 2147483647 ECU_ADDRESS 0x6D0090 BIT_MASK 0x00000040 /end MEASUREMENT
/begin MEASUREMENT Bit_Sint32_Bit_07.Intern_MEM.Bit_Test "" SLONG ident 1 100 -2147483648 2147483647 ECU_ADDRESS 0x6D0090 BIT_MASK 0x00000080 /end MEASUREMENT
/begin MEASUREMENT Bit_Sint32_Bit_08.Intern_MEM.Bit_Test "" SLONG ident 1 100 -2147483648 2147483647 ECU_ADDRESS 0x6D0090 BIT_MASK 0x00000100 /end MEASUREMENT
/begin MEASUREMENT Bit_Sint32_Bit_09.Intern_MEM.Bit_Test "" SLONG ident 1 100 -2147483648 2147483647 ECU_ADDRESS 0x6D0090 BIT_MASK 0x00000200 /end MEASUREMENT
/begin MEASUREMENT Bit_Sint32_Bit_10.Intern_MEM.Bit_Test "" SLONG ident 1 100 -2147483648 2147483647 ECU_ADDRESS 0x6D0090 BIT_MASK 0x00000400 /end MEASUREMENT
/begin MEASUREMENT Bit_Sint32_Bit_11.Intern_MEM.Bit_Test "" SLONG ident 1 100 -2147483648 2147483647 ECU_ADDRESS 0x6D0090 BIT_MASK 0x00000800 /end MEASUREMENT
/begin MEASUREMENT Bit_Sint32_Bit_12.Intern_MEM.Bit_Test "" SLONG ident 1 100 -2147483648 2147483647 ECU_ADDRESS 0x6D0090 BIT_MASK 0x00001000 /end MEASUREMENT
/begin MEASUREMENT Bit_Sint32_Bit_13.Intern_MEM.Bit_Test "" SLONG ident 1 100 -2147483648 2147483647 ECU_ADDRESS 0x6D0090 BIT_MASK 0x00002000 /end MEASUREMENT
/begin MEASUREMENT Bit_Sint32_Bit_14.Intern_MEM.Bit_Test "" SLONG ident 1 100 -2147483648 2147483647 ECU_ADDRESS 0x6D0090 BIT_MASK 0x00004000 /end MEASUREMENT
/begin MEASUREMENT Bit_Sint32_Bit_15.Intern_MEM.Bit_Test "" SLONG ident 1 100 -2147483648 2147483647 ECU_ADDRESS 0x6D0090 BIT_MASK 0x00008000 /end MEASUREMENT
/begin MEASUREMENT Bit_Sint32_Bit_16.Intern_MEM.Bit_Test "" SLONG ident 1 100 -2147483648 2147483647 ECU_ADDRESS 0x6D0090 BIT_MASK 0x00010000 /end MEASUREMENT
/begin MEASUREMENT Bit_Sint32_Bit_17.Intern_MEM.Bit_Test "" SLONG ident 1 100 -2147483648 2147483647 ECU_ADDRESS 0x6D0090 BIT_MASK 0x00020000 /end MEASUREMENT
/begin MEASUREMENT Bit_Sint32_Bit_18.Intern_MEM.Bit_Test "" SLONG ident 1 100 -2147483648 2147483647 ECU_ADDRESS 0x6D0090 BIT_MASK 0x00040000 /end MEASUREMENT
/begin MEASUREMENT Bit_Sint32_Bit_19.Intern_MEM.Bit_Test "" SLONG ident 1 100 -2147483648 2147483647 ECU_ADDRESS 0x6D0090 BIT_MASK 0x00080000 /end MEASUREMENT
/begin MEASUREMENT Bit_Sint32_Bit_20.Intern_MEM.Bit_Test "" SLONG ident 1 100 -2147483648 2147483647 ECU_ADDRESS 0x6D0090 BIT_MASK 0x00100000 /end MEASUREMENT
/begin MEASUREMENT Bit_Sint32_Bit_21.Intern_MEM.Bit_Test "" SLONG ident 1 100 -2147483648 2147483647 ECU_ADDRESS 0x6D0090 BIT_MASK 0x00200000 /end MEASUREMENT
/begin MEASUREMENT Bit_Sint32_Bit_22.Intern_MEM.Bit_Test "" SLONG ident 1 100 -2147483648 2147483647 ECU_ADDRESS 0x6D0090 BIT_MASK 0x00400000 /end MEASUREMENT
/begin MEASUREMENT Bit_Sint32_Bit_23.Intern_MEM.Bit_Test "" SLONG ident 1 100 -2147483648 2147483647 ECU_ADDRESS 0x6D0090 BIT_MASK 0x00800000 /end MEASUREMENT
/begin MEASUREMENT Bit_Sint32_Bit_24.Intern_MEM.Bit_Test "" SLONG ident 1 100 -2147483648 2147483647 ECU_ADDRESS 0x6D0090 BIT_MASK 0x01000000 /end MEASUREMENT
/begin MEASUREMENT Bit_Sint32_Bit_25.Intern_MEM.Bit_Test "" SLONG ident 1 100 -2147483648 2147483647 ECU_ADDRESS 0x6D0090 BIT_MASK 0x02000000 /end MEASUREMENT
/begin MEASUREMENT Bit_Sint32_Bit_26.Intern_MEM.Bit_Test "" SLONG ident 1 100 -2147483648 2147483647 ECU_ADDRESS 0x6D0090 BIT_MASK 0x04000000 /end MEASUREMENT
/begin MEASUREMENT Bit_Sint32_Bit_27.Intern_MEM.Bit_Test "" SLONG ident 1 100 -2147483648 2147483647 ECU_ADDRESS 0x6D0090 BIT_MASK 0x08000000 /end MEASUREMENT
/begin MEASUREMENT Bit_Sint32_Bit_28.Intern_MEM.Bit_Test "" SLONG ident 1 100 -2147483648 2147483647 ECU_ADDRESS 0x6D0090 BIT_MASK 0x10000000 /end MEASUREMENT
/begin MEASUREMENT Bit_Sint32_Bit_29.Intern_MEM.Bit_Test "" SLONG ident 1 100 -2147483648 2147483647 ECU_ADDRESS 0x6D0090 BIT_MASK 0x20000000 /end MEASUREMENT
/begin MEASUREMENT Bit_Sint32_Bit_30.Intern_MEM.Bit_Test "" SLONG ident 1 100 -2147483648 2147483647 ECU_ADDRESS 0x6D0090 BIT_MASK 0x40000000 /end MEASUREMENT
/begin MEASUREMENT Bit_Sint32_Bit_31.Intern_MEM.Bit_Test "" SLONG ident 1 100 -2147483648 2147483647 ECU_ADDRESS 0x6D0090 BIT_MASK 0x80000000 /end MEASUREMENT
/begin MEASUREMENT Bit_Sint8.P_Bit.Bit_Test "" SBYTE ident 1 100 -128 127 ECU_ADDRESS 0x6D0074 /end MEASUREMENT
/begin MEASUREMENT Bit_Sint8_E_Bit_x.Extern_MEM.Bit_Test "" SBYTE ident 1 100 -128 127 ECU_ADDRESS 0x6D0088 /end MEASUREMENT
/begin MEASUREMENT Bit_Sint8_E_Bit_0.Extern_MEM.Bit_Test "" SBYTE ident 1 100 -128 127 ECU_ADDRESS 0x6D0088 BIT_MASK 0x01 /end MEASUREMENT
/begin MEASUREMENT Bit_Sint8_E_Bit_1.Extern_MEM.Bit_Test "" SBYTE ident 1 100 -128 127 ECU_ADDRESS 0x6D0088 BIT_MASK 0x02 /end MEASUREMENT
/begin MEASUREMENT Bit_Sint8_E_Bit_2.Extern_MEM.Bit_Test "" SBYTE ident 1 100 -128 127 ECU_ADDRESS 0x6D0088 BIT_MASK 0x04 /end MEASUREMENT
/begin MEASUREMENT Bit_Sint8_E_Bit_3.Extern_MEM.Bit_Test "" SBYTE ident 1 100 -128 127 ECU_ADDRESS 0x6D0088 BIT_MASK 0x08 /end MEASUREMENT
/begin MEASUREMENT Bit_Sint8_E_Bit_4.Extern_MEM.Bit_Test "" SBYTE ident 1 100 -128 127 ECU_ADDRESS 0x6D0088 BIT_MASK 0x10 /end MEASUREMENT
/begin MEASUREMENT Bit_Sint8_E_Bit_5.Extern_MEM.Bit_Test "" SBYTE ident 1 100 -128 127 ECU_ADDRESS 0x6D0088 BIT_MASK 0x20 /end MEASUREMENT
/begin MEASUREMENT Bit_Sint8_E_Bit_6.Extern_MEM.Bit_Test "" SBYTE ident 1 100 -128 127 ECU_ADDRESS 0x6D0088 BIT_MASK 0x40 /end MEASUREMENT
/begin MEASUREMENT Bit_Sint8_E_Bit_7.Extern_MEM.Bit_Test "" SBYTE ident 1 100 -128 127 ECU_ADDRESS 0x6D0088 BIT_MASK 0x80 /end MEASUREMENT
/begin MEASUREMENT Bit_Sint8_E_Bit_x.Intern_MEM.Bit_Test "" SBYTE ident 1 100 -128 127 ECU_ADDRESS 0x6D009C /end MEASUREMENT
/begin MEASUREMENT Bit_Sint8_E_Bit_0.Intern_MEM.Bit_Test "" SBYTE ident 1 100 -128 127 ECU_ADDRESS 0x6D009C BIT_MASK 0x01 /end MEASUREMENT
/begin MEASUREMENT Bit_Sint8_E_Bit_1.Intern_MEM.Bit_Test "" SBYTE ident 1 100 -128 127 ECU_ADDRESS 0x6D009C BIT_MASK 0x02 /end MEASUREMENT
/begin MEASUREMENT Bit_Sint8_E_Bit_2.Intern_MEM.Bit_Test "" SBYTE ident 1 100 -128 127 ECU_ADDRESS 0x6D009C BIT_MASK 0x04 /end MEASUREMENT
/begin MEASUREMENT Bit_Sint8_E_Bit_3.Intern_MEM.Bit_Test "" SBYTE ident 1 100 -128 127 ECU_ADDRESS 0x6D009C BIT_MASK 0x08 /end MEASUREMENT
/begin MEASUREMENT Bit_Sint8_E_Bit_4.Intern_MEM.Bit_Test "" SBYTE ident 1 100 -128 127 ECU_ADDRESS 0x6D009C BIT_MASK 0x10 /end MEASUREMENT
/begin MEASUREMENT Bit_Sint8_E_Bit_5.Intern_MEM.Bit_Test "" SBYTE ident 1 100 -128 127 ECU_ADDRESS 0x6D009C BIT_MASK 0x20 /end MEASUREMENT
/begin MEASUREMENT Bit_Sint8_E_Bit_6.Intern_MEM.Bit_Test "" SBYTE ident 1 100 -128 127 ECU_ADDRESS 0x6D009C BIT_MASK 0x40 /end MEASUREMENT
/begin MEASUREMENT Bit_Sint8_E_Bit_7.Intern_MEM.Bit_Test "" SBYTE ident 1 100 -128 127 ECU_ADDRESS 0x6D009C BIT_MASK 0x80 /end MEASUREMENT
/begin MEASUREMENT Bit_Sint8_O_Bit_x.Extern_MEM.Bit_Test "" SBYTE ident 1 100 -128 127 ECU_ADDRESS 0x6D0089 /end MEASUREMENT
/begin MEASUREMENT Bit_Sint8_O_Bit_0.Extern_MEM.Bit_Test "" SBYTE ident 1 100 -128 127 ECU_ADDRESS 0x6D0089 BIT_MASK 0x01 /end MEASUREMENT
/begin MEASUREMENT Bit_Sint8_O_Bit_1.Extern_MEM.Bit_Test "" SBYTE ident 1 100 -128 127 ECU_ADDRESS 0x6D0089 BIT_MASK 0x02 /end MEASUREMENT
/begin MEASUREMENT Bit_Sint8_O_Bit_2.Extern_MEM.Bit_Test "" SBYTE ident 1 100 -128 127 ECU_ADDRESS 0x6D0089 BIT_MASK 0x04 /end MEASUREMENT
/begin MEASUREMENT Bit_Sint8_O_Bit_3.Extern_MEM.Bit_Test "" SBYTE ident 1 100 -128 127 ECU_ADDRESS 0x6D0089 BIT_MASK 0x08 /end MEASUREMENT
/begin MEASUREMENT Bit_Sint8_O_Bit_4.Extern_MEM.Bit_Test "" SBYTE ident 1 100 -128 127 ECU_ADDRESS 0x6D0089 BIT_MASK 0x10 /end MEASUREMENT
/begin MEASUREMENT Bit_Sint8_O_Bit_5.Extern_MEM.Bit_Test "" SBYTE ident 1 100 -128 127 ECU_ADDRESS 0x6D0089 BIT_MASK 0x20 /end MEASUREMENT
/begin MEASUREMENT Bit_Sint8_O_Bit_6.Extern_MEM.Bit_Test "" SBYTE ident 1 100 -128 127 ECU_ADDRESS 0x6D0089 BIT_MASK 0x40 /end MEASUREMENT
/begin MEASUREMENT Bit_Sint8_O_Bit_7.Extern_MEM.Bit_Test "" SBYTE ident 1 100 -128 127 ECU_ADDRESS 0x6D0089 BIT_MASK 0x80 /end MEASUREMENT
/begin MEASUREMENT Bit_Sint8_O_Bit_x.Intern_MEM.Bit_Test "" SBYTE ident 1 100 -128 127 ECU_ADDRESS 0x6D009D /end MEASUREMENT
/begin MEASUREMENT Bit_Sint8_O_Bit_0.Intern_MEM.Bit_Test "" SBYTE ident 1 100 -128 127 ECU_ADDRESS 0x6D009D BIT_MASK 0x01 /end MEASUREMENT
/begin MEASUREMENT Bit_Sint8_O_Bit_1.Intern_MEM.Bit_Test "" SBYTE ident 1 100 -128 127 ECU_ADDRESS 0x6D009D BIT_MASK 0x02 /end MEASUREMENT
/begin MEASUREMENT Bit_Sint8_O_Bit_2.Intern_MEM.Bit_Test "" SBYTE ident 1 100 -128 127 ECU_ADDRESS 0x6D009D BIT_MASK 0x04 /end MEASUREMENT
/begin MEASUREMENT Bit_Sint8_O_Bit_3.Intern_MEM.Bit_Test "" SBYTE ident 1 100 -128 127 ECU_ADDRESS 0x6D009D BIT_MASK 0x08 /end MEASUREMENT
/begin MEASUREMENT Bit_Sint8_O_Bit_4.Intern_MEM.Bit_Test "" SBYTE ident 1 100 -128 127 ECU_ADDRESS 0x6D009D BIT_MASK 0x10 /end MEASUREMENT
/begin MEASUREMENT Bit_Sint8_O_Bit_5.Intern_MEM.Bit_Test "" SBYTE ident 1 100 -128 127 ECU_ADDRESS 0x6D009D BIT_MASK 0x20 /end MEASUREMENT
/begin MEASUREMENT Bit_Sint8_O_Bit_6.Intern_MEM.Bit_Test "" SBYTE ident 1 100 -128 127 ECU_ADDRESS 0x6D009D BIT_MASK 0x40 /end MEASUREMENT
/begin MEASUREMENT Bit_Sint8_O_Bit_7.Intern_MEM.Bit_Test "" SBYTE ident 1 100 -128 127 ECU_ADDRESS 0x6D009D BIT_MASK 0x80 /end MEASUREMENT
/begin MEASUREMENT Bit_Uint16.P_Bit.Bit_Test "" UWORD ident 1 100 0 65535 ECU_ADDRESS 0x6D0072 /end MEASUREMENT
/begin MEASUREMENT Bit_Uint16_Bit_x.Extern_MEM.Bit_Test "" UWORD ident 1 100 0 65535 ECU_ADDRESS 0x6D0086 /end MEASUREMENT
/begin MEASUREMENT Bit_Uint16_Bit_00.Extern_MEM.Bit_Test "" UWORD ident 1 100 0 65535 ECU_ADDRESS 0x6D0086 BIT_MASK 0x0001 /end MEASUREMENT
/begin MEASUREMENT Bit_Uint16_Bit_01.Extern_MEM.Bit_Test "" UWORD ident 1 100 0 65535 ECU_ADDRESS 0x6D0086 BIT_MASK 0x0002 /end MEASUREMENT
/begin MEASUREMENT Bit_Uint16_Bit_02.Extern_MEM.Bit_Test "" UWORD ident 1 100 0 65535 ECU_ADDRESS 0x6D0086 BIT_MASK 0x0004 /end MEASUREMENT
/begin MEASUREMENT Bit_Uint16_Bit_03.Extern_MEM.Bit_Test "" UWORD ident 1 100 0 65535 ECU_ADDRESS 0x6D0086 BIT_MASK 0x0008 /end MEASUREMENT
/begin MEASUREMENT Bit_Uint16_Bit_04.Extern_MEM.Bit_Test "" UWORD ident 1 100 0 65535 ECU_ADDRESS 0x6D0086 BIT_MASK 0x0010 /end MEASUREMENT
/begin MEASUREMENT Bit_Uint16_Bit_05.Extern_MEM.Bit_Test "" UWORD ident 1 100 0 65535 ECU_ADDRESS 0x6D0086 BIT_MASK 0x0020 /end MEASUREMENT
/begin MEASUREMENT Bit_Uint16_Bit_06.Extern_MEM.Bit_Test "" UWORD ident 1 100 0 65535 ECU_ADDRESS 0x6D0086 BIT_MASK 0x0040 /end MEASUREMENT
/begin MEASUREMENT Bit_Uint16_Bit_07.Extern_MEM.Bit_Test "" UWORD ident 1 100 0 65535 ECU_ADDRESS 0x6D0086 BIT_MASK 0x0080 /end MEASUREMENT
/begin MEASUREMENT Bit_Uint16_Bit_08.Extern_MEM.Bit_Test "" UWORD ident 1 100 0 65535 ECU_ADDRESS 0x6D0086 BIT_MASK 0x0100 /end MEASUREMENT
/begin MEASUREMENT Bit_Uint16_Bit_09.Extern_MEM.Bit_Test "" UWORD ident 1 100 0 65535 ECU_ADDRESS 0x6D0086 BIT_MASK 0x0200 /end MEASUREMENT
/begin MEASUREMENT Bit_Uint16_Bit_10.Extern_MEM.Bit_Test "" UWORD ident 1 100 0 65535 ECU_ADDRESS 0x6D0086 BIT_MASK 0x0400 /end MEASUREMENT
/begin MEASUREMENT Bit_Uint16_Bit_11.Extern_MEM.Bit_Test "" UWORD ident 1 100 0 65535 ECU_ADDRESS 0x6D0086 BIT_MASK 0x0800 /end MEASUREMENT
/begin MEASUREMENT Bit_Uint16_Bit_12.Extern_MEM.Bit_Test "" UWORD ident 1 100 0 65535 ECU_ADDRESS 0x6D0086 BIT_MASK 0x1000 /end MEASUREMENT
/begin MEASUREMENT Bit_Uint16_Bit_13.Extern_MEM.Bit_Test "" UWORD ident 1 100 0 65535 ECU_ADDRESS 0x6D0086 BIT_MASK 0x2000 /end MEASUREMENT
/begin MEASUREMENT Bit_Uint16_Bit_14.Extern_MEM.Bit_Test "" UWORD ident 1 100 0 65535 ECU_ADDRESS 0x6D0086 BIT_MASK 0x4000 /end MEASUREMENT
/begin MEASUREMENT Bit_Uint16_Bit_15.Extern_MEM.Bit_Test "" UWORD ident 1 100 0 65535 ECU_ADDRESS 0x6D0086 BIT_MASK 0x8000 /end MEASUREMENT
/begin MEASUREMENT Bit_Uint16_Bit_x.Intern_MEM.Bit_Test "" UWORD ident 1 100 0 65535 ECU_ADDRESS 0x6D009A /end MEASUREMENT
/begin MEASUREMENT Bit_Uint16_Bit_00.Intern_MEM.Bit_Test "" UWORD ident 1 100 0 65535 ECU_ADDRESS 0x6D009A BIT_MASK 0x0001 /end MEASUREMENT
/begin MEASUREMENT Bit_Uint16_Bit_01.Intern_MEM.Bit_Test "" UWORD ident 1 100 0 65535 ECU_ADDRESS 0x6D009A BIT_MASK 0x0002 /end MEASUREMENT
/begin MEASUREMENT Bit_Uint16_Bit_02.Intern_MEM.Bit_Test "" UWORD ident 1 100 0 65535 ECU_ADDRESS 0x6D009A BIT_MASK 0x0004 /end MEASUREMENT
/begin MEASUREMENT Bit_Uint16_Bit_03.Intern_MEM.Bit_Test "" UWORD ident 1 100 0 65535 ECU_ADDRESS 0x6D009A BIT_MASK 0x0008 /end MEASUREMENT
/begin MEASUREMENT Bit_Uint16_Bit_04.Intern_MEM.Bit_Test "" UWORD ident 1 100 0 65535 ECU_ADDRESS 0x6D009A BIT_MASK 0x0010 /end MEASUREMENT
/begin MEASUREMENT Bit_Uint16_Bit_05.Intern_MEM.Bit_Test "" UWORD ident 1 100 0 65535 ECU_ADDRESS 0x6D009A BIT_MASK 0x0020 /end MEASUREMENT
/begin MEASUREMENT Bit_Uint16_Bit_06.Intern_MEM.Bit_Test "" UWORD ident 1 100 0 65535 ECU_ADDRESS 0x6D009A BIT_MASK 0x0040 /end MEASUREMENT
/begin MEASUREMENT Bit_Uint16_Bit_07.Intern_MEM.Bit_Test "" UWORD ident 1 100 0 65535 ECU_ADDRESS 0x6D009A BIT_MASK 0x0080 /end MEASUREMENT
/begin MEASUREMENT Bit_Uint16_Bit_08.Intern_MEM.Bit_Test "" UWORD ident 1 100 0 65535 ECU_ADDRESS 0x6D009A BIT_MASK 0x0100 /end MEASUREMENT
/begin MEASUREMENT Bit_Uint16_Bit_09.Intern_MEM.Bit_Test "" UWORD ident 1 100 0 65535 ECU_ADDRESS 0x6D009A BIT_MASK 0x0200 /end MEASUREMENT
/begin MEASUREMENT Bit_Uint16_Bit_10.Intern_MEM.Bit_Test "" UWORD ident 1 100 0 65535 ECU_ADDRESS 0x6D009A BIT_MASK 0x0400 /end MEASUREMENT
/begin MEASUREMENT Bit_Uint16_Bit_11.Intern_MEM.Bit_Test "" UWORD ident 1 100 0 65535 ECU_ADDRESS 0x6D009A BIT_MASK 0x0800 /end MEASUREMENT
/begin MEASUREMENT Bit_Uint16_Bit_12.Intern_MEM.Bit_Test "" UWORD ident 1 100 0 65535 ECU_ADDRESS 0x6D009A BIT_MASK 0x1000 /end MEASUREMENT
/begin MEASUREMENT Bit_Uint16_Bit_13.Intern_MEM.Bit_Test "" UWORD ident 1 100 0 65535 ECU_ADDRESS 0x6D009A BIT_MASK 0x2000 /end MEASUREMENT
/begin MEASUREMENT Bit_Uint16_Bit_14.Intern_MEM.Bit_Test "" UWORD ident 1 100 0 65535 ECU_ADDRESS 0x6D009A BIT_MASK 0x4000 /end MEASUREMENT
/begin MEASUREMENT Bit_Uint16_Bit_15.Intern_MEM.Bit_Test "" UWORD ident 1 100 0 65535 ECU_ADDRESS 0x6D009A BIT_MASK 0x8000 /end MEASUREMENT
/begin MEASUREMENT Bit_Uint32.P_Bit.Bit_Test "" ULONG ident 1 100 0 4294967295 ECU_ADDRESS 0x6D006C /end MEASUREMENT
/begin MEASUREMENT Bit_Uint32_Bit_x.Extern_MEM.Bit_Test "" ULONG ident 1 100 0 4294967295 ECU_ADDRESS 0x6D0080 /end MEASUREMENT
/begin MEASUREMENT Bit_Uint32_Bit_00.Extern_MEM.Bit_Test "" ULONG ident 1 100 0 4294967295 ECU_ADDRESS 0x6D0080 BIT_MASK 0x00000001 /end MEASUREMENT
/begin MEASUREMENT Bit_Uint32_Bit_01.Extern_MEM.Bit_Test "" ULONG ident 1 100 0 4294967295 ECU_ADDRESS 0x6D0080 BIT_MASK 0x00000002 /end MEASUREMENT
/begin MEASUREMENT Bit_Uint32_Bit_02.Extern_MEM.Bit_Test "" ULONG ident 1 100 0 4294967295 ECU_ADDRESS 0x6D0080 BIT_MASK 0x00000004 /end MEASUREMENT
/begin MEASUREMENT Bit_Uint32_Bit_03.Extern_MEM.Bit_Test "" ULONG ident 1 100 0 4294967295 ECU_ADDRESS 0x6D0080 BIT_MASK 0x00000008 /end MEASUREMENT
/begin MEASUREMENT Bit_Uint32_Bit_04.Extern_MEM.Bit_Test "" ULONG ident 1 100 0 4294967295 ECU_ADDRESS 0x6D0080 BIT_MASK 0x00000010 /end MEASUREMENT
/begin MEASUREMENT Bit_Uint32_Bit_05.Extern_MEM.Bit_Test "" ULONG ident 1 100 0 4294967295 ECU_ADDRESS 0x6D0080 BIT_MASK 0x00000020 /end MEASUREMENT
/begin MEASUREMENT Bit_Uint32_Bit_06.Extern_MEM.Bit_Test "" ULONG ident 1 100 0 4294967295 ECU_ADDRESS 0x6D0080 BIT_MASK 0x00000040 /end MEASUREMENT
/begin MEASUREMENT Bit_Uint32_Bit_07.Extern_MEM.Bit_Test "" ULONG ident 1 100 0 4294967295 ECU_ADDRESS 0x6D0080 BIT_MASK 0x00000080 /end MEASUREMENT
/begin MEASUREMENT Bit_Uint32_Bit_08.Extern_MEM.Bit_Test "" ULONG ident 1 100 0 4294967295 ECU_ADDRESS 0x6D0080 BIT_MASK 0x00000100 /end MEASUREMENT
/begin MEASUREMENT Bit_Uint32_Bit_09.Extern_MEM.Bit_Test "" ULONG ident 1 100 0 4294967295 ECU_ADDRESS 0x6D0080 BIT_MASK 0x00000200 /end MEASUREMENT
/begin MEASUREMENT Bit_Uint32_Bit_10.Extern_MEM.Bit_Test "" ULONG ident 1 100 0 4294967295 ECU_ADDRESS 0x6D0080 BIT_MASK 0x00000400 /end MEASUREMENT
/begin MEASUREMENT Bit_Uint32_Bit_11.Extern_MEM.Bit_Test "" ULONG ident 1 100 0 4294967295 ECU_ADDRESS 0x6D0080 BIT_MASK 0x00000800 /end MEASUREMENT
/begin MEASUREMENT Bit_Uint32_Bit_12.Extern_MEM.Bit_Test "" ULONG ident 1 100 0 4294967295 ECU_ADDRESS 0x6D0080 BIT_MASK 0x00001000 /end MEASUREMENT
/begin MEASUREMENT Bit_Uint32_Bit_13.Extern_MEM.Bit_Test "" ULONG ident 1 100 0 4294967295 ECU_ADDRESS 0x6D0080 BIT_MASK 0x00002000 /end MEASUREMENT
/begin MEASUREMENT Bit_Uint32_Bit_14.Extern_MEM.Bit_Test "" ULONG ident 1 100 0 4294967295 ECU_ADDRESS 0x6D0080 BIT_MASK 0x00004000 /end MEASUREMENT
/begin MEASUREMENT Bit_Uint32_Bit_15.Extern_MEM.Bit_Test "" ULONG ident 1 100 0 4294967295 ECU_ADDRESS 0x6D0080 BIT_MASK 0x00008000 /end MEASUREMENT
/begin MEASUREMENT Bit_Uint32_Bit_16.Extern_MEM.Bit_Test "" ULONG ident 1 100 0 4294967295 ECU_ADDRESS 0x6D0080 BIT_MASK 0x00010000 /end MEASUREMENT
/begin MEASUREMENT Bit_Uint32_Bit_17.Extern_MEM.Bit_Test "" ULONG ident 1 100 0 4294967295 ECU_ADDRESS 0x6D0080 BIT_MASK 0x00020000 /end MEASUREMENT
/begin MEASUREMENT Bit_Uint32_Bit_18.Extern_MEM.Bit_Test "" ULONG ident 1 100 0 4294967295 ECU_ADDRESS 0x6D0080 BIT_MASK 0x00040000 /end MEASUREMENT
/begin MEASUREMENT Bit_Uint32_Bit_19.Extern_MEM.Bit_Test "" ULONG ident 1 100 0 4294967295 ECU_ADDRESS 0x6D0080 BIT_MASK 0x00080000 /end MEASUREMENT
/begin MEASUREMENT Bit_Uint32_Bit_20.Extern_MEM.Bit_Test "" ULONG ident 1 100 0 4294967295 ECU_ADDRESS 0x6D0080 BIT_MASK 0x00100000 /end MEASUREMENT
/begin MEASUREMENT Bit_Uint32_Bit_21.Extern_MEM.Bit_Test "" ULONG ident 1 100 0 4294967295 ECU_ADDRESS 0x6D0080 BIT_MASK 0x00200000 /end MEASUREMENT
/begin MEASUREMENT Bit_Uint32_Bit_22.Extern_MEM.Bit_Test "" ULONG ident 1 100 0 4294967295 ECU_ADDRESS 0x6D0080 BIT_MASK 0x00400000 /end MEASUREMENT
/begin MEASUREMENT Bit_Uint32_Bit_23.Extern_MEM.Bit_Test "" ULONG ident 1 100 0 4294967295 ECU_ADDRESS 0x6D0080 BIT_MASK 0x00800000 /end MEASUREMENT
/begin MEASUREMENT Bit_Uint32_Bit_24.Extern_MEM.Bit_Test "" ULONG ident 1 100 0 4294967295 ECU_ADDRESS 0x6D0080 BIT_MASK 0x01000000 /end MEASUREMENT
/begin MEASUREMENT Bit_Uint32_Bit_25.Extern_MEM.Bit_Test "" ULONG ident 1 100 0 4294967295 ECU_ADDRESS 0x6D0080 BIT_MASK 0x02000000 /end MEASUREMENT
/begin MEASUREMENT Bit_Uint32_Bit_26.Extern_MEM.Bit_Test "" ULONG ident 1 100 0 4294967295 ECU_ADDRESS 0x6D0080 BIT_MASK 0x04000000 /end MEASUREMENT
/begin MEASUREMENT Bit_Uint32_Bit_27.Extern_MEM.Bit_Test "" ULONG ident 1 100 0 4294967295 ECU_ADDRESS 0x6D0080 BIT_MASK 0x08000000 /end MEASUREMENT
/begin MEASUREMENT Bit_Uint32_Bit_28.Extern_MEM.Bit_Test "" ULONG ident 1 100 0 4294967295 ECU_ADDRESS 0x6D0080 BIT_MASK 0x10000000 /end MEASUREMENT
/begin MEASUREMENT Bit_Uint32_Bit_29.Extern_MEM.Bit_Test "" ULONG ident 1 100 0 4294967295 ECU_ADDRESS 0x6D0080 BIT_MASK 0x20000000 /end MEASUREMENT
/begin MEASUREMENT Bit_Uint32_Bit_30.Extern_MEM.Bit_Test "" ULONG ident 1 100 0 4294967295 ECU_ADDRESS 0x6D0080 BIT_MASK 0x40000000 /end MEASUREMENT
/begin MEASUREMENT Bit_Uint32_Bit_31.Extern_MEM.Bit_Test "" ULONG ident 1 100 0 4294967295 ECU_ADDRESS 0x6D0080 BIT_MASK 0x80000000 /end MEASUREMENT
/begin MEASUREMENT Bit_Uint32_Bit_x.Intern_MEM.Bit_Test "" ULONG ident 1 100 0 4294967295 ECU_ADDRESS 0x6D0094 /end MEASUREMENT
/begin MEASUREMENT Bit_Uint32_Bit_00.Intern_MEM.Bit_Test "" ULONG ident 1 100 0 4294967295 ECU_ADDRESS 0x6D0094 BIT_MASK 0x00000001 /end MEASUREMENT
/begin MEASUREMENT Bit_Uint32_Bit_01.Intern_MEM.Bit_Test "" ULONG ident 1 100 0 4294967295 ECU_ADDRESS 0x6D0094 BIT_MASK 0x00000002 /end MEASUREMENT
/begin MEASUREMENT Bit_Uint32_Bit_02.Intern_MEM.Bit_Test "" ULONG ident 1 100 0 4294967295 ECU_ADDRESS 0x6D0094 BIT_MASK 0x00000004 /end MEASUREMENT
/begin MEASUREMENT Bit_Uint32_Bit_03.Intern_MEM.Bit_Test "" ULONG ident 1 100 0 4294967295 ECU_ADDRESS 0x6D0094 BIT_MASK 0x00000008 /end MEASUREMENT
/begin MEASUREMENT Bit_Uint32_Bit_04.Intern_MEM.Bit_Test "" ULONG ident 1 100 0 4294967295 ECU_ADDRESS 0x6D0094 BIT_MASK 0x00000010 /end MEASUREMENT
/begin MEASUREMENT Bit_Uint32_Bit_05.Intern_MEM.Bit_Test "" ULONG ident 1 100 0 4294967295 ECU_ADDRESS 0x6D0094 BIT_MASK 0x00000020 /end MEASUREMENT
/begin MEASUREMENT Bit_Uint32_Bit_06.Intern_MEM.Bit_Test "" ULONG ident 1 100 0 4294967295 ECU_ADDRESS 0x6D0094 BIT_MASK 0x00000040 /end MEASUREMENT
/begin MEASUREMENT Bit_Uint32_Bit_07.Intern_MEM.Bit_Test "" ULONG ident 1 100 0 4294967295 ECU_ADDRESS 0x6D0094 BIT_MASK 0x00000080 /end MEASUREMENT
/begin MEASUREMENT Bit_Uint32_Bit_08.Intern_MEM.Bit_Test "" ULONG ident 1 100 0 4294967295 ECU_ADDRESS 0x6D0094 BIT_MASK 0x00000100 /end MEASUREMENT
/begin MEASUREMENT Bit_Uint32_Bit_09.Intern_MEM.Bit_Test "" ULONG ident 1 100 0 4294967295 ECU_ADDRESS 0x6D0094 BIT_MASK 0x00000200 /end MEASUREMENT
/begin MEASUREMENT Bit_Uint32_Bit_10.Intern_MEM.Bit_Test "" ULONG ident 1 100 0 4294967295 ECU_ADDRESS 0x6D0094 BIT_MASK 0x00000400 /end MEASUREMENT
/begin MEASUREMENT Bit_Uint32_Bit_11.Intern_MEM.Bit_Test "" ULONG ident 1 100 0 4294967295 ECU_ADDRESS 0x6D0094 BIT_MASK 0x00000800 /end MEASUREMENT
/begin MEASUREMENT Bit_Uint32_Bit_12.Intern_MEM.Bit_Test "" ULONG ident 1 100 0 4294967295 ECU_ADDRESS 0x6D0094 BIT_MASK 0x00001000 /end MEASUREMENT
/begin MEASUREMENT Bit_Uint32_Bit_13.Intern_MEM.Bit_Test "" ULONG ident 1 100 0 4294967295 ECU_ADDRESS 0x6D0094 BIT_MASK 0x00002000 /end MEASUREMENT
/begin MEASUREMENT Bit_Uint32_Bit_14.Intern_MEM.Bit_Test "" ULONG ident 1 100 0 4294967295 ECU_ADDRESS 0x6D0094 BIT_MASK 0x00004000 /end MEASUREMENT
/begin MEASUREMENT Bit_Uint32_Bit_15.Intern_MEM.Bit_Test "" ULONG ident 1 100 0 4294967295 ECU_ADDRESS 0x6D0094 BIT_MASK 0x00008000 /end MEASUREMENT
/begin MEASUREMENT Bit_Uint32_Bit_16.Intern_MEM.Bit_Test "" ULONG ident 1 100 0 4294967295 ECU_ADDRESS 0x6D0094 BIT_MASK 0x00010000 /end MEASUREMENT
/begin MEASUREMENT Bit_Uint32_Bit_17.Intern_MEM.Bit_Test "" ULONG ident 1 100 0 4294967295 ECU_ADDRESS 0x6D0094 BIT_MASK 0x00020000 /end MEASUREMENT
/begin MEASUREMENT Bit_Uint32_Bit_18.Intern_MEM.Bit_Test "" ULONG ident 1 100 0 4294967295 ECU_ADDRESS 0x6D0094 BIT_MASK 0x00040000 /end MEASUREMENT
/begin MEASUREMENT Bit_Uint32_Bit_19.Intern_MEM.Bit_Test "" ULONG ident 1 100 0 4294967295 ECU_ADDRESS 0x6D0094 BIT_MASK 0x00080000 /end MEASUREMENT
/begin MEASUREMENT Bit_Uint32_Bit_20.Intern_MEM.Bit_Test "" ULONG ident 1 100 0 4294967295 ECU_ADDRESS 0x6D0094 BIT_MASK 0x00100000 /end MEASUREMENT
/begin MEASUREMENT Bit_Uint32_Bit_21.Intern_MEM.Bit_Test "" ULONG ident 1 100 0 4294967295 ECU_ADDRESS 0x6D0094 BIT_MASK 0x00200000 /end MEASUREMENT
/begin MEASUREMENT Bit_Uint32_Bit_22.Intern_MEM.Bit_Test "" ULONG ident 1 100 0 4294967295 ECU_ADDRESS 0x6D0094 BIT_MASK 0x00400000 /end MEASUREMENT
/begin MEASUREMENT Bit_Uint32_Bit_23.Intern_MEM.Bit_Test "" ULONG ident 1 100 0 4294967295 ECU_ADDRESS 0x6D0094 BIT_MASK 0x00800000 /end MEASUREMENT
/begin MEASUREMENT Bit_Uint32_Bit_24.Intern_MEM.Bit_Test "" ULONG ident 1 100 0 4294967295 ECU_ADDRESS 0x6D0094 BIT_MASK 0x01000000 /end MEASUREMENT
/begin MEASUREMENT Bit_Uint32_Bit_25.Intern_MEM.Bit_Test "" ULONG ident 1 100 0 4294967295 ECU_ADDRESS 0x6D0094 BIT_MASK 0x02000000 /end MEASUREMENT
/begin MEASUREMENT Bit_Uint32_Bit_26.Intern_MEM.Bit_Test "" ULONG ident 1 100 0 4294967295 ECU_ADDRESS 0x6D0094 BIT_MASK 0x04000000 /end MEASUREMENT
/begin MEASUREMENT Bit_Uint32_Bit_27.Intern_MEM.Bit_Test "" ULONG ident 1 100 0 4294967295 ECU_ADDRESS 0x6D0094 BIT_MASK 0x08000000 /end MEASUREMENT
/begin MEASUREMENT Bit_Uint32_Bit_28.Intern_MEM.Bit_Test "" ULONG ident 1 100 0 4294967295 ECU_ADDRESS 0x6D0094 BIT_MASK 0x10000000 /end MEASUREMENT
/begin MEASUREMENT Bit_Uint32_Bit_29.Intern_MEM.Bit_Test "" ULONG ident 1 100 0 4294967295 ECU_ADDRESS 0x6D0094 BIT_MASK 0x20000000 /end MEASUREMENT
/begin MEASUREMENT Bit_Uint32_Bit_30.Intern_MEM.Bit_Test "" ULONG ident 1 100 0 4294967295 ECU_ADDRESS 0x6D0094 BIT_MASK 0x40000000 /end MEASUREMENT
/begin MEASUREMENT Bit_Uint32_Bit_31.Intern_MEM.Bit_Test "" ULONG ident 1 100 0 4294967295 ECU_ADDRESS 0x6D0094 BIT_MASK 0x80000000 /end MEASUREMENT
/begin MEASUREMENT Bit_Uint8.P_Bit.Bit_Test "" UBYTE ident 1 100 0 255 ECU_ADDRESS 0x6D0075 /end MEASUREMENT
/begin MEASUREMENT Bit_Uint8_E_Bit_x.Extern_MEM.Bit_Test "" UBYTE ident 1 100 0 255 ECU_ADDRESS 0x6D008A /end MEASUREMENT
/begin MEASUREMENT Bit_Uint8_E_Bit_0.Extern_MEM.Bit_Test "" UBYTE ident 1 100 0 255 ECU_ADDRESS 0x6D008A BIT_MASK 0x01 /end MEASUREMENT
/begin MEASUREMENT Bit_Uint8_E_Bit_1.Extern_MEM.Bit_Test "" UBYTE ident 1 100 0 255 ECU_ADDRESS 0x6D008A BIT_MASK 0x02 /end MEASUREMENT
/begin MEASUREMENT Bit_Uint8_E_Bit_2.Extern_MEM.Bit_Test "" UBYTE ident 1 100 0 255 ECU_ADDRESS 0x6D008A BIT_MASK 0x04 /end MEASUREMENT
/begin MEASUREMENT Bit_Uint8_E_Bit_3.Extern_MEM.Bit_Test "" UBYTE ident 1 100 0 255 ECU_ADDRESS 0x6D008A BIT_MASK 0x08 /end MEASUREMENT
/begin MEASUREMENT Bit_Uint8_E_Bit_4.Extern_MEM.Bit_Test "" UBYTE ident 1 100 0 255 ECU_ADDRESS 0x6D008A BIT_MASK 0x10 /end MEASUREMENT
/begin MEASUREMENT Bit_Uint8_E_Bit_5.Extern_MEM.Bit_Test "" UBYTE ident 1 100 0 255 ECU_ADDRESS 0x6D008A BIT_MASK 0x20 /end MEASUREMENT
/begin MEASUREMENT Bit_Uint8_E_Bit_6.Extern_MEM.Bit_Test "" UBYTE ident 1 100 0 255 ECU_ADDRESS 0x6D008A BIT_MASK 0x40 /end MEASUREMENT
/begin MEASUREMENT Bit_Uint8_E_Bit_7.Extern_MEM.Bit_Test "" UBYTE ident 1 100 0 255 ECU_ADDRESS 0x6D008A BIT_MASK 0x80 /end MEASUREMENT
/begin MEASUREMENT Bit_Uint8_E_Bit_x.Intern_MEM.Bit_Test "" UBYTE ident 1 100 0 255 ECU_ADDRESS 0x6D009E /end MEASUREMENT
/begin MEASUREMENT Bit_Uint8_E_Bit_0.Intern_MEM.Bit_Test "" UBYTE ident 1 100 0 255 ECU_ADDRESS 0x6D009E BIT_MASK 0x01 /end MEASUREMENT
/begin MEASUREMENT Bit_Uint8_E_Bit_1.Intern_MEM.Bit_Test "" UBYTE ident 1 100 0 255 ECU_ADDRESS 0x6D009E BIT_MASK 0x02 /end MEASUREMENT
/begin MEASUREMENT Bit_Uint8_E_Bit_2.Intern_MEM.Bit_Test "" UBYTE ident 1 100 0 255 ECU_ADDRESS 0x6D009E BIT_MASK 0x04 /end MEASUREMENT
/begin MEASUREMENT Bit_Uint8_E_Bit_3.Intern_MEM.Bit_Test "" UBYTE ident 1 100 0 255 ECU_ADDRESS 0x6D009E BIT_MASK 0x08 /end MEASUREMENT
/begin MEASUREMENT Bit_Uint8_E_Bit_4.Intern_MEM.Bit_Test "" UBYTE ident 1 100 0 255 ECU_ADDRESS 0x6D009E BIT_MASK 0x10 /end MEASUREMENT
/begin MEASUREMENT Bit_Uint8_E_Bit_5.Intern_MEM.Bit_Test "" UBYTE ident 1 100 0 255 ECU_ADDRESS 0x6D009E BIT_MASK 0x20 /end MEASUREMENT
/begin MEASUREMENT Bit_Uint8_E_Bit_6.Intern_MEM.Bit_Test "" UBYTE ident 1 100 0 255 ECU_ADDRESS 0x6D009E BIT_MASK 0x40 /end MEASUREMENT
/begin MEASUREMENT Bit_Uint8_E_Bit_7.Intern_MEM.Bit_Test "" UBYTE ident 1 100 0 255 ECU_ADDRESS 0x6D009E BIT_MASK 0x80 /end MEASUREMENT
/begin MEASUREMENT Bit_Uint8_O_Bit_x.Extern_MEM.Bit_Test "" UBYTE ident 1 100 0 255 ECU_ADDRESS 0x6D008B /end MEASUREMENT
/begin MEASUREMENT Bit_Uint8_O_Bit_0.Extern_MEM.Bit_Test "" UBYTE ident 1 100 0 255 ECU_ADDRESS 0x6D008B BIT_MASK 0x01 /end MEASUREMENT
/begin MEASUREMENT Bit_Uint8_O_Bit_1.Extern_MEM.Bit_Test "" UBYTE ident 1 100 0 255 ECU_ADDRESS 0x6D008B BIT_MASK 0x02 /end MEASUREMENT
/begin MEASUREMENT Bit_Uint8_O_Bit_2.Extern_MEM.Bit_Test "" UBYTE ident 1 100 0 255 ECU_ADDRESS 0x6D008B BIT_MASK 0x04 /end MEASUREMENT
/begin MEASUREMENT Bit_Uint8_O_Bit_3.Extern_MEM.Bit_Test "" UBYTE ident 1 100 0 255 ECU_ADDRESS 0x6D008B BIT_MASK 0x08 /end MEASUREMENT
/begin MEASUREMENT Bit_Uint8_O_Bit_4.Extern_MEM.Bit_Test "" UBYTE ident 1 100 0 255 ECU_ADDRESS 0x6D008B BIT_MASK 0x10 /end MEASUREMENT
/begin MEASUREMENT Bit_Uint8_O_Bit_5.Extern_MEM.Bit_Test "" UBYTE ident 1 100 0 255 ECU_ADDRESS 0x6D008B BIT_MASK 0x20 /end MEASUREMENT
/begin MEASUREMENT Bit_Uint8_O_Bit_6.Extern_MEM.Bit_Test "" UBYTE ident 1 100 0 255 ECU_ADDRESS 0x6D008B BIT_MASK 0x40 /end MEASUREMENT
/begin MEASUREMENT Bit_Uint8_O_Bit_7.Extern_MEM.Bit_Test "" UBYTE ident 1 100 0 255 ECU_ADDRESS 0x6D008B BIT_MASK 0x80 /end MEASUREMENT
/begin MEASUREMENT Bit_Uint8_O_Bit_x.Intern_MEM.Bit_Test "" UBYTE ident 1 100 0 255 ECU_ADDRESS 0x6D009F /end MEASUREMENT
/begin MEASUREMENT Bit_Uint8_O_Bit_0.Intern_MEM.Bit_Test "" UBYTE ident 1 100 0 255 ECU_ADDRESS 0x6D009F BIT_MASK 0x01 /end MEASUREMENT
/begin MEASUREMENT Bit_Uint8_O_Bit_1.Intern_MEM.Bit_Test "" UBYTE ident 1 100 0 255 ECU_ADDRESS 0x6D009F BIT_MASK 0x02 /end MEASUREMENT
/begin MEASUREMENT Bit_Uint8_O_Bit_2.Intern_MEM.Bit_Test "" UBYTE ident 1 100 0 255 ECU_ADDRESS 0x6D009F BIT_MASK 0x04 /end MEASUREMENT
/begin MEASUREMENT Bit_Uint8_O_Bit_3.Intern_MEM.Bit_Test "" UBYTE ident 1 100 0 255 ECU_ADDRESS 0x6D009F BIT_MASK 0x08 /end MEASUREMENT
/begin MEASUREMENT Bit_Uint8_O_Bit_4.Intern_MEM.Bit_Test "" UBYTE ident 1 100 0 255 ECU_ADDRESS 0x6D009F BIT_MASK 0x10 /end MEASUREMENT
/begin MEASUREMENT Bit_Uint8_O_Bit_5.Intern_MEM.Bit_Test "" UBYTE ident 1 100 0 255 ECU_ADDRESS 0x6D009F BIT_MASK 0x20 /end MEASUREMENT
/begin MEASUREMENT Bit_Uint8_O_Bit_6.Intern_MEM.Bit_Test "" UBYTE ident 1 100 0 255 ECU_ADDRESS 0x6D009F BIT_MASK 0x40 /end MEASUREMENT
/begin MEASUREMENT Bit_Uint8_O_Bit_7.Intern_MEM.Bit_Test "" UBYTE ident 1 100 0 255 ECU_ADDRESS 0x6D009F BIT_MASK 0x80 /end MEASUREMENT
/begin MEASUREMENT c_CcpPower_u8.CCP_SHELL "" UBYTE ident 1 100 0 255 ECU_ADDRESS 0x7FB404 /end MEASUREMENT
/begin MEASUREMENT CCP_current_Page_please_use_SERAM_PageControl.CCP_Page "" UBYTE enum_CCP_Page_ENUM 1 100 0 2 ECU_ADDRESS 0x7FB3FE /end MEASUREMENT
/begin MEASUREMENT CCP_overload_counter_1.CCP_SHELL "" UBYTE ident 1 100 0 255 ECU_ADDRESS 0x7F8522 /end MEASUREMENT
/begin MEASUREMENT CCP_overload_counter_2.CCP_SHELL "" UBYTE ident 1 100 0 255 ECU_ADDRESS 0x7F8523 /end MEASUREMENT
/begin MEASUREMENT CCP_overload_counter_3.CCP_SHELL "" UBYTE ident 1 100 0 255 ECU_ADDRESS 0x7F8524 /end MEASUREMENT
/begin MEASUREMENT ctrBypassB01.BypassCounter "" ULONG ident 1 100 0 4294967295 ECU_ADDRESS 0x7FB334 /end MEASUREMENT
/begin MEASUREMENT ctrBypassB01_H.BypassCounter "" UWORD ident 1 100 0 65535 ECU_ADDRESS 0x7FB354 /end MEASUREMENT
/begin MEASUREMENT ctrBypassB01_L.BypassCounter "" UWORD ident 1 100 0 65535 ECU_ADDRESS 0x7FB356 /end MEASUREMENT
/begin MEASUREMENT ctrBypassB02.BypassCounter "" ULONG ident 1 100 0 4294967295 ECU_ADDRESS 0x7FB338 /end MEASUREMENT
/begin MEASUREMENT ctrBypassB02_H.BypassCounter "" UWORD ident 1 100 0 65535 ECU_ADDRESS 0x7FB358 /end MEASUREMENT
/begin MEASUREMENT ctrBypassB02_L.BypassCounter "" UWORD ident 1 100 0 65535 ECU_ADDRESS 0x7FB35A /end MEASUREMENT
/begin MEASUREMENT ctrBypassB03.BypassCounter "" ULONG ident 1 100 0 4294967295 ECU_ADDRESS 0x7FB33C /end MEASUREMENT
/begin MEASUREMENT ctrBypassB03_H.BypassCounter "" UWORD ident 1 100 0 65535 ECU_ADDRESS 0x7FB35C /end MEASUREMENT
/begin MEASUREMENT ctrBypassB03_L.BypassCounter "" UWORD ident 1 100 0 65535 ECU_ADDRESS 0x7FB35E /end MEASUREMENT
/begin MEASUREMENT ctrBypassB04.BypassCounter "" ULONG ident 1 100 0 4294967295 ECU_ADDRESS 0x7FB340 /end MEASUREMENT
/begin MEASUREMENT ctrBypassB04_H.BypassCounter "" UWORD ident 1 100 0 65535 ECU_ADDRESS 0x7FB360 /end MEASUREMENT
/begin MEASUREMENT ctrBypassB04_L.BypassCounter "" UWORD ident 1 100 0 65535 ECU_ADDRESS 0x7FB362 /end MEASUREMENT
/begin MEASUREMENT Err_Count_DAQ_SAMPLE.CCP_SHELL "" ULONG ident 1 100 0 4294967295 ECU_ADDRESS 0x7FB40C MATRIX_DIM 3 1 1 /end MEASUREMENT
/begin MEASUREMENT Err_Current_DAQ_SAMPLE.CCP_SHELL "" UBYTE ident 1 100 0 1 ECU_ADDRESS 0x7FB418 MATRIX_DIM 3 1 1 /end MEASUREMENT
/begin MEASUREMENT Err_Current_DAQ_SAMPLE_TYP.CCP_SHELL "" UBYTE ident 1 100 0 255 ECU_ADDRESS 0x7FB408 MATRIX_DIM 3 1 1 /end MEASUREMENT
/begin MEASUREMENT Err_State_DAQ_SAMPLE.CCP_SHELL "" UBYTE ident 1 100 0 1 ECU_ADDRESS 0x7F8568 MATRIX_DIM 3 1 1 /end MEASUREMENT
/begin MEASUREMENT g_CAN_B_IRQ_MaxExeTime_u32.HWE.BASE "" UBYTE ident 1 100 0 255 ECU_ADDRESS 0x7FB48A /end MEASUREMENT
/begin MEASUREMENT g_CcpActiveVersion_u8.CCP_SHELL "" UBYTE enum_CCP_ACTIVE_VERSION_ENUM 1 100 0 1 ECU_ADDRESS 0x7FB40B /end MEASUREMENT
/begin MEASUREMENT g_CcpByteOrder_u8.CCP_SHELL "" UBYTE enum_CCP_ByteOrder_e 1 100 0 1 ECU_ADDRESS 0x7F856B /end MEASUREMENT
/begin MEASUREMENT g_CcpMuxRaster_u32.CCP_SHELL "" ULONG ident 1 100 0 4294967295 ECU_ADDRESS 0x7F8510 /end MEASUREMENT
/begin MEASUREMENT g_CcpPower_u8.CCP_SHELL "" UBYTE ident 1 100 0 255 ECU_ADDRESS 0x7FB407 /end MEASUREMENT
/begin MEASUREMENT g_CcpPowerOn_u8.CCP_SHELL "" UBYTE ident 1 100 0 255 ECU_ADDRESS 0x7FB41B /end MEASUREMENT
/begin MEASUREMENT g_CcpResumeMasterConnectTimeout_u32.CCP_SHELL "" ULONG ident 1 100 0 4294967295 ECU_ADDRESS 0x7F856C /end MEASUREMENT
/begin MEASUREMENT g_CcpResumeMasterConnectTimeoutCheck_u8.CCP_SHELL "" UBYTE ident 1 100 0 255 ECU_ADDRESS 0x7FB406 /end MEASUREMENT
/begin MEASUREMENT g_CcpResumeMasterConnectTimeoutStart_u32.CCP_SHELL "" ULONG ident 1 100 0 4294967295 ECU_ADDRESS 0x7FB400 /end MEASUREMENT
/begin MEASUREMENT g_CcpResumeSupport_u8.CCP_SHELL "" UBYTE enum_XCP_Resume_e 1 100 0 1 ECU_ADDRESS 0x7FB41C /end MEASUREMENT
/begin MEASUREMENT g_CcpSessStatus_u8_nv.CCP_SHELL "" UBYTE ident 1 100 0 255 ECU_ADDRESS 0x7F811C /end MEASUREMENT
/begin MEASUREMENT g_CcpTrigResume_u8.CCP_SHELL "" UBYTE ident 1 100 0 255 ECU_ADDRESS 0x7FB405 /end MEASUREMENT
/begin MEASUREMENT g_Target_D_DIVF_u32.HWE_TARGET.BASE "" ULONG ident 1 100 0 4294967295 ECU_ADDRESS 0x7FB48C /end MEASUREMENT
/begin MEASUREMENT g_Target_D_IMBSPEED_u32.HWE_TARGET.BASE "" ULONG ident 1 100 0 4294967295 ECU_ADDRESS 0x7FB490 /end MEASUREMENT
/begin MEASUREMENT g_Target_D_MF_u32.HWE_TARGET.BASE "" ULONG ident 1 100 0 4294967295 ECU_ADDRESS 0x7FB494 /end MEASUREMENT
/begin MEASUREMENT g_Target_D_TB_NORM_MUL_u32.HWE_TARGET.BASE "" ULONG ident 1 100 0 4294967295 ECU_ADDRESS 0x7FB49C /end MEASUREMENT
/begin MEASUREMENT g_Target_D_TBS_u32.HWE_TARGET.BASE "" ULONG ident 1 100 0 4294967295 ECU_ADDRESS 0x7FB498 /end MEASUREMENT
/begin MEASUREMENT g_Target_F_IMB_u32.HWE_TARGET.BASE "" ULONG ident 1 100 0 4294967295 ECU_ADDRESS 0x7FB4A0 /end MEASUREMENT
/begin MEASUREMENT g_Target_F_OSC_u32.HWE_TARGET.BASE "" ULONG ident 1 100 0 4294967295 ECU_ADDRESS 0x7FB4A4 /end MEASUREMENT
/begin MEASUREMENT g_Target_F_SYS_u32.HWE_TARGET.BASE "" ULONG ident 1 100 0 4294967295 ECU_ADDRESS 0x7FB4A8 /end MEASUREMENT
/begin MEASUREMENT g_Target_F_TB_u32.HWE_TARGET.BASE "" ULONG ident 1 100 0 4294967295 ECU_ADDRESS 0x7FB4AC /end MEASUREMENT
/begin MEASUREMENT g_Target_SysTick_in_ns_u32.HWE_TARGET.BASE "" ULONG ident 1 100 0 4294967295 ECU_ADDRESS 0x7FB4B0 /end MEASUREMENT
/begin MEASUREMENT HWE_A_U_5V1_Err.SHELL.BASE "" UWORD ident 1 100 0 65535 ECU_ADDRESS 0x822FD4 /end MEASUREMENT
/begin MEASUREMENT HWE_A_U_5V1_Stat.SHELL.BASE "" UWORD ident 1 100 0 65535 ECU_ADDRESS 0x822FD6 /end MEASUREMENT
/begin MEASUREMENT HWE_A_U_5V2_Err.SHELL.BASE "" UWORD ident 1 100 0 65535 ECU_ADDRESS 0x822FD8 /end MEASUREMENT
/begin MEASUREMENT HWE_A_U_5V2_Stat.SHELL.BASE "" UWORD ident 1 100 0 65535 ECU_ADDRESS 0x822FDA /end MEASUREMENT
/begin MEASUREMENT HWE_A_U_5V3_Err.SHELL.BASE "" UWORD ident 1 100 0 65535 ECU_ADDRESS 0x822FDC /end MEASUREMENT
/begin MEASUREMENT HWE_A_U_5V3_Stat.SHELL.BASE "" UWORD ident 1 100 0 65535 ECU_ADDRESS 0x822FDE /end MEASUREMENT
/begin MEASUREMENT HWE_Alarm_Can_Num1_Driver.SHELL.BASE "" UWORD ident 1 100 0 65535 ECU_ADDRESS 0x822FE0 /end MEASUREMENT
/begin MEASUREMENT HWE_Can_DiagOpSwitch.SHELL.BASE "" SBYTE ident 1 100 0 1 BIT_MASK 0x1 ECU_ADDRESS 0x8230A5 /end MEASUREMENT
/begin MEASUREMENT HWE_CAN_DisableNormalMsgTx.SHELL.BASE "" SBYTE ident 1 100 0 1 BIT_MASK 0x1 ECU_ADDRESS 0x8230A4 /end MEASUREMENT
/begin MEASUREMENT HWE_Can_Rx_Ok.SHELL.BASE "" SBYTE ident 1 100 0 1 BIT_MASK 0x1 ECU_ADDRESS 0x8230A6 /end MEASUREMENT
/begin MEASUREMENT HWE_CANA_ID250RX_1.SHELL.BASE "" ULONG ident 1 100 0 4294967295 ECU_ADDRESS 0x822EE8 /end MEASUREMENT
/begin MEASUREMENT HWE_CANA_ID250RX_2.SHELL.BASE "" ULONG ident 1 100 0 4294967295 ECU_ADDRESS 0x822EEC /end MEASUREMENT
/begin MEASUREMENT HWE_CANA_ID258RX_1.SHELL.BASE "" ULONG ident 1 100 0 4294967295 ECU_ADDRESS 0x822EF0 /end MEASUREMENT
/begin MEASUREMENT HWE_CANA_ID258RX_2.SHELL.BASE "" ULONG ident 1 100 0 4294967295 ECU_ADDRESS 0x822EF4 /end MEASUREMENT
/begin MEASUREMENT HWE_CANA_ID260TX_1.SHELL.BASE "" ULONG ident 1 100 0 4294967295 ECU_ADDRESS 0x822EF8 /end MEASUREMENT
/begin MEASUREMENT HWE_CANA_ID260TX_2.SHELL.BASE "" ULONG ident 1 100 0 4294967295 ECU_ADDRESS 0x822EFC /end MEASUREMENT
/begin MEASUREMENT HWE_CANA_ID288TX_1.SHELL.BASE "" ULONG ident 1 100 0 4294967295 ECU_ADDRESS 0x822F00 /end MEASUREMENT
/begin MEASUREMENT HWE_CANA_ID288TX_2.SHELL.BASE "" ULONG ident 1 100 0 4294967295 ECU_ADDRESS 0x822F04 /end MEASUREMENT
/begin MEASUREMENT HWE_CANA_ID290RX_1.SHELL.BASE "" ULONG ident 1 100 0 4294967295 ECU_ADDRESS 0x822F08 /end MEASUREMENT
/begin MEASUREMENT HWE_CANA_ID290RX_2.SHELL.BASE "" ULONG ident 1 100 0 4294967295 ECU_ADDRESS 0x822F0C /end MEASUREMENT
/begin MEASUREMENT HWE_CANA_ID310TX_1.SHELL.BASE "" ULONG ident 1 100 0 4294967295 ECU_ADDRESS 0x822F10 /end MEASUREMENT
/begin MEASUREMENT HWE_CANA_ID310TX_2.SHELL.BASE "" ULONG ident 1 100 0 4294967295 ECU_ADDRESS 0x822F14 /end MEASUREMENT
/begin MEASUREMENT HWE_CANA_ID320RX_1.SHELL.BASE "" ULONG ident 1 100 0 4294967295 ECU_ADDRESS 0x822F18 /end MEASUREMENT
/begin MEASUREMENT HWE_CANA_ID320RX_2.SHELL.BASE "" ULONG ident 1 100 0 4294967295 ECU_ADDRESS 0x822F1C /end MEASUREMENT
/begin MEASUREMENT HWE_CANA_ID330TX_1.SHELL.BASE "" ULONG ident 1 100 0 4294967295 ECU_ADDRESS 0x822F20 /end MEASUREMENT
/begin MEASUREMENT HWE_CANA_ID330TX_2.SHELL.BASE "" ULONG ident 1 100 0 4294967295 ECU_ADDRESS 0x822F24 /end MEASUREMENT
/begin MEASUREMENT HWE_CANA_ID340RX_1.SHELL.BASE "" ULONG ident 1 100 0 4294967295 ECU_ADDRESS 0x822F28 /end MEASUREMENT
/begin MEASUREMENT HWE_CANA_ID340RX_2.SHELL.BASE "" ULONG ident 1 100 0 4294967295 ECU_ADDRESS 0x822F2C /end MEASUREMENT
/begin MEASUREMENT HWE_CANA_ID358RX_1.SHELL.BASE "" ULONG ident 1 100 0 4294967295 ECU_ADDRESS 0x822F30 /end MEASUREMENT
/begin MEASUREMENT HWE_CANA_ID358RX_2.SHELL.BASE "" ULONG ident 1 100 0 4294967295 ECU_ADDRESS 0x822F34 /end MEASUREMENT
/begin MEASUREMENT HWE_CANA_ID500RX_1.SHELL.BASE "" ULONG ident 1 100 0 4294967295 ECU_ADDRESS 0x822F38 /end MEASUREMENT
/begin MEASUREMENT HWE_CANA_ID500RX_2.SHELL.BASE "" ULONG ident 1 100 0 4294967295 ECU_ADDRESS 0x822F3C /end MEASUREMENT
/begin MEASUREMENT HWE_CANA_ID510RX_1.SHELL.BASE "" ULONG ident 1 100 0 4294967295 ECU_ADDRESS 0x822F40 /end MEASUREMENT
/begin MEASUREMENT HWE_CANA_ID510RX_2.SHELL.BASE "" ULONG ident 1 100 0 4294967295 ECU_ADDRESS 0x822F44 /end MEASUREMENT
/begin MEASUREMENT HWE_CANA_ID620TX_1.SHELL.BASE "" ULONG ident 1 100 0 4294967295 ECU_ADDRESS 0x822F48 /end MEASUREMENT
/begin MEASUREMENT HWE_CANA_ID620TX_2.SHELL.BASE "" ULONG ident 1 100 0 4294967295 ECU_ADDRESS 0x822F4C /end MEASUREMENT
/begin MEASUREMENT HWE_CANA_ID630RX_1.SHELL.BASE "" ULONG ident 1 100 0 4294967295 ECU_ADDRESS 0x822F50 /end MEASUREMENT
/begin MEASUREMENT HWE_CANA_ID630RX_2.SHELL.BASE "" ULONG ident 1 100 0 4294967295 ECU_ADDRESS 0x822F54 /end MEASUREMENT
/begin MEASUREMENT HWE_CANA_ID640RX_1.SHELL.BASE "" ULONG ident 1 100 0 4294967295 ECU_ADDRESS 0x822F58 /end MEASUREMENT
/begin MEASUREMENT HWE_CANA_ID640RX_2.SHELL.BASE "" ULONG ident 1 100 0 4294967295 ECU_ADDRESS 0x822F5C /end MEASUREMENT
/begin MEASUREMENT HWE_CANA_InitAfterBusOff.SHELL.BASE "" SBYTE ident 1 100 0 1 BIT_MASK 0x1 ECU_ADDRESS 0x7FB922 /end MEASUREMENT
/begin MEASUREMENT HWE_CANA_OBD_TX_V7.SHELL.BASE "" ULONG ident 1 100 0 4294967295 ECU_ADDRESS 0x7FB8AC /end MEASUREMENT
/begin MEASUREMENT HWE_CANA_stBusOff.SHELL.BASE "" UBYTE ident 1 100 0 255 ECU_ADDRESS 0x7FB923 /end MEASUREMENT
/begin MEASUREMENT HWE_CANB_CCP_DAQ0_V4.SHELL.BASE "" ULONG ident 1 100 0 4294967295 ECU_ADDRESS 0x7FB8B0 /end MEASUREMENT
/begin MEASUREMENT HWE_CANB_CCP_DAQ1_V5.SHELL.BASE "" ULONG ident 1 100 0 4294967295 ECU_ADDRESS 0x7FB8B4 /end MEASUREMENT
/begin MEASUREMENT HWE_CANB_CCP_DAQ2_V6.SHELL.BASE "" ULONG ident 1 100 0 4294967295 ECU_ADDRESS 0x7FB8B8 /end MEASUREMENT
/begin MEASUREMENT HWE_CANB_CCP_RX_V2.SHELL.BASE "" ULONG ident 1 100 0 4294967295 ECU_ADDRESS 0x7FB8BC /end MEASUREMENT
/begin MEASUREMENT HWE_CANB_CCP_TX_V3.SHELL.BASE "" ULONG ident 1 100 0 4294967295 ECU_ADDRESS 0x7FB8C0 /end MEASUREMENT
/begin MEASUREMENT HWE_CANB_ID348RXB_1.SHELL.BASE "" ULONG ident 1 100 0 4294967295 ECU_ADDRESS 0x822F60 /end MEASUREMENT
/begin MEASUREMENT HWE_CANB_ID348RXB_2.SHELL.BASE "" ULONG ident 1 100 0 4294967295 ECU_ADDRESS 0x822F64 /end MEASUREMENT
/begin MEASUREMENT HWE_CANB_ID350TX_1.SHELL.BASE "" ULONG ident 1 100 0 4294967295 ECU_ADDRESS 0x822F68 /end MEASUREMENT
/begin MEASUREMENT HWE_CANB_ID350TX_2.SHELL.BASE "" ULONG ident 1 100 0 4294967295 ECU_ADDRESS 0x822F6C /end MEASUREMENT
/begin MEASUREMENT HWE_CANB_ID360TX_1.SHELL.BASE "" ULONG ident 1 100 0 4294967295 ECU_ADDRESS 0x822F70 /end MEASUREMENT
/begin MEASUREMENT HWE_CANB_ID360TX_2.SHELL.BASE "" ULONG ident 1 100 0 4294967295 ECU_ADDRESS 0x822F74 /end MEASUREMENT
/begin MEASUREMENT HWE_CANB_ID380TX_1.SHELL.BASE "" ULONG ident 1 100 0 4294967295 ECU_ADDRESS 0x822F78 /end MEASUREMENT
/begin MEASUREMENT HWE_CANB_ID380TX_2.SHELL.BASE "" ULONG ident 1 100 0 4294967295 ECU_ADDRESS 0x822F7C /end MEASUREMENT
/begin MEASUREMENT HWE_CANB_ID578RXB_1.SHELL.BASE "" ULONG ident 1 100 0 4294967295 ECU_ADDRESS 0x822F80 /end MEASUREMENT
/begin MEASUREMENT HWE_CANB_ID578RXB_2.SHELL.BASE "" ULONG ident 1 100 0 4294967295 ECU_ADDRESS 0x822F84 /end MEASUREMENT
/begin MEASUREMENT HWE_CANB_ID590RXB_1.SHELL.BASE "" ULONG ident 1 100 0 4294967295 ECU_ADDRESS 0x822F88 /end MEASUREMENT
/begin MEASUREMENT HWE_CANB_ID590RXB_2.SHELL.BASE "" ULONG ident 1 100 0 4294967295 ECU_ADDRESS 0x822F8C /end MEASUREMENT
/begin MEASUREMENT HWE_CANB_ID5FFTX_1.SHELL.BASE "" ULONG ident 1 100 0 4294967295 ECU_ADDRESS 0x822F90 /end MEASUREMENT
/begin MEASUREMENT HWE_CANB_ID5FFTX_2.SHELL.BASE "" ULONG ident 1 100 0 4294967295 ECU_ADDRESS 0x822F94 /end MEASUREMENT
/begin MEASUREMENT HWE_CANB_ID690TX_1.SHELL.BASE "" ULONG ident 1 100 0 4294967295 ECU_ADDRESS 0x822F98 /end MEASUREMENT
/begin MEASUREMENT HWE_CANB_ID690TX_2.SHELL.BASE "" ULONG ident 1 100 0 4294967295 ECU_ADDRESS 0x822F9C /end MEASUREMENT
/begin MEASUREMENT HWE_CANB_ID691TX_1.SHELL.BASE "" ULONG ident 1 100 0 4294967295 ECU_ADDRESS 0x822FA0 /end MEASUREMENT
/begin MEASUREMENT HWE_CANB_ID691TX_2.SHELL.BASE "" ULONG ident 1 100 0 4294967295 ECU_ADDRESS 0x822FA4 /end MEASUREMENT
/begin MEASUREMENT HWE_CANB_ID695TX_1.SHELL.BASE "" ULONG ident 1 100 0 4294967295 ECU_ADDRESS 0x822FA8 /end MEASUREMENT
/begin MEASUREMENT HWE_CANB_ID695TX_2.SHELL.BASE "" ULONG ident 1 100 0 4294967295 ECU_ADDRESS 0x822FAC /end MEASUREMENT
/begin MEASUREMENT HWE_CANB_ID696RXB_1.SHELL.BASE "" ULONG ident 1 100 0 4294967295 ECU_ADDRESS 0x822FB0 /end MEASUREMENT
/begin MEASUREMENT HWE_CANB_InitAfterBusOff.SHELL.BASE "" SBYTE ident 1 100 0 1 BIT_MASK 0x1 ECU_ADDRESS 0x7FB924 /end MEASUREMENT
/begin MEASUREMENT HWE_CANB_MUX_ID5xx_V8.SHELL.BASE "" ULONG ident 1 100 0 4294967295 ECU_ADDRESS 0x822FB4 /end MEASUREMENT
/begin MEASUREMENT HWE_CANB_MUX_ID5xx_V8_U32_1.SHELL.BASE "" ULONG ident 1 100 0 4294967295 ECU_ADDRESS 0x822FB8 /end MEASUREMENT
/begin MEASUREMENT HWE_CANB_MUX_ID5xx_V8_U32_2.SHELL.BASE "" ULONG ident 1 100 0 4294967295 ECU_ADDRESS 0x822FBC /end MEASUREMENT
/begin MEASUREMENT HWE_CANB_stBusOff.SHELL.BASE "" UBYTE ident 1 100 0 255 ECU_ADDRESS 0x7FB925 /end MEASUREMENT
/begin MEASUREMENT HWE_CANC_ID100TX_1.SHELL.BASE "" ULONG ident 1 100 0 4294967295 ECU_ADDRESS 0x822FC0 /end MEASUREMENT
/begin MEASUREMENT HWE_CANC_ID100TX_2.SHELL.BASE "" ULONG ident 1 100 0 4294967295 ECU_ADDRESS 0x822FC4 /end MEASUREMENT
/begin MEASUREMENT HWE_CANC_ID101RX_1.SHELL.BASE "" ULONG ident 1 100 0 4294967295 ECU_ADDRESS 0x822FC8 /end MEASUREMENT
/begin MEASUREMENT HWE_CANC_ID101RX_2.SHELL.BASE "" ULONG ident 1 100 0 4294967295 ECU_ADDRESS 0x822FCC /end MEASUREMENT
/begin MEASUREMENT HWE_CANC_InitAfterBusOff.SHELL.BASE "" SBYTE ident 1 100 0 1 BIT_MASK 0x1 ECU_ADDRESS 0x7FB926 /end MEASUREMENT
/begin MEASUREMENT HWE_CANC_stBusOff.SHELL.BASE "" UBYTE ident 1 100 0 255 ECU_ADDRESS 0x7FB927 /end MEASUREMENT
/begin MEASUREMENT HWE_CJ230A_Err.SHELL.BASE "" UWORD ident 1 100 0 65535 ECU_ADDRESS 0x822FE2 /end MEASUREMENT
/begin MEASUREMENT HWE_CJ230A_Stat.SHELL.BASE "" UWORD ident 1 100 0 65535 ECU_ADDRESS 0x822FE4 /end MEASUREMENT
/begin MEASUREMENT HWE_CJ230B_Err.SHELL.BASE "" UWORD ident 1 100 0 65535 ECU_ADDRESS 0x822FE6 /end MEASUREMENT
/begin MEASUREMENT HWE_CJ230B_Stat.SHELL.BASE "" UWORD ident 1 100 0 65535 ECU_ADDRESS 0x822FE8 /end MEASUREMENT
/begin MEASUREMENT HWE_CJ945A_Err.SHELL.BASE "" UWORD ident 1 100 0 65535 ECU_ADDRESS 0x822FEA /end MEASUREMENT
/begin MEASUREMENT HWE_CJ945A_Stat.SHELL.BASE "" UWORD ident 1 100 0 65535 ECU_ADDRESS 0x822FEC /end MEASUREMENT
/begin MEASUREMENT HWE_CJ945B_Err.SHELL.BASE "" UWORD ident 1 100 0 65535 ECU_ADDRESS 0x822FEE /end MEASUREMENT
/begin MEASUREMENT HWE_CJ945B_Stat.SHELL.BASE "" UWORD ident 1 100 0 65535 ECU_ADDRESS 0x822FF0 /end MEASUREMENT
/begin MEASUREMENT HWE_Eep_AfterRun_st.SHELL.BASE "" UBYTE ident 1 100 0 255 ECU_ADDRESS 0x7FB928 /end MEASUREMENT
/begin MEASUREMENT HWE_Eep_Format.SHELL.BASE "" UBYTE ident 1 100 0 255 ECU_ADDRESS 0x7FB929 /end MEASUREMENT
/begin MEASUREMENT HWE_EepBlk_State.SHELL.BASE "" ULONG ident 1 100 0 4294967295 ECU_ADDRESS 0x7FB8C4 /end MEASUREMENT
/begin MEASUREMENT HWE_Enter_NL.SHELL.BASE "" SBYTE ident 1 100 0 1 BIT_MASK 0x1 ECU_ADDRESS 0x7FB92A /end MEASUREMENT
/begin MEASUREMENT HWE_IA_IPS.SHELL.BASE "" UWORD ADC_10bit 1 100 0.0 5.0 ECU_ADDRESS 0x823022 /end MEASUREMENT
/begin MEASUREMENT HWE_IA_ITS.SHELL.BASE "" UWORD ADC_10bit 1 100 0.0 5.0 ECU_ADDRESS 0x823024 /end MEASUREMENT
/begin MEASUREMENT HWE_IA_TER30.SHELL.BASE "" UWORD ADC_KL30B 1 100 0.0 24.1156462585034 ECU_ADDRESS 0x823026 /end MEASUREMENT
/begin MEASUREMENT HWE_IA_TER30B.SHELL.BASE "" UWORD ADC_KL30B 1 100 0.0 24.1156462585034 ECU_ADDRESS 0x823028 /end MEASUREMENT
/begin MEASUREMENT HWE_IA01.SHELL.BASE "" UWORD ADC_10bit 1 100 0.0 5.0 ECU_ADDRESS 0x822FF2 /end MEASUREMENT
/begin MEASUREMENT HWE_IA02.SHELL.BASE "" UWORD ADC_10bit 1 100 0.0 5.0 ECU_ADDRESS 0x822FF4 /end MEASUREMENT
/begin MEASUREMENT HWE_IA03.SHELL.BASE "" UWORD ADC_10bit 1 100 0.0 5.0 ECU_ADDRESS 0x822FF6 /end MEASUREMENT
/begin MEASUREMENT HWE_IA04.SHELL.BASE "" UWORD ADC_10bit 1 100 0.0 5.0 ECU_ADDRESS 0x822FF8 /end MEASUREMENT
/begin MEASUREMENT HWE_IA05.SHELL.BASE "" UWORD ADC_10bit 1 100 0.0 5.0 ECU_ADDRESS 0x822FFA /end MEASUREMENT
/begin MEASUREMENT HWE_IA06.SHELL.BASE "" UWORD ADC_10bit 1 100 0.0 5.0 ECU_ADDRESS 0x822FFC /end MEASUREMENT
/begin MEASUREMENT HWE_IA07.SHELL.BASE "" UWORD ADC_10bit 1 100 0.0 5.0 ECU_ADDRESS 0x822FFE /end MEASUREMENT
/begin MEASUREMENT HWE_IA08.SHELL.BASE "" UWORD ADC_10bit 1 100 0.0 5.0 ECU_ADDRESS 0x823000 /end MEASUREMENT
/begin MEASUREMENT HWE_IA09.SHELL.BASE "" UWORD ADC_10bit 1 100 0.0 5.0 ECU_ADDRESS 0x823002 /end MEASUREMENT
/begin MEASUREMENT HWE_IA10.SHELL.BASE "" UWORD ADC_10bit 1 100 0.0 5.0 ECU_ADDRESS 0x823004 /end MEASUREMENT
/begin MEASUREMENT HWE_IA11.SHELL.BASE "" UWORD ADC_10bit 1 100 0.0 5.0 ECU_ADDRESS 0x823006 /end MEASUREMENT
/begin MEASUREMENT HWE_IA12.SHELL.BASE "" UWORD ADC_10bit 1 100 0.0 5.0 ECU_ADDRESS 0x823008 /end MEASUREMENT
/begin MEASUREMENT HWE_IA13.SHELL.BASE "" UWORD ADC_10bit 1 100 0.0 5.0 ECU_ADDRESS 0x82300A /end MEASUREMENT
/begin MEASUREMENT HWE_IA14.SHELL.BASE "" UWORD ADC_10bit 1 100 0.0 5.0 ECU_ADDRESS 0x82300C /end MEASUREMENT
/begin MEASUREMENT HWE_IA15.SHELL.BASE "" UWORD ADC_10bit 1 100 0.0 5.0 ECU_ADDRESS 0x82300E /end MEASUREMENT
/begin MEASUREMENT HWE_IA16.SHELL.BASE "" UWORD ADC_10bit 1 100 0.0 5.0 ECU_ADDRESS 0x823010 /end MEASUREMENT
/begin MEASUREMENT HWE_IA17.SHELL.BASE "" UWORD ADC_10bit 1 100 0.0 5.0 ECU_ADDRESS 0x823012 /end MEASUREMENT
/begin MEASUREMENT HWE_IA18.SHELL.BASE "" UWORD ADC_10bit 1 100 0.0 5.0 ECU_ADDRESS 0x823014 /end MEASUREMENT
/begin MEASUREMENT HWE_IA19.SHELL.BASE "" UWORD ADC_10bit 1 100 0.0 5.0 ECU_ADDRESS 0x823016 /end MEASUREMENT
/begin MEASUREMENT HWE_IA20.SHELL.BASE "" UWORD ADC_10bit 1 100 0.0 5.0 ECU_ADDRESS 0x823018 /end MEASUREMENT
/begin MEASUREMENT HWE_IA21.SHELL.BASE "" UWORD ADC_10bit 1 100 0.0 5.0 ECU_ADDRESS 0x82301A /end MEASUREMENT
/begin MEASUREMENT HWE_IA22.SHELL.BASE "" UWORD ADC_10bit 1 100 0.0 5.0 ECU_ADDRESS 0x82301C /end MEASUREMENT
/begin MEASUREMENT HWE_IA25.SHELL.BASE "" UWORD ADC_10bit 1 100 0.0 5.0 ECU_ADDRESS 0x82301E /end MEASUREMENT
/begin MEASUREMENT HWE_IA26.SHELL.BASE "" UWORD ADC_10bit 1 100 0.0 5.0 ECU_ADDRESS 0x823020 /end MEASUREMENT
/begin MEASUREMENT HWE_ID101RX_failure.SHELL.BASE "" SBYTE ident 1 100 0 1 BIT_MASK 0x1 ECU_ADDRESS 0x8230A7 /end MEASUREMENT
/begin MEASUREMENT HWE_ID250RX_failure.SHELL.BASE "" SBYTE ident 1 100 0 1 BIT_MASK 0x1 ECU_ADDRESS 0x8230A8 /end MEASUREMENT
/begin MEASUREMENT HWE_ID258RX_failure.SHELL.BASE "" SBYTE ident 1 100 0 1 BIT_MASK 0x1 ECU_ADDRESS 0x8230A9 /end MEASUREMENT
/begin MEASUREMENT HWE_ID290RX_failure.SHELL.BASE "" SBYTE ident 1 100 0 1 BIT_MASK 0x1 ECU_ADDRESS 0x8230AA /end MEASUREMENT
/begin MEASUREMENT HWE_ID320RX_failure.SHELL.BASE "" SBYTE ident 1 100 0 1 BIT_MASK 0x1 ECU_ADDRESS 0x8230AB /end MEASUREMENT
/begin MEASUREMENT HWE_ID340RX_failure.SHELL.BASE "" SBYTE ident 1 100 0 1 BIT_MASK 0x1 ECU_ADDRESS 0x8230AC /end MEASUREMENT
/begin MEASUREMENT HWE_ID348RXB_failure.SHELL.BASE "" SBYTE ident 1 100 0 1 BIT_MASK 0x1 ECU_ADDRESS 0x8230AD /end MEASUREMENT
/begin MEASUREMENT HWE_ID358RX_failure.SHELL.BASE "" SBYTE ident 1 100 0 1 BIT_MASK 0x1 ECU_ADDRESS 0x8230AE /end MEASUREMENT
/begin MEASUREMENT HWE_ID500RX_failure.SHELL.BASE "" SBYTE ident 1 100 0 1 BIT_MASK 0x1 ECU_ADDRESS 0x8230AF /end MEASUREMENT
/begin MEASUREMENT HWE_ID510RX_failure.SHELL.BASE "" SBYTE ident 1 100 0 1 BIT_MASK 0x1 ECU_ADDRESS 0x8230B0 /end MEASUREMENT
/begin MEASUREMENT HWE_ID578RXB_failure.SHELL.BASE "" SBYTE ident 1 100 0 1 BIT_MASK 0x1 ECU_ADDRESS 0x8230B1 /end MEASUREMENT
/begin MEASUREMENT HWE_ID590RXB_failure.SHELL.BASE "" SBYTE ident 1 100 0 1 BIT_MASK 0x1 ECU_ADDRESS 0x8230B2 /end MEASUREMENT
/begin MEASUREMENT HWE_ID590RXB_failure_1.SHELL.BASE "" SBYTE ident 1 100 0 1 BIT_MASK 0x1 ECU_ADDRESS 0x8230B3 /end MEASUREMENT
/begin MEASUREMENT HWE_ID630RX_failure.SHELL.BASE "" SBYTE ident 1 100 0 1 BIT_MASK 0x1 ECU_ADDRESS 0x8230B4 /end MEASUREMENT
/begin MEASUREMENT HWE_ID640RX_failure.SHELL.BASE "" SBYTE ident 1 100 0 1 BIT_MASK 0x1 ECU_ADDRESS 0x8230B5 /end MEASUREMENT
/begin MEASUREMENT HWE_ID696RXB_failure.SHELL.BASE "" SBYTE ident 1 100 0 1 BIT_MASK 0x1 ECU_ADDRESS 0x8230B6 /end MEASUREMENT
/begin MEASUREMENT HWE_ID696RXB_failure_1.SHELL.BASE "" SBYTE ident 1 100 0 1 BIT_MASK 0x1 ECU_ADDRESS 0x8230B7 /end MEASUREMENT
/begin MEASUREMENT HWE_ID710RX_failure.SHELL.BASE "" SBYTE ident 1 100 0 1 BIT_MASK 0x1 ECU_ADDRESS 0x8230B8 /end MEASUREMENT
/begin MEASUREMENT HWE_ID760RX_failure.SHELL.BASE "" SBYTE ident 1 100 0 1 BIT_MASK 0x1 ECU_ADDRESS 0x8230B9 /end MEASUREMENT
/begin MEASUREMENT HWE_IP01_Dio.SHELL.BASE "" SBYTE ident 1 100 0 1 BIT_MASK 0x1 ECU_ADDRESS 0x8230BA /end MEASUREMENT
/begin MEASUREMENT HWE_IP02_Dio.SHELL.BASE "" SBYTE ident 1 100 0 1 BIT_MASK 0x1 ECU_ADDRESS 0x8230BB /end MEASUREMENT
/begin MEASUREMENT HWE_IP03_Dio.SHELL.BASE "" SBYTE ident 1 100 0 1 BIT_MASK 0x1 ECU_ADDRESS 0x8230BC /end MEASUREMENT
/begin MEASUREMENT HWE_IP04_Dio.SHELL.BASE "" SBYTE ident 1 100 0 1 BIT_MASK 0x1 ECU_ADDRESS 0x8230BD /end MEASUREMENT
/begin MEASUREMENT HWE_IP05_Dio.SHELL.BASE "" SBYTE ident 1 100 0 1 BIT_MASK 0x1 ECU_ADDRESS 0x8230BE /end MEASUREMENT
/begin MEASUREMENT HWE_IP06_Dio.SHELL.BASE "" SBYTE ident 1 100 0 1 BIT_MASK 0x1 ECU_ADDRESS 0x8230BF /end MEASUREMENT
/begin MEASUREMENT HWE_IP07_Dio.SHELL.BASE "" SBYTE ident 1 100 0 1 BIT_MASK 0x1 ECU_ADDRESS 0x8230C0 /end MEASUREMENT
/begin MEASUREMENT HWE_IP08_Dio.SHELL.BASE "" SBYTE ident 1 100 0 1 BIT_MASK 0x1 ECU_ADDRESS 0x8230C1 /end MEASUREMENT
/begin MEASUREMENT HWE_IP09_Dcyc.SHELL.BASE "" SWORD TPU_Dcyc 1 100 0.0 327.67 ECU_ADDRESS 0x82302A /end MEASUREMENT
/begin MEASUREMENT HWE_IP09_Err.SHELL.BASE "" UBYTE ident 1 100 0 255 ECU_ADDRESS 0x8230C2 /end MEASUREMENT
/begin MEASUREMENT HWE_IP09_Per.SHELL.BASE "" SWORD TPU_PerIn 1 100 0.0 327.67 ECU_ADDRESS 0x82302C /end MEASUREMENT
/begin MEASUREMENT HWE_IP10_Dcyc.SHELL.BASE "" SWORD TPU_Dcyc 1 100 0.0 327.67 ECU_ADDRESS 0x82302E /end MEASUREMENT
/begin MEASUREMENT HWE_IP10_Err.SHELL.BASE "" UBYTE ident 1 100 0 255 ECU_ADDRESS 0x8230C3 /end MEASUREMENT
/begin MEASUREMENT HWE_IP10_Per.SHELL.BASE "" SWORD TPU_PerIn 1 100 0.0 327.67 ECU_ADDRESS 0x823030 /end MEASUREMENT
/begin MEASUREMENT HWE_IP11_Dcyc.SHELL.BASE "" SWORD TPU_Dcyc 1 100 0.0 327.67 ECU_ADDRESS 0x823032 /end MEASUREMENT
/begin MEASUREMENT HWE_IP11_Err.SHELL.BASE "" UBYTE ident 1 100 0 255 ECU_ADDRESS 0x8230C4 /end MEASUREMENT
/begin MEASUREMENT HWE_IP11_Per.SHELL.BASE "" SWORD TPU_PerIn 1 100 0.0 327.67 ECU_ADDRESS 0x823034 /end MEASUREMENT
/begin MEASUREMENT HWE_IP12_Dcyc.SHELL.BASE "" SWORD TPU_Dcyc 1 100 0.0 327.67 ECU_ADDRESS 0x823036 /end MEASUREMENT
/begin MEASUREMENT HWE_IP12_Err.SHELL.BASE "" UBYTE ident 1 100 0 255 ECU_ADDRESS 0x8230C5 /end MEASUREMENT
/begin MEASUREMENT HWE_IP12_Per.SHELL.BASE "" SWORD TPU_PerIn 1 100 0.0 327.67 ECU_ADDRESS 0x823038 /end MEASUREMENT
/begin MEASUREMENT HWE_IS_ON.SHELL.BASE "" SBYTE ident 1 100 0 1 BIT_MASK 0x1 ECU_ADDRESS 0x8230D2 /end MEASUREMENT
/begin MEASUREMENT HWE_IS_TER15.SHELL.BASE "" SBYTE ident 1 100 0 1 BIT_MASK 0x1 ECU_ADDRESS 0x8230D3 /end MEASUREMENT
/begin MEASUREMENT HWE_IS_TER15R.SHELL.BASE "" SBYTE ident 1 100 0 1 BIT_MASK 0x1 ECU_ADDRESS 0x8230D4 /end MEASUREMENT
/begin MEASUREMENT HWE_IS_TER50.SHELL.BASE "" SBYTE ident 1 100 0 1 BIT_MASK 0x1 ECU_ADDRESS 0x8230D5 /end MEASUREMENT
/begin MEASUREMENT HWE_IS_WDA.SHELL.BASE "" SBYTE ident 1 100 0 1 BIT_MASK 0x1 ECU_ADDRESS 0x8230D6 /end MEASUREMENT
/begin MEASUREMENT HWE_IS01.SHELL.BASE "" SBYTE ident 1 100 0 1 BIT_MASK 0x1 ECU_ADDRESS 0x8230C6 /end MEASUREMENT
/begin MEASUREMENT HWE_IS02.SHELL.BASE "" SBYTE ident 1 100 0 1 BIT_MASK 0x1 ECU_ADDRESS 0x8230C7 /end MEASUREMENT
/begin MEASUREMENT HWE_IS03.SHELL.BASE "" SBYTE ident 1 100 0 1 BIT_MASK 0x1 ECU_ADDRESS 0x8230C8 /end MEASUREMENT
/begin MEASUREMENT HWE_IS04.SHELL.BASE "" SBYTE ident 1 100 0 1 BIT_MASK 0x1 ECU_ADDRESS 0x8230C9 /end MEASUREMENT
/begin MEASUREMENT HWE_IS05.SHELL.BASE "" SBYTE ident 1 100 0 1 BIT_MASK 0x1 ECU_ADDRESS 0x8230CA /end MEASUREMENT
/begin MEASUREMENT HWE_IS06.SHELL.BASE "" SBYTE ident 1 100 0 1 BIT_MASK 0x1 ECU_ADDRESS 0x8230CB /end MEASUREMENT
/begin MEASUREMENT HWE_IS07.SHELL.BASE "" SBYTE ident 1 100 0 1 BIT_MASK 0x1 ECU_ADDRESS 0x8230CC /end MEASUREMENT
/begin MEASUREMENT HWE_IS08.SHELL.BASE "" SBYTE ident 1 100 0 1 BIT_MASK 0x1 ECU_ADDRESS 0x8230CD /end MEASUREMENT
/begin MEASUREMENT HWE_IS09.SHELL.BASE "" SBYTE ident 1 100 0 1 BIT_MASK 0x1 ECU_ADDRESS 0x8230CE /end MEASUREMENT
/begin MEASUREMENT HWE_IS10.SHELL.BASE "" SBYTE ident 1 100 0 1 BIT_MASK 0x1 ECU_ADDRESS 0x8230CF /end MEASUREMENT
/begin MEASUREMENT HWE_IS11.SHELL.BASE "" SBYTE ident 1 100 0 1 BIT_MASK 0x1 ECU_ADDRESS 0x8230D0 /end MEASUREMENT
/begin MEASUREMENT HWE_IS12.SHELL.BASE "" SBYTE ident 1 100 0 1 BIT_MASK 0x1 ECU_ADDRESS 0x8230D1 /end MEASUREMENT
/begin MEASUREMENT HWE_OIC01_Dcyc.SHELL.BASE "" SWORD TPU_Dcyc 1 100 0.0 327.67 ECU_ADDRESS 0x82303A /end MEASUREMENT
/begin MEASUREMENT HWE_OIC01_DiagReg.SHELL.BASE "" UBYTE ident 1 100 0 255 ECU_ADDRESS 0x8230D7 /end MEASUREMENT
/begin MEASUREMENT HWE_OIC01_DiagRet.SHELL.BASE "" UBYTE ident 1 100 0 255 ECU_ADDRESS 0x8230D8 /end MEASUREMENT
/begin MEASUREMENT HWE_OIC01_Err.SHELL.BASE "" UWORD ident 1 100 0.0 65535.0 ECU_ADDRESS 0x82303C /end MEASUREMENT
/begin MEASUREMENT HWE_OIC01_Stat.SHELL.BASE "" UWORD ident 1 100 0.0 65535.0 ECU_ADDRESS 0x82303E /end MEASUREMENT
/begin MEASUREMENT HWE_OIC02_Dcyc.SHELL.BASE "" SWORD TPU_Dcyc 1 100 0.0 327.67 ECU_ADDRESS 0x823040 /end MEASUREMENT
/begin MEASUREMENT HWE_OIC02_Diag.SHELL.BASE "" UBYTE ident 1 100 0 255 ECU_ADDRESS 0x8230D9 /end MEASUREMENT
/begin MEASUREMENT HWE_OIC02_DiagReg.SHELL.BASE "" UBYTE ident 1 100 0 255 ECU_ADDRESS 0x8230DA /end MEASUREMENT
/begin MEASUREMENT HWE_OIC02_DiagRet.SHELL.BASE "" UBYTE ident 1 100 0 255 ECU_ADDRESS 0x8230DB /end MEASUREMENT
/begin MEASUREMENT HWE_OIC02_Err.SHELL.BASE "" UWORD ident 1 100 0.0 65535.0 ECU_ADDRESS 0x823042 /end MEASUREMENT
/begin MEASUREMENT HWE_OIC02_Stat.SHELL.BASE "" UWORD ident 1 100 0.0 65535.0 ECU_ADDRESS 0x823044 /end MEASUREMENT
/begin MEASUREMENT HWE_OPI01_Dcyc.SHELL.BASE "" SWORD TPU_Dcyc 1 100 0.0 327.67 ECU_ADDRESS 0x823046 /end MEASUREMENT
/begin MEASUREMENT HWE_OPI01_Err.SHELL.BASE "" UWORD ident 1 100 0 65535 ECU_ADDRESS 0x7FB8F4 /end MEASUREMENT
/begin MEASUREMENT HWE_OPI01_Stat.SHELL.BASE "" UWORD ident 1 100 0 65535 ECU_ADDRESS 0x7FB8F6 /end MEASUREMENT
/begin MEASUREMENT HWE_OPI02_Dcyc.SHELL.BASE "" SWORD TPU_Dcyc 1 100 0.0 327.67 ECU_ADDRESS 0x823048 /end MEASUREMENT
/begin MEASUREMENT HWE_OPI02_Err.SHELL.BASE "" UWORD ident 1 100 0 65535 ECU_ADDRESS 0x7FB8F8 /end MEASUREMENT
/begin MEASUREMENT HWE_OPI02_Stat.SHELL.BASE "" UWORD ident 1 100 0 65535 ECU_ADDRESS 0x7FB8FA /end MEASUREMENT
/begin MEASUREMENT HWE_OPI03_Dcyc.SHELL.BASE "" SWORD TPU_Dcyc 1 100 0.0 327.67 ECU_ADDRESS 0x82304A /end MEASUREMENT
/begin MEASUREMENT HWE_OPI03_Err.SHELL.BASE "" UWORD ident 1 100 0 65535 ECU_ADDRESS 0x7FB8FC /end MEASUREMENT
/begin MEASUREMENT HWE_OPI03_Stat.SHELL.BASE "" UWORD ident 1 100 0 65535 ECU_ADDRESS 0x7FB8FE /end MEASUREMENT
/begin MEASUREMENT HWE_OPI04_Dcyc.SHELL.BASE "" SWORD TPU_Dcyc 1 100 0.0 327.67 ECU_ADDRESS 0x82304C /end MEASUREMENT
/begin MEASUREMENT HWE_OPI04_Err.SHELL.BASE "" UWORD ident 1 100 0 65535 ECU_ADDRESS 0x7FB900 /end MEASUREMENT
/begin MEASUREMENT HWE_OPI04_Stat.SHELL.BASE "" UWORD ident 1 100 0 65535 ECU_ADDRESS 0x7FB902 /end MEASUREMENT
/begin MEASUREMENT HWE_OPI05_Dcyc.SHELL.BASE "" SWORD TPU_Dcyc 1 100 0.0 327.67 ECU_ADDRESS 0x82304E /end MEASUREMENT
/begin MEASUREMENT HWE_OPI05_Err.SHELL.BASE "" UWORD ident 1 100 0 65535 ECU_ADDRESS 0x7FB904 /end MEASUREMENT
/begin MEASUREMENT HWE_OPI05_Stat.SHELL.BASE "" UWORD ident 1 100 0 65535 ECU_ADDRESS 0x7FB906 /end MEASUREMENT
/begin MEASUREMENT HWE_OPI06_Dcyc.SHELL.BASE "" SWORD TPU_Dcyc 1 100 0.0 327.67 ECU_ADDRESS 0x823050 /end MEASUREMENT
/begin MEASUREMENT HWE_OPI06_Err.SHELL.BASE "" UWORD ident 1 100 0 65535 ECU_ADDRESS 0x7FB908 /end MEASUREMENT
/begin MEASUREMENT HWE_OPI06_Stat.SHELL.BASE "" UWORD ident 1 100 0 65535 ECU_ADDRESS 0x7FB90A /end MEASUREMENT
/begin MEASUREMENT HWE_OPI07_Dcyc.SHELL.BASE "" SWORD TPU_Dcyc 1 100 0.0 327.67 ECU_ADDRESS 0x823052 /end MEASUREMENT
/begin MEASUREMENT HWE_OPI07_Err.SHELL.BASE "" UWORD ident 1 100 0 65535 ECU_ADDRESS 0x7FB90C /end MEASUREMENT
/begin MEASUREMENT HWE_OPI07_Stat.SHELL.BASE "" UWORD ident 1 100 0 65535 ECU_ADDRESS 0x7FB90E /end MEASUREMENT
/begin MEASUREMENT HWE_OPI08_Dcyc.SHELL.BASE "" SWORD TPU_Dcyc 1 100 0.0 327.67 ECU_ADDRESS 0x823054 /end MEASUREMENT
/begin MEASUREMENT HWE_OPI08_Err.SHELL.BASE "" UWORD ident 1 100 0 65535 ECU_ADDRESS 0x7FB910 /end MEASUREMENT
/begin MEASUREMENT HWE_OPI08_Stat.SHELL.BASE "" UWORD ident 1 100 0 65535 ECU_ADDRESS 0x7FB912 /end MEASUREMENT
/begin MEASUREMENT HWE_OPI09_Dcyc.SHELL.BASE "" SWORD TPU_Dcyc 1 100 0.0 327.67 ECU_ADDRESS 0x823056 /end MEASUREMENT
/begin MEASUREMENT HWE_OPI09_Err.SHELL.BASE "" UWORD ident 1 100 0 65535 ECU_ADDRESS 0x7FB914 /end MEASUREMENT
/begin MEASUREMENT HWE_OPI09_Stat.SHELL.BASE "" UWORD ident 1 100 0 65535 ECU_ADDRESS 0x7FB916 /end MEASUREMENT
/begin MEASUREMENT HWE_OPI10_Dcyc.SHELL.BASE "" SWORD TPU_Dcyc 1 100 0.0 327.67 ECU_ADDRESS 0x823058 /end MEASUREMENT
/begin MEASUREMENT HWE_OPI10_Err.SHELL.BASE "" UWORD ident 1 100 0 65535 ECU_ADDRESS 0x7FB918 /end MEASUREMENT
/begin MEASUREMENT HWE_OPI10_Stat.SHELL.BASE "" UWORD ident 1 100 0 65535 ECU_ADDRESS 0x7FB91A /end MEASUREMENT
/begin MEASUREMENT HWE_OPI11_Dcyc.SHELL.BASE "" SWORD TPU_Dcyc 1 100 0.0 327.67 ECU_ADDRESS 0x82305A /end MEASUREMENT
/begin MEASUREMENT HWE_OPI11_Err.SHELL.BASE "" UWORD ident 1 100 0 65535 ECU_ADDRESS 0x7FB91C /end MEASUREMENT
/begin MEASUREMENT HWE_OPI11_Stat.SHELL.BASE "" UWORD ident 1 100 0 65535 ECU_ADDRESS 0x7FB91E /end MEASUREMENT
/begin MEASUREMENT HWE_OS_ModelState.SHELL.BASE "" ULONG ident 1 100 0 4294967295 ECU_ADDRESS 0x822FD0 /end MEASUREMENT
/begin MEASUREMENT HWE_OS_MR.SHELL.BASE "" SBYTE ident 1 100 0 1 BIT_MASK 0x1 ECU_ADDRESS 0x8230F7 /end MEASUREMENT
/begin MEASUREMENT HWE_OS01_DiagReg.SHELL.BASE "Diagnostic data of Hbridge #1" UBYTE ident 1 100 0 255 ECU_ADDRESS 0x8230DC /end MEASUREMENT
/begin MEASUREMENT HWE_OS01_DiagRet.SHELL.BASE "" UBYTE ident 1 100 0 255 ECU_ADDRESS 0x8230DD /end MEASUREMENT
/begin MEASUREMENT HWE_OS01_DiagStat.SHELL.BASE "" UBYTE ident 1 100 0 255 ECU_ADDRESS 0x8230DE /end MEASUREMENT
/begin MEASUREMENT HWE_OS01_Disable.SHELL.BASE "" UBYTE ident 1 100 0 1 BIT_MASK 0x1 ECU_ADDRESS 0x8230DF /end MEASUREMENT
/begin MEASUREMENT HWE_OS01_En.SHELL.BASE "" UBYTE ident 1 100 0 1 BIT_MASK 0x1 ECU_ADDRESS 0x8230E0 /end MEASUREMENT
/begin MEASUREMENT HWE_OS01_Err.SHELL.BASE "Diagnostic data of Hbridge #1" UWORD ident 1 100 0 65535 ECU_ADDRESS 0x82305C /end MEASUREMENT
/begin MEASUREMENT HWE_OS01_S_Dcyc.SHELL.BASE "" UWORD TPU_Dcyc 1 100 0.0 100.0 ECU_ADDRESS 0x82305E /end MEASUREMENT
/begin MEASUREMENT HWE_OS01_Stat.SHELL.BASE "Diagnostic data of Hbridge #1" UWORD ident 1 100 0 65535 ECU_ADDRESS 0x823060 /end MEASUREMENT
/begin MEASUREMENT HWE_OS01_V.SHELL.BASE "" SBYTE ident 1 100 0 1 BIT_MASK 0x1 ECU_ADDRESS 0x8230E1 /end MEASUREMENT
/begin MEASUREMENT HWE_OS02_DiagReg.SHELL.BASE "Diagnostic data of Hbridge #1" UBYTE ident 1 100 0 255 ECU_ADDRESS 0x8230E2 /end MEASUREMENT
/begin MEASUREMENT HWE_OS02_DiagRet.SHELL.BASE "" UBYTE ident 1 100 0 255 ECU_ADDRESS 0x8230E3 /end MEASUREMENT
/begin MEASUREMENT HWE_OS02_DiagStat.SHELL.BASE "" UBYTE ident 1 100 0 255 ECU_ADDRESS 0x8230E4 /end MEASUREMENT
/begin MEASUREMENT HWE_OS02_Disable.SHELL.BASE "" SBYTE ident 1 100 0 1 BIT_MASK 0x1 ECU_ADDRESS 0x8230E5 /end MEASUREMENT
/begin MEASUREMENT HWE_OS02_En.SHELL.BASE "" SBYTE ident 1 100 0 1 BIT_MASK 0x1 ECU_ADDRESS 0x8230E6 /end MEASUREMENT
/begin MEASUREMENT HWE_OS02_Err.SHELL.BASE "Diagnostic data of Hbridge #1" UWORD ident 1 100 0 65535 ECU_ADDRESS 0x823062 /end MEASUREMENT
/begin MEASUREMENT HWE_OS02_S_Dcyc.SHELL.BASE "" UWORD TPU_Dcyc 1 100 0.0 100.0 ECU_ADDRESS 0x823064 /end MEASUREMENT
/begin MEASUREMENT HWE_OS02_Stat.SHELL.BASE "Diagnostic data of Hbridge #1" UWORD ident 1 100 0 65535 ECU_ADDRESS 0x823066 /end MEASUREMENT
/begin MEASUREMENT HWE_OS02_V.SHELL.BASE "" SBYTE ident 1 100 0 1 BIT_MASK 0x1 ECU_ADDRESS 0x8230E7 /end MEASUREMENT
/begin MEASUREMENT HWE_OS03.SHELL.BASE "" SBYTE ident 1 100 0 1 BIT_MASK 0x1 ECU_ADDRESS 0x8230E8 /end MEASUREMENT
/begin MEASUREMENT HWE_OS03_Err.SHELL.BASE "" UWORD ident 1 100 0 65535 ECU_ADDRESS 0x823068 /end MEASUREMENT
/begin MEASUREMENT HWE_OS03_Stat.SHELL.BASE "" UWORD ident 1 100 0 65535 ECU_ADDRESS 0x82306A /end MEASUREMENT
/begin MEASUREMENT HWE_OS04.SHELL.BASE "" SBYTE ident 1 100 0 1 BIT_MASK 0x1 ECU_ADDRESS 0x8230E9 /end MEASUREMENT
/begin MEASUREMENT HWE_OS04_Err.SHELL.BASE "" UWORD ident 1 100 0 65535 ECU_ADDRESS 0x82306C /end MEASUREMENT
/begin MEASUREMENT HWE_OS04_Stat.SHELL.BASE "" UWORD ident 1 100 0 65535 ECU_ADDRESS 0x82306E /end MEASUREMENT
/begin MEASUREMENT HWE_OS05a.SHELL.BASE "" SBYTE ident 1 100 0 1 BIT_MASK 0x1 ECU_ADDRESS 0x8230EA /end MEASUREMENT
/begin MEASUREMENT HWE_OS05a_Err.SHELL.BASE "" UWORD ident 1 100 0 65535 ECU_ADDRESS 0x823070 /end MEASUREMENT
/begin MEASUREMENT HWE_OS05a_Stat.SHELL.BASE "" UWORD ident 1 100 0 65535 ECU_ADDRESS 0x823072 /end MEASUREMENT
/begin MEASUREMENT HWE_OS05b.SHELL.BASE "" SBYTE ident 1 100 0 1 BIT_MASK 0x1 ECU_ADDRESS 0x8230EB /end MEASUREMENT
/begin MEASUREMENT HWE_OS05b_Err.SHELL.BASE "" UWORD ident 1 100 0 65535 ECU_ADDRESS 0x823074 /end MEASUREMENT
/begin MEASUREMENT HWE_OS05b_Stat.SHELL.BASE "" UWORD ident 1 100 0 65535 ECU_ADDRESS 0x823076 /end MEASUREMENT
/begin MEASUREMENT HWE_OS05c.SHELL.BASE "" SBYTE ident 1 100 0 1 BIT_MASK 0x1 ECU_ADDRESS 0x8230EC /end MEASUREMENT
/begin MEASUREMENT HWE_OS05c_Err.SHELL.BASE "" UWORD ident 1 100 0 65535 ECU_ADDRESS 0x823078 /end MEASUREMENT
/begin MEASUREMENT HWE_OS05c_Stat.SHELL.BASE "" UWORD ident 1 100 0 65535 ECU_ADDRESS 0x82307A /end MEASUREMENT
/begin MEASUREMENT HWE_OS06.SHELL.BASE "" SBYTE ident 1 100 0 1 BIT_MASK 0x1 ECU_ADDRESS 0x8230ED /end MEASUREMENT
/begin MEASUREMENT HWE_OS06_Err.SHELL.BASE "" UWORD ident 1 100 0 65535 ECU_ADDRESS 0x82307C /end MEASUREMENT
/begin MEASUREMENT HWE_OS06_Stat.SHELL.BASE "" UWORD ident 1 100 0 65535 ECU_ADDRESS 0x82307E /end MEASUREMENT
/begin MEASUREMENT HWE_OS07.SHELL.BASE "" SBYTE ident 1 100 0 1 BIT_MASK 0x1 ECU_ADDRESS 0x8230EE /end MEASUREMENT
/begin MEASUREMENT HWE_OS07_Err.SHELL.BASE "" UWORD ident 1 100 0 65535 ECU_ADDRESS 0x823080 /end MEASUREMENT
/begin MEASUREMENT HWE_OS07_Stat.SHELL.BASE "" UWORD ident 1 100 0 65535 ECU_ADDRESS 0x823082 /end MEASUREMENT
/begin MEASUREMENT HWE_OS08.SHELL.BASE "" SBYTE ident 1 100 0 1 BIT_MASK 0x1 ECU_ADDRESS 0x8230EF /end MEASUREMENT
/begin MEASUREMENT HWE_OS08_Err.SHELL.BASE "" UWORD ident 1 100 0 65535 ECU_ADDRESS 0x823084 /end MEASUREMENT
/begin MEASUREMENT HWE_OS08_Stat.SHELL.BASE "" UWORD ident 1 100 0 65535 ECU_ADDRESS 0x823086 /end MEASUREMENT
/begin MEASUREMENT HWE_OS09.SHELL.BASE "" SBYTE ident 1 100 0 1 BIT_MASK 0x1 ECU_ADDRESS 0x8230F0 /end MEASUREMENT
/begin MEASUREMENT HWE_OS09_Err.SHELL.BASE "" UWORD ident 1 100 0 65535 ECU_ADDRESS 0x823088 /end MEASUREMENT
/begin MEASUREMENT HWE_OS09_Stat.SHELL.BASE "" UWORD ident 1 100 0 65535 ECU_ADDRESS 0x82308A /end MEASUREMENT
/begin MEASUREMENT HWE_OS10.SHELL.BASE "" SBYTE ident 1 100 0 1 BIT_MASK 0x1 ECU_ADDRESS 0x8230F1 /end MEASUREMENT
/begin MEASUREMENT HWE_OS10_Err.SHELL.BASE "" UWORD ident 1 100 0 65535 ECU_ADDRESS 0x82308C /end MEASUREMENT
/begin MEASUREMENT HWE_OS10_Stat.SHELL.BASE "" UWORD ident 1 100 0 65535 ECU_ADDRESS 0x82308E /end MEASUREMENT
/begin MEASUREMENT HWE_OS11.SHELL.BASE "" SBYTE ident 1 100 0 1 BIT_MASK 0x1 ECU_ADDRESS 0x8230F2 /end MEASUREMENT
/begin MEASUREMENT HWE_OS11_Err.SHELL.BASE "" UWORD ident 1 100 0 65535 ECU_ADDRESS 0x823090 /end MEASUREMENT
/begin MEASUREMENT HWE_OS11_Stat.SHELL.BASE "" UWORD ident 1 100 0 65535 ECU_ADDRESS 0x823092 /end MEASUREMENT
/begin MEASUREMENT HWE_OS12.SHELL.BASE "" SBYTE ident 1 100 0 1 BIT_MASK 0x1 ECU_ADDRESS 0x8230F3 /end MEASUREMENT
/begin MEASUREMENT HWE_OS12_Err.SHELL.BASE "" UWORD ident 1 100 0 65535 ECU_ADDRESS 0x823094 /end MEASUREMENT
/begin MEASUREMENT HWE_OS12_Stat.SHELL.BASE "" UWORD ident 1 100 0 65535 ECU_ADDRESS 0x823096 /end MEASUREMENT
/begin MEASUREMENT HWE_OS13.SHELL.BASE "" SBYTE ident 1 100 0 1 BIT_MASK 0x1 ECU_ADDRESS 0x8230F4 /end MEASUREMENT
/begin MEASUREMENT HWE_OS13_Err.SHELL.BASE "" UWORD ident 1 100 0 65535 ECU_ADDRESS 0x823098 /end MEASUREMENT
/begin MEASUREMENT HWE_OS13_Stat.SHELL.BASE "" UWORD ident 1 100 0 65535 ECU_ADDRESS 0x82309A /end MEASUREMENT
/begin MEASUREMENT HWE_OS14.SHELL.BASE "" SBYTE ident 1 100 0 1 BIT_MASK 0x1 ECU_ADDRESS 0x8230F5 /end MEASUREMENT
/begin MEASUREMENT HWE_OS14_Err.SHELL.BASE "" UWORD ident 1 100 0 65535 ECU_ADDRESS 0x82309C /end MEASUREMENT
/begin MEASUREMENT HWE_OS14_Stat.SHELL.BASE "" UWORD ident 1 100 0 65535 ECU_ADDRESS 0x82309E /end MEASUREMENT
/begin MEASUREMENT HWE_OS15.SHELL.BASE "" SBYTE ident 1 100 0 1 BIT_MASK 0x1 ECU_ADDRESS 0x8230F6 /end MEASUREMENT
/begin MEASUREMENT HWE_OS15_Err.SHELL.BASE "" UWORD ident 1 100 0 65535 ECU_ADDRESS 0x8230A0 /end MEASUREMENT
/begin MEASUREMENT HWE_OS15_Stat.SHELL.BASE "" UWORD ident 1 100 0 65535 ECU_ADDRESS 0x8230A2 /end MEASUREMENT
/begin MEASUREMENT HWE_PowerfailDetected.HWE.BASE "This messages indicates that there has been a  KL30 failure has occurred before the actual init" SBYTE ident 1 100 0 1 BIT_MASK 0x1 ECU_ADDRESS 0x7FB48B /end MEASUREMENT
/begin MEASUREMENT HWE_ResetMonitor_Adr.HWE.BASE "" ULONG ident 1 100 0 4294967295 ECU_ADDRESS 0x8227A8 MATRIX_DIM 10 1 1 /end MEASUREMENT
/begin MEASUREMENT HWE_ResetMonitor_Counter.HWE.BASE "" UWORD ident 1 100 0 65535 ECU_ADDRESS 0x822820 /end MEASUREMENT
/begin MEASUREMENT HWE_ResetMonitor_ID.HWE.BASE "" ULONG ident 1 100 0 4294967295 ECU_ADDRESS 0x8227F8 MATRIX_DIM 10 1 1 /end MEASUREMENT
/begin MEASUREMENT HWE_ResetMonitor_RSR.HWE.BASE "" ULONG ident 1 100 0 4294967295 ECU_ADDRESS 0x8227D0 MATRIX_DIM 10 1 1 /end MEASUREMENT
/begin MEASUREMENT HWE_ResetMonitor_Time.HWE.BASE "" FLOAT32_IEEE ident 1 100 -1.e+037 1.e+037 ECU_ADDRESS 0x822824 MATRIX_DIM 10 1 1 /end MEASUREMENT
/begin MEASUREMENT HWE_Rtmo_ctSample.SHELL.BASE "" UWORD ident 1 100 0 65535 ECU_ADDRESS 0x7FB920 /end MEASUREMENT
/begin MEASUREMENT HWE_Rtmo_ctSampleProc.SHELL.BASE "" ULONG ident 1 100 0 4294967295 ECU_ADDRESS 0x7FB8C8 /end MEASUREMENT
/begin MEASUREMENT HWE_Rtmo_pLoadMax.SHELL.BASE "" FLOAT32_IEEE ident 1 100 0.0 100.0 ECU_ADDRESS 0x7FB8CC /end MEASUREMENT
/begin MEASUREMENT HWE_Rtmo_tiAbsMax.SHELL.BASE "" ULONG Rtm_TicksToUs 1 100 0.0 1227133512.857143 ECU_ADDRESS 0x7FB8D0 /end MEASUREMENT
/begin MEASUREMENT HWE_Rtmo_tiAbsMax_1.SHELL.BASE "" ULONG Rtm_TicksToUs 1 100 0.0 1227133512.857143 ECU_ADDRESS 0x7FB8D4 /end MEASUREMENT
/begin MEASUREMENT HWE_Rtmo_tiAbsMin.SHELL.BASE "" ULONG Rtm_TicksToUs 1 100 0.0 1227133512.85714 ECU_ADDRESS 0x7FB8D8 /end MEASUREMENT
/begin MEASUREMENT HWE_Rtmo_tiAvrg.SHELL.BASE "" ULONG Rtm_TicksToUs 1 100 0.0 1227133512.857143 ECU_ADDRESS 0x7FB8DC /end MEASUREMENT
/begin MEASUREMENT HWE_Rtmo_tiMax.SHELL.BASE "" ULONG Rtm_TicksToUs 1 100 0.0 1227133512.85714 ECU_ADDRESS 0x7FB8E0 /end MEASUREMENT
/begin MEASUREMENT HWE_Rtmo_tiMaxCallDist.SHELL.BASE "" ULONG Rtm_TicksToUs 1 100 0.0 1227133512.85714 ECU_ADDRESS 0x7FB8E4 /end MEASUREMENT
/begin MEASUREMENT HWE_Rtmo_tiMin.SHELL.BASE "" ULONG Rtm_TicksToUs 1 100 0.0 1227133512.85714 ECU_ADDRESS 0x7FB8E8 /end MEASUREMENT
/begin MEASUREMENT HWE_Rtmo_tiMinCallDist.SHELL.BASE "" ULONG Rtm_TicksToUs 1 100 0.0 1227133512.85714 ECU_ADDRESS 0x7FB8EC /end MEASUREMENT
/begin MEASUREMENT HWE_ServiceCounter_st.SHELL.BASE "" ULONG ident 1 100 0 4294967295 ECU_ADDRESS 0x7FB8F0 /end MEASUREMENT
/begin MEASUREMENT HWE_SwitchOff.SHELL.BASE "" SBYTE ident 1 100 0 1 BIT_MASK 0x1 ECU_ADDRESS 0x7FB92B /end MEASUREMENT
/begin MEASUREMENT is_started.Time_Calc.HWE.BASE "" UBYTE ident 1 100 0 1 ECU_ADDRESS 0x7F89C8 MATRIX_DIM 3 1 1 /end MEASUREMENT
/begin MEASUREMENT l_baudrate_calculated_f32.HWE_CAN_A.SHELL.BASE "" FLOAT32_IEEE ident 1 100 0.0 1000000.0 ECU_ADDRESS 0x7F8FDC /end MEASUREMENT
/begin MEASUREMENT l_baudrate_calculated_f32.HWE_CAN_B.SHELL.BASE "" FLOAT32_IEEE ident 1 100 0.0 1000000.0 ECU_ADDRESS 0x7F8FEC /end MEASUREMENT
/begin MEASUREMENT l_baudrate_calculated_f32.HWE_CAN_C.SHELL.BASE "" FLOAT32_IEEE ident 1 100 0.0 1000000.0 ECU_ADDRESS 0x7F8FFC /end MEASUREMENT
/begin MEASUREMENT l_baudrate_e.HWE_CAN_A.SHELL.BASE "" UBYTE enum_HWE_CAN_BAUDRATE_ENUM 1 100 0 6 ECU_ADDRESS 0x7F8FE4 /end MEASUREMENT
/begin MEASUREMENT l_baudrate_e.HWE_CAN_B.SHELL.BASE "" UBYTE enum_HWE_CAN_BAUDRATE_ENUM 1 100 0 6 ECU_ADDRESS 0x7F8FF4 /end MEASUREMENT
/begin MEASUREMENT l_baudrate_e.HWE_CAN_C.SHELL.BASE "" UBYTE enum_HWE_CAN_BAUDRATE_ENUM 1 100 0 6 ECU_ADDRESS 0x7F9004 /end MEASUREMENT
/begin MEASUREMENT l_CAN_B_IRQ_begin_u32.HWE.BASE "" ULONG TickType2ms 1 100 0.1428571428571429 600000.0 ECU_ADDRESS 0x7F8994 /end MEASUREMENT
/begin MEASUREMENT l_CAN_B_IRQ_ExeTime_u32.HWE.BASE "" ULONG TickType2ms 1 100 0.1428571428571429 600000.0 ECU_ADDRESS 0x7F8990 /end MEASUREMENT
/begin MEASUREMENT l_dBRP_u8.HWE_CAN_A.SHELL.BASE "" UBYTE ident 1 100 1 64 ECU_ADDRESS 0x7F8FE5 /end MEASUREMENT
/begin MEASUREMENT l_dBRP_u8.HWE_CAN_B.SHELL.BASE "" UBYTE ident 1 100 1 64 ECU_ADDRESS 0x7F8FF5 /end MEASUREMENT
/begin MEASUREMENT l_dBRP_u8.HWE_CAN_C.SHELL.BASE "" UBYTE ident 1 100 1 64 ECU_ADDRESS 0x7F9005 /end MEASUREMENT
/begin MEASUREMENT l_dPropSeg_u8.HWE_CAN_A.SHELL.BASE "" UBYTE ident 1 100 1 8 ECU_ADDRESS 0x7F8FE8 /end MEASUREMENT
/begin MEASUREMENT l_dPropSeg_u8.HWE_CAN_B.SHELL.BASE "" UBYTE ident 1 100 1 8 ECU_ADDRESS 0x7F8FF8 /end MEASUREMENT
/begin MEASUREMENT l_dPropSeg_u8.HWE_CAN_C.SHELL.BASE "" UBYTE ident 1 100 1 8 ECU_ADDRESS 0x7F9008 /end MEASUREMENT
/begin MEASUREMENT l_dPSeg1_u8.HWE_CAN_A.SHELL.BASE "" UBYTE ident 1 100 1 8 ECU_ADDRESS 0x7F8FE6 /end MEASUREMENT
/begin MEASUREMENT l_dPSeg1_u8.HWE_CAN_B.SHELL.BASE "" UBYTE ident 1 100 1 8 ECU_ADDRESS 0x7F8FF6 /end MEASUREMENT
/begin MEASUREMENT l_dPSeg1_u8.HWE_CAN_C.SHELL.BASE "" UBYTE ident 1 100 1 8 ECU_ADDRESS 0x7F9006 /end MEASUREMENT
/begin MEASUREMENT l_dPSeg2_u8.HWE_CAN_A.SHELL.BASE "" UBYTE ident 1 100 1 8 ECU_ADDRESS 0x7F8FE7 /end MEASUREMENT
/begin MEASUREMENT l_dPSeg2_u8.HWE_CAN_B.SHELL.BASE "" UBYTE ident 1 100 1 8 ECU_ADDRESS 0x7F8FF7 /end MEASUREMENT
/begin MEASUREMENT l_dPSeg2_u8.HWE_CAN_C.SHELL.BASE "" UBYTE ident 1 100 1 8 ECU_ADDRESS 0x7F9007 /end MEASUREMENT
/begin MEASUREMENT l_dSJW_u8.HWE_CAN_A.SHELL.BASE "" UBYTE ident 1 100 1 4 ECU_ADDRESS 0x7F8FE9 /end MEASUREMENT
/begin MEASUREMENT l_dSJW_u8.HWE_CAN_B.SHELL.BASE "" UBYTE ident 1 100 1 4 ECU_ADDRESS 0x7F8FF9 /end MEASUREMENT
/begin MEASUREMENT l_dSJW_u8.HWE_CAN_C.SHELL.BASE "" UBYTE ident 1 100 1 4 ECU_ADDRESS 0x7F9009 /end MEASUREMENT
/begin MEASUREMENT l_ResetTimer_b.DAQ2_Sample.CCP_SHELL "" UBYTE ident 1 100 0 1 BIT_MASK 0x1 ECU_ADDRESS 0x7F8530 /end MEASUREMENT
/begin MEASUREMENT l_ResetTimer_b.DAQ2_Tx.CCP_SHELL "" UBYTE ident 1 100 0 1 BIT_MASK 0x1 ECU_ADDRESS 0x7F854C /end MEASUREMENT
/begin MEASUREMENT l_samplepoint_calculated_f32.HWE_CAN_A.SHELL.BASE "" FLOAT32_IEEE ident 1 100 0.0 1000000.0 ECU_ADDRESS 0x7F8FE0 /end MEASUREMENT
/begin MEASUREMENT l_samplepoint_calculated_f32.HWE_CAN_B.SHELL.BASE "" FLOAT32_IEEE ident 1 100 0.0 1000000.0 ECU_ADDRESS 0x7F8FF0 /end MEASUREMENT
/begin MEASUREMENT l_samplepoint_calculated_f32.HWE_CAN_C.SHELL.BASE "" FLOAT32_IEEE ident 1 100 0.0 1000000.0 ECU_ADDRESS 0x7F9000 /end MEASUREMENT
/begin MEASUREMENT l_StartTicks_u32.DAQ2_Sample.CCP_SHELL "" ULONG ident 1 100 0 4294967295 ECU_ADDRESS 0x7F8528 /end MEASUREMENT
/begin MEASUREMENT l_StartTicks_u32.DAQ2_Tx.CCP_SHELL "" ULONG ident 1 100 0 4294967295 ECU_ADDRESS 0x7F8540 /end MEASUREMENT
/begin MEASUREMENT l_StopTicks_u32.DAQ2_Sample.CCP_SHELL "" ULONG ident 1 100 0 4294967295 ECU_ADDRESS 0x7F852C /end MEASUREMENT
/begin MEASUREMENT l_StopTicks_u32.DAQ2_Tx.CCP_SHELL "" ULONG ident 1 100 0 4294967295 ECU_ADDRESS 0x7F8544 /end MEASUREMENT
/begin MEASUREMENT l_Timeout_b.DAQ2_Sample.CCP_SHELL "" UBYTE ident 1 100 0 1 BIT_MASK 0x1 ECU_ADDRESS 0x7F8531 /end MEASUREMENT
/begin MEASUREMENT l_Timeout_b.DAQ2_Tx.CCP_SHELL "" UBYTE ident 1 100 0 1 BIT_MASK 0x1 ECU_ADDRESS 0x7F854D /end MEASUREMENT
/begin MEASUREMENT l_TimerCorrection_u32.CCP_SHELL "" ULONG TickType2ms 1 100 0.0 1227133.512857143 ECU_ADDRESS 0x7F8514 /end MEASUREMENT
/begin MEASUREMENT l_TimeSum_u32.DAQ2_Tx.CCP_SHELL "" ULONG TickType2ms 1 100 0.0 1227133.512857143 ECU_ADDRESS 0x7F8548 /end MEASUREMENT
/begin MEASUREMENT l_UpdateBitTest_b.Bit_Test "" UBYTE ident 1 100 0 1 BIT_MASK 0x1 ECU_ADDRESS 0x7F8208 /end MEASUREMENT
/begin MEASUREMENT lastCtrB01.BypassCounter "" UBYTE ident 1 100 0 255 ECU_ADDRESS 0x7FB374 /end MEASUREMENT
/begin MEASUREMENT lastCtrB02.BypassCounter "" UBYTE ident 1 100 0 255 ECU_ADDRESS 0x7FB375 /end MEASUREMENT
/begin MEASUREMENT lastCtrB03.BypassCounter "" UBYTE ident 1 100 0 255 ECU_ADDRESS 0x7FB376 /end MEASUREMENT
/begin MEASUREMENT lastCtrB04.BypassCounter "" UBYTE ident 1 100 0 255 ECU_ADDRESS 0x7FB377 /end MEASUREMENT
/begin MEASUREMENT Max.MIN_MAX_Tick2Time.DAQ2_Sample.CCP_SHELL "" ULONG TickType2ms 1 100 0.0 1227133.512857143 ECU_ADDRESS 0x7F8534 /end MEASUREMENT
/begin MEASUREMENT Max.Time.DAQ2_Tx.CCP_SHELL "" ULONG TickType2ms 1 100 0.0 1227133.512857143 ECU_ADDRESS 0x7F8550 /end MEASUREMENT
/begin MEASUREMENT Max.TimeSum.DAQ2_Tx.CCP_SHELL "" ULONG TickType2ms 1 100 0.0 1227133.512857143 ECU_ADDRESS 0x7F855C /end MEASUREMENT
/begin MEASUREMENT Min.MIN_MAX_Tick2Time.DAQ2_Sample.CCP_SHELL "" ULONG TickType2ms 1 100 0.0 1227133.512857143 ECU_ADDRESS 0x7F8538 /end MEASUREMENT
/begin MEASUREMENT Min.Time.DAQ2_Tx.CCP_SHELL "" ULONG TickType2ms 1 100 0.0 1227133.512857143 ECU_ADDRESS 0x7F8554 /end MEASUREMENT
/begin MEASUREMENT Min.TimeSum.DAQ2_Tx.CCP_SHELL "" ULONG TickType2ms 1 100 0.0 1227133.512857143 ECU_ADDRESS 0x7F8560 /end MEASUREMENT
/begin MEASUREMENT ODT_tx_status.CCP_SHELL "" UBYTE ident 1 100 0 255 ECU_ADDRESS 0x7F8525 MATRIX_DIM 3 1 1 /end MEASUREMENT
/begin MEASUREMENT Result.Time_Calc.HWE.BASE "" ULONG TickType2ms 1 100 0.1428571428571429 600000.0 ECU_ADDRESS 0x7F89A4 MATRIX_DIM 3 1 1 /end MEASUREMENT
/begin MEASUREMENT Samp_Time_result.HWE.BASE "" ULONG TickType2ms 1 100 0.1428571428571429 600000.0 ECU_ADDRESS 0x7F8980 /end MEASUREMENT
/begin MEASUREMENT test_counter.CCP_SHELL "" UWORD ident 1 100 0 50000 ECU_ADDRESS 0x7F8518 MATRIX_DIM 5 1 1 /end MEASUREMENT
/begin MEASUREMENT test_counter.HWE.BASE "" UWORD ident 1 100 0 50000 ECU_ADDRESS 0x7F8998 MATRIX_DIM 5 1 1 /end MEASUREMENT
/begin MEASUREMENT Time.MIN_MAX_Tick2Time.DAQ2_Sample.CCP_SHELL "" ULONG TickType2ms 1 100 0.0 1227133.512857143 ECU_ADDRESS 0x7F853C /end MEASUREMENT
/begin MEASUREMENT Time.Time.DAQ2_Tx.CCP_SHELL "" ULONG TickType2ms 1 100 0.0 1227133.512857143 ECU_ADDRESS 0x7F8558 /end MEASUREMENT
/begin MEASUREMENT Time.TimeSum.DAQ2_Tx.CCP_SHELL "" ULONG TickType2ms 1 100 0.0 1227133.512857143 ECU_ADDRESS 0x7F8564 /end MEASUREMENT
/begin MEASUREMENT Timer_Zero_Error.HWE.BASE "" SLONG TickType2ms 1 100 0.1428571428571429 600000.0 ECU_ADDRESS 0x7F8984 /end MEASUREMENT
/begin MEASUREMENT TimeStampOne.Time_Calc.HWE.BASE "" ULONG TickType2ms 1 100 0.1428571428571429 600000.0 ECU_ADDRESS 0x7F89B0 MATRIX_DIM 3 1 1 /end MEASUREMENT
/begin MEASUREMENT TimeStampTwo.Time_Calc.HWE.BASE "" ULONG TickType2ms 1 100 0.1428571428571429 600000.0 ECU_ADDRESS 0x7F89BC MATRIX_DIM 3 1 1 /end MEASUREMENT
/begin MEASUREMENT Tx_time_result.HWE.BASE "" ULONG TickType2ms 1 100 0.1428571428571429 600000.0 ECU_ADDRESS 0x7F8988 /end MEASUREMENT
/begin MEASUREMENT Tx_time_sum.HWE.BASE "" ULONG TickType2ms 1 100 0.1428571428571429 600000.0 ECU_ADDRESS 0x7F898C /end MEASUREMENT
/begin MEASUREMENT waitCtrB01.BypassCounter "" ULONG ident 1 100 0 4294967295 ECU_ADDRESS 0x7FB344 /end MEASUREMENT
/begin MEASUREMENT waitCtrB01_H.BypassCounter "" UWORD ident 1 100 0 65535 ECU_ADDRESS 0x7FB364 /end MEASUREMENT
/begin MEASUREMENT waitCtrB01_L.BypassCounter "" UWORD ident 1 100 0 65535 ECU_ADDRESS 0x7FB366 /end MEASUREMENT
/begin MEASUREMENT waitCtrB02.BypassCounter "" ULONG ident 1 100 0 4294967295 ECU_ADDRESS 0x7FB348 /end MEASUREMENT
/begin MEASUREMENT waitCtrB02_H.BypassCounter "" UWORD ident 1 100 0 65535 ECU_ADDRESS 0x7FB368 /end MEASUREMENT
/begin MEASUREMENT waitCtrB02_L.BypassCounter "" UWORD ident 1 100 0 65535 ECU_ADDRESS 0x7FB36A /end MEASUREMENT
/begin MEASUREMENT waitCtrB03.BypassCounter "" ULONG ident 1 100 0 4294967295 ECU_ADDRESS 0x7FB34C /end MEASUREMENT
/begin MEASUREMENT waitCtrB03_H.BypassCounter "" UWORD ident 1 100 0 65535 ECU_ADDRESS 0x7FB36C /end MEASUREMENT
/begin MEASUREMENT waitCtrB03_L.BypassCounter "" UWORD ident 1 100 0 65535 ECU_ADDRESS 0x7FB36E /end MEASUREMENT
/begin MEASUREMENT waitCtrB04.BypassCounter "" ULONG ident 1 100 0 4294967295 ECU_ADDRESS 0x7FB350 /end MEASUREMENT
/begin MEASUREMENT waitCtrB04_H.BypassCounter "" UWORD ident 1 100 0 65535 ECU_ADDRESS 0x7FB370 /end MEASUREMENT
/begin MEASUREMENT waitCtrB04_L.BypassCounter "" UWORD ident 1 100 0 65535 ECU_ADDRESS 0x7FB372 /end MEASUREMENT
/begin COMPU_METHOD ADC_10bit "" RAT_FUNC "%12.4" "V" COEFFS 0 204.6 0 0 0 1 /end COMPU_METHOD
/begin COMPU_METHOD ADC_KL30B "Voltage Divide: 147/709" RAT_FUNC "%12.4" "V" COEFFS 0 42.42059238363893 0 0 0 1 /end COMPU_METHOD
/begin COMPU_METHOD enum_CCP_ACTIVE_VERSION_ENUM "" TAB_VERB "%8.4" "" COEFFS 0 1 0 0 0 1 COMPU_TAB_REF enum_CCP_ACTIVE_VERSION_ENUM_tab_ref /end COMPU_METHOD
/begin COMPU_METHOD enum_CCP_ByteOrder_e "" TAB_VERB "%8.4" "" COEFFS 0 1 0 0 0 1 COMPU_TAB_REF enum_CCP_ByteOrder_e_tab_ref /end COMPU_METHOD
/begin COMPU_METHOD enum_CCP_Page_ENUM "" TAB_VERB "%8.4" "" COEFFS 0 1 0 0 0 1 COMPU_TAB_REF enum_CCP_Page_ENUM_tab_ref /end COMPU_METHOD
/begin COMPU_METHOD enum_HWE_CAN_BAUDRATE_ENUM "" TAB_VERB "%8.4" "" COEFFS 0 1 0 0 0 1 COMPU_TAB_REF enum_HWE_CAN_BAUDRATE_ENUM_tab_ref /end COMPU_METHOD
/begin COMPU_METHOD enum_Tasks "" TAB_VERB "%8.4" "" COEFFS 0 1 0 0 0 1 COMPU_TAB_REF enum_Tasks_tab_ref /end COMPU_METHOD
/begin COMPU_METHOD enum_XCP_Resume_e "" TAB_VERB "%8.4" "" COEFFS 0 1 0 0 0 1 COMPU_TAB_REF enum_XCP_Resume_e_tab_ref /end COMPU_METHOD
/begin COMPU_METHOD ident "" RAT_FUNC "%12.4" "" COEFFS 0 1 0 0 0 1 /end COMPU_METHOD
/begin COMPU_METHOD Rtm_TicksToUs "" RAT_FUNC "%12.4" "us" COEFFS 0 3.5 0 0 0 1 /end COMPU_METHOD
/begin COMPU_METHOD TickType2ms "" RAT_FUNC "%12.4" "ms" COEFFS 0 3500.0 0 0 0 1 /end COMPU_METHOD
/begin COMPU_METHOD TPU_Dcyc "" RAT_FUNC "%12.4" "%" COEFFS 0 100 0 0 0 1 /end COMPU_METHOD
/begin COMPU_METHOD TPU_PerIn "" RAT_FUNC "%12.4" "ms" COEFFS 0 100 0 0 0 1 /end COMPU_METHOD
/begin COMPU_METHOD TPU_PerOut "" RAT_FUNC "%12.4" "ms" COEFFS 0 10 0 0 0 1 /end COMPU_METHOD
/begin COMPU_VTAB enum_CCP_ACTIVE_VERSION_ENUM_tab_ref "" TAB_VERB 2 0 "CCP_V210_0" 1 "CCP_V200_1" DEFAULT_VALUE "Error" /end COMPU_VTAB
/begin COMPU_VTAB enum_CCP_ByteOrder_e_tab_ref "" TAB_VERB 2 0 "INTEL_MSB_LAST_0" 1 "MOTOROLA_MSB_FIRST_1" DEFAULT_VALUE "Error" /end COMPU_VTAB
/begin COMPU_VTAB enum_CCP_Page_ENUM_tab_ref "" TAB_VERB 3 0 "FLASH" 1 "RAM" 2 "ETK" DEFAULT_VALUE "Error" /end COMPU_VTAB
/begin COMPU_VTAB enum_HWE_CAN_BAUDRATE_ENUM_tab_ref "" TAB_VERB 7 0 "Userdefined" 1 "_83_3_kHz" 2 "_100_kHz" 3 "_125_kHz" 4 "_250_kHz" 5 "_500_kHz" 6 "_1000_kHz" DEFAULT_VALUE "Error" /end COMPU_VTAB
/begin COMPU_VTAB enum_Tasks_tab_ref "" TAB_VERB 5 0 "NO_TASK" 1 "TASK_2MS" 2 "TASK_10MS" 3 "TASK_50MS" 4 "TASK_100MS" DEFAULT_VALUE "Error" /end COMPU_VTAB
/begin COMPU_VTAB enum_XCP_Resume_e_tab_ref "" TAB_VERB 2 0 "NO_RESUME_SUPPORT_0" 1 "RESUME_SUPPORTED_1" DEFAULT_VALUE "Error" /end COMPU_VTAB
/begin GROUP BASE "" ROOT
 /begin REF_MEASUREMENT HWE_A_U_5V1_Err.SHELL.BASE HWE_A_U_5V1_Stat.SHELL.BASE HWE_A_U_5V2_Err.SHELL.BASE HWE_A_U_5V2_Stat.SHELL.BASE HWE_A_U_5V3_Err.SHELL.BASE HWE_A_U_5V3_Stat.SHELL.BASE HWE_Alarm_Can_Num1_Driver.SHELL.BASE HWE_CANA_ID250RX_1.SHELL.BASE HWE_CANA_ID250RX_2.SHELL.BASE HWE_CANA_ID258RX_1.SHELL.BASE HWE_CANA_ID258RX_2.SHELL.BASE HWE_CANA_ID260TX_1.SHELL.BASE HWE_CANA_ID260TX_2.SHELL.BASE HWE_CANA_ID288TX_1.SHELL.BASE HWE_CANA_ID288TX_2.SHELL.BASE HWE_CANA_ID290RX_1.SHELL.BASE HWE_CANA_ID290RX_2.SHELL.BASE HWE_CANA_ID310TX_1.SHELL.BASE HWE_CANA_ID310TX_2.SHELL.BASE HWE_CANA_ID320RX_1.SHELL.BASE HWE_CANA_ID320RX_2.SHELL.BASE HWE_CANA_ID330TX_1.SHELL.BASE HWE_CANA_ID330TX_2.SHELL.BASE HWE_CANA_ID340RX_1.SHELL.BASE HWE_CANA_ID340RX_2.SHELL.BASE HWE_CANA_ID358RX_1.SHELL.BASE HWE_CANA_ID358RX_2.SHELL.BASE HWE_CANA_ID500RX_1.SHELL.BASE HWE_CANA_ID500RX_2.SHELL.BASE HWE_CANA_ID510RX_1.SHELL.BASE HWE_CANA_ID510RX_2.SHELL.BASE HWE_CANA_ID620TX_1.SHELL.BASE HWE_CANA_ID620TX_2.SHELL.BASE HWE_CANA_ID630RX_1.SHELL.BASE HWE_CANA_ID630RX_2.SHELL.BASE HWE_CANA_ID640RX_1.SHELL.BASE HWE_CANA_ID640RX_2.SHELL.BASE HWE_CANA_InitAfterBusOff.SHELL.BASE HWE_CANA_OBD_TX_V7.SHELL.BASE HWE_CANA_stBusOff.SHELL.BASE HWE_CANB_CCP_DAQ0_V4.SHELL.BASE HWE_CANB_CCP_DAQ1_V5.SHELL.BASE HWE_CANB_CCP_DAQ2_V6.SHELL.BASE HWE_CANB_CCP_RX_V2.SHELL.BASE HWE_CANB_CCP_TX_V3.SHELL.BASE HWE_CANB_ID348RXB_1.SHELL.BASE HWE_CANB_ID348RXB_2.SHELL.BASE HWE_CANB_ID350TX_1.SHELL.BASE HWE_CANB_ID350TX_2.SHELL.BASE HWE_CANB_ID360TX_1.SHELL.BASE HWE_CANB_ID360TX_2.SHELL.BASE HWE_CANB_ID380TX_1.SHELL.BASE HWE_CANB_ID380TX_2.SHELL.BASE HWE_CANB_ID578RXB_1.SHELL.BASE HWE_CANB_ID578RXB_2.SHELL.BASE HWE_CANB_ID590RXB_1.SHELL.BASE HWE_CANB_ID590RXB_2.SHELL.BASE HWE_CANB_ID5FFTX_1.SHELL.BASE HWE_CANB_ID5FFTX_2.SHELL.BASE HWE_CANB_ID690TX_1.SHELL.BASE HWE_CANB_ID690TX_2.SHELL.BASE HWE_CANB_ID691TX_1.SHELL.BASE HWE_CANB_ID691TX_2.SHELL.BASE HWE_CANB_ID695TX_1.SHELL.BASE HWE_CANB_ID695TX_2.SHELL.BASE HWE_CANB_ID696RXB_1.SHELL.BASE HWE_CANB_InitAfterBusOff.SHELL.BASE HWE_CANB_MUX_ID5xx_V8.SHELL.BASE HWE_CANB_MUX_ID5xx_V8_U32_1.SHELL.BASE HWE_CANB_MUX_ID5xx_V8_U32_2.SHELL.BASE HWE_CANB_stBusOff.SHELL.BASE HWE_CANC_ID100TX_1.SHELL.BASE HWE_CANC_ID100TX_2.SHELL.BASE HWE_CANC_ID101RX_1.SHELL.BASE HWE_CANC_ID101RX_2.SHELL.BASE HWE_CANC_InitAfterBusOff.SHELL.BASE HWE_CANC_stBusOff.SHELL.BASE HWE_CAN_DisableNormalMsgTx.SHELL.BASE HWE_CJ230A_Err.SHELL.BASE HWE_CJ230A_Stat.SHELL.BASE HWE_CJ230B_Err.SHELL.BASE HWE_CJ230B_Stat.SHELL.BASE HWE_CJ945A_Err.SHELL.BASE HWE_CJ945A_Stat.SHELL.BASE HWE_CJ945B_Err.SHELL.BASE HWE_CJ945B_Stat.SHELL.BASE HWE_Can_DiagOpSwitch.SHELL.BASE HWE_Can_Rx_Ok.SHELL.BASE HWE_EepBlk_State.SHELL.BASE HWE_Eep_AfterRun_st.SHELL.BASE HWE_Eep_Format.SHELL.BASE HWE_Enter_NL.SHELL.BASE HWE_IA01.SHELL.BASE HWE_IA02.SHELL.BASE HWE_IA03.SHELL.BASE HWE_IA04.SHELL.BASE HWE_IA05.SHELL.BASE HWE_IA06.SHELL.BASE HWE_IA07.SHELL.BASE HWE_IA08.SHELL.BASE HWE_IA09.SHELL.BASE HWE_IA10.SHELL.BASE HWE_IA11.SHELL.BASE HWE_IA12.SHELL.BASE HWE_IA13.SHELL.BASE HWE_IA14.SHELL.BASE HWE_IA15.SHELL.BASE HWE_IA16.SHELL.BASE HWE_IA17.SHELL.BASE HWE_IA18.SHELL.BASE HWE_IA19.SHELL.BASE HWE_IA20.SHELL.BASE HWE_IA21.SHELL.BASE HWE_IA22.SHELL.BASE HWE_IA25.SHELL.BASE HWE_IA26.SHELL.BASE HWE_IA_IPS.SHELL.BASE HWE_IA_ITS.SHELL.BASE HWE_IA_TER30.SHELL.BASE HWE_IA_TER30B.SHELL.BASE HWE_ID101RX_failure.SHELL.BASE HWE_ID250RX_failure.SHELL.BASE HWE_ID258RX_failure.SHELL.BASE HWE_ID290RX_failure.SHELL.BASE HWE_ID320RX_failure.SHELL.BASE HWE_ID340RX_failure.SHELL.BASE HWE_ID348RXB_failure.SHELL.BASE HWE_ID358RX_failure.SHELL.BASE HWE_ID500RX_failure.SHELL.BASE HWE_ID510RX_failure.SHELL.BASE HWE_ID578RXB_failure.SHELL.BASE HWE_ID590RXB_failure.SHELL.BASE HWE_ID590RXB_failure_1.SHELL.BASE HWE_ID630RX_failure.SHELL.BASE HWE_ID640RX_failure.SHELL.BASE HWE_ID696RXB_failure.SHELL.BASE HWE_ID696RXB_failure_1.SHELL.BASE HWE_ID710RX_failure.SHELL.BASE HWE_ID760RX_failure.SHELL.BASE HWE_IP01_Dio.SHELL.BASE HWE_IP02_Dio.SHELL.BASE HWE_IP03_Dio.SHELL.BASE HWE_IP04_Dio.SHELL.BASE HWE_IP05_Dio.SHELL.BASE HWE_IP06_Dio.SHELL.BASE HWE_IP07_Dio.SHELL.BASE HWE_IP08_Dio.SHELL.BASE HWE_IP09_Dcyc.SHELL.BASE HWE_IP09_Err.SHELL.BASE HWE_IP09_Per.SHELL.BASE HWE_IP10_Dcyc.SHELL.BASE HWE_IP10_Err.SHELL.BASE HWE_IP10_Per.SHELL.BASE HWE_IP11_Dcyc.SHELL.BASE HWE_IP11_Err.SHELL.BASE HWE_IP11_Per.SHELL.BASE HWE_IP12_Dcyc.SHELL.BASE HWE_IP12_Err.SHELL.BASE HWE_IP12_Per.SHELL.BASE HWE_IS01.SHELL.BASE HWE_IS02.SHELL.BASE HWE_IS03.SHELL.BASE HWE_IS04.SHELL.BASE HWE_IS05.SHELL.BASE HWE_IS06.SHELL.BASE HWE_IS07.SHELL.BASE HWE_IS08.SHELL.BASE HWE_IS09.SHELL.BASE HWE_IS10.SHELL.BASE HWE_IS11.SHELL.BASE HWE_IS12.SHELL.BASE HWE_IS_ON.SHELL.BASE HWE_IS_TER15.SHELL.BASE HWE_IS_TER15R.SHELL.BASE HWE_IS_TER50.SHELL.BASE HWE_IS_WDA.SHELL.BASE HWE_OIC01_Dcyc.SHELL.BASE HWE_OIC01_DiagReg.SHELL.BASE HWE_OIC01_DiagRet.SHELL.BASE HWE_OIC01_Err.SHELL.BASE HWE_OIC01_Stat.SHELL.BASE HWE_OIC02_Dcyc.SHELL.BASE HWE_OIC02_Diag.SHELL.BASE HWE_OIC02_DiagReg.SHELL.BASE HWE_OIC02_DiagRet.SHELL.BASE HWE_OIC02_Err.SHELL.BASE HWE_OIC02_Stat.SHELL.BASE HWE_OPI01_Dcyc.SHELL.BASE HWE_OPI01_Err.SHELL.BASE HWE_OPI01_Stat.SHELL.BASE HWE_OPI02_Dcyc.SHELL.BASE HWE_OPI02_Err.SHELL.BASE HWE_OPI02_Stat.SHELL.BASE HWE_OPI03_Dcyc.SHELL.BASE HWE_OPI03_Err.SHELL.BASE HWE_OPI03_Stat.SHELL.BASE HWE_OPI04_Dcyc.SHELL.BASE HWE_OPI04_Err.SHELL.BASE HWE_OPI04_Stat.SHELL.BASE HWE_OPI05_Dcyc.SHELL.BASE HWE_OPI05_Err.SHELL.BASE HWE_OPI05_Stat.SHELL.BASE HWE_OPI06_Dcyc.SHELL.BASE HWE_OPI06_Err.SHELL.BASE HWE_OPI06_Stat.SHELL.BASE HWE_OPI07_Dcyc.SHELL.BASE HWE_OPI07_Err.SHELL.BASE HWE_OPI07_Stat.SHELL.BASE HWE_OPI08_Dcyc.SHELL.BASE HWE_OPI08_Err.SHELL.BASE HWE_OPI08_Stat.SHELL.BASE HWE_OPI09_Dcyc.SHELL.BASE HWE_OPI09_Err.SHELL.BASE HWE_OPI09_Stat.SHELL.BASE HWE_OPI10_Dcyc.SHELL.BASE HWE_OPI10_Err.SHELL.BASE HWE_OPI10_Stat.SHELL.BASE HWE_OPI11_Dcyc.SHELL.BASE HWE_OPI11_Err.SHELL.BASE HWE_OPI11_Stat.SHELL.BASE HWE_OS01_DiagReg.SHELL.BASE HWE_OS01_DiagRet.SHELL.BASE HWE_OS01_DiagStat.SHELL.BASE HWE_OS01_Disable.SHELL.BASE HWE_OS01_En.SHELL.BASE HWE_OS01_Err.SHELL.BASE HWE_OS01_S_Dcyc.SHELL.BASE HWE_OS01_Stat.SHELL.BASE HWE_OS01_V.SHELL.BASE HWE_OS02_DiagReg.SHELL.BASE HWE_OS02_DiagRet.SHELL.BASE HWE_OS02_DiagStat.SHELL.BASE HWE_OS02_Disable.SHELL.BASE HWE_OS02_En.SHELL.BASE HWE_OS02_Err.SHELL.BASE HWE_OS02_S_Dcyc.SHELL.BASE HWE_OS02_Stat.SHELL.BASE HWE_OS02_V.SHELL.BASE HWE_OS03.SHELL.BASE HWE_OS03_Err.SHELL.BASE HWE_OS03_Stat.SHELL.BASE HWE_OS04.SHELL.BASE HWE_OS04_Err.SHELL.BASE HWE_OS04_Stat.SHELL.BASE HWE_OS05a.SHELL.BASE HWE_OS05a_Err.SHELL.BASE HWE_OS05a_Stat.SHELL.BASE HWE_OS05b.SHELL.BASE HWE_OS05b_Err.SHELL.BASE HWE_OS05b_Stat.SHELL.BASE HWE_OS05c.SHELL.BASE HWE_OS05c_Err.SHELL.BASE HWE_OS05c_Stat.SHELL.BASE HWE_OS06.SHELL.BASE HWE_OS06_Err.SHELL.BASE HWE_OS06_Stat.SHELL.BASE HWE_OS07.SHELL.BASE HWE_OS07_Err.SHELL.BASE HWE_OS07_Stat.SHELL.BASE HWE_OS08.SHELL.BASE HWE_OS08_Err.SHELL.BASE HWE_OS08_Stat.SHELL.BASE HWE_OS09.SHELL.BASE HWE_OS09_Err.SHELL.BASE HWE_OS09_Stat.SHELL.BASE HWE_OS10.SHELL.BASE HWE_OS10_Err.SHELL.BASE HWE_OS10_Stat.SHELL.BASE HWE_OS11.SHELL.BASE HWE_OS11_Err.SHELL.BASE HWE_OS11_Stat.SHELL.BASE HWE_OS12.SHELL.BASE HWE_OS12_Err.SHELL.BASE HWE_OS12_Stat.SHELL.BASE HWE_OS13.SHELL.BASE HWE_OS13_Err.SHELL.BASE HWE_OS13_Stat.SHELL.BASE HWE_OS14.SHELL.BASE HWE_OS14_Err.SHELL.BASE HWE_OS14_Stat.SHELL.BASE HWE_OS15.SHELL.BASE HWE_OS15_Err.SHELL.BASE HWE_OS15_Stat.SHELL.BASE HWE_OS_MR.SHELL.BASE HWE_OS_ModelState.SHELL.BASE HWE_PowerfailDetected.HWE.BASE HWE_ResetMonitor_Adr.HWE.BASE HWE_ResetMonitor_Counter.HWE.BASE HWE_ResetMonitor_ID.HWE.BASE HWE_ResetMonitor_RSR.HWE.BASE HWE_ResetMonitor_Time.HWE.BASE HWE_Rtmo_ctSample.SHELL.BASE HWE_Rtmo_ctSampleProc.SHELL.BASE HWE_Rtmo_pLoadMax.SHELL.BASE HWE_Rtmo_tiAbsMax.SHELL.BASE HWE_Rtmo_tiAbsMax_1.SHELL.BASE HWE_Rtmo_tiAbsMin.SHELL.BASE HWE_Rtmo_tiAvrg.SHELL.BASE HWE_Rtmo_tiMax.SHELL.BASE HWE_Rtmo_tiMaxCallDist.SHELL.BASE HWE_Rtmo_tiMin.SHELL.BASE HWE_Rtmo_tiMinCallDist.SHELL.BASE HWE_ServiceCounter_st.SHELL.BASE HWE_SwitchOff.SHELL.BASE Result.Time_Calc.HWE.BASE Samp_Time_result.HWE.BASE TimeStampOne.Time_Calc.HWE.BASE TimeStampTwo.Time_Calc.HWE.BASE Timer_Zero_Error.HWE.BASE Tx_time_result.HWE.BASE Tx_time_sum.HWE.BASE _HWE_CAN_A_BAUDRATE_V_unused.SHELL.BASE _HWE_CAN_B_BAUDRATE_V_unused.SHELL.BASE _HWE_CAN_C_BAUDRATE_V_unused.SHELL.BASE g_CAN_B_IRQ_MaxExeTime_u32.HWE.BASE g_Target_D_DIVF_u32.HWE_TARGET.BASE g_Target_D_IMBSPEED_u32.HWE_TARGET.BASE g_Target_D_MF_u32.HWE_TARGET.BASE g_Target_D_TBS_u32.HWE_TARGET.BASE g_Target_D_TB_NORM_MUL_u32.HWE_TARGET.BASE g_Target_F_IMB_u32.HWE_TARGET.BASE g_Target_F_OSC_u32.HWE_TARGET.BASE g_Target_F_SYS_u32.HWE_TARGET.BASE g_Target_F_TB_u32.HWE_TARGET.BASE g_Target_SysTick_in_ns_u32.HWE_TARGET.BASE is_started.Time_Calc.HWE.BASE l_CAN_B_IRQ_ExeTime_u32.HWE.BASE l_CAN_B_IRQ_begin_u32.HWE.BASE l_baudrate_calculated_f32.HWE_CAN_A.SHELL.BASE l_baudrate_calculated_f32.HWE_CAN_B.SHELL.BASE l_baudrate_calculated_f32.HWE_CAN_C.SHELL.BASE l_baudrate_e.HWE_CAN_A.SHELL.BASE l_baudrate_e.HWE_CAN_B.SHELL.BASE l_baudrate_e.HWE_CAN_C.SHELL.BASE l_dBRP_u8.HWE_CAN_A.SHELL.BASE l_dBRP_u8.HWE_CAN_B.SHELL.BASE l_dBRP_u8.HWE_CAN_C.SHELL.BASE l_dPSeg1_u8.HWE_CAN_A.SHELL.BASE l_dPSeg1_u8.HWE_CAN_B.SHELL.BASE l_dPSeg1_u8.HWE_CAN_C.SHELL.BASE l_dPSeg2_u8.HWE_CAN_A.SHELL.BASE l_dPSeg2_u8.HWE_CAN_B.SHELL.BASE l_dPSeg2_u8.HWE_CAN_C.SHELL.BASE l_dPropSeg_u8.HWE_CAN_A.SHELL.BASE l_dPropSeg_u8.HWE_CAN_B.SHELL.BASE l_dPropSeg_u8.HWE_CAN_C.SHELL.BASE l_dSJW_u8.HWE_CAN_A.SHELL.BASE l_dSJW_u8.HWE_CAN_B.SHELL.BASE l_dSJW_u8.HWE_CAN_C.SHELL.BASE l_samplepoint_calculated_f32.HWE_CAN_A.SHELL.BASE l_samplepoint_calculated_f32.HWE_CAN_B.SHELL.BASE l_samplepoint_calculated_f32.HWE_CAN_C.SHELL.BASE test_counter.HWE.BASE /end REF_MEASUREMENT
 /begin REF_CHARACTERISTIC HWE_CANA_OBD_TX_P7.SHELL.BASE HWE_CANA_StopDebTicks.SHELL.BASE HWE_CANA_UseBusOffTimer.SHELL.BASE HWE_CANB_CCP_DAQ0_P4.SHELL.BASE HWE_CANB_CCP_DAQ1_P5.SHELL.BASE HWE_CANB_CCP_DAQ2_P6.SHELL.BASE HWE_CANB_CCP_RX_P2.SHELL.BASE HWE_CANB_CCP_TX_P3.SHELL.BASE HWE_CANB_MUX_ID5xx_P8.SHELL.BASE HWE_CANB_StopDebTicks.SHELL.BASE HWE_CANB_UseBusOffTimer.SHELL.BASE HWE_CANB_XCP_CMD_RX_P4.SHELL.BASE HWE_CANB_XCP_DAQ0_P6.SHELL.BASE HWE_CANB_XCP_RES_TX_P5.SHELL.BASE HWE_CANB_XCP_STIM0_P0.SHELL.BASE HWE_CANB_XCP_STIM1_P1.SHELL.BASE HWE_CANB_XCP_STIM2_P2.SHELL.BASE HWE_CANB_XCP_STIM3_P3.SHELL.BASE HWE_CANC_StopDebTicks.SHELL.BASE HWE_CANC_UseBusOffTimer.SHELL.BASE HWE_IP09_DcycMax.SHELL.BASE HWE_IP09_DcycMin.SHELL.BASE HWE_IP09_PerMax.SHELL.BASE HWE_IP09_PerMin.SHELL.BASE HWE_IP10_DcycMax.SHELL.BASE HWE_IP10_DcycMin.SHELL.BASE HWE_IP10_PerMax.SHELL.BASE HWE_IP10_PerMin.SHELL.BASE HWE_IP11_DcycMax.SHELL.BASE HWE_IP11_DcycMin.SHELL.BASE HWE_IP11_PerMax.SHELL.BASE HWE_IP11_PerMin.SHELL.BASE HWE_IP12_DcycMax.SHELL.BASE HWE_IP12_DcycMin.SHELL.BASE HWE_IP12_PerMax.SHELL.BASE HWE_IP12_PerMin.SHELL.BASE HWE_OIC01_Per.SHELL.BASE HWE_OIC02_Per.SHELL.BASE HWE_OPI01_Per.SHELL.BASE HWE_OPI02_Per.SHELL.BASE HWE_OPI03_Per.SHELL.BASE HWE_OPI04_Per.SHELL.BASE HWE_OPI05_Per.SHELL.BASE HWE_OPI06_Per.SHELL.BASE HWE_OPI07_Per.SHELL.BASE HWE_OPI08_Per.SHELL.BASE HWE_OPI09_Per.SHELL.BASE HWE_OPI10_Per.SHELL.BASE HWE_OPI11_Per.SHELL.BASE HWE_OS01_S_Per.SHELL.BASE HWE_OS02_S_Per.SHELL.BASE HWE_Rtmo_Tasks.HWE.BASE HWE_Rtmo_adStart.SHELL.BASE HWE_Rtmo_stSampleTime.SHELL.BASE iflag_mask.HWE.BASE p_baudrate_e.HWE_CAN_A.SHELL.BASE p_baudrate_e.HWE_CAN_B.SHELL.BASE p_baudrate_e.HWE_CAN_C.SHELL.BASE p_dBRP_u8.HWE_CAN_A.SHELL.BASE p_dBRP_u8.HWE_CAN_B.SHELL.BASE p_dBRP_u8.HWE_CAN_C.SHELL.BASE p_dPSeg1_u8.HWE_CAN_A.SHELL.BASE p_dPSeg1_u8.HWE_CAN_B.SHELL.BASE p_dPSeg1_u8.HWE_CAN_C.SHELL.BASE p_dPSeg2_u8.HWE_CAN_A.SHELL.BASE p_dPSeg2_u8.HWE_CAN_B.SHELL.BASE p_dPSeg2_u8.HWE_CAN_C.SHELL.BASE p_dPropSeg_u8.HWE_CAN_A.SHELL.BASE p_dPropSeg_u8.HWE_CAN_B.SHELL.BASE p_dPropSeg_u8.HWE_CAN_C.SHELL.BASE p_dSJW_u8.HWE_CAN_A.SHELL.BASE p_dSJW_u8.HWE_CAN_B.SHELL.BASE p_dSJW_u8.HWE_CAN_C.SHELL.BASE /end REF_CHARACTERISTIC
 /begin SUB_GROUP AS.BASE HWE.BASE HWE_TARGET.BASE SHELL.BASE /end SUB_GROUP
/end GROUP
/begin GROUP Bit_Test "" ROOT
 /begin REF_MEASUREMENT Bit_Sint16.P_Bit.Bit_Test Bit_Sint16_Bit_00.Extern_MEM.Bit_Test Bit_Sint16_Bit_00.Intern_MEM.Bit_Test Bit_Sint16_Bit_01.Extern_MEM.Bit_Test Bit_Sint16_Bit_01.Intern_MEM.Bit_Test Bit_Sint16_Bit_02.Extern_MEM.Bit_Test Bit_Sint16_Bit_02.Intern_MEM.Bit_Test Bit_Sint16_Bit_03.Extern_MEM.Bit_Test Bit_Sint16_Bit_03.Intern_MEM.Bit_Test Bit_Sint16_Bit_04.Extern_MEM.Bit_Test Bit_Sint16_Bit_04.Intern_MEM.Bit_Test Bit_Sint16_Bit_05.Extern_MEM.Bit_Test Bit_Sint16_Bit_05.Intern_MEM.Bit_Test Bit_Sint16_Bit_06.Extern_MEM.Bit_Test Bit_Sint16_Bit_06.Intern_MEM.Bit_Test Bit_Sint16_Bit_07.Extern_MEM.Bit_Test Bit_Sint16_Bit_07.Intern_MEM.Bit_Test Bit_Sint16_Bit_08.Extern_MEM.Bit_Test Bit_Sint16_Bit_08.Intern_MEM.Bit_Test Bit_Sint16_Bit_09.Extern_MEM.Bit_Test Bit_Sint16_Bit_09.Intern_MEM.Bit_Test Bit_Sint16_Bit_10.Extern_MEM.Bit_Test Bit_Sint16_Bit_10.Intern_MEM.Bit_Test Bit_Sint16_Bit_11.Extern_MEM.Bit_Test Bit_Sint16_Bit_11.Intern_MEM.Bit_Test Bit_Sint16_Bit_12.Extern_MEM.Bit_Test Bit_Sint16_Bit_12.Intern_MEM.Bit_Test Bit_Sint16_Bit_13.Extern_MEM.Bit_Test Bit_Sint16_Bit_13.Intern_MEM.Bit_Test Bit_Sint16_Bit_14.Extern_MEM.Bit_Test Bit_Sint16_Bit_14.Intern_MEM.Bit_Test Bit_Sint16_Bit_15.Extern_MEM.Bit_Test Bit_Sint16_Bit_15.Intern_MEM.Bit_Test Bit_Sint16_Bit_x.Extern_MEM.Bit_Test Bit_Sint16_Bit_x.Intern_MEM.Bit_Test Bit_Sint32.P_Bit.Bit_Test Bit_Sint32_Bit_00.Extern_MEM.Bit_Test Bit_Sint32_Bit_00.Intern_MEM.Bit_Test Bit_Sint32_Bit_01.Extern_MEM.Bit_Test Bit_Sint32_Bit_01.Intern_MEM.Bit_Test Bit_Sint32_Bit_02.Extern_MEM.Bit_Test Bit_Sint32_Bit_02.Intern_MEM.Bit_Test Bit_Sint32_Bit_03.Extern_MEM.Bit_Test Bit_Sint32_Bit_03.Intern_MEM.Bit_Test Bit_Sint32_Bit_04.Extern_MEM.Bit_Test Bit_Sint32_Bit_04.Intern_MEM.Bit_Test Bit_Sint32_Bit_05.Extern_MEM.Bit_Test Bit_Sint32_Bit_05.Intern_MEM.Bit_Test Bit_Sint32_Bit_06.Extern_MEM.Bit_Test Bit_Sint32_Bit_06.Intern_MEM.Bit_Test Bit_Sint32_Bit_07.Extern_MEM.Bit_Test Bit_Sint32_Bit_07.Intern_MEM.Bit_Test Bit_Sint32_Bit_08.Extern_MEM.Bit_Test Bit_Sint32_Bit_08.Intern_MEM.Bit_Test Bit_Sint32_Bit_09.Extern_MEM.Bit_Test Bit_Sint32_Bit_09.Intern_MEM.Bit_Test Bit_Sint32_Bit_10.Extern_MEM.Bit_Test Bit_Sint32_Bit_10.Intern_MEM.Bit_Test Bit_Sint32_Bit_11.Extern_MEM.Bit_Test Bit_Sint32_Bit_11.Intern_MEM.Bit_Test Bit_Sint32_Bit_12.Extern_MEM.Bit_Test Bit_Sint32_Bit_12.Intern_MEM.Bit_Test Bit_Sint32_Bit_13.Extern_MEM.Bit_Test Bit_Sint32_Bit_13.Intern_MEM.Bit_Test Bit_Sint32_Bit_14.Extern_MEM.Bit_Test Bit_Sint32_Bit_14.Intern_MEM.Bit_Test Bit_Sint32_Bit_15.Extern_MEM.Bit_Test Bit_Sint32_Bit_15.Intern_MEM.Bit_Test Bit_Sint32_Bit_16.Extern_MEM.Bit_Test Bit_Sint32_Bit_16.Intern_MEM.Bit_Test Bit_Sint32_Bit_17.Extern_MEM.Bit_Test Bit_Sint32_Bit_17.Intern_MEM.Bit_Test Bit_Sint32_Bit_18.Extern_MEM.Bit_Test Bit_Sint32_Bit_18.Intern_MEM.Bit_Test Bit_Sint32_Bit_19.Extern_MEM.Bit_Test Bit_Sint32_Bit_19.Intern_MEM.Bit_Test Bit_Sint32_Bit_20.Extern_MEM.Bit_Test Bit_Sint32_Bit_20.Intern_MEM.Bit_Test Bit_Sint32_Bit_21.Extern_MEM.Bit_Test Bit_Sint32_Bit_21.Intern_MEM.Bit_Test Bit_Sint32_Bit_22.Extern_MEM.Bit_Test Bit_Sint32_Bit_22.Intern_MEM.Bit_Test Bit_Sint32_Bit_23.Extern_MEM.Bit_Test Bit_Sint32_Bit_23.Intern_MEM.Bit_Test Bit_Sint32_Bit_24.Extern_MEM.Bit_Test Bit_Sint32_Bit_24.Intern_MEM.Bit_Test Bit_Sint32_Bit_25.Extern_MEM.Bit_Test Bit_Sint32_Bit_25.Intern_MEM.Bit_Test Bit_Sint32_Bit_26.Extern_MEM.Bit_Test Bit_Sint32_Bit_26.Intern_MEM.Bit_Test Bit_Sint32_Bit_27.Extern_MEM.Bit_Test Bit_Sint32_Bit_27.Intern_MEM.Bit_Test Bit_Sint32_Bit_28.Extern_MEM.Bit_Test Bit_Sint32_Bit_28.Intern_MEM.Bit_Test Bit_Sint32_Bit_29.Extern_MEM.Bit_Test Bit_Sint32_Bit_29.Intern_MEM.Bit_Test Bit_Sint32_Bit_30.Extern_MEM.Bit_Test Bit_Sint32_Bit_30.Intern_MEM.Bit_Test Bit_Sint32_Bit_31.Extern_MEM.Bit_Test Bit_Sint32_Bit_31.Intern_MEM.Bit_Test Bit_Sint32_Bit_x.Extern_MEM.Bit_Test Bit_Sint32_Bit_x.Intern_MEM.Bit_Test Bit_Sint8.P_Bit.Bit_Test Bit_Sint8_E_Bit_0.Extern_MEM.Bit_Test Bit_Sint8_E_Bit_0.Intern_MEM.Bit_Test Bit_Sint8_E_Bit_1.Extern_MEM.Bit_Test Bit_Sint8_E_Bit_1.Intern_MEM.Bit_Test Bit_Sint8_E_Bit_2.Extern_MEM.Bit_Test Bit_Sint8_E_Bit_2.Intern_MEM.Bit_Test Bit_Sint8_E_Bit_3.Extern_MEM.Bit_Test Bit_Sint8_E_Bit_3.Intern_MEM.Bit_Test Bit_Sint8_E_Bit_4.Extern_MEM.Bit_Test Bit_Sint8_E_Bit_4.Intern_MEM.Bit_Test Bit_Sint8_E_Bit_5.Extern_MEM.Bit_Test Bit_Sint8_E_Bit_5.Intern_MEM.Bit_Test Bit_Sint8_E_Bit_6.Extern_MEM.Bit_Test Bit_Sint8_E_Bit_6.Intern_MEM.Bit_Test Bit_Sint8_E_Bit_7.Extern_MEM.Bit_Test Bit_Sint8_E_Bit_7.Intern_MEM.Bit_Test Bit_Sint8_E_Bit_x.Extern_MEM.Bit_Test Bit_Sint8_E_Bit_x.Intern_MEM.Bit_Test Bit_Sint8_O_Bit_0.Extern_MEM.Bit_Test Bit_Sint8_O_Bit_0.Intern_MEM.Bit_Test Bit_Sint8_O_Bit_1.Extern_MEM.Bit_Test Bit_Sint8_O_Bit_1.Intern_MEM.Bit_Test Bit_Sint8_O_Bit_2.Extern_MEM.Bit_Test Bit_Sint8_O_Bit_2.Intern_MEM.Bit_Test Bit_Sint8_O_Bit_3.Extern_MEM.Bit_Test Bit_Sint8_O_Bit_3.Intern_MEM.Bit_Test Bit_Sint8_O_Bit_4.Extern_MEM.Bit_Test Bit_Sint8_O_Bit_4.Intern_MEM.Bit_Test Bit_Sint8_O_Bit_5.Extern_MEM.Bit_Test Bit_Sint8_O_Bit_5.Intern_MEM.Bit_Test Bit_Sint8_O_Bit_6.Extern_MEM.Bit_Test Bit_Sint8_O_Bit_6.Intern_MEM.Bit_Test Bit_Sint8_O_Bit_7.Extern_MEM.Bit_Test Bit_Sint8_O_Bit_7.Intern_MEM.Bit_Test Bit_Sint8_O_Bit_x.Extern_MEM.Bit_Test Bit_Sint8_O_Bit_x.Intern_MEM.Bit_Test Bit_Uint16.P_Bit.Bit_Test Bit_Uint16_Bit_00.Extern_MEM.Bit_Test Bit_Uint16_Bit_00.Intern_MEM.Bit_Test Bit_Uint16_Bit_01.Extern_MEM.Bit_Test Bit_Uint16_Bit_01.Intern_MEM.Bit_Test Bit_Uint16_Bit_02.Extern_MEM.Bit_Test Bit_Uint16_Bit_02.Intern_MEM.Bit_Test Bit_Uint16_Bit_03.Extern_MEM.Bit_Test Bit_Uint16_Bit_03.Intern_MEM.Bit_Test Bit_Uint16_Bit_04.Extern_MEM.Bit_Test Bit_Uint16_Bit_04.Intern_MEM.Bit_Test Bit_Uint16_Bit_05.Extern_MEM.Bit_Test Bit_Uint16_Bit_05.Intern_MEM.Bit_Test Bit_Uint16_Bit_06.Extern_MEM.Bit_Test Bit_Uint16_Bit_06.Intern_MEM.Bit_Test Bit_Uint16_Bit_07.Extern_MEM.Bit_Test Bit_Uint16_Bit_07.Intern_MEM.Bit_Test Bit_Uint16_Bit_08.Extern_MEM.Bit_Test Bit_Uint16_Bit_08.Intern_MEM.Bit_Test Bit_Uint16_Bit_09.Extern_MEM.Bit_Test Bit_Uint16_Bit_09.Intern_MEM.Bit_Test Bit_Uint16_Bit_10.Extern_MEM.Bit_Test Bit_Uint16_Bit_10.Intern_MEM.Bit_Test Bit_Uint16_Bit_11.Extern_MEM.Bit_Test Bit_Uint16_Bit_11.Intern_MEM.Bit_Test Bit_Uint16_Bit_12.Extern_MEM.Bit_Test Bit_Uint16_Bit_12.Intern_MEM.Bit_Test Bit_Uint16_Bit_13.Extern_MEM.Bit_Test Bit_Uint16_Bit_13.Intern_MEM.Bit_Test Bit_Uint16_Bit_14.Extern_MEM.Bit_Test Bit_Uint16_Bit_14.Intern_MEM.Bit_Test Bit_Uint16_Bit_15.Extern_MEM.Bit_Test Bit_Uint16_Bit_15.Intern_MEM.Bit_Test Bit_Uint16_Bit_x.Extern_MEM.Bit_Test Bit_Uint16_Bit_x.Intern_MEM.Bit_Test Bit_Uint32.P_Bit.Bit_Test Bit_Uint32_Bit_00.Extern_MEM.Bit_Test Bit_Uint32_Bit_00.Intern_MEM.Bit_Test Bit_Uint32_Bit_01.Extern_MEM.Bit_Test Bit_Uint32_Bit_01.Intern_MEM.Bit_Test Bit_Uint32_Bit_02.Extern_MEM.Bit_Test Bit_Uint32_Bit_02.Intern_MEM.Bit_Test Bit_Uint32_Bit_03.Extern_MEM.Bit_Test Bit_Uint32_Bit_03.Intern_MEM.Bit_Test Bit_Uint32_Bit_04.Extern_MEM.Bit_Test Bit_Uint32_Bit_04.Intern_MEM.Bit_Test Bit_Uint32_Bit_05.Extern_MEM.Bit_Test Bit_Uint32_Bit_05.Intern_MEM.Bit_Test Bit_Uint32_Bit_06.Extern_MEM.Bit_Test Bit_Uint32_Bit_06.Intern_MEM.Bit_Test Bit_Uint32_Bit_07.Extern_MEM.Bit_Test Bit_Uint32_Bit_07.Intern_MEM.Bit_Test Bit_Uint32_Bit_08.Extern_MEM.Bit_Test Bit_Uint32_Bit_08.Intern_MEM.Bit_Test Bit_Uint32_Bit_09.Extern_MEM.Bit_Test Bit_Uint32_Bit_09.Intern_MEM.Bit_Test Bit_Uint32_Bit_10.Extern_MEM.Bit_Test Bit_Uint32_Bit_10.Intern_MEM.Bit_Test Bit_Uint32_Bit_11.Extern_MEM.Bit_Test Bit_Uint32_Bit_11.Intern_MEM.Bit_Test Bit_Uint32_Bit_12.Extern_MEM.Bit_Test Bit_Uint32_Bit_12.Intern_MEM.Bit_Test Bit_Uint32_Bit_13.Extern_MEM.Bit_Test Bit_Uint32_Bit_13.Intern_MEM.Bit_Test Bit_Uint32_Bit_14.Extern_MEM.Bit_Test Bit_Uint32_Bit_14.Intern_MEM.Bit_Test Bit_Uint32_Bit_15.Extern_MEM.Bit_Test Bit_Uint32_Bit_15.Intern_MEM.Bit_Test Bit_Uint32_Bit_16.Extern_MEM.Bit_Test Bit_Uint32_Bit_16.Intern_MEM.Bit_Test Bit_Uint32_Bit_17.Extern_MEM.Bit_Test Bit_Uint32_Bit_17.Intern_MEM.Bit_Test Bit_Uint32_Bit_18.Extern_MEM.Bit_Test Bit_Uint32_Bit_18.Intern_MEM.Bit_Test Bit_Uint32_Bit_19.Extern_MEM.Bit_Test Bit_Uint32_Bit_19.Intern_MEM.Bit_Test Bit_Uint32_Bit_20.Extern_MEM.Bit_Test Bit_Uint32_Bit_20.Intern_MEM.Bit_Test Bit_Uint32_Bit_21.Extern_MEM.Bit_Test Bit_Uint32_Bit_21.Intern_MEM.Bit_Test Bit_Uint32_Bit_22.Extern_MEM.Bit_Test Bit_Uint32_Bit_22.Intern_MEM.Bit_Test Bit_Uint32_Bit_23.Extern_MEM.Bit_Test Bit_Uint32_Bit_23.Intern_MEM.Bit_Test Bit_Uint32_Bit_24.Extern_MEM.Bit_Test Bit_Uint32_Bit_24.Intern_MEM.Bit_Test Bit_Uint32_Bit_25.Extern_MEM.Bit_Test Bit_Uint32_Bit_25.Intern_MEM.Bit_Test Bit_Uint32_Bit_26.Extern_MEM.Bit_Test Bit_Uint32_Bit_26.Intern_MEM.Bit_Test Bit_Uint32_Bit_27.Extern_MEM.Bit_Test Bit_Uint32_Bit_27.Intern_MEM.Bit_Test Bit_Uint32_Bit_28.Extern_MEM.Bit_Test Bit_Uint32_Bit_28.Intern_MEM.Bit_Test Bit_Uint32_Bit_29.Extern_MEM.Bit_Test Bit_Uint32_Bit_29.Intern_MEM.Bit_Test Bit_Uint32_Bit_30.Extern_MEM.Bit_Test Bit_Uint32_Bit_30.Intern_MEM.Bit_Test Bit_Uint32_Bit_31.Extern_MEM.Bit_Test Bit_Uint32_Bit_31.Intern_MEM.Bit_Test Bit_Uint32_Bit_x.Extern_MEM.Bit_Test Bit_Uint32_Bit_x.Intern_MEM.Bit_Test Bit_Uint8.P_Bit.Bit_Test Bit_Uint8_E_Bit_0.Extern_MEM.Bit_Test Bit_Uint8_E_Bit_0.Intern_MEM.Bit_Test Bit_Uint8_E_Bit_1.Extern_MEM.Bit_Test Bit_Uint8_E_Bit_1.Intern_MEM.Bit_Test Bit_Uint8_E_Bit_2.Extern_MEM.Bit_Test Bit_Uint8_E_Bit_2.Intern_MEM.Bit_Test Bit_Uint8_E_Bit_3.Extern_MEM.Bit_Test Bit_Uint8_E_Bit_3.Intern_MEM.Bit_Test Bit_Uint8_E_Bit_4.Extern_MEM.Bit_Test Bit_Uint8_E_Bit_4.Intern_MEM.Bit_Test Bit_Uint8_E_Bit_5.Extern_MEM.Bit_Test Bit_Uint8_E_Bit_5.Intern_MEM.Bit_Test Bit_Uint8_E_Bit_6.Extern_MEM.Bit_Test Bit_Uint8_E_Bit_6.Intern_MEM.Bit_Test Bit_Uint8_E_Bit_7.Extern_MEM.Bit_Test Bit_Uint8_E_Bit_7.Intern_MEM.Bit_Test Bit_Uint8_E_Bit_x.Extern_MEM.Bit_Test Bit_Uint8_E_Bit_x.Intern_MEM.Bit_Test Bit_Uint8_O_Bit_0.Extern_MEM.Bit_Test Bit_Uint8_O_Bit_0.Intern_MEM.Bit_Test Bit_Uint8_O_Bit_1.Extern_MEM.Bit_Test Bit_Uint8_O_Bit_1.Intern_MEM.Bit_Test Bit_Uint8_O_Bit_2.Extern_MEM.Bit_Test Bit_Uint8_O_Bit_2.Intern_MEM.Bit_Test Bit_Uint8_O_Bit_3.Extern_MEM.Bit_Test Bit_Uint8_O_Bit_3.Intern_MEM.Bit_Test Bit_Uint8_O_Bit_4.Extern_MEM.Bit_Test Bit_Uint8_O_Bit_4.Intern_MEM.Bit_Test Bit_Uint8_O_Bit_5.Extern_MEM.Bit_Test Bit_Uint8_O_Bit_5.Intern_MEM.Bit_Test Bit_Uint8_O_Bit_6.Extern_MEM.Bit_Test Bit_Uint8_O_Bit_6.Intern_MEM.Bit_Test Bit_Uint8_O_Bit_7.Extern_MEM.Bit_Test Bit_Uint8_O_Bit_7.Intern_MEM.Bit_Test Bit_Uint8_O_Bit_x.Extern_MEM.Bit_Test Bit_Uint8_O_Bit_x.Intern_MEM.Bit_Test l_UpdateBitTest_b.Bit_Test /end REF_MEASUREMENT
 /begin REF_CHARACTERISTIC P_Bit_Sint16.Extern_MEM.Bit_Test P_Bit_Sint16.Intern_MEM.Bit_Test P_Bit_Sint16_Bit_00.P_Bit.Bit_Test P_Bit_Sint16_Bit_01.P_Bit.Bit_Test P_Bit_Sint16_Bit_02.P_Bit.Bit_Test P_Bit_Sint16_Bit_03.P_Bit.Bit_Test P_Bit_Sint16_Bit_04.P_Bit.Bit_Test P_Bit_Sint16_Bit_05.P_Bit.Bit_Test P_Bit_Sint16_Bit_06.P_Bit.Bit_Test P_Bit_Sint16_Bit_07.P_Bit.Bit_Test P_Bit_Sint16_Bit_08.P_Bit.Bit_Test P_Bit_Sint16_Bit_09.P_Bit.Bit_Test P_Bit_Sint16_Bit_10.P_Bit.Bit_Test P_Bit_Sint16_Bit_11.P_Bit.Bit_Test P_Bit_Sint16_Bit_12.P_Bit.Bit_Test P_Bit_Sint16_Bit_13.P_Bit.Bit_Test P_Bit_Sint16_Bit_14.P_Bit.Bit_Test P_Bit_Sint16_Bit_15.P_Bit.Bit_Test P_Bit_Sint32.Extern_MEM.Bit_Test P_Bit_Sint32.Intern_MEM.Bit_Test P_Bit_Sint32_Bit_00.P_Bit.Bit_Test P_Bit_Sint32_Bit_01.P_Bit.Bit_Test P_Bit_Sint32_Bit_02.P_Bit.Bit_Test P_Bit_Sint32_Bit_03.P_Bit.Bit_Test P_Bit_Sint32_Bit_04.P_Bit.Bit_Test P_Bit_Sint32_Bit_05.P_Bit.Bit_Test P_Bit_Sint32_Bit_06.P_Bit.Bit_Test P_Bit_Sint32_Bit_07.P_Bit.Bit_Test P_Bit_Sint32_Bit_08.P_Bit.Bit_Test P_Bit_Sint32_Bit_09.P_Bit.Bit_Test P_Bit_Sint32_Bit_10.P_Bit.Bit_Test P_Bit_Sint32_Bit_11.P_Bit.Bit_Test P_Bit_Sint32_Bit_12.P_Bit.Bit_Test P_Bit_Sint32_Bit_13.P_Bit.Bit_Test P_Bit_Sint32_Bit_14.P_Bit.Bit_Test P_Bit_Sint32_Bit_15.P_Bit.Bit_Test P_Bit_Sint32_Bit_16.P_Bit.Bit_Test P_Bit_Sint32_Bit_17.P_Bit.Bit_Test P_Bit_Sint32_Bit_18.P_Bit.Bit_Test P_Bit_Sint32_Bit_19.P_Bit.Bit_Test P_Bit_Sint32_Bit_20.P_Bit.Bit_Test P_Bit_Sint32_Bit_21.P_Bit.Bit_Test P_Bit_Sint32_Bit_22.P_Bit.Bit_Test P_Bit_Sint32_Bit_23.P_Bit.Bit_Test P_Bit_Sint32_Bit_24.P_Bit.Bit_Test P_Bit_Sint32_Bit_25.P_Bit.Bit_Test P_Bit_Sint32_Bit_26.P_Bit.Bit_Test P_Bit_Sint32_Bit_27.P_Bit.Bit_Test P_Bit_Sint32_Bit_28.P_Bit.Bit_Test P_Bit_Sint32_Bit_29.P_Bit.Bit_Test P_Bit_Sint32_Bit_30.P_Bit.Bit_Test P_Bit_Sint32_Bit_31.P_Bit.Bit_Test P_Bit_Sint8_Bit_0.P_Bit.Bit_Test P_Bit_Sint8_Bit_1.P_Bit.Bit_Test P_Bit_Sint8_Bit_2.P_Bit.Bit_Test P_Bit_Sint8_Bit_3.P_Bit.Bit_Test P_Bit_Sint8_Bit_4.P_Bit.Bit_Test P_Bit_Sint8_Bit_5.P_Bit.Bit_Test P_Bit_Sint8_Bit_6.P_Bit.Bit_Test P_Bit_Sint8_Bit_7.P_Bit.Bit_Test P_Bit_Sint8_E.Extern_MEM.Bit_Test P_Bit_Sint8_E.Intern_MEM.Bit_Test P_Bit_Sint8_O.Extern_MEM.Bit_Test P_Bit_Sint8_O.Intern_MEM.Bit_Test P_Bit_Uint16.Extern_MEM.Bit_Test P_Bit_Uint16.Intern_MEM.Bit_Test P_Bit_Uint16_Bit_00.P_Bit.Bit_Test P_Bit_Uint16_Bit_01.P_Bit.Bit_Test P_Bit_Uint16_Bit_02.P_Bit.Bit_Test P_Bit_Uint16_Bit_03.P_Bit.Bit_Test P_Bit_Uint16_Bit_04.P_Bit.Bit_Test P_Bit_Uint16_Bit_05.P_Bit.Bit_Test P_Bit_Uint16_Bit_06.P_Bit.Bit_Test P_Bit_Uint16_Bit_07.P_Bit.Bit_Test P_Bit_Uint16_Bit_08.P_Bit.Bit_Test P_Bit_Uint16_Bit_09.P_Bit.Bit_Test P_Bit_Uint16_Bit_10.P_Bit.Bit_Test P_Bit_Uint16_Bit_11.P_Bit.Bit_Test P_Bit_Uint16_Bit_12.P_Bit.Bit_Test P_Bit_Uint16_Bit_13.P_Bit.Bit_Test P_Bit_Uint16_Bit_14.P_Bit.Bit_Test P_Bit_Uint16_Bit_15.P_Bit.Bit_Test P_Bit_Uint32.Extern_MEM.Bit_Test P_Bit_Uint32.Intern_MEM.Bit_Test P_Bit_Uint32_Bit_00.P_Bit.Bit_Test P_Bit_Uint32_Bit_01.P_Bit.Bit_Test P_Bit_Uint32_Bit_02.P_Bit.Bit_Test P_Bit_Uint32_Bit_03.P_Bit.Bit_Test P_Bit_Uint32_Bit_04.P_Bit.Bit_Test P_Bit_Uint32_Bit_05.P_Bit.Bit_Test P_Bit_Uint32_Bit_06.P_Bit.Bit_Test P_Bit_Uint32_Bit_07.P_Bit.Bit_Test P_Bit_Uint32_Bit_08.P_Bit.Bit_Test P_Bit_Uint32_Bit_09.P_Bit.Bit_Test P_Bit_Uint32_Bit_10.P_Bit.Bit_Test P_Bit_Uint32_Bit_11.P_Bit.Bit_Test P_Bit_Uint32_Bit_12.P_Bit.Bit_Test P_Bit_Uint32_Bit_13.P_Bit.Bit_Test P_Bit_Uint32_Bit_14.P_Bit.Bit_Test P_Bit_Uint32_Bit_15.P_Bit.Bit_Test P_Bit_Uint32_Bit_16.P_Bit.Bit_Test P_Bit_Uint32_Bit_17.P_Bit.Bit_Test P_Bit_Uint32_Bit_18.P_Bit.Bit_Test P_Bit_Uint32_Bit_19.P_Bit.Bit_Test P_Bit_Uint32_Bit_20.P_Bit.Bit_Test P_Bit_Uint32_Bit_21.P_Bit.Bit_Test P_Bit_Uint32_Bit_22.P_Bit.Bit_Test P_Bit_Uint32_Bit_23.P_Bit.Bit_Test P_Bit_Uint32_Bit_24.P_Bit.Bit_Test P_Bit_Uint32_Bit_25.P_Bit.Bit_Test P_Bit_Uint32_Bit_26.P_Bit.Bit_Test P_Bit_Uint32_Bit_27.P_Bit.Bit_Test P_Bit_Uint32_Bit_28.P_Bit.Bit_Test P_Bit_Uint32_Bit_29.P_Bit.Bit_Test P_Bit_Uint32_Bit_30.P_Bit.Bit_Test P_Bit_Uint32_Bit_31.P_Bit.Bit_Test P_Bit_Uint8_Bit_0.P_Bit.Bit_Test P_Bit_Uint8_Bit_1.P_Bit.Bit_Test P_Bit_Uint8_Bit_2.P_Bit.Bit_Test P_Bit_Uint8_Bit_3.P_Bit.Bit_Test P_Bit_Uint8_Bit_4.P_Bit.Bit_Test P_Bit_Uint8_Bit_5.P_Bit.Bit_Test P_Bit_Uint8_Bit_6.P_Bit.Bit_Test P_Bit_Uint8_Bit_7.P_Bit.Bit_Test P_Bit_Uint8_E.Extern_MEM.Bit_Test P_Bit_Uint8_E.Intern_MEM.Bit_Test P_Bit_Uint8_O.Extern_MEM.Bit_Test P_Bit_Uint8_O.Intern_MEM.Bit_Test p_UpdateBitTest_b.Bit_Test /end REF_CHARACTERISTIC
 /begin SUB_GROUP Extern_MEM.Bit_Test Intern_MEM.Bit_Test P_Bit.Bit_Test /end SUB_GROUP
/end GROUP
/begin GROUP BypassCounter "" ROOT
 /begin REF_MEASUREMENT ctrBypassB01.BypassCounter ctrBypassB01_H.BypassCounter ctrBypassB01_L.BypassCounter ctrBypassB02.BypassCounter ctrBypassB02_H.BypassCounter ctrBypassB02_L.BypassCounter ctrBypassB03.BypassCounter ctrBypassB03_H.BypassCounter ctrBypassB03_L.BypassCounter ctrBypassB04.BypassCounter ctrBypassB04_H.BypassCounter ctrBypassB04_L.BypassCounter lastCtrB01.BypassCounter lastCtrB02.BypassCounter lastCtrB03.BypassCounter lastCtrB04.BypassCounter waitCtrB01.BypassCounter waitCtrB01_H.BypassCounter waitCtrB01_L.BypassCounter waitCtrB02.BypassCounter waitCtrB02_H.BypassCounter waitCtrB02_L.BypassCounter waitCtrB03.BypassCounter waitCtrB03_H.BypassCounter waitCtrB03_L.BypassCounter waitCtrB04.BypassCounter waitCtrB04_H.BypassCounter waitCtrB04_L.BypassCounter /end REF_MEASUREMENT
/end GROUP
/begin GROUP CCP_Page "" ROOT /begin REF_MEASUREMENT CCP_current_Page_please_use_SERAM_PageControl.CCP_Page /end REF_MEASUREMENT
 /begin REF_CHARACTERISTIC P_PageSwitch_unused.CCP_Page _element_have_been_moved_to_ALL_PROT__SERAM_PageControl.CCP_Page p_SeramCheckParamRange_u8_unused.CCP_Page /end REF_CHARACTERISTIC
/end GROUP
/begin GROUP CCP_SHELL "" ROOT
 /begin REF_MEASUREMENT CCP_overload_counter_1.CCP_SHELL CCP_overload_counter_2.CCP_SHELL CCP_overload_counter_3.CCP_SHELL Err_Count_DAQ_SAMPLE.CCP_SHELL Err_Current_DAQ_SAMPLE.CCP_SHELL Err_Current_DAQ_SAMPLE_TYP.CCP_SHELL Err_State_DAQ_SAMPLE.CCP_SHELL Max.MIN_MAX_Tick2Time.DAQ2_Sample.CCP_SHELL Max.Time.DAQ2_Tx.CCP_SHELL Max.TimeSum.DAQ2_Tx.CCP_SHELL Min.MIN_MAX_Tick2Time.DAQ2_Sample.CCP_SHELL Min.Time.DAQ2_Tx.CCP_SHELL Min.TimeSum.DAQ2_Tx.CCP_SHELL ODT_tx_status.CCP_SHELL Time.MIN_MAX_Tick2Time.DAQ2_Sample.CCP_SHELL Time.Time.DAQ2_Tx.CCP_SHELL Time.TimeSum.DAQ2_Tx.CCP_SHELL c_CcpPower_u8.CCP_SHELL g_CcpActiveVersion_u8.CCP_SHELL g_CcpByteOrder_u8.CCP_SHELL g_CcpMuxRaster_u32.CCP_SHELL g_CcpPowerOn_u8.CCP_SHELL g_CcpPower_u8.CCP_SHELL g_CcpResumeMasterConnectTimeoutCheck_u8.CCP_SHELL g_CcpResumeMasterConnectTimeoutStart_u32.CCP_SHELL g_CcpResumeMasterConnectTimeout_u32.CCP_SHELL g_CcpResumeSupport_u8.CCP_SHELL g_CcpSessStatus_u8_nv.CCP_SHELL g_CcpTrigResume_u8.CCP_SHELL l_ResetTimer_b.DAQ2_Sample.CCP_SHELL l_ResetTimer_b.DAQ2_Tx.CCP_SHELL l_StartTicks_u32.DAQ2_Sample.CCP_SHELL l_StartTicks_u32.DAQ2_Tx.CCP_SHELL l_StopTicks_u32.DAQ2_Sample.CCP_SHELL l_StopTicks_u32.DAQ2_Tx.CCP_SHELL l_TimeSum_u32.DAQ2_Tx.CCP_SHELL l_Timeout_b.DAQ2_Sample.CCP_SHELL l_Timeout_b.DAQ2_Tx.CCP_SHELL l_TimerCorrection_u32.CCP_SHELL test_counter.CCP_SHELL /end REF_MEASUREMENT
 /begin REF_CHARACTERISTIC iflag_mask.CCP_SHELL p_CcpByteOrder_u8.CCP_SHELL p_CcpPower_u8.CCP_SHELL p_CcpTrigResume_u8.CCP_SHELL p_ResetTimer_b.DAQ2_Sample.CCP_SHELL p_ResetTimer_b.DAQ2_Tx.CCP_SHELL /end REF_CHARACTERISTIC
 /begin SUB_GROUP DAQ2_Sample.CCP_SHELL DAQ2_Tx.CCP_SHELL /end SUB_GROUP
/end GROUP
/begin GROUP DAQ2_Sample.CCP_SHELL ""
 /begin REF_MEASUREMENT Max.MIN_MAX_Tick2Time.DAQ2_Sample.CCP_SHELL Min.MIN_MAX_Tick2Time.DAQ2_Sample.CCP_SHELL Time.MIN_MAX_Tick2Time.DAQ2_Sample.CCP_SHELL l_ResetTimer_b.DAQ2_Sample.CCP_SHELL l_StartTicks_u32.DAQ2_Sample.CCP_SHELL l_StopTicks_u32.DAQ2_Sample.CCP_SHELL l_Timeout_b.DAQ2_Sample.CCP_SHELL /end REF_MEASUREMENT
 /begin REF_CHARACTERISTIC p_ResetTimer_b.DAQ2_Sample.CCP_SHELL /end REF_CHARACTERISTIC
/end GROUP
/begin GROUP DAQ2_Tx.CCP_SHELL ""
 /begin REF_MEASUREMENT Max.Time.DAQ2_Tx.CCP_SHELL Max.TimeSum.DAQ2_Tx.CCP_SHELL Min.Time.DAQ2_Tx.CCP_SHELL Min.TimeSum.DAQ2_Tx.CCP_SHELL Time.Time.DAQ2_Tx.CCP_SHELL Time.TimeSum.DAQ2_Tx.CCP_SHELL l_ResetTimer_b.DAQ2_Tx.CCP_SHELL l_StartTicks_u32.DAQ2_Tx.CCP_SHELL l_StopTicks_u32.DAQ2_Tx.CCP_SHELL l_TimeSum_u32.DAQ2_Tx.CCP_SHELL l_Timeout_b.DAQ2_Tx.CCP_SHELL /end REF_MEASUREMENT
 /begin REF_CHARACTERISTIC p_ResetTimer_b.DAQ2_Tx.CCP_SHELL /end REF_CHARACTERISTIC
/end GROUP
/begin GROUP Extern_MEM.Bit_Test ""
 /begin REF_MEASUREMENT Bit_Sint16_Bit_00.Extern_MEM.Bit_Test Bit_Sint16_Bit_01.Extern_MEM.Bit_Test Bit_Sint16_Bit_02.Extern_MEM.Bit_Test Bit_Sint16_Bit_03.Extern_MEM.Bit_Test Bit_Sint16_Bit_04.Extern_MEM.Bit_Test Bit_Sint16_Bit_05.Extern_MEM.Bit_Test Bit_Sint16_Bit_06.Extern_MEM.Bit_Test Bit_Sint16_Bit_07.Extern_MEM.Bit_Test Bit_Sint16_Bit_08.Extern_MEM.Bit_Test Bit_Sint16_Bit_09.Extern_MEM.Bit_Test Bit_Sint16_Bit_10.Extern_MEM.Bit_Test Bit_Sint16_Bit_11.Extern_MEM.Bit_Test Bit_Sint16_Bit_12.Extern_MEM.Bit_Test Bit_Sint16_Bit_13.Extern_MEM.Bit_Test Bit_Sint16_Bit_14.Extern_MEM.Bit_Test Bit_Sint16_Bit_15.Extern_MEM.Bit_Test Bit_Sint16_Bit_x.Extern_MEM.Bit_Test Bit_Sint32_Bit_00.Extern_MEM.Bit_Test Bit_Sint32_Bit_01.Extern_MEM.Bit_Test Bit_Sint32_Bit_02.Extern_MEM.Bit_Test Bit_Sint32_Bit_03.Extern_MEM.Bit_Test Bit_Sint32_Bit_04.Extern_MEM.Bit_Test Bit_Sint32_Bit_05.Extern_MEM.Bit_Test Bit_Sint32_Bit_06.Extern_MEM.Bit_Test Bit_Sint32_Bit_07.Extern_MEM.Bit_Test Bit_Sint32_Bit_08.Extern_MEM.Bit_Test Bit_Sint32_Bit_09.Extern_MEM.Bit_Test Bit_Sint32_Bit_10.Extern_MEM.Bit_Test Bit_Sint32_Bit_11.Extern_MEM.Bit_Test Bit_Sint32_Bit_12.Extern_MEM.Bit_Test Bit_Sint32_Bit_13.Extern_MEM.Bit_Test Bit_Sint32_Bit_14.Extern_MEM.Bit_Test Bit_Sint32_Bit_15.Extern_MEM.Bit_Test Bit_Sint32_Bit_16.Extern_MEM.Bit_Test Bit_Sint32_Bit_17.Extern_MEM.Bit_Test Bit_Sint32_Bit_18.Extern_MEM.Bit_Test Bit_Sint32_Bit_19.Extern_MEM.Bit_Test Bit_Sint32_Bit_20.Extern_MEM.Bit_Test Bit_Sint32_Bit_21.Extern_MEM.Bit_Test Bit_Sint32_Bit_22.Extern_MEM.Bit_Test Bit_Sint32_Bit_23.Extern_MEM.Bit_Test Bit_Sint32_Bit_24.Extern_MEM.Bit_Test Bit_Sint32_Bit_25.Extern_MEM.Bit_Test Bit_Sint32_Bit_26.Extern_MEM.Bit_Test Bit_Sint32_Bit_27.Extern_MEM.Bit_Test Bit_Sint32_Bit_28.Extern_MEM.Bit_Test Bit_Sint32_Bit_29.Extern_MEM.Bit_Test Bit_Sint32_Bit_30.Extern_MEM.Bit_Test Bit_Sint32_Bit_31.Extern_MEM.Bit_Test Bit_Sint32_Bit_x.Extern_MEM.Bit_Test Bit_Sint8_E_Bit_0.Extern_MEM.Bit_Test Bit_Sint8_E_Bit_1.Extern_MEM.Bit_Test Bit_Sint8_E_Bit_2.Extern_MEM.Bit_Test Bit_Sint8_E_Bit_3.Extern_MEM.Bit_Test Bit_Sint8_E_Bit_4.Extern_MEM.Bit_Test Bit_Sint8_E_Bit_5.Extern_MEM.Bit_Test Bit_Sint8_E_Bit_6.Extern_MEM.Bit_Test Bit_Sint8_E_Bit_7.Extern_MEM.Bit_Test Bit_Sint8_E_Bit_x.Extern_MEM.Bit_Test Bit_Sint8_O_Bit_0.Extern_MEM.Bit_Test Bit_Sint8_O_Bit_1.Extern_MEM.Bit_Test Bit_Sint8_O_Bit_2.Extern_MEM.Bit_Test Bit_Sint8_O_Bit_3.Extern_MEM.Bit_Test Bit_Sint8_O_Bit_4.Extern_MEM.Bit_Test Bit_Sint8_O_Bit_5.Extern_MEM.Bit_Test Bit_Sint8_O_Bit_6.Extern_MEM.Bit_Test Bit_Sint8_O_Bit_7.Extern_MEM.Bit_Test Bit_Sint8_O_Bit_x.Extern_MEM.Bit_Test Bit_Uint16_Bit_00.Extern_MEM.Bit_Test Bit_Uint16_Bit_01.Extern_MEM.Bit_Test Bit_Uint16_Bit_02.Extern_MEM.Bit_Test Bit_Uint16_Bit_03.Extern_MEM.Bit_Test Bit_Uint16_Bit_04.Extern_MEM.Bit_Test Bit_Uint16_Bit_05.Extern_MEM.Bit_Test Bit_Uint16_Bit_06.Extern_MEM.Bit_Test Bit_Uint16_Bit_07.Extern_MEM.Bit_Test Bit_Uint16_Bit_08.Extern_MEM.Bit_Test Bit_Uint16_Bit_09.Extern_MEM.Bit_Test Bit_Uint16_Bit_10.Extern_MEM.Bit_Test Bit_Uint16_Bit_11.Extern_MEM.Bit_Test Bit_Uint16_Bit_12.Extern_MEM.Bit_Test Bit_Uint16_Bit_13.Extern_MEM.Bit_Test Bit_Uint16_Bit_14.Extern_MEM.Bit_Test Bit_Uint16_Bit_15.Extern_MEM.Bit_Test Bit_Uint16_Bit_x.Extern_MEM.Bit_Test Bit_Uint32_Bit_00.Extern_MEM.Bit_Test Bit_Uint32_Bit_01.Extern_MEM.Bit_Test Bit_Uint32_Bit_02.Extern_MEM.Bit_Test Bit_Uint32_Bit_03.Extern_MEM.Bit_Test Bit_Uint32_Bit_04.Extern_MEM.Bit_Test Bit_Uint32_Bit_05.Extern_MEM.Bit_Test Bit_Uint32_Bit_06.Extern_MEM.Bit_Test Bit_Uint32_Bit_07.Extern_MEM.Bit_Test Bit_Uint32_Bit_08.Extern_MEM.Bit_Test Bit_Uint32_Bit_09.Extern_MEM.Bit_Test Bit_Uint32_Bit_10.Extern_MEM.Bit_Test Bit_Uint32_Bit_11.Extern_MEM.Bit_Test Bit_Uint32_Bit_12.Extern_MEM.Bit_Test Bit_Uint32_Bit_13.Extern_MEM.Bit_Test Bit_Uint32_Bit_14.Extern_MEM.Bit_Test Bit_Uint32_Bit_15.Extern_MEM.Bit_Test Bit_Uint32_Bit_16.Extern_MEM.Bit_Test Bit_Uint32_Bit_17.Extern_MEM.Bit_Test Bit_Uint32_Bit_18.Extern_MEM.Bit_Test Bit_Uint32_Bit_19.Extern_MEM.Bit_Test Bit_Uint32_Bit_20.Extern_MEM.Bit_Test Bit_Uint32_Bit_21.Extern_MEM.Bit_Test Bit_Uint32_Bit_22.Extern_MEM.Bit_Test Bit_Uint32_Bit_23.Extern_MEM.Bit_Test Bit_Uint32_Bit_24.Extern_MEM.Bit_Test Bit_Uint32_Bit_25.Extern_MEM.Bit_Test Bit_Uint32_Bit_26.Extern_MEM.Bit_Test Bit_Uint32_Bit_27.Extern_MEM.Bit_Test Bit_Uint32_Bit_28.Extern_MEM.Bit_Test Bit_Uint32_Bit_29.Extern_MEM.Bit_Test Bit_Uint32_Bit_30.Extern_MEM.Bit_Test Bit_Uint32_Bit_31.Extern_MEM.Bit_Test Bit_Uint32_Bit_x.Extern_MEM.Bit_Test Bit_Uint8_E_Bit_0.Extern_MEM.Bit_Test Bit_Uint8_E_Bit_1.Extern_MEM.Bit_Test Bit_Uint8_E_Bit_2.Extern_MEM.Bit_Test Bit_Uint8_E_Bit_3.Extern_MEM.Bit_Test Bit_Uint8_E_Bit_4.Extern_MEM.Bit_Test Bit_Uint8_E_Bit_5.Extern_MEM.Bit_Test Bit_Uint8_E_Bit_6.Extern_MEM.Bit_Test Bit_Uint8_E_Bit_7.Extern_MEM.Bit_Test Bit_Uint8_E_Bit_x.Extern_MEM.Bit_Test Bit_Uint8_O_Bit_0.Extern_MEM.Bit_Test Bit_Uint8_O_Bit_1.Extern_MEM.Bit_Test Bit_Uint8_O_Bit_2.Extern_MEM.Bit_Test Bit_Uint8_O_Bit_3.Extern_MEM.Bit_Test Bit_Uint8_O_Bit_4.Extern_MEM.Bit_Test Bit_Uint8_O_Bit_5.Extern_MEM.Bit_Test Bit_Uint8_O_Bit_6.Extern_MEM.Bit_Test Bit_Uint8_O_Bit_7.Extern_MEM.Bit_Test Bit_Uint8_O_Bit_x.Extern_MEM.Bit_Test /end REF_MEASUREMENT
 /begin REF_CHARACTERISTIC P_Bit_Sint16.Extern_MEM.Bit_Test P_Bit_Sint32.Extern_MEM.Bit_Test P_Bit_Sint8_E.Extern_MEM.Bit_Test P_Bit_Sint8_O.Extern_MEM.Bit_Test P_Bit_Uint16.Extern_MEM.Bit_Test P_Bit_Uint32.Extern_MEM.Bit_Test P_Bit_Uint8_E.Extern_MEM.Bit_Test P_Bit_Uint8_O.Extern_MEM.Bit_Test /end REF_CHARACTERISTIC
/end GROUP
/begin GROUP HWE.BASE ""
 /begin REF_MEASUREMENT HWE_PowerfailDetected.HWE.BASE HWE_ResetMonitor_Adr.HWE.BASE HWE_ResetMonitor_Counter.HWE.BASE HWE_ResetMonitor_ID.HWE.BASE HWE_ResetMonitor_RSR.HWE.BASE HWE_ResetMonitor_Time.HWE.BASE Result.Time_Calc.HWE.BASE Samp_Time_result.HWE.BASE TimeStampOne.Time_Calc.HWE.BASE TimeStampTwo.Time_Calc.HWE.BASE Timer_Zero_Error.HWE.BASE Tx_time_result.HWE.BASE Tx_time_sum.HWE.BASE g_CAN_B_IRQ_MaxExeTime_u32.HWE.BASE is_started.Time_Calc.HWE.BASE l_CAN_B_IRQ_ExeTime_u32.HWE.BASE l_CAN_B_IRQ_begin_u32.HWE.BASE test_counter.HWE.BASE /end REF_MEASUREMENT
 /begin REF_CHARACTERISTIC HWE_Rtmo_Tasks.HWE.BASE iflag_mask.HWE.BASE /end REF_CHARACTERISTIC
/end GROUP
/begin GROUP HWE_CAN_A.SHELL.BASE ""
 /begin REF_MEASUREMENT l_baudrate_calculated_f32.HWE_CAN_A.SHELL.BASE l_baudrate_e.HWE_CAN_A.SHELL.BASE l_dBRP_u8.HWE_CAN_A.SHELL.BASE l_dPSeg1_u8.HWE_CAN_A.SHELL.BASE l_dPSeg2_u8.HWE_CAN_A.SHELL.BASE l_dPropSeg_u8.HWE_CAN_A.SHELL.BASE l_dSJW_u8.HWE_CAN_A.SHELL.BASE l_samplepoint_calculated_f32.HWE_CAN_A.SHELL.BASE /end REF_MEASUREMENT
 /begin REF_CHARACTERISTIC p_baudrate_e.HWE_CAN_A.SHELL.BASE p_dBRP_u8.HWE_CAN_A.SHELL.BASE p_dPSeg1_u8.HWE_CAN_A.SHELL.BASE p_dPSeg2_u8.HWE_CAN_A.SHELL.BASE p_dPropSeg_u8.HWE_CAN_A.SHELL.BASE p_dSJW_u8.HWE_CAN_A.SHELL.BASE /end REF_CHARACTERISTIC
/end GROUP
/begin GROUP HWE_CAN_B.SHELL.BASE ""
 /begin REF_MEASUREMENT l_baudrate_calculated_f32.HWE_CAN_B.SHELL.BASE l_baudrate_e.HWE_CAN_B.SHELL.BASE l_dBRP_u8.HWE_CAN_B.SHELL.BASE l_dPSeg1_u8.HWE_CAN_B.SHELL.BASE l_dPSeg2_u8.HWE_CAN_B.SHELL.BASE l_dPropSeg_u8.HWE_CAN_B.SHELL.BASE l_dSJW_u8.HWE_CAN_B.SHELL.BASE l_samplepoint_calculated_f32.HWE_CAN_B.SHELL.BASE /end REF_MEASUREMENT
 /begin REF_CHARACTERISTIC p_baudrate_e.HWE_CAN_B.SHELL.BASE p_dBRP_u8.HWE_CAN_B.SHELL.BASE p_dPSeg1_u8.HWE_CAN_B.SHELL.BASE p_dPSeg2_u8.HWE_CAN_B.SHELL.BASE p_dPropSeg_u8.HWE_CAN_B.SHELL.BASE p_dSJW_u8.HWE_CAN_B.SHELL.BASE /end REF_CHARACTERISTIC
/end GROUP
/begin GROUP HWE_CAN_C.SHELL.BASE ""
 /begin REF_MEASUREMENT l_baudrate_calculated_f32.HWE_CAN_C.SHELL.BASE l_baudrate_e.HWE_CAN_C.SHELL.BASE l_dBRP_u8.HWE_CAN_C.SHELL.BASE l_dPSeg1_u8.HWE_CAN_C.SHELL.BASE l_dPSeg2_u8.HWE_CAN_C.SHELL.BASE l_dPropSeg_u8.HWE_CAN_C.SHELL.BASE l_dSJW_u8.HWE_CAN_C.SHELL.BASE l_samplepoint_calculated_f32.HWE_CAN_C.SHELL.BASE /end REF_MEASUREMENT
 /begin REF_CHARACTERISTIC p_baudrate_e.HWE_CAN_C.SHELL.BASE p_dBRP_u8.HWE_CAN_C.SHELL.BASE p_dPSeg1_u8.HWE_CAN_C.SHELL.BASE p_dPSeg2_u8.HWE_CAN_C.SHELL.BASE p_dPropSeg_u8.HWE_CAN_C.SHELL.BASE p_dSJW_u8.HWE_CAN_C.SHELL.BASE /end REF_CHARACTERISTIC
/end GROUP
/begin GROUP HWE_TARGET.BASE ""
 /begin REF_MEASUREMENT g_Target_D_DIVF_u32.HWE_TARGET.BASE g_Target_D_IMBSPEED_u32.HWE_TARGET.BASE g_Target_D_MF_u32.HWE_TARGET.BASE g_Target_D_TBS_u32.HWE_TARGET.BASE g_Target_D_TB_NORM_MUL_u32.HWE_TARGET.BASE g_Target_F_IMB_u32.HWE_TARGET.BASE g_Target_F_OSC_u32.HWE_TARGET.BASE g_Target_F_SYS_u32.HWE_TARGET.BASE g_Target_F_TB_u32.HWE_TARGET.BASE g_Target_SysTick_in_ns_u32.HWE_TARGET.BASE /end REF_MEASUREMENT
/end GROUP
/begin GROUP Intern_MEM.Bit_Test ""
 /begin REF_MEASUREMENT Bit_Sint16_Bit_00.Intern_MEM.Bit_Test Bit_Sint16_Bit_01.Intern_MEM.Bit_Test Bit_Sint16_Bit_02.Intern_MEM.Bit_Test Bit_Sint16_Bit_03.Intern_MEM.Bit_Test Bit_Sint16_Bit_04.Intern_MEM.Bit_Test Bit_Sint16_Bit_05.Intern_MEM.Bit_Test Bit_Sint16_Bit_06.Intern_MEM.Bit_Test Bit_Sint16_Bit_07.Intern_MEM.Bit_Test Bit_Sint16_Bit_08.Intern_MEM.Bit_Test Bit_Sint16_Bit_09.Intern_MEM.Bit_Test Bit_Sint16_Bit_10.Intern_MEM.Bit_Test Bit_Sint16_Bit_11.Intern_MEM.Bit_Test Bit_Sint16_Bit_12.Intern_MEM.Bit_Test Bit_Sint16_Bit_13.Intern_MEM.Bit_Test Bit_Sint16_Bit_14.Intern_MEM.Bit_Test Bit_Sint16_Bit_15.Intern_MEM.Bit_Test Bit_Sint16_Bit_x.Intern_MEM.Bit_Test Bit_Sint32_Bit_00.Intern_MEM.Bit_Test Bit_Sint32_Bit_01.Intern_MEM.Bit_Test Bit_Sint32_Bit_02.Intern_MEM.Bit_Test Bit_Sint32_Bit_03.Intern_MEM.Bit_Test Bit_Sint32_Bit_04.Intern_MEM.Bit_Test Bit_Sint32_Bit_05.Intern_MEM.Bit_Test Bit_Sint32_Bit_06.Intern_MEM.Bit_Test Bit_Sint32_Bit_07.Intern_MEM.Bit_Test Bit_Sint32_Bit_08.Intern_MEM.Bit_Test Bit_Sint32_Bit_09.Intern_MEM.Bit_Test Bit_Sint32_Bit_10.Intern_MEM.Bit_Test Bit_Sint32_Bit_11.Intern_MEM.Bit_Test Bit_Sint32_Bit_12.Intern_MEM.Bit_Test Bit_Sint32_Bit_13.Intern_MEM.Bit_Test Bit_Sint32_Bit_14.Intern_MEM.Bit_Test Bit_Sint32_Bit_15.Intern_MEM.Bit_Test Bit_Sint32_Bit_16.Intern_MEM.Bit_Test Bit_Sint32_Bit_17.Intern_MEM.Bit_Test Bit_Sint32_Bit_18.Intern_MEM.Bit_Test Bit_Sint32_Bit_19.Intern_MEM.Bit_Test Bit_Sint32_Bit_20.Intern_MEM.Bit_Test Bit_Sint32_Bit_21.Intern_MEM.Bit_Test Bit_Sint32_Bit_22.Intern_MEM.Bit_Test Bit_Sint32_Bit_23.Intern_MEM.Bit_Test Bit_Sint32_Bit_24.Intern_MEM.Bit_Test Bit_Sint32_Bit_25.Intern_MEM.Bit_Test Bit_Sint32_Bit_26.Intern_MEM.Bit_Test Bit_Sint32_Bit_27.Intern_MEM.Bit_Test Bit_Sint32_Bit_28.Intern_MEM.Bit_Test Bit_Sint32_Bit_29.Intern_MEM.Bit_Test Bit_Sint32_Bit_30.Intern_MEM.Bit_Test Bit_Sint32_Bit_31.Intern_MEM.Bit_Test Bit_Sint32_Bit_x.Intern_MEM.Bit_Test Bit_Sint8_E_Bit_0.Intern_MEM.Bit_Test Bit_Sint8_E_Bit_1.Intern_MEM.Bit_Test Bit_Sint8_E_Bit_2.Intern_MEM.Bit_Test Bit_Sint8_E_Bit_3.Intern_MEM.Bit_Test Bit_Sint8_E_Bit_4.Intern_MEM.Bit_Test Bit_Sint8_E_Bit_5.Intern_MEM.Bit_Test Bit_Sint8_E_Bit_6.Intern_MEM.Bit_Test Bit_Sint8_E_Bit_7.Intern_MEM.Bit_Test Bit_Sint8_E_Bit_x.Intern_MEM.Bit_Test Bit_Sint8_O_Bit_0.Intern_MEM.Bit_Test Bit_Sint8_O_Bit_1.Intern_MEM.Bit_Test Bit_Sint8_O_Bit_2.Intern_MEM.Bit_Test Bit_Sint8_O_Bit_3.Intern_MEM.Bit_Test Bit_Sint8_O_Bit_4.Intern_MEM.Bit_Test Bit_Sint8_O_Bit_5.Intern_MEM.Bit_Test Bit_Sint8_O_Bit_6.Intern_MEM.Bit_Test Bit_Sint8_O_Bit_7.Intern_MEM.Bit_Test Bit_Sint8_O_Bit_x.Intern_MEM.Bit_Test Bit_Uint16_Bit_00.Intern_MEM.Bit_Test Bit_Uint16_Bit_01.Intern_MEM.Bit_Test Bit_Uint16_Bit_02.Intern_MEM.Bit_Test Bit_Uint16_Bit_03.Intern_MEM.Bit_Test Bit_Uint16_Bit_04.Intern_MEM.Bit_Test Bit_Uint16_Bit_05.Intern_MEM.Bit_Test Bit_Uint16_Bit_06.Intern_MEM.Bit_Test Bit_Uint16_Bit_07.Intern_MEM.Bit_Test Bit_Uint16_Bit_08.Intern_MEM.Bit_Test Bit_Uint16_Bit_09.Intern_MEM.Bit_Test Bit_Uint16_Bit_10.Intern_MEM.Bit_Test Bit_Uint16_Bit_11.Intern_MEM.Bit_Test Bit_Uint16_Bit_12.Intern_MEM.Bit_Test Bit_Uint16_Bit_13.Intern_MEM.Bit_Test Bit_Uint16_Bit_14.Intern_MEM.Bit_Test Bit_Uint16_Bit_15.Intern_MEM.Bit_Test Bit_Uint16_Bit_x.Intern_MEM.Bit_Test Bit_Uint32_Bit_00.Intern_MEM.Bit_Test Bit_Uint32_Bit_01.Intern_MEM.Bit_Test Bit_Uint32_Bit_02.Intern_MEM.Bit_Test Bit_Uint32_Bit_03.Intern_MEM.Bit_Test Bit_Uint32_Bit_04.Intern_MEM.Bit_Test Bit_Uint32_Bit_05.Intern_MEM.Bit_Test Bit_Uint32_Bit_06.Intern_MEM.Bit_Test Bit_Uint32_Bit_07.Intern_MEM.Bit_Test Bit_Uint32_Bit_08.Intern_MEM.Bit_Test Bit_Uint32_Bit_09.Intern_MEM.Bit_Test Bit_Uint32_Bit_10.Intern_MEM.Bit_Test Bit_Uint32_Bit_11.Intern_MEM.Bit_Test Bit_Uint32_Bit_12.Intern_MEM.Bit_Test Bit_Uint32_Bit_13.Intern_MEM.Bit_Test Bit_Uint32_Bit_14.Intern_MEM.Bit_Test Bit_Uint32_Bit_15.Intern_MEM.Bit_Test Bit_Uint32_Bit_16.Intern_MEM.Bit_Test Bit_Uint32_Bit_17.Intern_MEM.Bit_Test Bit_Uint32_Bit_18.Intern_MEM.Bit_Test Bit_Uint32_Bit_19.Intern_MEM.Bit_Test Bit_Uint32_Bit_20.Intern_MEM.Bit_Test Bit_Uint32_Bit_21.Intern_MEM.Bit_Test Bit_Uint32_Bit_22.Intern_MEM.Bit_Test Bit_Uint32_Bit_23.Intern_MEM.Bit_Test Bit_Uint32_Bit_24.Intern_MEM.Bit_Test Bit_Uint32_Bit_25.Intern_MEM.Bit_Test Bit_Uint32_Bit_26.Intern_MEM.Bit_Test Bit_Uint32_Bit_27.Intern_MEM.Bit_Test Bit_Uint32_Bit_28.Intern_MEM.Bit_Test Bit_Uint32_Bit_29.Intern_MEM.Bit_Test Bit_Uint32_Bit_30.Intern_MEM.Bit_Test Bit_Uint32_Bit_31.Intern_MEM.Bit_Test Bit_Uint32_Bit_x.Intern_MEM.Bit_Test Bit_Uint8_E_Bit_0.Intern_MEM.Bit_Test Bit_Uint8_E_Bit_1.Intern_MEM.Bit_Test Bit_Uint8_E_Bit_2.Intern_MEM.Bit_Test Bit_Uint8_E_Bit_3.Intern_MEM.Bit_Test Bit_Uint8_E_Bit_4.Intern_MEM.Bit_Test Bit_Uint8_E_Bit_5.Intern_MEM.Bit_Test Bit_Uint8_E_Bit_6.Intern_MEM.Bit_Test Bit_Uint8_E_Bit_7.Intern_MEM.Bit_Test Bit_Uint8_E_Bit_x.Intern_MEM.Bit_Test Bit_Uint8_O_Bit_0.Intern_MEM.Bit_Test Bit_Uint8_O_Bit_1.Intern_MEM.Bit_Test Bit_Uint8_O_Bit_2.Intern_MEM.Bit_Test Bit_Uint8_O_Bit_3.Intern_MEM.Bit_Test Bit_Uint8_O_Bit_4.Intern_MEM.Bit_Test Bit_Uint8_O_Bit_5.Intern_MEM.Bit_Test Bit_Uint8_O_Bit_6.Intern_MEM.Bit_Test Bit_Uint8_O_Bit_7.Intern_MEM.Bit_Test Bit_Uint8_O_Bit_x.Intern_MEM.Bit_Test /end REF_MEASUREMENT
 /begin REF_CHARACTERISTIC P_Bit_Sint16.Intern_MEM.Bit_Test P_Bit_Sint32.Intern_MEM.Bit_Test P_Bit_Sint8_E.Intern_MEM.Bit_Test P_Bit_Sint8_O.Intern_MEM.Bit_Test P_Bit_Uint16.Intern_MEM.Bit_Test P_Bit_Uint32.Intern_MEM.Bit_Test P_Bit_Uint8_E.Intern_MEM.Bit_Test P_Bit_Uint8_O.Intern_MEM.Bit_Test /end REF_CHARACTERISTIC
/end GROUP
/begin GROUP MIN_MAX_Tick2Time.DAQ2_Sample.CCP_SHELL ""
 /begin REF_MEASUREMENT Max.MIN_MAX_Tick2Time.DAQ2_Sample.CCP_SHELL Min.MIN_MAX_Tick2Time.DAQ2_Sample.CCP_SHELL Time.MIN_MAX_Tick2Time.DAQ2_Sample.CCP_SHELL /end REF_MEASUREMENT
/end GROUP
/begin GROUP P_Bit.Bit_Test ""
 /begin REF_MEASUREMENT Bit_Sint16.P_Bit.Bit_Test Bit_Sint32.P_Bit.Bit_Test Bit_Sint8.P_Bit.Bit_Test Bit_Uint16.P_Bit.Bit_Test Bit_Uint32.P_Bit.Bit_Test Bit_Uint8.P_Bit.Bit_Test /end REF_MEASUREMENT
 /begin REF_CHARACTERISTIC P_Bit_Sint16_Bit_00.P_Bit.Bit_Test P_Bit_Sint16_Bit_01.P_Bit.Bit_Test P_Bit_Sint16_Bit_02.P_Bit.Bit_Test P_Bit_Sint16_Bit_03.P_Bit.Bit_Test P_Bit_Sint16_Bit_04.P_Bit.Bit_Test P_Bit_Sint16_Bit_05.P_Bit.Bit_Test P_Bit_Sint16_Bit_06.P_Bit.Bit_Test P_Bit_Sint16_Bit_07.P_Bit.Bit_Test P_Bit_Sint16_Bit_08.P_Bit.Bit_Test P_Bit_Sint16_Bit_09.P_Bit.Bit_Test P_Bit_Sint16_Bit_10.P_Bit.Bit_Test P_Bit_Sint16_Bit_11.P_Bit.Bit_Test P_Bit_Sint16_Bit_12.P_Bit.Bit_Test P_Bit_Sint16_Bit_13.P_Bit.Bit_Test P_Bit_Sint16_Bit_14.P_Bit.Bit_Test P_Bit_Sint16_Bit_15.P_Bit.Bit_Test P_Bit_Sint32_Bit_00.P_Bit.Bit_Test P_Bit_Sint32_Bit_01.P_Bit.Bit_Test P_Bit_Sint32_Bit_02.P_Bit.Bit_Test P_Bit_Sint32_Bit_03.P_Bit.Bit_Test P_Bit_Sint32_Bit_04.P_Bit.Bit_Test P_Bit_Sint32_Bit_05.P_Bit.Bit_Test P_Bit_Sint32_Bit_06.P_Bit.Bit_Test P_Bit_Sint32_Bit_07.P_Bit.Bit_Test P_Bit_Sint32_Bit_08.P_Bit.Bit_Test P_Bit_Sint32_Bit_09.P_Bit.Bit_Test P_Bit_Sint32_Bit_10.P_Bit.Bit_Test P_Bit_Sint32_Bit_11.P_Bit.Bit_Test P_Bit_Sint32_Bit_12.P_Bit.Bit_Test P_Bit_Sint32_Bit_13.P_Bit.Bit_Test P_Bit_Sint32_Bit_14.P_Bit.Bit_Test P_Bit_Sint32_Bit_15.P_Bit.Bit_Test P_Bit_Sint32_Bit_16.P_Bit.Bit_Test P_Bit_Sint32_Bit_17.P_Bit.Bit_Test P_Bit_Sint32_Bit_18.P_Bit.Bit_Test P_Bit_Sint32_Bit_19.P_Bit.Bit_Test P_Bit_Sint32_Bit_20.P_Bit.Bit_Test P_Bit_Sint32_Bit_21.P_Bit.Bit_Test P_Bit_Sint32_Bit_22.P_Bit.Bit_Test P_Bit_Sint32_Bit_23.P_Bit.Bit_Test P_Bit_Sint32_Bit_24.P_Bit.Bit_Test P_Bit_Sint32_Bit_25.P_Bit.Bit_Test P_Bit_Sint32_Bit_26.P_Bit.Bit_Test P_Bit_Sint32_Bit_27.P_Bit.Bit_Test P_Bit_Sint32_Bit_28.P_Bit.Bit_Test P_Bit_Sint32_Bit_29.P_Bit.Bit_Test P_Bit_Sint32_Bit_30.P_Bit.Bit_Test P_Bit_Sint32_Bit_31.P_Bit.Bit_Test P_Bit_Sint8_Bit_0.P_Bit.Bit_Test P_Bit_Sint8_Bit_1.P_Bit.Bit_Test P_Bit_Sint8_Bit_2.P_Bit.Bit_Test P_Bit_Sint8_Bit_3.P_Bit.Bit_Test P_Bit_Sint8_Bit_4.P_Bit.Bit_Test P_Bit_Sint8_Bit_5.P_Bit.Bit_Test P_Bit_Sint8_Bit_6.P_Bit.Bit_Test P_Bit_Sint8_Bit_7.P_Bit.Bit_Test P_Bit_Uint16_Bit_00.P_Bit.Bit_Test P_Bit_Uint16_Bit_01.P_Bit.Bit_Test P_Bit_Uint16_Bit_02.P_Bit.Bit_Test P_Bit_Uint16_Bit_03.P_Bit.Bit_Test P_Bit_Uint16_Bit_04.P_Bit.Bit_Test P_Bit_Uint16_Bit_05.P_Bit.Bit_Test P_Bit_Uint16_Bit_06.P_Bit.Bit_Test P_Bit_Uint16_Bit_07.P_Bit.Bit_Test P_Bit_Uint16_Bit_08.P_Bit.Bit_Test P_Bit_Uint16_Bit_09.P_Bit.Bit_Test P_Bit_Uint16_Bit_10.P_Bit.Bit_Test P_Bit_Uint16_Bit_11.P_Bit.Bit_Test P_Bit_Uint16_Bit_12.P_Bit.Bit_Test P_Bit_Uint16_Bit_13.P_Bit.Bit_Test P_Bit_Uint16_Bit_14.P_Bit.Bit_Test P_Bit_Uint16_Bit_15.P_Bit.Bit_Test P_Bit_Uint32_Bit_00.P_Bit.Bit_Test P_Bit_Uint32_Bit_01.P_Bit.Bit_Test P_Bit_Uint32_Bit_02.P_Bit.Bit_Test P_Bit_Uint32_Bit_03.P_Bit.Bit_Test P_Bit_Uint32_Bit_04.P_Bit.Bit_Test P_Bit_Uint32_Bit_05.P_Bit.Bit_Test P_Bit_Uint32_Bit_06.P_Bit.Bit_Test P_Bit_Uint32_Bit_07.P_Bit.Bit_Test P_Bit_Uint32_Bit_08.P_Bit.Bit_Test P_Bit_Uint32_Bit_09.P_Bit.Bit_Test P_Bit_Uint32_Bit_10.P_Bit.Bit_Test P_Bit_Uint32_Bit_11.P_Bit.Bit_Test P_Bit_Uint32_Bit_12.P_Bit.Bit_Test P_Bit_Uint32_Bit_13.P_Bit.Bit_Test P_Bit_Uint32_Bit_14.P_Bit.Bit_Test P_Bit_Uint32_Bit_15.P_Bit.Bit_Test P_Bit_Uint32_Bit_16.P_Bit.Bit_Test P_Bit_Uint32_Bit_17.P_Bit.Bit_Test P_Bit_Uint32_Bit_18.P_Bit.Bit_Test P_Bit_Uint32_Bit_19.P_Bit.Bit_Test P_Bit_Uint32_Bit_20.P_Bit.Bit_Test P_Bit_Uint32_Bit_21.P_Bit.Bit_Test P_Bit_Uint32_Bit_22.P_Bit.Bit_Test P_Bit_Uint32_Bit_23.P_Bit.Bit_Test P_Bit_Uint32_Bit_24.P_Bit.Bit_Test P_Bit_Uint32_Bit_25.P_Bit.Bit_Test P_Bit_Uint32_Bit_26.P_Bit.Bit_Test P_Bit_Uint32_Bit_27.P_Bit.Bit_Test P_Bit_Uint32_Bit_28.P_Bit.Bit_Test P_Bit_Uint32_Bit_29.P_Bit.Bit_Test P_Bit_Uint32_Bit_30.P_Bit.Bit_Test P_Bit_Uint32_Bit_31.P_Bit.Bit_Test P_Bit_Uint8_Bit_0.P_Bit.Bit_Test P_Bit_Uint8_Bit_1.P_Bit.Bit_Test P_Bit_Uint8_Bit_2.P_Bit.Bit_Test P_Bit_Uint8_Bit_3.P_Bit.Bit_Test P_Bit_Uint8_Bit_4.P_Bit.Bit_Test P_Bit_Uint8_Bit_5.P_Bit.Bit_Test P_Bit_Uint8_Bit_6.P_Bit.Bit_Test P_Bit_Uint8_Bit_7.P_Bit.Bit_Test /end REF_CHARACTERISTIC
/end GROUP
/begin GROUP SHELL.BASE ""
 /begin REF_MEASUREMENT HWE_A_U_5V1_Err.SHELL.BASE HWE_A_U_5V1_Stat.SHELL.BASE HWE_A_U_5V2_Err.SHELL.BASE HWE_A_U_5V2_Stat.SHELL.BASE HWE_A_U_5V3_Err.SHELL.BASE HWE_A_U_5V3_Stat.SHELL.BASE HWE_Alarm_Can_Num1_Driver.SHELL.BASE HWE_CANA_ID250RX_1.SHELL.BASE HWE_CANA_ID250RX_2.SHELL.BASE HWE_CANA_ID258RX_1.SHELL.BASE HWE_CANA_ID258RX_2.SHELL.BASE HWE_CANA_ID260TX_1.SHELL.BASE HWE_CANA_ID260TX_2.SHELL.BASE HWE_CANA_ID288TX_1.SHELL.BASE HWE_CANA_ID288TX_2.SHELL.BASE HWE_CANA_ID290RX_1.SHELL.BASE HWE_CANA_ID290RX_2.SHELL.BASE HWE_CANA_ID310TX_1.SHELL.BASE HWE_CANA_ID310TX_2.SHELL.BASE HWE_CANA_ID320RX_1.SHELL.BASE HWE_CANA_ID320RX_2.SHELL.BASE HWE_CANA_ID330TX_1.SHELL.BASE HWE_CANA_ID330TX_2.SHELL.BASE HWE_CANA_ID340RX_1.SHELL.BASE HWE_CANA_ID340RX_2.SHELL.BASE HWE_CANA_ID358RX_1.SHELL.BASE HWE_CANA_ID358RX_2.SHELL.BASE HWE_CANA_ID500RX_1.SHELL.BASE HWE_CANA_ID500RX_2.SHELL.BASE HWE_CANA_ID510RX_1.SHELL.BASE HWE_CANA_ID510RX_2.SHELL.BASE HWE_CANA_ID620TX_1.SHELL.BASE HWE_CANA_ID620TX_2.SHELL.BASE HWE_CANA_ID630RX_1.SHELL.BASE HWE_CANA_ID630RX_2.SHELL.BASE HWE_CANA_ID640RX_1.SHELL.BASE HWE_CANA_ID640RX_2.SHELL.BASE HWE_CANA_InitAfterBusOff.SHELL.BASE HWE_CANA_OBD_TX_V7.SHELL.BASE HWE_CANA_stBusOff.SHELL.BASE HWE_CANB_CCP_DAQ0_V4.SHELL.BASE HWE_CANB_CCP_DAQ1_V5.SHELL.BASE HWE_CANB_CCP_DAQ2_V6.SHELL.BASE HWE_CANB_CCP_RX_V2.SHELL.BASE HWE_CANB_CCP_TX_V3.SHELL.BASE HWE_CANB_ID348RXB_1.SHELL.BASE HWE_CANB_ID348RXB_2.SHELL.BASE HWE_CANB_ID350TX_1.SHELL.BASE HWE_CANB_ID350TX_2.SHELL.BASE HWE_CANB_ID360TX_1.SHELL.BASE HWE_CANB_ID360TX_2.SHELL.BASE HWE_CANB_ID380TX_1.SHELL.BASE HWE_CANB_ID380TX_2.SHELL.BASE HWE_CANB_ID578RXB_1.SHELL.BASE HWE_CANB_ID578RXB_2.SHELL.BASE HWE_CANB_ID590RXB_1.SHELL.BASE HWE_CANB_ID590RXB_2.SHELL.BASE HWE_CANB_ID5FFTX_1.SHELL.BASE HWE_CANB_ID5FFTX_2.SHELL.BASE HWE_CANB_ID690TX_1.SHELL.BASE HWE_CANB_ID690TX_2.SHELL.BASE HWE_CANB_ID691TX_1.SHELL.BASE HWE_CANB_ID691TX_2.SHELL.BASE HWE_CANB_ID695TX_1.SHELL.BASE HWE_CANB_ID695TX_2.SHELL.BASE HWE_CANB_ID696RXB_1.SHELL.BASE HWE_CANB_InitAfterBusOff.SHELL.BASE HWE_CANB_MUX_ID5xx_V8.SHELL.BASE HWE_CANB_MUX_ID5xx_V8_U32_1.SHELL.BASE HWE_CANB_MUX_ID5xx_V8_U32_2.SHELL.BASE HWE_CANB_stBusOff.SHELL.BASE HWE_CANC_ID100TX_1.SHELL.BASE HWE_CANC_ID100TX_2.SHELL.BASE HWE_CANC_ID101RX_1.SHELL.BASE HWE_CANC_ID101RX_2.SHELL.BASE HWE_CANC_InitAfterBusOff.SHELL.BASE HWE_CANC_stBusOff.SHELL.BASE HWE_CAN_DisableNormalMsgTx.SHELL.BASE HWE_CJ230A_Err.SHELL.BASE HWE_CJ230A_Stat.SHELL.BASE HWE_CJ230B_Err.SHELL.BASE HWE_CJ230B_Stat.SHELL.BASE HWE_CJ945A_Err.SHELL.BASE HWE_CJ945A_Stat.SHELL.BASE HWE_CJ945B_Err.SHELL.BASE HWE_CJ945B_Stat.SHELL.BASE HWE_Can_DiagOpSwitch.SHELL.BASE HWE_Can_Rx_Ok.SHELL.BASE HWE_EepBlk_State.SHELL.BASE HWE_Eep_AfterRun_st.SHELL.BASE HWE_Eep_Format.SHELL.BASE HWE_Enter_NL.SHELL.BASE HWE_IA01.SHELL.BASE HWE_IA02.SHELL.BASE HWE_IA03.SHELL.BASE HWE_IA04.SHELL.BASE HWE_IA05.SHELL.BASE HWE_IA06.SHELL.BASE HWE_IA07.SHELL.BASE HWE_IA08.SHELL.BASE HWE_IA09.SHELL.BASE HWE_IA10.SHELL.BASE HWE_IA11.SHELL.BASE HWE_IA12.SHELL.BASE HWE_IA13.SHELL.BASE HWE_IA14.SHELL.BASE HWE_IA15.SHELL.BASE HWE_IA16.SHELL.BASE HWE_IA17.SHELL.BASE HWE_IA18.SHELL.BASE HWE_IA19.SHELL.BASE HWE_IA20.SHELL.BASE HWE_IA21.SHELL.BASE HWE_IA22.SHELL.BASE HWE_IA25.SHELL.BASE HWE_IA26.SHELL.BASE HWE_IA_IPS.SHELL.BASE HWE_IA_ITS.SHELL.BASE HWE_IA_TER30.SHELL.BASE HWE_IA_TER30B.SHELL.BASE HWE_ID101RX_failure.SHELL.BASE HWE_ID250RX_failure.SHELL.BASE HWE_ID258RX_failure.SHELL.BASE HWE_ID290RX_failure.SHELL.BASE HWE_ID320RX_failure.SHELL.BASE HWE_ID340RX_failure.SHELL.BASE HWE_ID348RXB_failure.SHELL.BASE HWE_ID358RX_failure.SHELL.BASE HWE_ID500RX_failure.SHELL.BASE HWE_ID510RX_failure.SHELL.BASE HWE_ID578RXB_failure.SHELL.BASE HWE_ID590RXB_failure.SHELL.BASE HWE_ID590RXB_failure_1.SHELL.BASE HWE_ID630RX_failure.SHELL.BASE HWE_ID640RX_failure.SHELL.BASE HWE_ID696RXB_failure.SHELL.BASE HWE_ID696RXB_failure_1.SHELL.BASE HWE_ID710RX_failure.SHELL.BASE HWE_ID760RX_failure.SHELL.BASE HWE_IP01_Dio.SHELL.BASE HWE_IP02_Dio.SHELL.BASE HWE_IP03_Dio.SHELL.BASE HWE_IP04_Dio.SHELL.BASE HWE_IP05_Dio.SHELL.BASE HWE_IP06_Dio.SHELL.BASE HWE_IP07_Dio.SHELL.BASE HWE_IP08_Dio.SHELL.BASE HWE_IP09_Dcyc.SHELL.BASE HWE_IP09_Err.SHELL.BASE HWE_IP09_Per.SHELL.BASE HWE_IP10_Dcyc.SHELL.BASE HWE_IP10_Err.SHELL.BASE HWE_IP10_Per.SHELL.BASE HWE_IP11_Dcyc.SHELL.BASE HWE_IP11_Err.SHELL.BASE HWE_IP11_Per.SHELL.BASE HWE_IP12_Dcyc.SHELL.BASE HWE_IP12_Err.SHELL.BASE HWE_IP12_Per.SHELL.BASE HWE_IS01.SHELL.BASE HWE_IS02.SHELL.BASE HWE_IS03.SHELL.BASE HWE_IS04.SHELL.BASE HWE_IS05.SHELL.BASE HWE_IS06.SHELL.BASE HWE_IS07.SHELL.BASE HWE_IS08.SHELL.BASE HWE_IS09.SHELL.BASE HWE_IS10.SHELL.BASE HWE_IS11.SHELL.BASE HWE_IS12.SHELL.BASE HWE_IS_ON.SHELL.BASE HWE_IS_TER15.SHELL.BASE HWE_IS_TER15R.SHELL.BASE HWE_IS_TER50.SHELL.BASE HWE_IS_WDA.SHELL.BASE HWE_OIC01_Dcyc.SHELL.BASE HWE_OIC01_DiagReg.SHELL.BASE HWE_OIC01_DiagRet.SHELL.BASE HWE_OIC01_Err.SHELL.BASE HWE_OIC01_Stat.SHELL.BASE HWE_OIC02_Dcyc.SHELL.BASE HWE_OIC02_Diag.SHELL.BASE HWE_OIC02_DiagReg.SHELL.BASE HWE_OIC02_DiagRet.SHELL.BASE HWE_OIC02_Err.SHELL.BASE HWE_OIC02_Stat.SHELL.BASE HWE_OPI01_Dcyc.SHELL.BASE HWE_OPI01_Err.SHELL.BASE HWE_OPI01_Stat.SHELL.BASE HWE_OPI02_Dcyc.SHELL.BASE HWE_OPI02_Err.SHELL.BASE HWE_OPI02_Stat.SHELL.BASE HWE_OPI03_Dcyc.SHELL.BASE HWE_OPI03_Err.SHELL.BASE HWE_OPI03_Stat.SHELL.BASE HWE_OPI04_Dcyc.SHELL.BASE HWE_OPI04_Err.SHELL.BASE HWE_OPI04_Stat.SHELL.BASE HWE_OPI05_Dcyc.SHELL.BASE HWE_OPI05_Err.SHELL.BASE HWE_OPI05_Stat.SHELL.BASE HWE_OPI06_Dcyc.SHELL.BASE HWE_OPI06_Err.SHELL.BASE HWE_OPI06_Stat.SHELL.BASE HWE_OPI07_Dcyc.SHELL.BASE HWE_OPI07_Err.SHELL.BASE HWE_OPI07_Stat.SHELL.BASE HWE_OPI08_Dcyc.SHELL.BASE HWE_OPI08_Err.SHELL.BASE HWE_OPI08_Stat.SHELL.BASE HWE_OPI09_Dcyc.SHELL.BASE HWE_OPI09_Err.SHELL.BASE HWE_OPI09_Stat.SHELL.BASE HWE_OPI10_Dcyc.SHELL.BASE HWE_OPI10_Err.SHELL.BASE HWE_OPI10_Stat.SHELL.BASE HWE_OPI11_Dcyc.SHELL.BASE HWE_OPI11_Err.SHELL.BASE HWE_OPI11_Stat.SHELL.BASE HWE_OS01_DiagReg.SHELL.BASE HWE_OS01_DiagRet.SHELL.BASE HWE_OS01_DiagStat.SHELL.BASE HWE_OS01_Disable.SHELL.BASE HWE_OS01_En.SHELL.BASE HWE_OS01_Err.SHELL.BASE HWE_OS01_S_Dcyc.SHELL.BASE HWE_OS01_Stat.SHELL.BASE HWE_OS01_V.SHELL.BASE HWE_OS02_DiagReg.SHELL.BASE HWE_OS02_DiagRet.SHELL.BASE HWE_OS02_DiagStat.SHELL.BASE HWE_OS02_Disable.SHELL.BASE HWE_OS02_En.SHELL.BASE HWE_OS02_Err.SHELL.BASE HWE_OS02_S_Dcyc.SHELL.BASE HWE_OS02_Stat.SHELL.BASE HWE_OS02_V.SHELL.BASE HWE_OS03.SHELL.BASE HWE_OS03_Err.SHELL.BASE HWE_OS03_Stat.SHELL.BASE HWE_OS04.SHELL.BASE HWE_OS04_Err.SHELL.BASE HWE_OS04_Stat.SHELL.BASE HWE_OS05a.SHELL.BASE HWE_OS05a_Err.SHELL.BASE HWE_OS05a_Stat.SHELL.BASE HWE_OS05b.SHELL.BASE HWE_OS05b_Err.SHELL.BASE HWE_OS05b_Stat.SHELL.BASE HWE_OS05c.SHELL.BASE HWE_OS05c_Err.SHELL.BASE HWE_OS05c_Stat.SHELL.BASE HWE_OS06.SHELL.BASE HWE_OS06_Err.SHELL.BASE HWE_OS06_Stat.SHELL.BASE HWE_OS07.SHELL.BASE HWE_OS07_Err.SHELL.BASE HWE_OS07_Stat.SHELL.BASE HWE_OS08.SHELL.BASE HWE_OS08_Err.SHELL.BASE HWE_OS08_Stat.SHELL.BASE HWE_OS09.SHELL.BASE HWE_OS09_Err.SHELL.BASE HWE_OS09_Stat.SHELL.BASE HWE_OS10.SHELL.BASE HWE_OS10_Err.SHELL.BASE HWE_OS10_Stat.SHELL.BASE HWE_OS11.SHELL.BASE HWE_OS11_Err.SHELL.BASE HWE_OS11_Stat.SHELL.BASE HWE_OS12.SHELL.BASE HWE_OS12_Err.SHELL.BASE HWE_OS12_Stat.SHELL.BASE HWE_OS13.SHELL.BASE HWE_OS13_Err.SHELL.BASE HWE_OS13_Stat.SHELL.BASE HWE_OS14.SHELL.BASE HWE_OS14_Err.SHELL.BASE HWE_OS14_Stat.SHELL.BASE HWE_OS15.SHELL.BASE HWE_OS15_Err.SHELL.BASE HWE_OS15_Stat.SHELL.BASE HWE_OS_MR.SHELL.BASE HWE_OS_ModelState.SHELL.BASE HWE_Rtmo_ctSample.SHELL.BASE HWE_Rtmo_ctSampleProc.SHELL.BASE HWE_Rtmo_pLoadMax.SHELL.BASE HWE_Rtmo_tiAbsMax.SHELL.BASE HWE_Rtmo_tiAbsMax_1.SHELL.BASE HWE_Rtmo_tiAbsMin.SHELL.BASE HWE_Rtmo_tiAvrg.SHELL.BASE HWE_Rtmo_tiMax.SHELL.BASE HWE_Rtmo_tiMaxCallDist.SHELL.BASE HWE_Rtmo_tiMin.SHELL.BASE HWE_Rtmo_tiMinCallDist.SHELL.BASE HWE_ServiceCounter_st.SHELL.BASE HWE_SwitchOff.SHELL.BASE _HWE_CAN_A_BAUDRATE_V_unused.SHELL.BASE _HWE_CAN_B_BAUDRATE_V_unused.SHELL.BASE _HWE_CAN_C_BAUDRATE_V_unused.SHELL.BASE l_baudrate_calculated_f32.HWE_CAN_A.SHELL.BASE l_baudrate_calculated_f32.HWE_CAN_B.SHELL.BASE l_baudrate_calculated_f32.HWE_CAN_C.SHELL.BASE l_baudrate_e.HWE_CAN_A.SHELL.BASE l_baudrate_e.HWE_CAN_B.SHELL.BASE l_baudrate_e.HWE_CAN_C.SHELL.BASE l_dBRP_u8.HWE_CAN_A.SHELL.BASE l_dBRP_u8.HWE_CAN_B.SHELL.BASE l_dBRP_u8.HWE_CAN_C.SHELL.BASE l_dPSeg1_u8.HWE_CAN_A.SHELL.BASE l_dPSeg1_u8.HWE_CAN_B.SHELL.BASE l_dPSeg1_u8.HWE_CAN_C.SHELL.BASE l_dPSeg2_u8.HWE_CAN_A.SHELL.BASE l_dPSeg2_u8.HWE_CAN_B.SHELL.BASE l_dPSeg2_u8.HWE_CAN_C.SHELL.BASE l_dPropSeg_u8.HWE_CAN_A.SHELL.BASE l_dPropSeg_u8.HWE_CAN_B.SHELL.BASE l_dPropSeg_u8.HWE_CAN_C.SHELL.BASE l_dSJW_u8.HWE_CAN_A.SHELL.BASE l_dSJW_u8.HWE_CAN_B.SHELL.BASE l_dSJW_u8.HWE_CAN_C.SHELL.BASE l_samplepoint_calculated_f32.HWE_CAN_A.SHELL.BASE l_samplepoint_calculated_f32.HWE_CAN_B.SHELL.BASE l_samplepoint_calculated_f32.HWE_CAN_C.SHELL.BASE /end REF_MEASUREMENT
 /begin REF_CHARACTERISTIC HWE_CANA_OBD_TX_P7.SHELL.BASE HWE_CANA_StopDebTicks.SHELL.BASE HWE_CANA_UseBusOffTimer.SHELL.BASE HWE_CANB_CCP_DAQ0_P4.SHELL.BASE HWE_CANB_CCP_DAQ1_P5.SHELL.BASE HWE_CANB_CCP_DAQ2_P6.SHELL.BASE HWE_CANB_CCP_RX_P2.SHELL.BASE HWE_CANB_CCP_TX_P3.SHELL.BASE HWE_CANB_MUX_ID5xx_P8.SHELL.BASE HWE_CANB_StopDebTicks.SHELL.BASE HWE_CANB_UseBusOffTimer.SHELL.BASE HWE_CANB_XCP_CMD_RX_P4.SHELL.BASE HWE_CANB_XCP_DAQ0_P6.SHELL.BASE HWE_CANB_XCP_RES_TX_P5.SHELL.BASE HWE_CANB_XCP_STIM0_P0.SHELL.BASE HWE_CANB_XCP_STIM1_P1.SHELL.BASE HWE_CANB_XCP_STIM2_P2.SHELL.BASE HWE_CANB_XCP_STIM3_P3.SHELL.BASE HWE_CANC_StopDebTicks.SHELL.BASE HWE_CANC_UseBusOffTimer.SHELL.BASE HWE_IP09_DcycMax.SHELL.BASE HWE_IP09_DcycMin.SHELL.BASE HWE_IP09_PerMax.SHELL.BASE HWE_IP09_PerMin.SHELL.BASE HWE_IP10_DcycMax.SHELL.BASE HWE_IP10_DcycMin.SHELL.BASE HWE_IP10_PerMax.SHELL.BASE HWE_IP10_PerMin.SHELL.BASE HWE_IP11_DcycMax.SHELL.BASE HWE_IP11_DcycMin.SHELL.BASE HWE_IP11_PerMax.SHELL.BASE HWE_IP11_PerMin.SHELL.BASE HWE_IP12_DcycMax.SHELL.BASE HWE_IP12_DcycMin.SHELL.BASE HWE_IP12_PerMax.SHELL.BASE HWE_IP12_PerMin.SHELL.BASE HWE_OIC01_Per.SHELL.BASE HWE_OIC02_Per.SHELL.BASE HWE_OPI01_Per.SHELL.BASE HWE_OPI02_Per.SHELL.BASE HWE_OPI03_Per.SHELL.BASE HWE_OPI04_Per.SHELL.BASE HWE_OPI05_Per.SHELL.BASE HWE_OPI06_Per.SHELL.BASE HWE_OPI07_Per.SHELL.BASE HWE_OPI08_Per.SHELL.BASE HWE_OPI09_Per.SHELL.BASE HWE_OPI10_Per.SHELL.BASE HWE_OPI11_Per.SHELL.BASE HWE_OS01_S_Per.SHELL.BASE HWE_OS02_S_Per.SHELL.BASE HWE_Rtmo_adStart.SHELL.BASE HWE_Rtmo_stSampleTime.SHELL.BASE p_baudrate_e.HWE_CAN_A.SHELL.BASE p_baudrate_e.HWE_CAN_B.SHELL.BASE p_baudrate_e.HWE_CAN_C.SHELL.BASE p_dBRP_u8.HWE_CAN_A.SHELL.BASE p_dBRP_u8.HWE_CAN_B.SHELL.BASE p_dBRP_u8.HWE_CAN_C.SHELL.BASE p_dPSeg1_u8.HWE_CAN_A.SHELL.BASE p_dPSeg1_u8.HWE_CAN_B.SHELL.BASE p_dPSeg1_u8.HWE_CAN_C.SHELL.BASE p_dPSeg2_u8.HWE_CAN_A.SHELL.BASE p_dPSeg2_u8.HWE_CAN_B.SHELL.BASE p_dPSeg2_u8.HWE_CAN_C.SHELL.BASE p_dPropSeg_u8.HWE_CAN_A.SHELL.BASE p_dPropSeg_u8.HWE_CAN_B.SHELL.BASE p_dPropSeg_u8.HWE_CAN_C.SHELL.BASE p_dSJW_u8.HWE_CAN_A.SHELL.BASE p_dSJW_u8.HWE_CAN_B.SHELL.BASE p_dSJW_u8.HWE_CAN_C.SHELL.BASE /end REF_CHARACTERISTIC
/end GROUP
/begin GROUP Time.DAQ2_Tx.CCP_SHELL ""
 /begin REF_MEASUREMENT Max.Time.DAQ2_Tx.CCP_SHELL Min.Time.DAQ2_Tx.CCP_SHELL Time.Time.DAQ2_Tx.CCP_SHELL /end REF_MEASUREMENT
/end GROUP
/begin GROUP TimeSum.DAQ2_Tx.CCP_SHELL ""
 /begin REF_MEASUREMENT Max.TimeSum.DAQ2_Tx.CCP_SHELL Min.TimeSum.DAQ2_Tx.CCP_SHELL Time.TimeSum.DAQ2_Tx.CCP_SHELL /end REF_MEASUREMENT
/end GROUP
/begin GROUP Time_Calc.HWE.BASE ""
 /begin REF_MEASUREMENT Result.Time_Calc.HWE.BASE TimeStampOne.Time_Calc.HWE.BASE TimeStampTwo.Time_Calc.HWE.BASE is_started.Time_Calc.HWE.BASE /end REF_MEASUREMENT
/end GROUP
/begin RECORD_LAYOUT STANDARD_VALUE_S16 FNC_VALUES 1 SWORD COLUMN_DIR DIRECT /end RECORD_LAYOUT
/begin RECORD_LAYOUT STANDARD_VALUE_S32 FNC_VALUES 1 SLONG COLUMN_DIR DIRECT /end RECORD_LAYOUT
/begin RECORD_LAYOUT STANDARD_VALUE_S8 FNC_VALUES 1 SBYTE COLUMN_DIR DIRECT /end RECORD_LAYOUT
/begin RECORD_LAYOUT STANDARD_VALUE_U16 FNC_VALUES 1 UWORD COLUMN_DIR DIRECT /end RECORD_LAYOUT
/begin RECORD_LAYOUT STANDARD_VALUE_U32 FNC_VALUES 1 ULONG COLUMN_DIR DIRECT /end RECORD_LAYOUT
/begin RECORD_LAYOUT STANDARD_VALUE_U8 FNC_VALUES 1 UBYTE COLUMN_DIR DIRECT /end RECORD_LAYOUT
/end MODULE
/end PROJECT
