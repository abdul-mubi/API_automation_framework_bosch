ASAP2_VERSION 1 61
/begin PROJECT HWA_UDSonCAN_ReferenceSystem "Modified for UDSonCAN Tests with new CalMeasure Mapping"
/begin HEADER "" VERSION "000" PROJECT_NO ASD /end HEADER
/begin MODULE HWA_UDSonCAN_ReferenceSystem "Modified for UDSonCAN Tests with new CalMeasure Mapping"
/* AML Section included by script insert_a2mls.pl */
/* END: AML Section included by script insert_a2mls.pl */
/begin MOD_PAR "" VERSION "000" ADDR_EPK 0x1D0010 EPK "M9U_2013-05-06_09:49:33_mkl9fe_F" SUPPLIER "ETAS" CUSTOMER "intern" CUSTOMER_NO "000" USER "xxx" PHONE_NO "000" ECU "Rev. C" CPU_TYPE "MPC563" NO_OF_INTERFACES 1 /* /begin C:/ETAS/ASCET513/target/mpc555/Add_ToolChain/ASAP_Templates\mem_lay_me9u_serial_protocols.a2l inserted by post asap script INSERT_MEM_LAY.pl */ /* *
* Change description: *
* 07.03 BPS-Stu Additional Code sections added (extFlash2, extFlash3, cbb, cmfFlash) *
* 02.02 ETAS-PU new memory Areas for C-Sample - green oak. *
* In the Data Section The last 4 Words are reserved. *
* Reason: INCA calculates the checksum *
* of the Data Eprom Areas. Omit the Signature area for checksum. *
* ??.02.2005 ETAS-ZJ : Add XCP part and moved file to MEM_LAY_pl.a2l *
* for post ASAP script processing *
* 29.03.2007 ETAS-Mle : change ADDR_MAPPING --> ADDRESS_MAPPING *
* 30.10.2007 ETAS-Mle : VARIABLES RAM INTERN 0x800000 0x20000 for MEMORY_SEGMENT Ram800000 *
* as MEMORY_SEGMENT ExtRam940000 allready contains VARIABLES RAM EXTERN *
* at 0x940000 for Trigger Segment Ram800000 has to be INTERN *
* ETK can only handle one MEMORY_SEGMENT with VARIABLES RAM INTERN *
* 30.10.2007 ETAS-Mle : change OFFLINE_DATA --> RESERVED for MEMORY_SEGMENT Dst942000 *
* 30.10.2007 ETAS-Mle : change OFFLINE_DATA --> RESERVED for MEMORY_SEGMENT Dst1E0000 *
* 27.11.2007 ETAS-Mle : create separate MEMORY_SEGMENT "Dst942000_ETK" & "Dst1D0000_ETK" for ETK *
* 14.01.2008 ETAS-Mle : comment MEMORY_SEGMENT "Dst942000_ETK" & "Dst1D0000_ETK" for ETK *
* 24.08.2010 ETAS-Mle : modify to support slewing MEMORY_SEGMENT CALIBRATION_VARIABLES *
*/
 /begin MEMORY_SEGMENT boot0000 "" RESERVED EPROM EXTERN 0x00000 0x2000 -1 -1 -1 -1 -1 /begin IF_DATA ASAP1B_CCP ADDRESS_MAPPING 0x00000 0x00000 0x2000 /end IF_DATA /begin IF_DATA ASAP1B_KWP2000 ADDRESS_MAPPING 0x00000 0x00000 0x2000 /end IF_DATA
  /begin IF_DATA ASAP1B_DIAGNOSTIC_SERVICES ADDRESS_MAPPING 0x00000 0x00000 0x2000 /end IF_DATA
  /begin IF_DATA ETK ADDRESS_MAPPING 0x00000 0x00000 0x2000 /end IF_DATA
 /end MEMORY_SEGMENT
 /begin MEMORY_SEGMENT boot4000 "" RESERVED EPROM EXTERN 0x04000 0x2000 -1 -1 -1 -1 -1 /begin IF_DATA ASAP1B_CCP ADDRESS_MAPPING 0x04000 0x04000 0x2000 /end IF_DATA /begin IF_DATA ASAP1B_KWP2000 ADDRESS_MAPPING 0x04000 0x04000 0x2000 /end IF_DATA
  /begin IF_DATA ASAP1B_DIAGNOSTIC_SERVICES ADDRESS_MAPPING 0x04000 0x04000 0x2000 /end IF_DATA
  /begin IF_DATA ETK ADDRESS_MAPPING 0x04000 0x04000 0x2000 /end IF_DATA
 /end MEMORY_SEGMENT
 /begin MEMORY_SEGMENT boot10000 "" RESERVED EPROM EXTERN 0x10000 0x10000 -1 -1 -1 -1 -1 /begin IF_DATA ASAP1B_CCP ADDRESS_MAPPING 0x10000 0x10000 0x10000 /end IF_DATA /begin IF_DATA ASAP1B_KWP2000 ADDRESS_MAPPING 0x10000 0x10000 0x10000 /end IF_DATA
  /begin IF_DATA ASAP1B_DIAGNOSTIC_SERVICES ADDRESS_MAPPING 0x10000 0x10000 0x10000 /end IF_DATA
  /begin IF_DATA ETK ADDRESS_MAPPING 0x10000 0x10000 0x10000 /end IF_DATA
 /end MEMORY_SEGMENT
 /begin MEMORY_SEGMENT Pst20000 "" CODE EPROM EXTERN 0x20000 0x60000 -1 -1 -1 -1 -1 /begin IF_DATA ASAP1B_CCP ADDRESS_MAPPING 0x20000 0x20000 0x60000 /end IF_DATA /begin IF_DATA ASAP1B_KWP2000 ADDRESS_MAPPING 0x20000 0x20000 0x60000 /end IF_DATA
  /begin IF_DATA ASAP1B_DIAGNOSTIC_SERVICES ADDRESS_MAPPING 0x20000 0x20000 0x60000 /end IF_DATA
  /begin IF_DATA ETK ADDRESS_MAPPING 0x20000 0x20000 0x60000 /end IF_DATA
 /end MEMORY_SEGMENT
 /begin MEMORY_SEGMENT Pst80000 "" CODE EPROM EXTERN 0x80000 0x20000 -1 -1 -1 -1 -1 /begin IF_DATA ASAP1B_CCP ADDRESS_MAPPING 0x80000 0x80000 0x20000 /end IF_DATA /begin IF_DATA ASAP1B_KWP2000 ADDRESS_MAPPING 0x80000 0x80000 0x20000 /end IF_DATA
  /begin IF_DATA ASAP1B_DIAGNOSTIC_SERVICES ADDRESS_MAPPING 0x80000 0x80000 0x20000 /end IF_DATA
  /begin IF_DATA ETK ADDRESS_MAPPING 0x80000 0x80000 0x20000 /end IF_DATA
 /end MEMORY_SEGMENT
 /begin MEMORY_SEGMENT PstA0000 "" CODE EPROM EXTERN 0xA0000 0x120000 -1 -1 -1 -1 -1 /begin IF_DATA ASAP1B_CCP ADDRESS_MAPPING 0xA0000 0xA0000 0x120000 /end IF_DATA /begin IF_DATA ASAP1B_KWP2000 ADDRESS_MAPPING 0xA0000 0xA0000 0x120000 /end IF_DATA
  /begin IF_DATA ASAP1B_DIAGNOSTIC_SERVICES ADDRESS_MAPPING 0xA0000 0xA0000 0x120000 /end IF_DATA
  /begin IF_DATA ETK ADDRESS_MAPPING 0xA0000 0xA0000 0x120000 /end IF_DATA
 /end MEMORY_SEGMENT
 /begin MEMORY_SEGMENT Pst400000 "" CODE EPROM EXTERN 0x400000 0x80000 -1 -1 -1 -1 -1 /begin IF_DATA ASAP1B_CCP ADDRESS_MAPPING 0x400000 0x400000 0x80000 /end IF_DATA /begin IF_DATA ASAP1B_KWP2000 ADDRESS_MAPPING 0x400000 0x400000 0x80000 /end IF_DATA
  /begin IF_DATA ASAP1B_DIAGNOSTIC_SERVICES ADDRESS_MAPPING 0x400000 0x400000 0x80000 /end IF_DATA
  /begin IF_DATA ETK ADDRESS_MAPPING 0x400000 0x400000 0x80000 /end IF_DATA
  /begin IF_DATA XCP
   /begin SEGMENT 0x00 0x01 0x00 0x00 0x00 /begin CHECKSUM XCP_ADD_14 /end CHECKSUM
    /begin PAGE 0x00 ECU_ACCESS_WITH_XCP_ONLY XCP_READ_ACCESS_WITH_ECU_ONLY XCP_WRITE_ACCESS_NOT_ALLOWED /end PAGE
    /begin ADDRESS_MAPPING 0x400000 0x400000 0x80000 /end ADDRESS_MAPPING
   /end SEGMENT
  /end IF_DATA
 /end MEMORY_SEGMENT
 /begin MEMORY_SEGMENT Dst942000 "" RESERVED EPROM EXTERN 0x1C2000 0xE000 -1 -1 -1 -1 -1 /begin IF_DATA ASAP1B_CCP ADDRESS_MAPPING 0x1C2000 0x942000 0xE000 /end IF_DATA /begin IF_DATA ASAP1B_KWP2000 ADDRESS_MAPPING 0x1C2000 0x942000 0xE000 /end IF_DATA
  /begin IF_DATA ASAP1B_DIAGNOSTIC_SERVICES ADDRESS_MAPPING 0x1C2000 0x942000 0xE000 /end IF_DATA
  /begin IF_DATA ETK ADDRESS_MAPPING 0x1C2000 0x942000 0xE000 /end IF_DATA
 /end MEMORY_SEGMENT
 /begin MEMORY_SEGMENT Dst5D0000 "" DATA EPROM EXTERN 0x1D0000 0xF000 -1 -1 -1 -1 -1 /begin IF_DATA ASAP1B_CCP ADDRESS_MAPPING 0x1D0000 0x5D0000 0xF000 /end IF_DATA /begin IF_DATA ASAP1B_KWP2000 ADDRESS_MAPPING 0x1D0000 0x5D0000 0xF000 /end IF_DATA
  /begin IF_DATA ASAP1B_DIAGNOSTIC_SERVICES ADDRESS_MAPPING 0x1D0000 0x5D0000 0xF000 /end IF_DATA
  /begin IF_DATA ETK ADDRESS_MAPPING 0x1D0000 0x950000 0xF000 /end IF_DATA
  /begin IF_DATA XCP
   /begin SEGMENT 0x01 0x02 0x00 0x00 0x00 /begin CHECKSUM XCP_ADD_14 /end CHECKSUM
    /begin PAGE 0x00 ECU_ACCESS_WITH_XCP_ONLY XCP_READ_ACCESS_WITH_ECU_ONLY XCP_WRITE_ACCESS_NOT_ALLOWED /end PAGE
    /begin PAGE 0x01 ECU_ACCESS_WITH_XCP_ONLY XCP_READ_ACCESS_WITH_ECU_ONLY XCP_WRITE_ACCESS_WITH_ECU_ONLY /end PAGE
    /begin ADDRESS_MAPPING 0x1D0000 0x5D0000 0xF000 /end ADDRESS_MAPPING
   /end SEGMENT
  /end IF_DATA
 /end MEMORY_SEGMENT
 /begin MEMORY_SEGMENT Dst1DF000 "" CALIBRATION_VARIABLES FLASH EXTERN 0x1DF000 0x1000 -1 -1 -1 -1 -1 /begin IF_DATA ASAP1B_CCP ADDRESS_MAPPING 0x1DF000 0x5DF000 0x1000 /end IF_DATA /begin IF_DATA ASAP1B_KWP2000 ADDRESS_MAPPING 0x1DF000 0x5DF000 0x1000 /end IF_DATA
  /begin IF_DATA ASAP1B_DIAGNOSTIC_SERVICES ADDRESS_MAPPING 0x1DF000 0x5DF000 0x1000 /end IF_DATA
  /begin IF_DATA ETK ADDRESS_MAPPING 0x1DF000 0x95F000 0x1000 /end IF_DATA
  /begin IF_DATA XCP
   /begin SEGMENT 0x04 0x02 0x00 0x00 0x00 /begin CHECKSUM XCP_ADD_14 /end CHECKSUM
    /begin PAGE 0x00 ECU_ACCESS_WITH_XCP_ONLY XCP_READ_ACCESS_WITH_ECU_ONLY XCP_WRITE_ACCESS_NOT_ALLOWED /end PAGE
    /begin PAGE 0x01 ECU_ACCESS_WITH_XCP_ONLY XCP_READ_ACCESS_WITH_ECU_ONLY XCP_WRITE_ACCESS_WITH_ECU_ONLY /end PAGE
    /begin ADDRESS_MAPPING 0x1DF000 0x5DF000 0x1000 /end ADDRESS_MAPPING
   /end SEGMENT
  /end IF_DATA
 /end MEMORY_SEGMENT
 /begin MEMORY_SEGMENT Dst1E0000 "" RESERVED EPROM EXTERN 0x1E0000 0x20000 -1 -1 -1 -1 -1 /begin IF_DATA ASAP1B_CCP ADDRESS_MAPPING 0x1E0000 0x960000 0x20000 /end IF_DATA /begin IF_DATA ASAP1B_KWP2000 ADDRESS_MAPPING 0x1E0000 0x960000 0x20000 /end IF_DATA
  /begin IF_DATA ASAP1B_DIAGNOSTIC_SERVICES ADDRESS_MAPPING 0x1E0000 0x960000 0x20000 /end IF_DATA
  /begin IF_DATA ETK ADDRESS_MAPPING 0x1E0000 0x960000 0x20000 /end IF_DATA
 /end MEMORY_SEGMENT
 /begin MEMORY_SEGMENT ExtRam940000 "" VARIABLES RAM EXTERN 0x940000 0x2000 -1 -1 -1 -1 -1 /begin IF_DATA ETK ADDRESS_MAPPING 0x940000 0x940000 0x2000 /end IF_DATA /end MEMORY_SEGMENT
 /begin MEMORY_SEGMENT Ram7F8000 "" VARIABLES RAM INTERN 0x7F8000 0x8000 -1 -1 -1 -1 -1
  /begin IF_DATA XCP
   /begin SEGMENT 0x02 0x01 0x00 0x00 0x00 /begin CHECKSUM XCP_ADD_14 /end CHECKSUM
    /begin PAGE 0x00 ECU_ACCESS_WITH_XCP_ONLY XCP_READ_ACCESS_WITH_ECU_ONLY XCP_WRITE_ACCESS_WITH_ECU_ONLY /end PAGE
   /end SEGMENT
  /end IF_DATA
 /end MEMORY_SEGMENT
 /begin MEMORY_SEGMENT Ram800000 "" VARIABLES RAM INTERN 0x800000 0x20000 -1 -1 -1 -1 -1
  /begin IF_DATA XCP
   /begin SEGMENT 0x03 0x01 0x00 0x00 0x00 /begin CHECKSUM XCP_ADD_14 /end CHECKSUM
    /begin PAGE 0x00 ECU_ACCESS_WITH_XCP_ONLY XCP_READ_ACCESS_WITH_ECU_ONLY XCP_WRITE_ACCESS_WITH_ECU_ONLY /end PAGE
   /end SEGMENT
  /end IF_DATA
 /end MEMORY_SEGMENT
 /begin MEMORY_SEGMENT CalMeasure_0x6D0000 "" VARIABLES RAM INTERN 0x6D0000 0xF000 -1 -1 -1 -1 -1 /end MEMORY_SEGMENT
 /begin CALIBRATION_METHOD "Slewing" /* Method name */ 1 /* Method version */
  /begin CALIBRATION_HANDLE 1961984 /* Start address 0x1DF000 of slew range */ 4096 /* Size of slew range 0x1000 includes daf.log*/ 0 /* Initialization value for slew range */ AllSlews /* Name of FUNCTION that includes all slewing groups as SUB_FUNCTIONs */ /end CALIBRATION_HANDLE
 /end CALIBRATION_METHOD
 /* /end C:/ETAS/ASCET513/target/mpc555/Add_ToolChain/ASAP_Templates\mem_lay_me9u_serial_protocols.a2l inserted by post asap script INSERT_MEM_LAY.pl */ /end MOD_PAR
/begin MOD_COMMON "2013-05-06 09:52:20	create by ETASHexVirtualAddressTableHeaderV2" BYTE_ORDER MSB_FIRST ALIGNMENT_BYTE 1 ALIGNMENT_WORD 2 ALIGNMENT_LONG 4 ALIGNMENT_FLOAT32_IEEE 4 ALIGNMENT_FLOAT64_IEEE 8 /end MOD_COMMON
/* *
* Change description: *
* 2007-12-19 ETAS-Mle: Change Rate in Rate in Scaling Unit of CCP_R02 to 5 --> 50ms *
* 2002-12-05 ETAS-Pu: Change RAM_INIT_BY_TOOL to RAM_INIT_BY_ECU *
* 2002-03-15 ETAS-Pu: mofify security key names for ccp *
* 2008-06-10 ETAS-Mle: Change CAN parameter according to recomendation of Hf *
* - CALL 77855 and CALL 82090 *
* 2008-08-20 ETAS-Mle: add STORE_SUPPORTED and FLASH_BACK (freezs mode) *
* 2009-07-14 ETAS-Mle: add first PID for CCP - see call 88978 *
* 2009-09-02 ETAS-Mle: activate RESUME_SUPPORTED (does not work on M9U so far) *
* 2009-09-02 ETAS-Mle: activate OPTIONAL_CMD 0x09 "GET_ACTIVE_CAL_PAGE" (V2.1 only) *
*/
/begin IF_DATA ASAP1B_CCP /* spezific definition for CCP */
 /begin SOURCE "CCP_R01" 2 1
  /begin QP_BLOB /* The QP-BLOB specifies the behavior of*/ 0 LENGTH 20 CAN_ID_FIXED 0x320 RASTER 0 /end QP_BLOB
 /end SOURCE
 /begin SOURCE "CCP_R02" 2 1
  /begin QP_BLOB /* The QP-BLOB specifies the behavior of*/ 1 LENGTH 30 CAN_ID_FIXED 0x321 RASTER 1 FIRST_PID 0x14 /* First Packet ID (PID) of the DAQ List */ /end QP_BLOB
 /end SOURCE
 /begin SOURCE "CCP_R03" 1 1
  /begin QP_BLOB /* The QP-BLOB specify the behavior of */ 2 LENGTH 40 CAN_ID_FIXED 0x322 RASTER 2 FIRST_PID 0x32 /* First Packet ID (PID) of the DAQ List */ /end QP_BLOB
 /end SOURCE
 /begin RASTER "CCP_R01" "CCP_R01" 0 4 /* Scaling Unit: 4 = 10 msec */ 1 /* Rate in Scaling Unit: 1 --> 10ms */ /* Refresh rate = 10 msec * 1 = 10 msec */ /end RASTER
 /begin RASTER "CCP_R02" "CCP_R02" 1 4 /* Scaling Unit: 4 = 10 msec */ 5 /* Rate in Scaling Unit: 5 --> 50ms */ /* Refresh rate = 10 msec * 1 = 10 msec */ /end RASTER
 /begin RASTER "CCP_R03" "CCP_R03" 2 103 /* Scaling Unit: 103 = cylinder segment */ 1 /* Refresh rate = */ /* every cylinder combustion */ /end RASTER
 /begin SEED_KEY /* Specifies the DLL with the Seed&Key- */ /* Algorithm (optional parameter) */ "seedplus1rr1.dll" /* DLL for measure-function */ "seedplus2rr1.dll" /* DLL for calibration-function */ "seedplus3rr1.dll" /* DLL for programming-function */ /end SEED_KEY
 /begin TP_BLOB /* This BLOB describes all parameters */ /* that are necessary for CAN-timing and*/ /* ECU-calibration-technics */ 0x0201 /* CCP-Version V2.1 => 0x0201 */ 0x0202 /* BLOB-Version V2.2 => 0x0202 */ 0x4F0 /* CAN-ID INCA -> ECU, Bit 32= ext.ID */ 0x31E /* CAN-ID ECU -> INCA */ 0x1234 /* ECU CCP-Address */ 1 /* Byte-order: 1 - High-Byte-First (MOT)*/ /* 2 - Low-Byte-First(INTEL)*/ BAUDRATE 1000000 /* in Hz */ SAMPLE_POINT 80 /* in % */ SAMPLE_RATE 1 /* 1 or 3 */ BTL_CYCLES 10 SJW 2 SYNC_EDGE SINGLE /* SINGLE or DUAL */ RESUME_SUPPORTED /* necessary for Suspended Mode */ STORE_SUPPORTED /* necessary for flash ECU at power down */
  /begin CHECKSUM_PARAM 0x8001 /* Checksumalgorithm: */ /* 0x8001 - M_16_BIT_BY_ADD8 */ 0xFFFFFFFF /* max. checksum-length in ECU */ /* 0xFFFFFFFF */ CHECKSUM_CALCULATION ACTIVE_PAGE /* Checksum-calculation on activ-page */ /end CHECKSUM_PARAM
  /begin DEFINED_PAGES /* Description of the memory-page */ 1 /* Logical-page-number */ "Referencepage" /* Name of page */ 0x0000 /* Address-Extension */ /* (only low-byte sgnificant) */ 0x5D0000 /* Address of Memorypage */ 0x10000 /* Memorysize */ ROM /* Memorytype */ /end DEFINED_PAGES
  /begin DEFINED_PAGES /* Description of the memory-page */ 2 /* Logical-page-number */ "Workingpage" /* Name of page */ 0x0000 /* Address-Extension */ /* (only low-byte sgnificant) */ 0x810000 /* Address of Memorypage */ 0x10000 /* Memorysize */ RAM /* Memorytype */ RAM_INIT_BY_ECU /* Initialisationmethod */ FLASH_BACK /* necessary for Store bit */ /end DEFINED_PAGES
  /* OPTIONAL_CMD 0x05 */ /* optional CCP-command "TEST" */ /* OPTIONAL_CMD 0x08 */ /* optional CCP-command "START_STOP_ALL" */ OPTIONAL_CMD 0x09 /* optional CCP-command "GET_ACTIVE_CAL_PAGE" */ OPTIONAL_CMD 0x0C /* optional CCP-command "SET_S_STATUS" */ OPTIONAL_CMD 0x0D /* optional CCP-command "GET_S_STATUS" */ OPTIONAL_CMD 0x0E /* optional CCP-command "BUILD_CHKSUM" */ /* OPTIONAL_CMD 0x0F */ /* optional CCP-command "SHORT_UP" */ OPTIONAL_CMD 0x10 /* optional CCP-command "CLEAR_MEMORY" */ OPTIONAL_CMD 0x11 /* optional CCP-command "SEL_CAL_PAGE" */ OPTIONAL_CMD 0x12 /* optional CCP-command "GET_SEED" */ OPTIONAL_CMD 0x13 /* optional CCP-command "UNLOCK" */ OPTIONAL_CMD 0x18 /* optional CCP-command "PROGRAM" */ OPTIONAL_CMD 0x19 /* optional CCP-command "MOVE" */ /* OPTIONAL_CMD 0x20 */ /* optional CCP-command "DIAG_SERVICE" */ OPTIONAL_CMD 0x21 /* optional CCP-command "ACTIONSERVICE" */ OPTIONAL_CMD 0x22 /* optional CCP-command "PROGRAM6" */ /* OPTIONAL_CMD 0x23 */ /* optional CCP-command "DOWNLOD6" */ /end TP_BLOB
/end IF_DATA
/* *
* Change description: *
* ??.01.03 ETAS-PU : Change Baudrate and Baudrateparameters for 56 MHz Frequency *
* ??.02.02 ETAS-PU : New Baudrate selection added "DIAG_BAUD" for 10400 kBaud *
* ??.02.02 ETAS-PU : New Timing Parameters added "KWP_TIMING" for KWP on CAN (with p2max= 100) *
* 29.03.07 ETAS-Mle: Change KLINE+CAN --> CAN due to INTECRIO Warning *
* 26.07.07 ETAS-Mle: Change CAN --> KLINE_AND_CAN possible with new AML *
* 21.04.07 ETAS-Mle: Change XDL_MAX 0x500 --> 0xFA *
* 10.06.08 ETAS-Mle: Change CAN parameter according to recomendation of Hf - CALL 77855 *
* 25.08.08 ETAS-Mle: Change FLASH - TOOLFLASHBACK behaviour ( copy WP --> RP ) : *
* RequestRoutineResults 0x3 --> StartRoutine 0x1 *
* 03.04.09 ETAS-Mle: Change/Activate SECURITY_ACCESS : accMode = 1 ; calcmethod = 16 (rand) *
* delay is not testet yet *
* 02.09.09 ETAS-Mle: Change SECURITY_ACCESS configurations : default - first entry: delay = 10s *
* 03.09.09 ETAS-Mle: renaming of raster XXXms_RYY --> RYY_XXXms (improvement for manual tests) *
*/
/begin IF_DATA ASAP1B_KWP2000 /* Specific definition for KWP2000 */
 /begin SEED_KEY "DiagSeedM9U.dll" /end SEED_KEY
 /begin SOURCE "KWP2000_R01_10ms_AddressMode" 4 1 /begin QP_BLOB KLINE_AND_CAN ADDRESSMODE 0xf0 56 120 0x711 20 /end QP_BLOB /end SOURCE
 /begin SOURCE "KWP2000_R02_50ms_AddressMode" 4 5 /begin QP_BLOB KLINE_AND_CAN ADDRESSMODE 0xf5 56 120 0x711 20 /end QP_BLOB /end SOURCE
 /begin SOURCE "KWP2000_R03_100ms_AddressMode" 4 10 /begin QP_BLOB KLINE_AND_CAN ADDRESSMODE 0xfa 56 120 0x711 20 /end QP_BLOB /end SOURCE
 /begin SOURCE "KWP2000_R01_10ms_BlockMode" 4 1 /begin QP_BLOB KLINE_AND_CAN BLOCKMODE 0xf0 56 120 0x711 20 /end QP_BLOB /end SOURCE
 /begin SOURCE "KWP2000_R02_50ms_BlockMode" 4 5 /begin QP_BLOB KLINE_AND_CAN BLOCKMODE 0xf5 56 120 0x711 20 /end QP_BLOB /end SOURCE
 /begin SOURCE "KWP2000_R03_100ms_BlockMode" 4 10 /begin QP_BLOB KLINE_AND_CAN BLOCKMODE 0xfa 56 120 0x711 20 /end QP_BLOB /end SOURCE
 /begin TP_BLOB /* TP-Blob includes general information */ /* for the ASAP1b driver */ 0x0200 /* blob version */ VDA_1996 /* KWP2000 version */ MSB_FIRST /* byte order in measurements and characteristics */
  /begin K_LINE WuP /* stimulation mode of ECU: WuP / 5Baud */ 0x12 /* ECU address on k line */ 0xF1 /* required tester address */ /end K_LINE
  /begin CAN 1000000 /* Baudrate [Hz] */ 80 /* Sample point [% complete bit time] */ 1 /* 1 or 3 samples per bit */ 10 /* BTL_CYCLES [slots/bit time] */ 2 /* SJW length synchr. segm. In BTL_CYCLES */ 0 /* SYNC_EDGE */
   /begin ADDRESS 0x612 /* CAN_ID ECU (gateway)-> INCA */ 0x6F0 /* CAN_ID INCA -> ECU (gateway) */ TGT_INCA 0xF0 /* Extended address INCA */ TGT_ECU 0x12 /* Extended / remote address ECU ^ */ /end ADDRESS
   NETWORK_LIMITS 10 /* WFT_MAX */ 0xFA /* XDL_MAX */ START_STOP 0x05 /* Start_stop FREE_RUNNING : routine number */ /end CAN
  /begin DIAG_BAUD 10400 0x86 BD_PARA 0x06 0x00 0x28 0xA0 /end DIAG_BAUD
  /begin DIAG_BAUD 125000 0x86 BD_PARA 0x06 0x01 0xE8 0x48 /end DIAG_BAUD
  /begin DIAG_BAUD 250000 0x86 BD_PARA 0x06 0x03 0xD0 0x90 /end DIAG_BAUD
  /begin TIME_DEF /*Timing parameter: p1Max p2Min p2Max p3Min p3Max p4Min [ms] */ KWP_TIMING 0x0001 0x0000 0x0064 0x0003 0x1388 0x0000 KWP_TIMING 0x0001 0x0000 0x0032 0x0003 0x1388 0x0001 KWP_TIMING 0x0001 0x0032 0x0064 0x0037 0x1388 0x0001 /* As Bs Cr [ms] */ USDTP_TIMING 0x03E8 0x03E8 0x03E8 USDTP_TIMING 0x0100 0x0100 0x0100 /end TIME_DEF
  /* 10.08.01 XC-Stu security access commented */ /*Parameter for Seed&Key: accMode calcmethod delay */ SECURITY_ACCESS 1 16 10 SECURITY_ACCESS 3 16 0 SECURITY_ACCESS 5 16 20 SECURITY_ACCESS 7 16 15 SECURITY_ACCESS 1 16 0
  /begin COPY RAM_InitByECU /* ECU mode for copying Flash into RAM */ 0x81 /* diagnostic mode for copying Flash into RAM */ COPY_PARA 3 /* list of add. parameters for StartDiag */ /end COPY
  /begin FLASH TOOLFLASHBACK /* ECU mode for copying RAM into Flash */ 3 /* No of local routine for copy RAM into Flash */ StartRoutine /* result of copy routine delivered by */ COPY_FRAME 1 /* list of page frames to be copied */ RNC_RESULT 0x23 0xfb 0xfc /* only at 'RequestRoutineResults': */ /* result codes, that sign 'copy in progress' */ /end FLASH
  /begin CHECKSUM 0x020202 /* check sum type qualifier (see table) */ 1 /* 1: check sum calculation only on active page */ 5 /* No of local routine for checksum */ StartRoutine /* result of checksum routine delivered by */ /* result codes, that sign 'calculation in progress' */ /end CHECKSUM
  /begin PAGE_SWITCH ESCAPE_CODE /* type of page switching service */ /* Reference Page Working Page */ PAGE_CODE 0x00 0x01 ESCAPE_CODE_PARA_SET 0x90 ESCAPE_CODE_PARA_GET 0x91 /end PAGE_SWITCH
  DATA_ACCESS 0x000000 /* ECU address type qualifier for Flash page */ 0x000000 /* ECU address type qualifier for RAMpage */ 1 /* Flag 1: Upload from ECU flash data possible */ 0 /* Flag 1: Verify access on ECU flash code possible */ 0 /* Flag 1: Upload from ECU flash code possible */ 1 /* Flag1: Upload and download only on active.page. */ /end TP_BLOB
/end IF_DATA
/* *
* Change description: *
* ??.01.03 ETAS-PU : Change Baudrate and Baudrateparameters for 56 MHz Frequency *
* ??.02.02 ETAS-PU : New Baudrate selection added "DIAG_BAUD" for 10400 kBaud *
* ??.02.02 ETAS-PU : New Timing Parameters added "KWP_TIMING" for KWP on CAN (with p2max= 100) *
* 29.03.07 ETAS-Mle: Change KLINE+CAN --> CAN due to INTECRIO Warning *
* 26.07.07 ETAS-Mle: Change CAN --> KLINE_AND_CAN possible with new AML *
* 21.04.07 ETAS-Mle: Change XDL_MAX 0x500 --> 0xFA *
* 21.04.07 ETAS-Mle: Change flags in DATA_ACCESS due to Download - Problem *
* 10.06.08 ETAS-Mle: Change CAN parameter according to recomendation of Hf - CALL 77855 *
* 11.06.08 ETAS-Mle: Change AVAILABLE_PERIODIC_IDENTIFIER_RANGE *
* 25.08.08 ETAS-Mle: Change FLASH - TOOLFLASHBACK behaviour ( copy WP --> RP ) : *
* RequestRoutineResults 0x3 --> StartRoutine 0x1 *
* 29.08.08 ETAS-Mle: Remove FREERUNNINGMODE as not running on M9U yet *
* 08.09.08 ETAS-Mle: Change USDTP_TIMING equal to KWP_TIMING *
* CAUTION : there is no AccessTimingParameter service on UDSonCAN *
* 03.04.09 ETAS-Mle: Change/Activate SECURITY_ACCESS : accMode = 1 ; calcmethod = 16 (rand) *
* delay is not testet yet *
* 02.09.09 ETAS-Mle: Change SECURITY_ACCESS configurations : default - first entry: delay = 10s *
* 03.09.09 ETAS-Mle: renaming of raster XXXms_RYY --> RYY_XXXms (improvement for manual tests) *
* 11.09.09 ETAS-Mle: remove DIAG_BAUD blocks (INTECRIO error = no K-Line support for UDS *
*/
/begin IF_DATA ASAP1B_DIAGNOSTIC_SERVICES /* Definition for UDSonCAN (ISO14229) */
 /begin SOURCE "UDS_R01_10ms_AddressMode" 4 1 QP_BLOB QP_BLOB_VERSION 0x0300 ADDRESSMODE MAX_NO_OF_SIGNALS 56 MAX_NO_OF_BYTES 120 AVAILABLE_ON CAN /end SOURCE
 /begin SOURCE "UDS_R02_50ms_AddressMode" 4 5 QP_BLOB QP_BLOB_VERSION 0x0300 ADDRESSMODE MAX_NO_OF_SIGNALS 56 MAX_NO_OF_BYTES 120 AVAILABLE_ON CAN /end SOURCE
 /begin SOURCE "UDS_R03_100ms_AddressMode" 4 10 QP_BLOB QP_BLOB_VERSION 0x0300 ADDRESSMODE MAX_NO_OF_SIGNALS 56 MAX_NO_OF_BYTES 120 AVAILABLE_ON CAN /end SOURCE
 /begin SOURCE "UDS_R01_10ms_FAST3" 4 1 /* Rate in Scaling Unit: 100 */ QP_BLOB QP_BLOB_VERSION 0x0300 FREERUNNINGMODE RDBPI_PARAMETER RESPONSE_TYPE RDBPI_RESPONSE_TYPE_UUDT
  /begin CAN
   /begin UUDT_CAN_IDs FIRST_CAN_ID 0x690 LAST_CAN_ID 0x697 /* Last CAN-ID of R01 - Pool */ /end UUDT_CAN_IDs
  /end CAN
  TRANSMISSION_MODE TRANSMISSION_MODE_FAST /begin AVAILABLE_PERIODIC_IDENTIFIER_RANGE FIRST_ID 0xF200 LAST_ID 0xF207 /end AVAILABLE_PERIODIC_IDENTIFIER_RANGE AVAILABLE_ON CAN /end SOURCE
 /begin SOURCE "UDS_R02_50ms_MEDIUM2" 4 5 QP_BLOB QP_BLOB_VERSION 0x0300 FREERUNNINGMODE RDBPI_PARAMETER RESPONSE_TYPE RDBPI_RESPONSE_TYPE_UUDT
  /begin CAN
   /begin UUDT_CAN_IDs FIRST_CAN_ID 0x98DDF118 LAST_CAN_ID 0x98DDF11F /* Last CAN-ID of R02 - Pool */ /end UUDT_CAN_IDs
  /end CAN
  TRANSMISSION_MODE TRANSMISSION_MODE_MEDIUM /begin AVAILABLE_PERIODIC_IDENTIFIER_RANGE FIRST_ID 0xF208 LAST_ID 0xF20F /end AVAILABLE_PERIODIC_IDENTIFIER_RANGE AVAILABLE_ON CAN /end SOURCE
 /begin SOURCE "UDS_R03_100ms_SLOW1" 4 10 QP_BLOB QP_BLOB_VERSION 0x0300 FREERUNNINGMODE RDBPI_PARAMETER RESPONSE_TYPE RDBPI_RESPONSE_TYPE_UUDT
  /begin CAN
   /begin UUDT_CAN_IDs FIRST_CAN_ID 0x6A0 LAST_CAN_ID 0x6A7 /* Last CAN-ID of R03 - Pool */ /end UUDT_CAN_IDs
  /end CAN
  TRANSMISSION_MODE TRANSMISSION_MODE_SLOW /begin AVAILABLE_PERIODIC_IDENTIFIER_RANGE FIRST_ID 0xF210 LAST_ID 0xF217 /end AVAILABLE_PERIODIC_IDENTIFIER_RANGE AVAILABLE_ON CAN /end SOURCE
 /begin SOURCE "UDS_R01_10ms_BlockMode" 4 1 QP_BLOB QP_BLOB_VERSION 0x0300 BLOCKMODE LOCAL_ID 0xF300 MAX_NO_OF_SIGNALS 56 MAX_NO_OF_BYTES 120 AVAILABLE_ON CAN /end SOURCE
 /begin SOURCE "UDS_R02_50ms_BlockMode" 4 5 QP_BLOB QP_BLOB_VERSION 0x0300 BLOCKMODE LOCAL_ID 0xF350 MAX_NO_OF_SIGNALS 56 MAX_NO_OF_BYTES 120 AVAILABLE_ON CAN /end SOURCE
 /begin SOURCE "UDS_R03_100ms_BlockMode" 4 10 QP_BLOB QP_BLOB_VERSION 0x0300 BLOCKMODE LOCAL_ID 0xF364 MAX_NO_OF_SIGNALS 56 MAX_NO_OF_BYTES 120 AVAILABLE_ON CAN /end SOURCE
 /begin TP_BLOB /* TP-Blob includes general information */ 0x0300 /* blob version */ ISO14229_1_2003 /* KWP2000 version */ BYTEORDER_MSB_FIRST /* byte order in measurements and characteristics */
  /begin ADDRESS_AND_LENGTH_FORMAT_IDENTIFIER 0x13 /* Ruo: as I remember Volvo uses 4 Byte Addresses --> 0x24 */ AALFI_FOR_WRITE_MEMORY_BY_ADDR 0x13 /end ADDRESS_AND_LENGTH_FORMAT_IDENTIFIER
  /begin CAN 1000000 /* Baudrate [Hz] */ SamplePoint 80 /* Sample point [% complete bit time] */ SamplesPerBit 1 /* 1 or 3 samples per bit */ BTL_CYCLES 10 /* BTL_CYCLES [slots/bit time] */ SJW 2 /* SJW length synchr. segm. In BTL_CYCLES */ SYNC_EDGE 0 /* SYNC_EDGE */
   /begin ADDRESS 0x612 /* CAN_ID ECU (gateway)-> INCA */ 0x6F0 /* CAN_ID INCA -> ECU (gateway) */ TGT_ECU 0x12 /* Extended / remote address ECU */ TGT_INCA 0xF0 /* Extended address INCA */ /end ADDRESS
   /begin TransportProtocolVersion ISO15765_2_2003 /end TransportProtocolVersion
   NETWORK_LIMITS 10 /* WFT_MAX */ 0xFA /* XDL_MAX */ /* AS BS CD P2min P2max P3min P3max in ms */ USDTP_TIMING_DEFAULTS 0x03E8 0x03E8 0x03E8 0x0000 0x0064 0x0003 0x1388 USDTP_TIMING 0x0100 0x0100 0x0100 0x0000 0x0032 0x0003 0x1388 USDTP_TIMING 0x03E8 0x03E8 0x03E8 0x0032 0x0064 0x0037 0x1388 /end CAN
  /begin SECURITY_ACCESS 1 16 10 SEED_KEY "DiagSeedM9U.dll" /end SECURITY_ACCESS
  /begin SECURITY_ACCESS 3 16 0 SEED_KEY "DiagSeedM9U.dll" /end SECURITY_ACCESS
  /begin SECURITY_ACCESS 5 16 20 SEED_KEY "DiagSeedM9U.dll" /end SECURITY_ACCESS
  /begin SECURITY_ACCESS 7 16 15 SEED_KEY "DiagSeedM9U.dll" /end SECURITY_ACCESS
  /begin SECURITY_ACCESS 1 16 0 SEED_KEY "DiagSeedM9U.dll" /end SECURITY_ACCESS
  /begin COPY RAM_InitByEcu /* ECU mode for copying Flash into RAM */
   /begin RAM_InitByTool 0x41 /* EXTDS (Extended Diagnostic Session) to copy Flash into RAM */ COPY_PARA 0x03 /end RAM_InitByTool
  /end COPY
  /begin FLASH TOOLFLASHBACK /* ECU mode for copying RAM into Flash */ 0xF001 /* No of local routine for copy RAM into Flash */ COPY_FRAME 42 /* list of page frames to be copied */ StartRoutine /* result of copy routine delivered by */ /end FLASH
  /begin SESSION "extendedDiagnosticSession" 0x03 SessionOpeningOrder 0 /* SeedKey_StartDiagSession_0, StartDiagSession_SeedKey_1, StartDiagSession_2 */ /end SESSION
  /begin CHECKSUM 0x020404 /* check sum type qualifier (see table) */ 1 /* 1: check sum calculation only on active page */ 0xFF01 /* No of local routine for checksum */ CHECKSUM_RESULT StartRoutine /* result of checksum routine delivered by */ /end CHECKSUM
  /begin PAGE_SWITCH PAGE_CODE 0x00 0x01 /* Reference Page, Working Page */ LOCAL_ROUTINE ROUTINE_NUMBER_SET 0xF002 StartRoutine /end PAGE_SWITCH
  /begin DATA_ACCESS 0x000000 /* ECU address type qualifier for Flash page */ 0x000000 /* ECU address type qualifier for RAMpage */ 1 /* Flag 1: Upload from ECU flash data possible */ 0 /* Flag 1: Verify access on ECU flash code possible */ 0 /* Flag 1: Upload from ECU flash code possible */ 1 /* Flag 1: Upload and download only on active.page. */ /end DATA_ACCESS
 /end TP_BLOB
/end IF_DATA
/* *
* Change description: *
* 10.06.08 ETAS-Mle: Change CAN parameter according to recomendation of Hf - CALL 77855 *
* 25.06.08 ETAS-Mle: Comment PROGRAM_NEXT - is not supported yet *
* 18.08.08 ETAS-Mle: MAX_SEGMENTS : 2 --> 4, FREEZ_SUPPORTED *
* 29.08.08 ETAS-Mle: Comment PID_OFF_SUPPORTED as default for INCA in A2L -File *
* 04.09.08 ETAS-Mle: Comment around COMMUNICATION_MODE_SUPPORTED was wrong and is supported now *
* 02.04.09 ETAS-Mle: Change BSmax 10 -> 42 and STmin 2 -> 0 to speedup block download *
* 03.09.09 ETAS-Mle: enable RESUME_SUPPORTED *
*/ /*********** IF_DATA XCP ***********/
/begin IF_DATA XCP
 /begin PROTOCOL_LAYER 0x0100 /* XCP 1.0 */ 100 /* T1 ms = default Timeout for most CMDs */ 100 /* T2 ms = Timeout for Build Checksum */ 100 /* T3 ms = Timeout for Program - Start, - Prepare, - Verify */ 45000 /* T4 ms = Timeout for Program Clear */ 100 /* T5 ms = Timeout for Program, - Reset, -Max */ 100 /* T6 ms = RepeatTimeout between "CONNECT(USER_DEFINED)" */ 100 /* T7 ms = Timeout for PreAction after CMD - Timeout (Master) */ 0x08 /* MAX_CTO */ 0x0008 /* MAX_DTO */ BYTE_ORDER_MSB_FIRST /* _FIRST = 0 , _LAST = 1 */ ADDRESS_GRANULARITY_BYTE /* _BYTE = 0 , _WORD = 1 , _DWORD = 2 */ OPTIONAL_CMD GET_COMM_MODE_INFO /* 0xFB */ OPTIONAL_CMD GET_ID /* 0xFA */ OPTIONAL_CMD SET_REQUEST /* 0xF9 */ OPTIONAL_CMD GET_SEED /* 0xF8 */ OPTIONAL_CMD UNLOCK /* 0xF7 */ OPTIONAL_CMD SET_MTA /* 0xF6 */ OPTIONAL_CMD UPLOAD /* 0xF5 */ OPTIONAL_CMD SHORT_UPLOAD /* 0xF4 */ OPTIONAL_CMD BUILD_CHECKSUM /* 0xF3 */ OPTIONAL_CMD TRANSPORT_LAYER_CMD /* 0xF2 */ OPTIONAL_CMD USER_CMD /* 0xF1 */ /* OPTIONAL_CMD DOWNLOAD                /* 0xF0   ??? NOT_OPTIONAL ??? * / */ OPTIONAL_CMD DOWNLOAD_NEXT /* 0xEF */ OPTIONAL_CMD DOWNLOAD_MAX /* 0xEE */ OPTIONAL_CMD SHORT_DOWNLOAD /* 0xED */ OPTIONAL_CMD MODIFY_BITS /* 0xEC */ OPTIONAL_CMD SET_CAL_PAGE /* 0xEB */ OPTIONAL_CMD GET_CAL_PAGE /* 0xEA */ OPTIONAL_CMD GET_PAG_PROCESSOR_INFO /* 0xE9 */ OPTIONAL_CMD GET_SEGMENT_INFO /* 0xE8 */ OPTIONAL_CMD GET_PAGE_INFO /* 0xE7 */ OPTIONAL_CMD GET_SEGMENT_MODE /* 0xE6 */ OPTIONAL_CMD SET_SEGMENT_MODE /* 0xE5 */ OPTIONAL_CMD COPY_CAL_PAGE /* 0xE4 */ OPTIONAL_CMD CLEAR_DAQ_LIST /* 0xE3 */ OPTIONAL_CMD SET_DAQ_PTR /* 0xE2 */ OPTIONAL_CMD WRITE_DAQ /* 0xE1 */ OPTIONAL_CMD SET_DAQ_LIST_MODE /* 0xE0 */ OPTIONAL_CMD GET_DAQ_LIST_MODE /* 0xDF */ OPTIONAL_CMD START_STOP_DAQ_LIST /* 0xDE */ OPTIONAL_CMD START_STOP_SYNCH /* 0xDD */ OPTIONAL_CMD GET_DAQ_CLOCK /* 0xDC */ OPTIONAL_CMD READ_DAQ /* 0xDB */ OPTIONAL_CMD GET_DAQ_PROCESSOR_INFO /* 0xDA */ OPTIONAL_CMD GET_DAQ_RESOLUTION_INFO /* 0xD9 */ OPTIONAL_CMD GET_DAQ_LIST_INFO /* 0xD8 */ OPTIONAL_CMD GET_DAQ_EVENT_INFO /* 0xD7 */ OPTIONAL_CMD FREE_DAQ /* 0xD6 */ OPTIONAL_CMD ALLOC_DAQ /* 0xD5 */ OPTIONAL_CMD ALLOC_ODT /* 0xD4 */ OPTIONAL_CMD ALLOC_ODT_ENTRY /* 0xD3 */ OPTIONAL_CMD PROGRAM_START /* 0xD2 */ OPTIONAL_CMD PROGRAM_CLEAR /* 0xD1 */ OPTIONAL_CMD PROGRAM /* 0xD0 */ OPTIONAL_CMD PROGRAM_RESET /* 0xCF */ OPTIONAL_CMD GET_PGM_PROCESSOR_INFO /* 0xCE */ OPTIONAL_CMD GET_SECTOR_INFO /* 0xCD */ OPTIONAL_CMD PROGRAM_PREPARE /* 0xCC */ OPTIONAL_CMD PROGRAM_FORMAT /* 0xCB */ /* OPTIONAL_CMD PROGRAM_NEXT              /* 0xCA   BLOCK_MODE only ?* / */ OPTIONAL_CMD PROGRAM_MAX /* 0xC9 */ OPTIONAL_CMD PROGRAM_VERIFY /* 0xC8 */ COMMUNICATION_MODE_SUPPORTED BLOCK /* Master and/or Slave ??? */ SLAVE MASTER 42 0 /* MAX_BS, MIN_ST:unit 100 us ??? in 100us */ SEED_AND_KEY_EXTERNAL_FUNCTION "SeedNKeyXcpDaq2Cal1Stim4Pgm3.dll" /end PROTOCOL_LAYER
 /begin DAQ STATIC /* DAQ_CONFIG_TYPE STATIC / DYNAMIC */ 0x08 /* MAX_DAQ */ 0x06 /* MAX_EVENT_CHANNEL */ 0x00 /* MIN_DAQ = Num of predef DAQs*/ OPTIMISATION_TYPE_DEFAULT /* _DEFAULT = 0, _ODT_TYPE_16 = 1, _ODT_TYPE_32 = 2, _ODT_TYPE_64 = 3, _ODT_TYPE_ALIGNMENT = 4, _MAX_ENTRY_SIZE = 5 */ ADDRESS_EXTENSION_FREE /* _FREE = 0, _ODT = 1, _DAQ = 3 */ IDENTIFICATION_FIELD_TYPE_ABSOLUTE /* _ABSOLUTE = 0, _RELATIVE_BYTE = 1, _RELATIVE_WORD = 2, _RELATIVE_WORD_ALIGNED" = 3 */ GRANULARITY_ODT_ENTRY_SIZE_DAQ_BYTE /* _BYTE = 1, _WORD = 2, _DWORD = 4, _DLONG = 8*/ 0x08 /* MAX_ODT_ENTRY_SIZE_DAQ */ OVERLOAD_INDICATION_EVENT /* NO_ = 0, _PID = 1, _EVENT = 2 */ PRESCALER_SUPPORTED /* DIRECTION = DAQ ! ??? How does the Master act */ RESUME_SUPPORTED /* RESUME_SUPPORTED ? M9U not yet */
  /begin STIM GRANULARITY_ODT_ENTRY_SIZE_STIM_BYTE /* _BYTE = 1, _WORD = 2, _DWORD = 4, _DLONG = 8*/ 8 /* MAX_ODT_ENTRY_SIZE_STIM */ BIT_STIM_SUPPORTED /* BIT_STIM_SUPPORTED must not be changed for INTECRIO */ /* otherwise Phyton script will not work with bool */ /end STIM
  /begin TIMESTAMP_SUPPORTED 36535 /* TIMESTAMP_TICKS ??? */ NO_TIME_STAMP /* NO_TIME_STAMP = 0; SIZE_BYTE, _WORD, _DWORD */ UNIT_1NS /* UNIT_1NS = 0 */ /* TIMESTAMP_FIXED */ /* TIMESTAMP_FIXED */ /end TIMESTAMP_SUPPORTED
  /* PID_OFF_SUPPORTED */ /* PID_OFF_SUPPORTED */
  /begin DAQ_LIST 0 DAQ_LIST_TYPE DAQ MAX_ODT 0x0A MAX_ODT_ENTRIES 0x08 FIRST_PID 0 EVENT_FIXED 0 /end DAQ_LIST
  /begin DAQ_LIST 1 DAQ_LIST_TYPE DAQ MAX_ODT 0x0A MAX_ODT_ENTRIES 0x08 FIRST_PID 0x0A EVENT_FIXED 1 /end DAQ_LIST
  /begin DAQ_LIST 2 DAQ_LIST_TYPE DAQ MAX_ODT 0x0A MAX_ODT_ENTRIES 0x08 FIRST_PID 0x14 EVENT_FIXED 2 /end DAQ_LIST
  /begin DAQ_LIST 3 DAQ_LIST_TYPE DAQ MAX_ODT 0x0A MAX_ODT_ENTRIES 0x08 FIRST_PID 0x1E EVENT_FIXED 5 /end DAQ_LIST
  /begin DAQ_LIST 4 DAQ_LIST_TYPE STIM MAX_ODT 0x0A MAX_ODT_ENTRIES 0x08 FIRST_PID 0x28 EVENT_FIXED 3 /end DAQ_LIST
  /begin DAQ_LIST 5 DAQ_LIST_TYPE STIM MAX_ODT 0x0A MAX_ODT_ENTRIES 0x08 FIRST_PID 0x32 EVENT_FIXED 4 /end DAQ_LIST
  /begin DAQ_LIST 6 DAQ_LIST_TYPE DAQ /* STIM --> DAQ */ MAX_ODT 0x0A MAX_ODT_ENTRIES 0x08 FIRST_PID 0x3C EVENT_FIXED 2 /end DAQ_LIST
  /begin DAQ_LIST 7 DAQ_LIST_TYPE STIM MAX_ODT 0x0A MAX_ODT_ENTRIES 0x08 FIRST_PID 0x46 EVENT_FIXED 5 /end DAQ_LIST
  /begin EVENT "Byp_01_receive_from_ECU" "R01" 0x00 DAQ 0x01 0x0A /* TIME_CYCLE (10ms)*/ 0x06 /* TIME_UNIT (1ms) */ 0x02 /* PRIORITY 0 --> FF ? Effect in Bypass and/or MC usecase ?*/ /end EVENT
  /begin EVENT "Byp_02_receive_from_ECU" "R02" 0x01 DAQ 0x01 0x05 /* TIME_CYCLE (50ms)*/ 0x07 0x01 /end EVENT
  /begin EVENT "XCP_EV2_100ms_DAQ329_STIM325isCMD" "R03" 0x02 DAQ_STIM 0x02 0x0A /* TIME_CYCLE(100ms) */ 0x07 0x00 /end EVENT
  /begin EVENT "Byp_01_send_to_ECU" "B01" 0x03 STIM 0x01 0x0A /* TIME_CYCLE (10ms)*/ 0x06 /* TIME_UNIT (1ms) */ 0x02 /* PRIORITY 0 --> FF ? Effect in Bypass and/or MC usecase ?*/ /end EVENT
  /begin EVENT "Byp_02_send_to_ECU" "B02" 0x04 STIM 0x01 0x05 /* TIME_CYCLE (50ms)*/ 0x07 0x01 /end EVENT
  /begin EVENT "XCP_EV5_Sync_DAQ329_STIM325isCMD" "Sync" 0x05 DAQ_STIM 0x02 0x00 /* TIME_CYCLE(100ms) */ 0x00 0x03 /end EVENT
 /end DAQ
 /begin PAG 0x04 /* MAX_SEGMENTS */ FREEZE_SUPPORTED /*FREEZE_SUPPORTED*/ /end PAG
 /begin XCP_ON_CAN 0x0100 /* XCP on CAN version : e.g V1.0 = 0x0100*/ /*CAN_ID_BROADCAST */ /* Auto detection CAN-ID ??? */ CAN_ID_MASTER 0x04F8 /* CMD/STIM (CROs) ??? STIM ??? */ CAN_ID_SLAVE 0x0326 /* RES/ERR/EV/SERV/DAQ (DTOs) */ BAUDRATE 1000000 /* BAUDRATE */ SAMPLE_POINT 80 SAMPLE_RATE SINGLE BTL_CYCLES 10 SJW 2 SYNC_EDGE SINGLE /*MAX_DLC_REQUIRED*/ /* MAX_DLC_REQUIRED --> Master has to send alwas DLC = 8 */ /begin DAQ_LIST_CAN_ID 0x0000 /* for DAQ_LIST 0 */ FIXED 0x327 /end DAQ_LIST_CAN_ID /* DAQ_LIST 1 (DAQ direction is expected on XCP-RESPONCE CAN-ID 0x0326 */ /begin DAQ_LIST_CAN_ID 0x0002 /* for DAQ_LIST 2 */ FIXED 0x329 /end DAQ_LIST_CAN_ID /begin DAQ_LIST_CAN_ID 0x0003 /* for DAQ_LIST 3 */ FIXED 0x326 /end DAQ_LIST_CAN_ID /begin DAQ_LIST_CAN_ID 0x0004 /* for DAQ LIST 4 (STIM_direction) */ FIXED 0x2F0 /end DAQ_LIST_CAN_ID /begin DAQ_LIST_CAN_ID 0x0005 /* for DAQ LIST 5 (STIM_direction) */ FIXED 0x2F1 /end DAQ_LIST_CAN_ID /* DAQ_LIST 6 (STIM direction is expected on XCP-Command CAN-ID 0x04F8 */ /* DAQ_LIST 6 (DAQ direction is expected on XCP-RESPONCE CAN-ID 0x0326 */ /* DAQ_LIST 7 (STIM direction is expected on XCP-Command CAN-ID 0x04F8 */ /end XCP_ON_CAN
/end IF_DATA
/* /begin C:/ETAS/ASCET513/target/mpc555/Add_ToolChain/ASAP_Templates\bypass_if_data.a2l inserted by post asap script insert_bypass_if_data.pl */
/begin IF_DATA ASAP1B_Bypass
 /begin TP_BLOB 0x100 /* Bypass version */ 0x100 /* Blob version */ /end TP_BLOB
/end IF_DATA
/* /end C:/ETAS/ASCET513/target/mpc555/Add_ToolChain/ASAP_Templates\bypass_if_data.a2l inserted by post asap script insert_bypass_if_data.pl */
/begin IF_DATA ETK /* /begin C:/ETAS/ASCET513/target/mpc555/Add_ToolChain/ASAP_Templates/dim_x_AML1_2_M9U.a2l inserted by post asap script Multiple_DIM_X.pl */ /*
2004-01-22 ETAS-Dm: Corrected TRGSEg SIze in TRG_CFG Value
2003-11-04 ETAS-PU: -adapt Trigersegment for ETKP3, 128 Byte segment with trigger addresses
ETAS-PU: -Codecheck wurde ausgeschaltet
-Adressen fuer Distab koennen auf 5Cxxxxx liegen, wenn im memory Layout gemapped wird
-(siehe mem_lay.a2l) ansonsten auf 1C0000
2002-01-18 ETAS-Gt: Anpassung an ETKP3 auf C-Muster XCellsis, Adressanpassungen an C-Muster Memorylayout
2006-11-29 ETAS-Mle: Anpassung an ETKP7
2007-01-12 ETAS-Mle: For ETK-Mailbox Flashing with BOSCH StBootblock Mailbox is at 900000
For ETK-Distab "trgsegad" is at 940000
2007-02-21 ETAS-Mle: remove \begin \end DISTAB_CFG (just use DISTAB_CFG)
Replace RESERVED with RESERVED_DISTAB_MEMORY
2008-01-14 ETAS-Mle: change bypass TriggerID-address "Byp_B01" --> 0x940060
change bypass TriggerID-address "Byp_B02" --> 0x940062
2010-11-10 ETAS-Mle: bugfix of Basic scaling unit and Period definition
*/ /*begin IF_DATA ETK*/
 /begin TP_BLOB /*version:*/ 0x1000100 /*IFS:*/ INTERFACE_SPEED_100MBIT /* InterfaceSpeed 1=8MBit, 2=100MBit */ /* for INCA please use INTERFACE_SPEED_100MBIT for ASCET < 5.0 use number 2 */ /*reset_cfg:*/ 0x0 /* Dummy */ DISTAB_CFG /*dsptab:*/ 0xD /*dat_mod:*/ 0x1 /*rfg:*/ 0x1 /*trgsegad:*/ 0x940000 /*trg_cfg: */ 0x1010100 TRG_MOD /*Id:*/ 0x0 /*trg_mod:*/ 0xFF 0x0 0x0 0x0 CODE_CHK /*prg_data:*/ 0x00000 /*prg_length:*/ 0x0 /*prg_eram:*/ 0x00000 /*prg_length:*/ 0x0 ETK_CFG 0x03 0xC2 0x3D 0xFF 0xEF 0x3E 0xDF 0xEF 0x3D 0xFF 0xFB 0xFE 0xFF 0xFF 0xFE 0xFF 0xFF 0xF0 0x0F 0xFF 0x03 0xCD 0xFF 0xFF /* ??? no CRC-Check via display table please use RESERVED ... ??? */ RESERVED_DISTAB_MEMORY /*start_addr:*/ 0x942250 0x7F8 /*location*/ EXTERN /*mirrors*/ -1 -1 -1 -1 -1 RESERVED_DISTAB_MEMORY /*start_addr:*/ 0x95FFF0 0x0F /*location*/ EXTERN /*mirrors*/ -1 -1 -1 -1 -1 ETK_MAILBOX /*pattern:*/ 0x55555555 /*page_ecu:*/ DATA /*ecu_adr:*/ 0x903000 0x8000 /*page_am:*/ EXRAM /*am_adr:*/ 0x901000 0x7000 /end TP_BLOB
 /begin SOURCE "R_01" 103 1 /* Period definition : Rate in basic scaling units e.g. 1 x 10ms */ QP_BLOB 0x0100 15 INDIRECT 31 MEASUREMENT 0x940040 0x38 0x942250 0x940100 /* Data memory: CHNL_R1 */ 0 0x0 0x0 5000 /end SOURCE
 /begin SOURCE "R_02" 4 5 /* Period definition : Rate in basic scaling units e.g. 5 x 10ms */ QP_BLOB 0x0100 16 INDIRECT 29 MEASUREMENT 0x940042 0x58 0x942338 0x940138 /* Data memory: CHNL_R2 */ 0 0x0 0x0 10000 /end SOURCE
 /begin SOURCE "R_03" 5 1 /* Period definition : Rate in basic scaling units e.g. 1 x 100ms */ QP_BLOB 0x0100 16 INDIRECT 27 MEASUREMENT 0x940044 0x58 0x9424A0 0x940190 /* Data memory: CHNL_R3 */ 0x58 /* Max Size of Bypass Table in Byte ??? */ 0x0 0x0 20000 /end SOURCE
 /begin SOURCE "Byp_01" 103 1 QP_BLOB 0x0100 15 INDIRECT 32 BYPASS 0x940060 0x58 0x942608 0x9401E8 /* Data memory: CHNL_B1 */ 0x58 0x0 0x9428D8 5000 /end SOURCE
 /begin SOURCE "Byp_02" 4 5 /* Period definition : Rate in basic scaling units e.g. 5 x 10ms */ QP_BLOB 0x0100 16 INDIRECT 30 BYPASS 0x940062 0x58 0x942770 0x940240 /* Data memory: CHNL_B2 */ 0x58 0x0 0x942990 10000 /end SOURCE
 /*end IF_DATA*/ /* /end C:/ETAS/ASCET513/target/mpc555/Add_ToolChain/ASAP_Templates/dim_x_AML1_2_M9U.a2l inserted by post asap script Multiple_DIM_X.pl */ /end IF_DATA
/begin CHARACTERISTIC Alarm_ID.AT2ms.Restart_Raster_16T "" VALUE 0x1DA5E8 STANDARD_VALUE_U8 0.0 ident 0 255 /end CHARACTERISTIC
/begin CHARACTERISTIC Alarm_ID.ATRestartRaster.Restart_Raster_16T "" VALUE 0x1DA5F8 STANDARD_VALUE_U8 0.0 ident 0 255 /end CHARACTERISTIC
/begin CHARACTERISTIC EBEN_ASD.AS.BASE "" VALUE 0x1D004C STANDARD_VALUE_U32 0.0 identity 0 4294967295 /end CHARACTERISTIC
/begin CHARACTERISTIC One_D.STD_sint16_sint16.All_Curves_STD.Curves_Raster_1 "" CURVE 0x1D1A08 STANDARD_CURVE_S16S16 0.0 ident -32768.0 32767.0
 /begin AXIS_DESCR STD_AXIS M_In.STD_sint16_sint16.All_Curves_STD.Curves_Raster_1 ident 10 -32768.0 32767.0 /end AXIS_DESCR
/end CHARACTERISTIC
/begin CHARACTERISTIC One_D.STD_sint32_sint32.All_Curves_STD.Curves_Raster_1 "" CURVE 0x1D1A40 STANDARD_CURVE_S32S32 0.0 ident -2147483648.0 2147483647.0
 /begin AXIS_DESCR STD_AXIS M_In.STD_sint32_sint32.All_Curves_STD.Curves_Raster_1 ident 10 -2147483648.0 2147483647.0 /end AXIS_DESCR
/end CHARACTERISTIC
/begin CHARACTERISTIC One_D.STD_sint8_sint8.All_Curves_STD.Curves_Raster_1 "" CURVE 0x1D1A9A STANDARD_CURVE_S8S8 0.0 ident -128.0 127.0
 /begin AXIS_DESCR STD_AXIS M_In.STD_sint8_sint8.All_Curves_STD.Curves_Raster_1 ident 10 -128.0 127.0 /end AXIS_DESCR
/end CHARACTERISTIC
/begin CHARACTERISTIC One_D.STD_uint16_uint16.All_Curves_STD.Curves_Raster_1 "" CURVE 0x1D1AB8 STANDARD_CURVE_U16U16 0.0 ident 0.0 65535.0
 /begin AXIS_DESCR STD_AXIS M_In.STD_uint16_uint16.All_Curves_STD.Curves_Raster_1 ident 10 0.0 65535.0 /end AXIS_DESCR
/end CHARACTERISTIC
/begin CHARACTERISTIC One_D.STD_uint32_uint32.All_Curves_STD.Curves_Raster_1 "" CURVE 0x1D1AF0 STANDARD_CURVE_U32U32 0.0 ident 0.0 4294967295.0
 /begin AXIS_DESCR STD_AXIS M_In.STD_uint32_uint32.All_Curves_STD.Curves_Raster_1 ident 10 0.0 4294967295.0 /end AXIS_DESCR
/end CHARACTERISTIC
/begin CHARACTERISTIC One_D.STD_uint8_uint8.All_Curves_STD.Curves_Raster_1 "" CURVE 0x1D1B4A STANDARD_CURVE_U8U8 0.0 ident 0.0 255.0
 /begin AXIS_DESCR STD_AXIS M_In.STD_uint8_uint8.All_Curves_STD.Curves_Raster_1 ident 10 0.0 255.0 /end AXIS_DESCR
/end CHARACTERISTIC
/begin CHARACTERISTIC One_D_1.GRP_sint16_sint16.All_Curves_GRP.Curves_Raster_1 "" CURVE 0x1D188A STANDARD_GROUP_S16 0.0 ident -32768.0 32767.0
 /begin AXIS_DESCR COM_AXIS M_In.GRP_sint16_sint16.All_Curves_GRP.Curves_Raster_1 ident 10 -32768.0 32767.0 AXIS_PTS_REF distrib.GRP_sint16_sint16.All_Curves_GRP.Curves_Raster_1 /end AXIS_DESCR
/end CHARACTERISTIC
/begin CHARACTERISTIC One_D_1.GRP_sint16_sint16.All_Curves_GRP.Curves_Raster_2 "" CURVE 0x1D1C6A STANDARD_GROUP_S16 0.0 ident -32768.0 32767.0
 /begin AXIS_DESCR COM_AXIS M_In.GRP_sint16_sint16.All_Curves_GRP.Curves_Raster_2 ident 10 -32768.0 32767.0 AXIS_PTS_REF distrib.GRP_sint16_sint16.All_Curves_GRP.Curves_Raster_2 /end AXIS_DESCR
/end CHARACTERISTIC
/begin CHARACTERISTIC One_D_1.GRP_sint16_sint16.All_Curves_GRP.Curves_Raster_3 "" CURVE 0x1D204A STANDARD_GROUP_S16 0.0 ident -32768.0 32767.0
 /begin AXIS_DESCR COM_AXIS M_In.GRP_sint16_sint16.All_Curves_GRP.Curves_Raster_3 ident 10 -32768.0 32767.0 AXIS_PTS_REF distrib.GRP_sint16_sint16.All_Curves_GRP.Curves_Raster_3 /end AXIS_DESCR
/end CHARACTERISTIC
/begin CHARACTERISTIC One_D_1.GRP_sint32_sint32.All_Curves_GRP.Curves_Raster_1 "" CURVE 0x1D18C4 STANDARD_GROUP_S32 0.0 ident -2147483648.0 2147483647.0
 /begin AXIS_DESCR COM_AXIS M_In.GRP_sint32_sint32.All_Curves_GRP.Curves_Raster_1 ident 10 -2147483648.0 2147483647.0 AXIS_PTS_REF distrib.GRP_sint32_sint32.All_Curves_GRP.Curves_Raster_1 /end AXIS_DESCR
/end CHARACTERISTIC
/begin CHARACTERISTIC One_D_1.GRP_sint32_sint32.All_Curves_GRP.Curves_Raster_2 "" CURVE 0x1D1CA4 STANDARD_GROUP_S32 0.0 ident -2147483648.0 2147483647.0
 /begin AXIS_DESCR COM_AXIS M_In.GRP_sint32_sint32.All_Curves_GRP.Curves_Raster_2 ident 10 -2147483648.0 2147483647.0 AXIS_PTS_REF distrib.GRP_sint32_sint32.All_Curves_GRP.Curves_Raster_2 /end AXIS_DESCR
/end CHARACTERISTIC
/begin CHARACTERISTIC One_D_1.GRP_sint32_sint32.All_Curves_GRP.Curves_Raster_3 "" CURVE 0x1D2084 STANDARD_GROUP_S32 0.0 ident -2147483648.0 2147483647.0
 /begin AXIS_DESCR COM_AXIS M_In.GRP_sint32_sint32.All_Curves_GRP.Curves_Raster_3 ident 10 -2147483648.0 2147483647.0 AXIS_PTS_REF distrib.GRP_sint32_sint32.All_Curves_GRP.Curves_Raster_3 /end AXIS_DESCR
/end CHARACTERISTIC
/begin CHARACTERISTIC One_D_1.GRP_sint8_sint8.All_Curves_GRP.Curves_Raster_1 "" CURVE 0x1D1924 STANDARD_GROUP_S8 0.0 ident -128.0 127.0
 /begin AXIS_DESCR COM_AXIS M_In.GRP_sint8_sint8.All_Curves_GRP.Curves_Raster_1 ident 10 -128.0 127.0 AXIS_PTS_REF distrib.GRP_sint8_sint8.All_Curves_GRP.Curves_Raster_1 /end AXIS_DESCR
/end CHARACTERISTIC
/begin CHARACTERISTIC One_D_1.GRP_sint8_sint8.All_Curves_GRP.Curves_Raster_2 "" CURVE 0x1D1D04 STANDARD_GROUP_S8 0.0 ident -128.0 127.0
 /begin AXIS_DESCR COM_AXIS M_In.GRP_sint8_sint8.All_Curves_GRP.Curves_Raster_2 ident 10 -128.0 127.0 AXIS_PTS_REF distrib.GRP_sint8_sint8.All_Curves_GRP.Curves_Raster_2 /end AXIS_DESCR
/end CHARACTERISTIC
/begin CHARACTERISTIC One_D_1.GRP_sint8_sint8.All_Curves_GRP.Curves_Raster_3 "" CURVE 0x1D20E4 STANDARD_GROUP_S8 0.0 ident -128.0 127.0
 /begin AXIS_DESCR COM_AXIS M_In.GRP_sint8_sint8.All_Curves_GRP.Curves_Raster_3 ident 10 -128.0 127.0 AXIS_PTS_REF distrib.GRP_sint8_sint8.All_Curves_GRP.Curves_Raster_3 /end AXIS_DESCR
/end CHARACTERISTIC
/begin CHARACTERISTIC One_D_1.GRP_uint16_uint16.All_Curves_GRP.Curves_Raster_1 "" CURVE 0x1D194A STANDARD_GROUP_U16 0.0 ident 0.0 65535.0
 /begin AXIS_DESCR COM_AXIS M_In.GRP_uint16_uint16.All_Curves_GRP.Curves_Raster_1 ident 10 0.0 65535.0 AXIS_PTS_REF distrib.GRP_uint16_uint16.All_Curves_GRP.Curves_Raster_1 /end AXIS_DESCR
/end CHARACTERISTIC
/begin CHARACTERISTIC One_D_1.GRP_uint16_uint16.All_Curves_GRP.Curves_Raster_2 "" CURVE 0x1D1D2A STANDARD_GROUP_U16 0.0 ident 0.0 65535.0
 /begin AXIS_DESCR COM_AXIS M_In.GRP_uint16_uint16.All_Curves_GRP.Curves_Raster_2 ident 10 0.0 65535.0 AXIS_PTS_REF distrib.GRP_uint16_uint16.All_Curves_GRP.Curves_Raster_2 /end AXIS_DESCR
/end CHARACTERISTIC
/begin CHARACTERISTIC One_D_1.GRP_uint16_uint16.All_Curves_GRP.Curves_Raster_3 "" CURVE 0x1D210A STANDARD_GROUP_U16 0.0 ident 0.0 65535.0
 /begin AXIS_DESCR COM_AXIS M_In.GRP_uint16_uint16.All_Curves_GRP.Curves_Raster_3 ident 10 0.0 65535.0 AXIS_PTS_REF distrib.GRP_uint16_uint16.All_Curves_GRP.Curves_Raster_3 /end AXIS_DESCR
/end CHARACTERISTIC
/begin CHARACTERISTIC One_D_1.GRP_uint32_uint32.All_Curves_GRP.Curves_Raster_1 "" CURVE 0x1D1984 STANDARD_GROUP_U32 0.0 ident 0.0 4294967295.0
 /begin AXIS_DESCR COM_AXIS M_In.GRP_uint32_uint32.All_Curves_GRP.Curves_Raster_1 ident 10 0.0 4294967295.0 AXIS_PTS_REF distrib.GRP_uint32_uint32.All_Curves_GRP.Curves_Raster_1 /end AXIS_DESCR
/end CHARACTERISTIC
/begin CHARACTERISTIC One_D_1.GRP_uint32_uint32.All_Curves_GRP.Curves_Raster_2 "" CURVE 0x1D1D64 STANDARD_GROUP_U32 0.0 ident 0.0 4294967295.0
 /begin AXIS_DESCR COM_AXIS M_In.GRP_uint32_uint32.All_Curves_GRP.Curves_Raster_2 ident 10 0.0 4294967295.0 AXIS_PTS_REF distrib.GRP_uint32_uint32.All_Curves_GRP.Curves_Raster_2 /end AXIS_DESCR
/end CHARACTERISTIC
/begin CHARACTERISTIC One_D_1.GRP_uint32_uint32.All_Curves_GRP.Curves_Raster_3 "" CURVE 0x1D2144 STANDARD_GROUP_U32 0.0 ident 0.0 4294967295.0
 /begin AXIS_DESCR COM_AXIS M_In.GRP_uint32_uint32.All_Curves_GRP.Curves_Raster_3 ident 10 0.0 4294967295.0 AXIS_PTS_REF distrib.GRP_uint32_uint32.All_Curves_GRP.Curves_Raster_3 /end AXIS_DESCR
/end CHARACTERISTIC
/begin CHARACTERISTIC One_D_1.GRP_uint8_uint8.All_Curves_GRP.Curves_Raster_1 "" CURVE 0x1D19E4 STANDARD_GROUP_U8 0.0 ident 0.0 255.0
 /begin AXIS_DESCR COM_AXIS M_In.GRP_uint8_uint8.All_Curves_GRP.Curves_Raster_1 ident 10 0.0 255.0 AXIS_PTS_REF distrib.GRP_uint8_uint8.All_Curves_GRP.Curves_Raster_1 /end AXIS_DESCR
/end CHARACTERISTIC
/begin CHARACTERISTIC One_D_1.GRP_uint8_uint8.All_Curves_GRP.Curves_Raster_2 "" CURVE 0x1D1DC4 STANDARD_GROUP_U8 0.0 ident 0.0 255.0
 /begin AXIS_DESCR COM_AXIS M_In.GRP_uint8_uint8.All_Curves_GRP.Curves_Raster_2 ident 10 0.0 255.0 AXIS_PTS_REF distrib.GRP_uint8_uint8.All_Curves_GRP.Curves_Raster_2 /end AXIS_DESCR
/end CHARACTERISTIC
/begin CHARACTERISTIC One_D_1.GRP_uint8_uint8.All_Curves_GRP.Curves_Raster_3 "" CURVE 0x1D21A4 STANDARD_GROUP_U8 0.0 ident 0.0 255.0
 /begin AXIS_DESCR COM_AXIS M_In.GRP_uint8_uint8.All_Curves_GRP.Curves_Raster_3 ident 10 0.0 255.0 AXIS_PTS_REF distrib.GRP_uint8_uint8.All_Curves_GRP.Curves_Raster_3 /end AXIS_DESCR
/end CHARACTERISTIC
/begin CHARACTERISTIC One_D_Fix.FIX_sint16_sint16.All_Curves_FIX.Curves_Raster_1 "" CURVE 0x1D1796 STANDARD_FIXED_S16 0.0 ident -32768.0 32767.0
 /begin AXIS_DESCR FIX_AXIS M_In.FIX_sint16_sint16.All_Curves_FIX.Curves_Raster_1 ident 10 -32768.0 32767.0 FIX_AXIS_PAR_DIST 0 1 10 /end AXIS_DESCR
/end CHARACTERISTIC
/begin CHARACTERISTIC One_D_Fix.FIX_sint16_sint16.All_Curves_FIX.Curves_Raster_2 "" CURVE 0x1D1B76 STANDARD_FIXED_S16 0.0 ident -32768.0 32767.0
 /begin AXIS_DESCR FIX_AXIS M_In.FIX_sint16_sint16.All_Curves_FIX.Curves_Raster_2 ident 10 -32768.0 32767.0 FIX_AXIS_PAR_DIST 0 1 10 /end AXIS_DESCR
/end CHARACTERISTIC
/begin CHARACTERISTIC One_D_Fix.FIX_sint16_sint16.All_Curves_FIX.Curves_Raster_3 "" CURVE 0x1D1F56 STANDARD_FIXED_S16 0.0 ident -32768.0 32767.0
 /begin AXIS_DESCR FIX_AXIS M_In.FIX_sint16_sint16.All_Curves_FIX.Curves_Raster_3 ident 10 -32768.0 32767.0 FIX_AXIS_PAR_DIST 0 1 10 /end AXIS_DESCR
/end CHARACTERISTIC
/begin CHARACTERISTIC One_D_Fix.FIX_sint32_sint32.All_Curves_FIX.Curves_Raster_1 "" CURVE 0x1D17C4 STANDARD_FIXED_S32 0.0 ident -2147483648.0 2147483647.0
 /begin AXIS_DESCR FIX_AXIS M_In.FIX_sint32_sint32.All_Curves_FIX.Curves_Raster_1 ident 10 -2147483648.0 2147483647.0 FIX_AXIS_PAR_DIST 0 1 10 /end AXIS_DESCR
/end CHARACTERISTIC
/begin CHARACTERISTIC One_D_Fix.FIX_sint32_sint32.All_Curves_FIX.Curves_Raster_2 "" CURVE 0x1D1BA4 STANDARD_FIXED_S32 0.0 ident -2147483648.0 2147483647.0
 /begin AXIS_DESCR FIX_AXIS M_In.FIX_sint32_sint32.All_Curves_FIX.Curves_Raster_2 ident 10 -2147483648.0 2147483647.0 FIX_AXIS_PAR_DIST 0 1 10 /end AXIS_DESCR
/end CHARACTERISTIC
/begin CHARACTERISTIC One_D_Fix.FIX_sint32_sint32.All_Curves_FIX.Curves_Raster_3 "" CURVE 0x1D1F84 STANDARD_FIXED_S32 0.0 ident -2147483648.0 2147483647.0
 /begin AXIS_DESCR FIX_AXIS M_In.FIX_sint32_sint32.All_Curves_FIX.Curves_Raster_3 ident 10 -2147483648.0 2147483647.0 FIX_AXIS_PAR_DIST 0 1 10 /end AXIS_DESCR
/end CHARACTERISTIC
/begin CHARACTERISTIC One_D_Fix.FIX_sint8_sint8.All_Curves_FIX.Curves_Raster_1 "" CURVE 0x1D17F5 STANDARD_FIXED_S8 0.0 ident -128.0 127.0
 /begin AXIS_DESCR FIX_AXIS M_In.FIX_sint8_sint8.All_Curves_FIX.Curves_Raster_1 ident 10 -128.0 127.0 FIX_AXIS_PAR_DIST 0 1 10 /end AXIS_DESCR
/end CHARACTERISTIC
/begin CHARACTERISTIC One_D_Fix.FIX_sint8_sint8.All_Curves_FIX.Curves_Raster_2 "" CURVE 0x1D1BD5 STANDARD_FIXED_S8 0.0 ident -128.0 127.0
 /begin AXIS_DESCR FIX_AXIS M_In.FIX_sint8_sint8.All_Curves_FIX.Curves_Raster_2 ident 10 -128.0 127.0 FIX_AXIS_PAR_DIST 0 1 10 /end AXIS_DESCR
/end CHARACTERISTIC
/begin CHARACTERISTIC One_D_Fix.FIX_sint8_sint8.All_Curves_FIX.Curves_Raster_3 "" CURVE 0x1D1FB5 STANDARD_FIXED_S8 0.0 ident -128.0 127.0
 /begin AXIS_DESCR FIX_AXIS M_In.FIX_sint8_sint8.All_Curves_FIX.Curves_Raster_3 ident 10 -128.0 127.0 FIX_AXIS_PAR_DIST 0 1 10 /end AXIS_DESCR
/end CHARACTERISTIC
/begin CHARACTERISTIC One_D_Fix.FIX_uint16_uint16.All_Curves_FIX.Curves_Raster_1 "" CURVE 0x1D180E STANDARD_FIXED_U16 0.0 ident 0.0 65535.0
 /begin AXIS_DESCR FIX_AXIS M_In.FIX_uint16_uint16.All_Curves_FIX.Curves_Raster_1 ident 10 0.0 65535.0 FIX_AXIS_PAR_DIST 0 1 10 /end AXIS_DESCR
/end CHARACTERISTIC
/begin CHARACTERISTIC One_D_Fix.FIX_uint16_uint16.All_Curves_FIX.Curves_Raster_2 "" CURVE 0x1D1BEE STANDARD_FIXED_U16 0.0 ident 0.0 65535.0
 /begin AXIS_DESCR FIX_AXIS M_In.FIX_uint16_uint16.All_Curves_FIX.Curves_Raster_2 ident 10 0.0 65535.0 FIX_AXIS_PAR_DIST 0 1 10 /end AXIS_DESCR
/end CHARACTERISTIC
/begin CHARACTERISTIC One_D_Fix.FIX_uint16_uint16.All_Curves_FIX.Curves_Raster_3 "" CURVE 0x1D1FCE STANDARD_FIXED_U16 0.0 ident 0.0 65535.0
 /begin AXIS_DESCR FIX_AXIS M_In.FIX_uint16_uint16.All_Curves_FIX.Curves_Raster_3 ident 10 0.0 65535.0 FIX_AXIS_PAR_DIST 0 1 10 /end AXIS_DESCR
/end CHARACTERISTIC
/begin CHARACTERISTIC One_D_Fix.FIX_uint32_uint32.All_Curves_FIX.Curves_Raster_1 "" CURVE 0x1D183C STANDARD_FIXED_U32 0.0 ident 0.0 4294967295.0
 /begin AXIS_DESCR FIX_AXIS M_In.FIX_uint32_uint32.All_Curves_FIX.Curves_Raster_1 ident 10 0.0 4294967295.0 FIX_AXIS_PAR_DIST 0 1 10 /end AXIS_DESCR
/end CHARACTERISTIC
/begin CHARACTERISTIC One_D_Fix.FIX_uint32_uint32.All_Curves_FIX.Curves_Raster_2 "" CURVE 0x1D1C1C STANDARD_FIXED_U32 0.0 ident 0.0 4294967295.0
 /begin AXIS_DESCR FIX_AXIS M_In.FIX_uint32_uint32.All_Curves_FIX.Curves_Raster_2 ident 10 0.0 4294967295.0 FIX_AXIS_PAR_DIST 0 1 10 /end AXIS_DESCR
/end CHARACTERISTIC
/begin CHARACTERISTIC One_D_Fix.FIX_uint32_uint32.All_Curves_FIX.Curves_Raster_3 "" CURVE 0x1D1FFC STANDARD_FIXED_U32 0.0 ident 0.0 4294967295.0
 /begin AXIS_DESCR FIX_AXIS M_In.FIX_uint32_uint32.All_Curves_FIX.Curves_Raster_3 ident 10 0.0 4294967295.0 FIX_AXIS_PAR_DIST 0 1 10 /end AXIS_DESCR
/end CHARACTERISTIC
/begin CHARACTERISTIC One_D_Fix.FIX_uint8_uint8.All_Curves_FIX.Curves_Raster_1 "" CURVE 0x1D186D STANDARD_FIXED_U8 0.0 ident 0.0 255.0
 /begin AXIS_DESCR FIX_AXIS M_In.FIX_uint8_uint8.All_Curves_FIX.Curves_Raster_1 ident 10 0.0 255.0 FIX_AXIS_PAR_DIST 0 1 10 /end AXIS_DESCR
/end CHARACTERISTIC
/begin CHARACTERISTIC One_D_Fix.FIX_uint8_uint8.All_Curves_FIX.Curves_Raster_2 "" CURVE 0x1D1C4D STANDARD_FIXED_U8 0.0 ident 0.0 255.0
 /begin AXIS_DESCR FIX_AXIS M_In.FIX_uint8_uint8.All_Curves_FIX.Curves_Raster_2 ident 10 0.0 255.0 FIX_AXIS_PAR_DIST 0 1 10 /end AXIS_DESCR
/end CHARACTERISTIC
/begin CHARACTERISTIC One_D_Fix.FIX_uint8_uint8.All_Curves_FIX.Curves_Raster_3 "" CURVE 0x1D202D STANDARD_FIXED_U8 0.0 ident 0.0 255.0
 /begin AXIS_DESCR FIX_AXIS M_In.FIX_uint8_uint8.All_Curves_FIX.Curves_Raster_3 ident 10 0.0 255.0 FIX_AXIS_PAR_DIST 0 1 10 /end AXIS_DESCR
/end CHARACTERISTIC
/begin CHARACTERISTIC p_1SlewingMode_e.Slewing1.AllSlews "" VALUE 0x1DF000 STANDARD_VALUE_U8 0.0 enum_SLEWING_MODE_E 0 2 /end CHARACTERISTIC
/begin CHARACTERISTIC p_2SlewingAbsolute_u8.Slewing1.AllSlews "" VALUE 0x1DF001 STANDARD_VALUE_U8 0.0 ident 0.0 255.0 /end CHARACTERISTIC
/begin CHARACTERISTIC p_3SlewingModify_u8.Slewing1.AllSlews "" VALUE 0x1DF002 STANDARD_VALUE_U8 0.0 ident 0.0 255.0 /end CHARACTERISTIC
/begin CHARACTERISTIC P_alarm_cycle.AT2ms.Restart_Raster_16T "" VALUE 0x1DA5E0 STANDARD_VALUE_U32 0.0 TickType2ms 0.0 1227133.512857143 /end CHARACTERISTIC
/begin CHARACTERISTIC P_alarm_cycle.ATRestartRaster.Restart_Raster_16T "" VALUE 0x1DA5F0 STANDARD_VALUE_U32 0.0 TickType2ms 0.0 1227133.512857143 /end CHARACTERISTIC
/begin CHARACTERISTIC P_alarm_cycle_delay.AT2ms.Restart_Raster_16T "" VALUE 0x1DA5E4 STANDARD_VALUE_U32 0.0 TickType2ms 0.0 1227133.512857143 /end CHARACTERISTIC
/begin CHARACTERISTIC P_alarm_cycle_delay.ATRestartRaster.Restart_Raster_16T "" VALUE 0x1DA5F4 STANDARD_VALUE_U32 0.0 TickType2ms 0.0 1227133.512857143 /end CHARACTERISTIC
/begin CHARACTERISTIC p_ChecksumByteOrder_u8.Checksum.ALL_PROT "" VALUE 0x1D00AD STANDARD_VALUE_U8 0.0 enum_XCP_ByteOrder_e 0 1 /end CHARACTERISTIC
/begin CHARACTERISTIC p_ChecksumType_u8.Checksum.ALL_PROT "" VALUE 0x1D00AC STANDARD_VALUE_U8 0.0 enum_XCP_ChecksumType_e 0 9 /end CHARACTERISTIC
/begin CHARACTERISTIC P_Do_Active_Fix.FIX_sint16_sint16.All_Curves_FIX.Curves_Raster_1 "" VALUE 0x1D178E STANDARD_VALUE_S8 0.0 ident 0 1 BIT_MASK 0x1 /end CHARACTERISTIC
/begin CHARACTERISTIC P_Do_Active_Fix.FIX_sint16_sint16.All_Curves_FIX.Curves_Raster_2 "" VALUE 0x1D1B6E STANDARD_VALUE_S8 0.0 ident 0 1 BIT_MASK 0x1 /end CHARACTERISTIC
/begin CHARACTERISTIC P_Do_Active_Fix.FIX_sint16_sint16.All_Curves_FIX.Curves_Raster_3 "" VALUE 0x1D1F4E STANDARD_VALUE_S8 0.0 ident 0 1 BIT_MASK 0x1 /end CHARACTERISTIC
/begin CHARACTERISTIC P_Do_Active_Fix.FIX_sint32_sint32.All_Curves_FIX.Curves_Raster_1 "" VALUE 0x1D17B4 STANDARD_VALUE_S8 0.0 ident 0 1 BIT_MASK 0x1 /end CHARACTERISTIC
/begin CHARACTERISTIC P_Do_Active_Fix.FIX_sint32_sint32.All_Curves_FIX.Curves_Raster_2 "" VALUE 0x1D1B94 STANDARD_VALUE_S8 0.0 ident 0 1 BIT_MASK 0x1 /end CHARACTERISTIC
/begin CHARACTERISTIC P_Do_Active_Fix.FIX_sint32_sint32.All_Curves_FIX.Curves_Raster_3 "" VALUE 0x1D1F74 STANDARD_VALUE_S8 0.0 ident 0 1 BIT_MASK 0x1 /end CHARACTERISTIC
/begin CHARACTERISTIC P_Do_Active_Fix.FIX_sint8_sint8.All_Curves_FIX.Curves_Raster_1 "" VALUE 0x1D17F0 STANDARD_VALUE_S8 0.0 ident 0 1 BIT_MASK 0x1 /end CHARACTERISTIC
/begin CHARACTERISTIC P_Do_Active_Fix.FIX_sint8_sint8.All_Curves_FIX.Curves_Raster_2 "" VALUE 0x1D1BD0 STANDARD_VALUE_S8 0.0 ident 0 1 BIT_MASK 0x1 /end CHARACTERISTIC
/begin CHARACTERISTIC P_Do_Active_Fix.FIX_sint8_sint8.All_Curves_FIX.Curves_Raster_3 "" VALUE 0x1D1FB0 STANDARD_VALUE_S8 0.0 ident 0 1 BIT_MASK 0x1 /end CHARACTERISTIC
/begin CHARACTERISTIC P_Do_Active_Fix.FIX_uint16_uint16.All_Curves_FIX.Curves_Raster_1 "" VALUE 0x1D1806 STANDARD_VALUE_S8 0.0 ident 0 1 BIT_MASK 0x1 /end CHARACTERISTIC
/begin CHARACTERISTIC P_Do_Active_Fix.FIX_uint16_uint16.All_Curves_FIX.Curves_Raster_2 "" VALUE 0x1D1BE6 STANDARD_VALUE_S8 0.0 ident 0 1 BIT_MASK 0x1 /end CHARACTERISTIC
/begin CHARACTERISTIC P_Do_Active_Fix.FIX_uint16_uint16.All_Curves_FIX.Curves_Raster_3 "" VALUE 0x1D1FC6 STANDARD_VALUE_S8 0.0 ident 0 1 BIT_MASK 0x1 /end CHARACTERISTIC
/begin CHARACTERISTIC P_Do_Active_Fix.FIX_uint32_uint32.All_Curves_FIX.Curves_Raster_1 "" VALUE 0x1D182C STANDARD_VALUE_S8 0.0 ident 0 1 BIT_MASK 0x1 /end CHARACTERISTIC
/begin CHARACTERISTIC P_Do_Active_Fix.FIX_uint32_uint32.All_Curves_FIX.Curves_Raster_2 "" VALUE 0x1D1C0C STANDARD_VALUE_S8 0.0 ident 0 1 BIT_MASK 0x1 /end CHARACTERISTIC
/begin CHARACTERISTIC P_Do_Active_Fix.FIX_uint32_uint32.All_Curves_FIX.Curves_Raster_3 "" VALUE 0x1D1FEC STANDARD_VALUE_S8 0.0 ident 0 1 BIT_MASK 0x1 /end CHARACTERISTIC
/begin CHARACTERISTIC P_Do_Active_Fix.FIX_uint8_uint8.All_Curves_FIX.Curves_Raster_1 "" VALUE 0x1D1868 STANDARD_VALUE_S8 0.0 ident 0 1 BIT_MASK 0x1 /end CHARACTERISTIC
/begin CHARACTERISTIC P_Do_Active_Fix.FIX_uint8_uint8.All_Curves_FIX.Curves_Raster_2 "" VALUE 0x1D1C48 STANDARD_VALUE_S8 0.0 ident 0 1 BIT_MASK 0x1 /end CHARACTERISTIC
/begin CHARACTERISTIC P_Do_Active_Fix.FIX_uint8_uint8.All_Curves_FIX.Curves_Raster_3 "" VALUE 0x1D2028 STANDARD_VALUE_S8 0.0 ident 0 1 BIT_MASK 0x1 /end CHARACTERISTIC
/begin CHARACTERISTIC P_Do_Active_Grp.GRP_sint16_sint16.All_Curves_GRP.Curves_Raster_1 "" VALUE 0x1D1886 STANDARD_VALUE_U8 0.0 ident 0 1 BIT_MASK 0x1 /end CHARACTERISTIC
/begin CHARACTERISTIC P_Do_Active_Grp.GRP_sint16_sint16.All_Curves_GRP.Curves_Raster_2 "" VALUE 0x1D1C66 STANDARD_VALUE_U8 0.0 ident 0 1 BIT_MASK 0x1 /end CHARACTERISTIC
/begin CHARACTERISTIC P_Do_Active_Grp.GRP_sint16_sint16.All_Curves_GRP.Curves_Raster_3 "" VALUE 0x1D2046 STANDARD_VALUE_U8 0.0 ident 0 1 BIT_MASK 0x1 /end CHARACTERISTIC
/begin CHARACTERISTIC P_Do_Active_Grp.GRP_sint32_sint32.All_Curves_GRP.Curves_Raster_1 "" VALUE 0x1D18C0 STANDARD_VALUE_S8 0.0 ident 0 1 BIT_MASK 0x1 /end CHARACTERISTIC
/begin CHARACTERISTIC P_Do_Active_Grp.GRP_sint32_sint32.All_Curves_GRP.Curves_Raster_2 "" VALUE 0x1D1CA0 STANDARD_VALUE_S8 0.0 ident 0 1 BIT_MASK 0x1 /end CHARACTERISTIC
/begin CHARACTERISTIC P_Do_Active_Grp.GRP_sint32_sint32.All_Curves_GRP.Curves_Raster_3 "" VALUE 0x1D2080 STANDARD_VALUE_S8 0.0 ident 0 1 BIT_MASK 0x1 /end CHARACTERISTIC
/begin CHARACTERISTIC P_Do_Active_Grp.GRP_sint8_sint8.All_Curves_GRP.Curves_Raster_1 "" VALUE 0x1D1920 STANDARD_VALUE_U8 0.0 ident 0 1 BIT_MASK 0x1 /end CHARACTERISTIC
/begin CHARACTERISTIC P_Do_Active_Grp.GRP_sint8_sint8.All_Curves_GRP.Curves_Raster_2 "" VALUE 0x1D1D00 STANDARD_VALUE_U8 0.0 ident 0 1 BIT_MASK 0x1 /end CHARACTERISTIC
/begin CHARACTERISTIC P_Do_Active_Grp.GRP_sint8_sint8.All_Curves_GRP.Curves_Raster_3 "" VALUE 0x1D20E0 STANDARD_VALUE_U8 0.0 ident 0 1 BIT_MASK 0x1 /end CHARACTERISTIC
/begin CHARACTERISTIC P_Do_Active_Grp.GRP_uint16_uint16.All_Curves_GRP.Curves_Raster_1 "" VALUE 0x1D1946 STANDARD_VALUE_U8 0.0 ident 0 1 BIT_MASK 0x1 /end CHARACTERISTIC
/begin CHARACTERISTIC P_Do_Active_Grp.GRP_uint16_uint16.All_Curves_GRP.Curves_Raster_2 "" VALUE 0x1D1D26 STANDARD_VALUE_U8 0.0 ident 0 1 BIT_MASK 0x1 /end CHARACTERISTIC
/begin CHARACTERISTIC P_Do_Active_Grp.GRP_uint16_uint16.All_Curves_GRP.Curves_Raster_3 "" VALUE 0x1D2106 STANDARD_VALUE_U8 0.0 ident 0 1 BIT_MASK 0x1 /end CHARACTERISTIC
/begin CHARACTERISTIC P_Do_Active_Grp.GRP_uint32_uint32.All_Curves_GRP.Curves_Raster_1 "" VALUE 0x1D1980 STANDARD_VALUE_S8 0.0 ident 0 1 BIT_MASK 0x1 /end CHARACTERISTIC
/begin CHARACTERISTIC P_Do_Active_Grp.GRP_uint32_uint32.All_Curves_GRP.Curves_Raster_2 "" VALUE 0x1D1D60 STANDARD_VALUE_S8 0.0 ident 0 1 BIT_MASK 0x1 /end CHARACTERISTIC
/begin CHARACTERISTIC P_Do_Active_Grp.GRP_uint32_uint32.All_Curves_GRP.Curves_Raster_3 "" VALUE 0x1D2140 STANDARD_VALUE_S8 0.0 ident 0 1 BIT_MASK 0x1 /end CHARACTERISTIC
/begin CHARACTERISTIC P_Do_Active_Grp.GRP_uint8_uint8.All_Curves_GRP.Curves_Raster_1 "" VALUE 0x1D19E0 STANDARD_VALUE_U8 0.0 ident 0 1 BIT_MASK 0x1 /end CHARACTERISTIC
/begin CHARACTERISTIC P_Do_Active_Grp.GRP_uint8_uint8.All_Curves_GRP.Curves_Raster_2 "" VALUE 0x1D1DC0 STANDARD_VALUE_U8 0.0 ident 0 1 BIT_MASK 0x1 /end CHARACTERISTIC
/begin CHARACTERISTIC P_Do_Active_Grp.GRP_uint8_uint8.All_Curves_GRP.Curves_Raster_3 "" VALUE 0x1D21A0 STANDARD_VALUE_U8 0.0 ident 0 1 BIT_MASK 0x1 /end CHARACTERISTIC
/begin CHARACTERISTIC P_Do_Active_Std.STD_sint16_sint16.All_Curves_STD.Curves_Raster_1 "" VALUE 0x1D1A06 STANDARD_VALUE_U8 0.0 ident 0 1 BIT_MASK 0x1 /end CHARACTERISTIC
/begin CHARACTERISTIC P_Do_Active_Std.STD_sint32_sint32.All_Curves_STD.Curves_Raster_1 "" VALUE 0x1D1A3C STANDARD_VALUE_U8 0.0 ident 0 1 BIT_MASK 0x1 /end CHARACTERISTIC
/begin CHARACTERISTIC P_Do_Active_Std.STD_sint8_sint8.All_Curves_STD.Curves_Raster_1 "" VALUE 0x1D1A98 STANDARD_VALUE_U8 0.0 ident 0 1 BIT_MASK 0x1 /end CHARACTERISTIC
/begin CHARACTERISTIC P_Do_Active_Std.STD_uint16_uint16.All_Curves_STD.Curves_Raster_1 "" VALUE 0x1D1AB6 STANDARD_VALUE_U8 0.0 ident 0 1 BIT_MASK 0x1 /end CHARACTERISTIC
/begin CHARACTERISTIC P_Do_Active_Std.STD_uint32_uint32.All_Curves_STD.Curves_Raster_1 "" VALUE 0x1D1AEC STANDARD_VALUE_U8 0.0 ident 0 1 BIT_MASK 0x1 /end CHARACTERISTIC
/begin CHARACTERISTIC P_Do_Active_Std.STD_uint8_uint8.All_Curves_STD.Curves_Raster_1 "" VALUE 0x1D1B48 STANDARD_VALUE_U8 0.0 ident 0 1 BIT_MASK 0x1 /end CHARACTERISTIC
/begin CHARACTERISTIC P_Do_All_FIX_Curves.All_Curves_FIX.Curves_Raster_1 "" VALUE 0x1D1784 STANDARD_VALUE_U8 0.0 ident 0 1 BIT_MASK 0x1 /end CHARACTERISTIC
/begin CHARACTERISTIC P_Do_All_FIX_Curves.All_Curves_FIX.Curves_Raster_2 "" VALUE 0x1D1B64 STANDARD_VALUE_U8 0.0 ident 0 1 BIT_MASK 0x1 /end CHARACTERISTIC
/begin CHARACTERISTIC P_Do_All_FIX_Curves.All_Curves_FIX.Curves_Raster_3 "" VALUE 0x1D1F44 STANDARD_VALUE_U8 0.0 ident 0 1 BIT_MASK 0x1 /end CHARACTERISTIC
/begin CHARACTERISTIC P_Do_All_GRP_Curves.All_Curves_GRP.Curves_Raster_1 "" VALUE 0x1D1878 STANDARD_VALUE_U8 0.0 ident 0 1 BIT_MASK 0x1 /end CHARACTERISTIC
/begin CHARACTERISTIC P_Do_All_GRP_Curves.All_Curves_GRP.Curves_Raster_2 "" VALUE 0x1D1C58 STANDARD_VALUE_U8 0.0 ident 0 1 BIT_MASK 0x1 /end CHARACTERISTIC
/begin CHARACTERISTIC P_Do_All_GRP_Curves.All_Curves_GRP.Curves_Raster_3 "" VALUE 0x1D2038 STANDARD_VALUE_U8 0.0 ident 0 1 BIT_MASK 0x1 /end CHARACTERISTIC
/begin CHARACTERISTIC P_Do_All_STD_Curves.All_Curves_STD.Curves_Raster_1 "" VALUE 0x1D19FC STANDARD_VALUE_U8 0.0 ident 0 1 BIT_MASK 0x1 /end CHARACTERISTIC
/begin CHARACTERISTIC P_Do_Grp_get.GRP_sint16_sint16.All_Curves_GRP.Curves_Raster_1 "" VALUE 0x1D1887 STANDARD_VALUE_S8 0.0 ident 0 1 BIT_MASK 0x1 /end CHARACTERISTIC
/begin CHARACTERISTIC P_Do_Grp_get.GRP_sint16_sint16.All_Curves_GRP.Curves_Raster_2 "" VALUE 0x1D1C67 STANDARD_VALUE_S8 0.0 ident 0 1 BIT_MASK 0x1 /end CHARACTERISTIC
/begin CHARACTERISTIC P_Do_Grp_get.GRP_sint16_sint16.All_Curves_GRP.Curves_Raster_3 "" VALUE 0x1D2047 STANDARD_VALUE_S8 0.0 ident 0 1 BIT_MASK 0x1 /end CHARACTERISTIC
/begin CHARACTERISTIC P_Do_Grp_get.GRP_sint32_sint32.All_Curves_GRP.Curves_Raster_1 "" VALUE 0x1D18C1 STANDARD_VALUE_S8 0.0 ident 0 1 BIT_MASK 0x1 /end CHARACTERISTIC
/begin CHARACTERISTIC P_Do_Grp_get.GRP_sint32_sint32.All_Curves_GRP.Curves_Raster_2 "" VALUE 0x1D1CA1 STANDARD_VALUE_S8 0.0 ident 0 1 BIT_MASK 0x1 /end CHARACTERISTIC
/begin CHARACTERISTIC P_Do_Grp_get.GRP_sint32_sint32.All_Curves_GRP.Curves_Raster_3 "" VALUE 0x1D2081 STANDARD_VALUE_S8 0.0 ident 0 1 BIT_MASK 0x1 /end CHARACTERISTIC
/begin CHARACTERISTIC P_Do_Grp_get.GRP_sint8_sint8.All_Curves_GRP.Curves_Raster_1 "" VALUE 0x1D1921 STANDARD_VALUE_S8 0.0 ident 0 1 BIT_MASK 0x1 /end CHARACTERISTIC
/begin CHARACTERISTIC P_Do_Grp_get.GRP_sint8_sint8.All_Curves_GRP.Curves_Raster_2 "" VALUE 0x1D1D01 STANDARD_VALUE_S8 0.0 ident 0 1 BIT_MASK 0x1 /end CHARACTERISTIC
/begin CHARACTERISTIC P_Do_Grp_get.GRP_sint8_sint8.All_Curves_GRP.Curves_Raster_3 "" VALUE 0x1D20E1 STANDARD_VALUE_S8 0.0 ident 0 1 BIT_MASK 0x1 /end CHARACTERISTIC
/begin CHARACTERISTIC P_Do_Grp_get.GRP_uint16_uint16.All_Curves_GRP.Curves_Raster_1 "" VALUE 0x1D1947 STANDARD_VALUE_S8 0.0 ident 0 1 BIT_MASK 0x1 /end CHARACTERISTIC
/begin CHARACTERISTIC P_Do_Grp_get.GRP_uint16_uint16.All_Curves_GRP.Curves_Raster_2 "" VALUE 0x1D1D27 STANDARD_VALUE_S8 0.0 ident 0 1 BIT_MASK 0x1 /end CHARACTERISTIC
/begin CHARACTERISTIC P_Do_Grp_get.GRP_uint16_uint16.All_Curves_GRP.Curves_Raster_3 "" VALUE 0x1D2107 STANDARD_VALUE_S8 0.0 ident 0 1 BIT_MASK 0x1 /end CHARACTERISTIC
/begin CHARACTERISTIC P_Do_Grp_get.GRP_uint32_uint32.All_Curves_GRP.Curves_Raster_1 "" VALUE 0x1D1981 STANDARD_VALUE_S8 0.0 ident 0 1 BIT_MASK 0x1 /end CHARACTERISTIC
/begin CHARACTERISTIC P_Do_Grp_get.GRP_uint32_uint32.All_Curves_GRP.Curves_Raster_2 "" VALUE 0x1D1D61 STANDARD_VALUE_S8 0.0 ident 0 1 BIT_MASK 0x1 /end CHARACTERISTIC
/begin CHARACTERISTIC P_Do_Grp_get.GRP_uint32_uint32.All_Curves_GRP.Curves_Raster_3 "" VALUE 0x1D2141 STANDARD_VALUE_S8 0.0 ident 0 1 BIT_MASK 0x1 /end CHARACTERISTIC
/begin CHARACTERISTIC P_Do_Grp_get.GRP_uint8_uint8.All_Curves_GRP.Curves_Raster_1 "" VALUE 0x1D19E1 STANDARD_VALUE_S8 0.0 ident 0 1 BIT_MASK 0x1 /end CHARACTERISTIC
/begin CHARACTERISTIC P_Do_Grp_get.GRP_uint8_uint8.All_Curves_GRP.Curves_Raster_2 "" VALUE 0x1D1DC1 STANDARD_VALUE_S8 0.0 ident 0 1 BIT_MASK 0x1 /end CHARACTERISTIC
/begin CHARACTERISTIC P_Do_Grp_get.GRP_uint8_uint8.All_Curves_GRP.Curves_Raster_3 "" VALUE 0x1D21A1 STANDARD_VALUE_S8 0.0 ident 0 1 BIT_MASK 0x1 /end CHARACTERISTIC
/begin CHARACTERISTIC P_Do_Grp_set.GRP_sint16_sint16.All_Curves_GRP.Curves_Raster_1 "" VALUE 0x1D1888 STANDARD_VALUE_S8 0.0 ident 0 1 BIT_MASK 0x1 /end CHARACTERISTIC
/begin CHARACTERISTIC P_Do_Grp_set.GRP_sint16_sint16.All_Curves_GRP.Curves_Raster_2 "" VALUE 0x1D1C68 STANDARD_VALUE_S8 0.0 ident 0 1 BIT_MASK 0x1 /end CHARACTERISTIC
/begin CHARACTERISTIC P_Do_Grp_set.GRP_sint16_sint16.All_Curves_GRP.Curves_Raster_3 "" VALUE 0x1D2048 STANDARD_VALUE_S8 0.0 ident 0 1 BIT_MASK 0x1 /end CHARACTERISTIC
/begin CHARACTERISTIC P_Do_Grp_set.GRP_sint32_sint32.All_Curves_GRP.Curves_Raster_1 "" VALUE 0x1D18C2 STANDARD_VALUE_S8 0.0 ident 0 1 BIT_MASK 0x1 /end CHARACTERISTIC
/begin CHARACTERISTIC P_Do_Grp_set.GRP_sint32_sint32.All_Curves_GRP.Curves_Raster_2 "" VALUE 0x1D1CA2 STANDARD_VALUE_S8 0.0 ident 0 1 BIT_MASK 0x1 /end CHARACTERISTIC
/begin CHARACTERISTIC P_Do_Grp_set.GRP_sint32_sint32.All_Curves_GRP.Curves_Raster_3 "" VALUE 0x1D2082 STANDARD_VALUE_S8 0.0 ident 0 1 BIT_MASK 0x1 /end CHARACTERISTIC
/begin CHARACTERISTIC P_Do_Grp_set.GRP_sint8_sint8.All_Curves_GRP.Curves_Raster_1 "" VALUE 0x1D1922 STANDARD_VALUE_S8 0.0 ident 0 1 BIT_MASK 0x1 /end CHARACTERISTIC
/begin CHARACTERISTIC P_Do_Grp_set.GRP_sint8_sint8.All_Curves_GRP.Curves_Raster_2 "" VALUE 0x1D1D02 STANDARD_VALUE_S8 0.0 ident 0 1 BIT_MASK 0x1 /end CHARACTERISTIC
/begin CHARACTERISTIC P_Do_Grp_set.GRP_sint8_sint8.All_Curves_GRP.Curves_Raster_3 "" VALUE 0x1D20E2 STANDARD_VALUE_S8 0.0 ident 0 1 BIT_MASK 0x1 /end CHARACTERISTIC
/begin CHARACTERISTIC P_Do_Grp_set.GRP_uint16_uint16.All_Curves_GRP.Curves_Raster_1 "" VALUE 0x1D1948 STANDARD_VALUE_S8 0.0 ident 0 1 BIT_MASK 0x1 /end CHARACTERISTIC
/begin CHARACTERISTIC P_Do_Grp_set.GRP_uint16_uint16.All_Curves_GRP.Curves_Raster_2 "" VALUE 0x1D1D28 STANDARD_VALUE_S8 0.0 ident 0 1 BIT_MASK 0x1 /end CHARACTERISTIC
/begin CHARACTERISTIC P_Do_Grp_set.GRP_uint16_uint16.All_Curves_GRP.Curves_Raster_3 "" VALUE 0x1D2108 STANDARD_VALUE_S8 0.0 ident 0 1 BIT_MASK 0x1 /end CHARACTERISTIC
/begin CHARACTERISTIC P_Do_Grp_set.GRP_uint32_uint32.All_Curves_GRP.Curves_Raster_1 "" VALUE 0x1D1982 STANDARD_VALUE_S8 0.0 ident 0 1 BIT_MASK 0x1 /end CHARACTERISTIC
/begin CHARACTERISTIC P_Do_Grp_set.GRP_uint32_uint32.All_Curves_GRP.Curves_Raster_2 "" VALUE 0x1D1D62 STANDARD_VALUE_S8 0.0 ident 0 1 BIT_MASK 0x1 /end CHARACTERISTIC
/begin CHARACTERISTIC P_Do_Grp_set.GRP_uint32_uint32.All_Curves_GRP.Curves_Raster_3 "" VALUE 0x1D2142 STANDARD_VALUE_S8 0.0 ident 0 1 BIT_MASK 0x1 /end CHARACTERISTIC
/begin CHARACTERISTIC P_Do_Grp_set.GRP_uint8_uint8.All_Curves_GRP.Curves_Raster_1 "" VALUE 0x1D19E2 STANDARD_VALUE_S8 0.0 ident 0 1 BIT_MASK 0x1 /end CHARACTERISTIC
/begin CHARACTERISTIC P_Do_Grp_set.GRP_uint8_uint8.All_Curves_GRP.Curves_Raster_2 "" VALUE 0x1D1DC2 STANDARD_VALUE_S8 0.0 ident 0 1 BIT_MASK 0x1 /end CHARACTERISTIC
/begin CHARACTERISTIC P_Do_Grp_set.GRP_uint8_uint8.All_Curves_GRP.Curves_Raster_3 "" VALUE 0x1D21A2 STANDARD_VALUE_S8 0.0 ident 0 1 BIT_MASK 0x1 /end CHARACTERISTIC
/begin CHARACTERISTIC p_FlashFake_u8.FlashFake.ALL_PROT "" VALUE 0x1D00E0 STANDARD_VALUE_U8 0.0 enum_ALL_FAKE_FLASHING_e 0 1 /end CHARACTERISTIC
/begin CHARACTERISTIC p_HWE_IS01_fake_u8.ALL_PROT "" VALUE 0x1D0040 STANDARD_VALUE_U8 0.0 ident 0 1 BIT_MASK 0x1 /end CHARACTERISTIC
/begin CHARACTERISTIC P_In.FIX_sint16_sint16.All_Curves_FIX.Curves_Raster_1 "" VALUE 0x1D178C STANDARD_VALUE_S16 0.0 ident -32768.0 32767.0 /end CHARACTERISTIC
/begin CHARACTERISTIC P_In.FIX_sint16_sint16.All_Curves_FIX.Curves_Raster_2 "" VALUE 0x1D1B6C STANDARD_VALUE_S16 0.0 ident -32768.0 32767.0 /end CHARACTERISTIC
/begin CHARACTERISTIC P_In.FIX_sint16_sint16.All_Curves_FIX.Curves_Raster_3 "" VALUE 0x1D1F4C STANDARD_VALUE_S16 0.0 ident -32768.0 32767.0 /end CHARACTERISTIC
/begin CHARACTERISTIC P_In.FIX_sint32_sint32.All_Curves_FIX.Curves_Raster_1 "" VALUE 0x1D17B0 STANDARD_VALUE_S32 0.0 ident -2147483648.0 2147483647.0 /end CHARACTERISTIC
/begin CHARACTERISTIC P_In.FIX_sint32_sint32.All_Curves_FIX.Curves_Raster_2 "" VALUE 0x1D1B90 STANDARD_VALUE_S32 0.0 ident -2147483648.0 2147483647.0 /end CHARACTERISTIC
/begin CHARACTERISTIC P_In.FIX_sint32_sint32.All_Curves_FIX.Curves_Raster_3 "" VALUE 0x1D1F70 STANDARD_VALUE_S32 0.0 ident -2147483648.0 2147483647.0 /end CHARACTERISTIC
/begin CHARACTERISTIC P_In.FIX_sint8_sint8.All_Curves_FIX.Curves_Raster_1 "" VALUE 0x1D17F1 STANDARD_VALUE_S8 0.0 ident -128.0 127.0 /end CHARACTERISTIC
/begin CHARACTERISTIC P_In.FIX_sint8_sint8.All_Curves_FIX.Curves_Raster_2 "" VALUE 0x1D1BD1 STANDARD_VALUE_S8 0.0 ident -128.0 127.0 /end CHARACTERISTIC
/begin CHARACTERISTIC P_In.FIX_sint8_sint8.All_Curves_FIX.Curves_Raster_3 "" VALUE 0x1D1FB1 STANDARD_VALUE_S8 0.0 ident -128.0 127.0 /end CHARACTERISTIC
/begin CHARACTERISTIC P_In.FIX_uint16_uint16.All_Curves_FIX.Curves_Raster_1 "" VALUE 0x1D1804 STANDARD_VALUE_U16 0.0 ident 0.0 65535.0 /end CHARACTERISTIC
/begin CHARACTERISTIC P_In.FIX_uint16_uint16.All_Curves_FIX.Curves_Raster_2 "" VALUE 0x1D1BE4 STANDARD_VALUE_U16 0.0 ident 0.0 65535.0 /end CHARACTERISTIC
/begin CHARACTERISTIC P_In.FIX_uint16_uint16.All_Curves_FIX.Curves_Raster_3 "" VALUE 0x1D1FC4 STANDARD_VALUE_U16 0.0 ident 0.0 65535.0 /end CHARACTERISTIC
/begin CHARACTERISTIC P_In.FIX_uint32_uint32.All_Curves_FIX.Curves_Raster_1 "" VALUE 0x1D1828 STANDARD_VALUE_U32 0.0 ident 0.0 4294967295.0 /end CHARACTERISTIC
/begin CHARACTERISTIC P_In.FIX_uint32_uint32.All_Curves_FIX.Curves_Raster_2 "" VALUE 0x1D1C08 STANDARD_VALUE_U32 0.0 ident 0.0 4294967295.0 /end CHARACTERISTIC
/begin CHARACTERISTIC P_In.FIX_uint32_uint32.All_Curves_FIX.Curves_Raster_3 "" VALUE 0x1D1FE8 STANDARD_VALUE_U32 0.0 ident 0.0 4294967295.0 /end CHARACTERISTIC
/begin CHARACTERISTIC P_In.FIX_uint8_uint8.All_Curves_FIX.Curves_Raster_1 "" VALUE 0x1D1869 STANDARD_VALUE_U8 0.0 ident 0.0 255.0 /end CHARACTERISTIC
/begin CHARACTERISTIC P_In.FIX_uint8_uint8.All_Curves_FIX.Curves_Raster_2 "" VALUE 0x1D1C49 STANDARD_VALUE_U8 0.0 ident 0.0 255.0 /end CHARACTERISTIC
/begin CHARACTERISTIC P_In.FIX_uint8_uint8.All_Curves_FIX.Curves_Raster_3 "" VALUE 0x1D2029 STANDARD_VALUE_U8 0.0 ident 0.0 255.0 /end CHARACTERISTIC
/begin CHARACTERISTIC P_In.GRP_sint16_sint16.All_Curves_GRP.Curves_Raster_1 "" VALUE 0x1D1884 STANDARD_VALUE_S16 0.0 ident -32768.0 32767.0 /end CHARACTERISTIC
/begin CHARACTERISTIC P_In.GRP_sint16_sint16.All_Curves_GRP.Curves_Raster_2 "" VALUE 0x1D1C64 STANDARD_VALUE_S16 0.0 ident -32768.0 32767.0 /end CHARACTERISTIC
/begin CHARACTERISTIC P_In.GRP_sint16_sint16.All_Curves_GRP.Curves_Raster_3 "" VALUE 0x1D2044 STANDARD_VALUE_S16 0.0 ident -32768.0 32767.0 /end CHARACTERISTIC
/begin CHARACTERISTIC P_In.GRP_sint32_sint32.All_Curves_GRP.Curves_Raster_1 "" VALUE 0x1D18BC STANDARD_VALUE_S32 0.0 ident -2147483648.0 2147483647.0 /end CHARACTERISTIC
/begin CHARACTERISTIC P_In.GRP_sint32_sint32.All_Curves_GRP.Curves_Raster_2 "" VALUE 0x1D1C9C STANDARD_VALUE_S32 0.0 ident -2147483648.0 2147483647.0 /end CHARACTERISTIC
/begin CHARACTERISTIC P_In.GRP_sint32_sint32.All_Curves_GRP.Curves_Raster_3 "" VALUE 0x1D207C STANDARD_VALUE_S32 0.0 ident -2147483648.0 2147483647.0 /end CHARACTERISTIC
/begin CHARACTERISTIC P_In.GRP_sint8_sint8.All_Curves_GRP.Curves_Raster_1 "" VALUE 0x1D1923 STANDARD_VALUE_S8 0.0 ident -128.0 127.0 /end CHARACTERISTIC
/begin CHARACTERISTIC P_In.GRP_sint8_sint8.All_Curves_GRP.Curves_Raster_2 "" VALUE 0x1D1D03 STANDARD_VALUE_S8 0.0 ident -128.0 127.0 /end CHARACTERISTIC
/begin CHARACTERISTIC P_In.GRP_sint8_sint8.All_Curves_GRP.Curves_Raster_3 "" VALUE 0x1D20E3 STANDARD_VALUE_S8 0.0 ident -128.0 127.0 /end CHARACTERISTIC
/begin CHARACTERISTIC P_In.GRP_uint16_uint16.All_Curves_GRP.Curves_Raster_1 "" VALUE 0x1D1944 STANDARD_VALUE_U16 0.0 ident 0.0 65535.0 /end CHARACTERISTIC
/begin CHARACTERISTIC P_In.GRP_uint16_uint16.All_Curves_GRP.Curves_Raster_2 "" VALUE 0x1D1D24 STANDARD_VALUE_U16 0.0 ident 0.0 65535.0 /end CHARACTERISTIC
/begin CHARACTERISTIC P_In.GRP_uint16_uint16.All_Curves_GRP.Curves_Raster_3 "" VALUE 0x1D2104 STANDARD_VALUE_U16 0.0 ident 0.0 65535.0 /end CHARACTERISTIC
/begin CHARACTERISTIC P_In.GRP_uint32_uint32.All_Curves_GRP.Curves_Raster_1 "" VALUE 0x1D197C STANDARD_VALUE_U32 0.0 ident 0.0 4294967295.0 /end CHARACTERISTIC
/begin CHARACTERISTIC P_In.GRP_uint32_uint32.All_Curves_GRP.Curves_Raster_2 "" VALUE 0x1D1D5C STANDARD_VALUE_U32 0.0 ident 0.0 4294967295.0 /end CHARACTERISTIC
/begin CHARACTERISTIC P_In.GRP_uint32_uint32.All_Curves_GRP.Curves_Raster_3 "" VALUE 0x1D213C STANDARD_VALUE_U32 0.0 ident 0.0 4294967295.0 /end CHARACTERISTIC
/begin CHARACTERISTIC P_In.GRP_uint8_uint8.All_Curves_GRP.Curves_Raster_1 "" VALUE 0x1D19E3 STANDARD_VALUE_U8 0.0 ident 0.0 255.0 /end CHARACTERISTIC
/begin CHARACTERISTIC P_In.GRP_uint8_uint8.All_Curves_GRP.Curves_Raster_2 "" VALUE 0x1D1DC3 STANDARD_VALUE_U8 0.0 ident 0.0 255.0 /end CHARACTERISTIC
/begin CHARACTERISTIC P_In.GRP_uint8_uint8.All_Curves_GRP.Curves_Raster_3 "" VALUE 0x1D21A3 STANDARD_VALUE_U8 0.0 ident 0.0 255.0 /end CHARACTERISTIC
/begin CHARACTERISTIC P_In.STD_sint16_sint16.All_Curves_STD.Curves_Raster_1 "" VALUE 0x1D1A04 STANDARD_VALUE_S16 0.0 ident -32768.0 32767.0 /end CHARACTERISTIC
/begin CHARACTERISTIC P_In.STD_sint32_sint32.All_Curves_STD.Curves_Raster_1 "" VALUE 0x1D1A38 STANDARD_VALUE_S32 0.0 ident -2147483648.0 2147483647.0 /end CHARACTERISTIC
/begin CHARACTERISTIC P_In.STD_sint8_sint8.All_Curves_STD.Curves_Raster_1 "" VALUE 0x1D1A99 STANDARD_VALUE_S8 0.0 ident -128.0 127.0 /end CHARACTERISTIC
/begin CHARACTERISTIC P_In.STD_uint16_uint16.All_Curves_STD.Curves_Raster_1 "" VALUE 0x1D1AB4 STANDARD_VALUE_U16 0.0 ident 0.0 65535.0 /end CHARACTERISTIC
/begin CHARACTERISTIC P_In.STD_uint32_uint32.All_Curves_STD.Curves_Raster_1 "" VALUE 0x1D1AE8 STANDARD_VALUE_U32 0.0 ident 0.0 4294967295.0 /end CHARACTERISTIC
/begin CHARACTERISTIC P_In.STD_uint8_uint8.All_Curves_STD.Curves_Raster_1 "" VALUE 0x1D1B49 STANDARD_VALUE_U8 0.0 ident 0.0 255.0 /end CHARACTERISTIC
/begin CHARACTERISTIC P_PageSwitch.SERAM_PageControl.ALL_PROT "" VALUE 0x1c3A50 STANDARD_VALUE_U8 0.0 enum_CCP_Page_ENUM 0 2 /end CHARACTERISTIC
/begin CHARACTERISTIC p_SeramCheckParamRange_u8.SERAM_PageControl.ALL_PROT "" VALUE 0x1D00E8 STANDARD_VALUE_U8 0.0 ident 0 255 /end CHARACTERISTIC
/begin AXIS_PTS distrib.GRP_sint16_sint16.All_Curves_GRP.Curves_Raster_1 "" 0x1D189E M_In.GRP_sint16_sint16.All_Curves_GRP.Curves_Raster_1 STANDARD_DIST_S16 0.0 ident 10 -32768.0 32767.0 /end AXIS_PTS
/begin AXIS_PTS distrib.GRP_sint16_sint16.All_Curves_GRP.Curves_Raster_2 "" 0x1D1C7E M_In.GRP_sint16_sint16.All_Curves_GRP.Curves_Raster_2 STANDARD_DIST_S16 0.0 ident 10 -32768.0 32767.0 /end AXIS_PTS
/begin AXIS_PTS distrib.GRP_sint16_sint16.All_Curves_GRP.Curves_Raster_3 "" 0x1D205E M_In.GRP_sint16_sint16.All_Curves_GRP.Curves_Raster_3 STANDARD_DIST_S16 0.0 ident 10 -32768.0 32767.0 /end AXIS_PTS
/begin AXIS_PTS distrib.GRP_sint32_sint32.All_Curves_GRP.Curves_Raster_1 "" 0x1D18EC M_In.GRP_sint32_sint32.All_Curves_GRP.Curves_Raster_1 STANDARD_DIST_S32 0.0 ident 10 -2147483648.0 2147483647.0 /end AXIS_PTS
/begin AXIS_PTS distrib.GRP_sint32_sint32.All_Curves_GRP.Curves_Raster_2 "" 0x1D1CCC M_In.GRP_sint32_sint32.All_Curves_GRP.Curves_Raster_2 STANDARD_DIST_S32 0.0 ident 10 -2147483648.0 2147483647.0 /end AXIS_PTS
/begin AXIS_PTS distrib.GRP_sint32_sint32.All_Curves_GRP.Curves_Raster_3 "" 0x1D20AC M_In.GRP_sint32_sint32.All_Curves_GRP.Curves_Raster_3 STANDARD_DIST_S32 0.0 ident 10 -2147483648.0 2147483647.0 /end AXIS_PTS
/begin AXIS_PTS distrib.GRP_sint8_sint8.All_Curves_GRP.Curves_Raster_1 "" 0x1D192E M_In.GRP_sint8_sint8.All_Curves_GRP.Curves_Raster_1 STANDARD_DIST_S8 0.0 ident 10 -128.0 127.0 /end AXIS_PTS
/begin AXIS_PTS distrib.GRP_sint8_sint8.All_Curves_GRP.Curves_Raster_2 "" 0x1D1D0E M_In.GRP_sint8_sint8.All_Curves_GRP.Curves_Raster_2 STANDARD_DIST_S8 0.0 ident 10 -128.0 127.0 /end AXIS_PTS
/begin AXIS_PTS distrib.GRP_sint8_sint8.All_Curves_GRP.Curves_Raster_3 "" 0x1D20EE M_In.GRP_sint8_sint8.All_Curves_GRP.Curves_Raster_3 STANDARD_DIST_S8 0.0 ident 10 -128.0 127.0 /end AXIS_PTS
/begin AXIS_PTS distrib.GRP_uint16_uint16.All_Curves_GRP.Curves_Raster_1 "" 0x1D195E M_In.GRP_uint16_uint16.All_Curves_GRP.Curves_Raster_1 STANDARD_DIST_U16 0.0 ident 10 0.0 65535.0 /end AXIS_PTS
/begin AXIS_PTS distrib.GRP_uint16_uint16.All_Curves_GRP.Curves_Raster_2 "" 0x1D1D3E M_In.GRP_uint16_uint16.All_Curves_GRP.Curves_Raster_2 STANDARD_DIST_U16 0.0 ident 10 0.0 65535.0 /end AXIS_PTS
/begin AXIS_PTS distrib.GRP_uint16_uint16.All_Curves_GRP.Curves_Raster_3 "" 0x1D211E M_In.GRP_uint16_uint16.All_Curves_GRP.Curves_Raster_3 STANDARD_DIST_U16 0.0 ident 10 0.0 65535.0 /end AXIS_PTS
/begin AXIS_PTS distrib.GRP_uint32_uint32.All_Curves_GRP.Curves_Raster_1 "" 0x1D19AC M_In.GRP_uint32_uint32.All_Curves_GRP.Curves_Raster_1 STANDARD_DIST_U32 0.0 ident 10 0.0 4294967295.0 /end AXIS_PTS
/begin AXIS_PTS distrib.GRP_uint32_uint32.All_Curves_GRP.Curves_Raster_2 "" 0x1D1D8C M_In.GRP_uint32_uint32.All_Curves_GRP.Curves_Raster_2 STANDARD_DIST_U32 0.0 ident 10 0.0 4294967295.0 /end AXIS_PTS
/begin AXIS_PTS distrib.GRP_uint32_uint32.All_Curves_GRP.Curves_Raster_3 "" 0x1D216C M_In.GRP_uint32_uint32.All_Curves_GRP.Curves_Raster_3 STANDARD_DIST_U32 0.0 ident 10 0.0 4294967295.0 /end AXIS_PTS
/begin AXIS_PTS distrib.GRP_uint8_uint8.All_Curves_GRP.Curves_Raster_1 "" 0x1D19EE M_In.GRP_uint8_uint8.All_Curves_GRP.Curves_Raster_1 STANDARD_DIST_U8 0.0 ident 10 0.0 255.0 /end AXIS_PTS
/begin AXIS_PTS distrib.GRP_uint8_uint8.All_Curves_GRP.Curves_Raster_2 "" 0x1D1DCE M_In.GRP_uint8_uint8.All_Curves_GRP.Curves_Raster_2 STANDARD_DIST_U8 0.0 ident 10 0.0 255.0 /end AXIS_PTS
/begin AXIS_PTS distrib.GRP_uint8_uint8.All_Curves_GRP.Curves_Raster_3 "" 0x1D21AE M_In.GRP_uint8_uint8.All_Curves_GRP.Curves_Raster_3 STANDARD_DIST_U8 0.0 ident 10 0.0 255.0 /end AXIS_PTS
/begin MEASUREMENT ActivePage.SERAM_PageControl.ALL_PROT "" UBYTE enum_CCP_Page_ENUM 1 100 0 2 ECU_ADDRESS 0x7FB3B1 /end MEASUREMENT
/begin MEASUREMENT Calculated.FIX_sint16_sint16.All_Curves_FIX.Curves_Raster_1 "" SBYTE ident 1 100 0 1 BIT_MASK 0x1 ECU_ADDRESS 0x7F8624 /end MEASUREMENT
/begin MEASUREMENT Calculated.FIX_sint16_sint16.All_Curves_FIX.Curves_Raster_2 "" SBYTE ident 1 100 0 1 BIT_MASK 0x1 ECU_ADDRESS 0x7F86B4 /end MEASUREMENT
/begin MEASUREMENT Calculated.FIX_sint16_sint16.All_Curves_FIX.Curves_Raster_3 "" SBYTE ident 1 100 0 1 BIT_MASK 0x1 ECU_ADDRESS 0x7F8744 /end MEASUREMENT
/begin MEASUREMENT Calculated.FIX_sint32_sint32.All_Curves_FIX.Curves_Raster_1 "" SBYTE ident 1 100 0 1 BIT_MASK 0x1 ECU_ADDRESS 0x7F8630 /end MEASUREMENT
/begin MEASUREMENT Calculated.FIX_sint32_sint32.All_Curves_FIX.Curves_Raster_2 "" SBYTE ident 1 100 0 1 BIT_MASK 0x1 ECU_ADDRESS 0x7F86C0 /end MEASUREMENT
/begin MEASUREMENT Calculated.FIX_sint32_sint32.All_Curves_FIX.Curves_Raster_3 "" SBYTE ident 1 100 0 1 BIT_MASK 0x1 ECU_ADDRESS 0x7F8750 /end MEASUREMENT
/begin MEASUREMENT Calculated.FIX_sint8_sint8.All_Curves_FIX.Curves_Raster_1 "" SBYTE ident 1 100 0 1 BIT_MASK 0x1 ECU_ADDRESS 0x7F8634 /end MEASUREMENT
/begin MEASUREMENT Calculated.FIX_sint8_sint8.All_Curves_FIX.Curves_Raster_2 "" SBYTE ident 1 100 0 1 BIT_MASK 0x1 ECU_ADDRESS 0x7F86C4 /end MEASUREMENT
/begin MEASUREMENT Calculated.FIX_sint8_sint8.All_Curves_FIX.Curves_Raster_3 "" SBYTE ident 1 100 0 1 BIT_MASK 0x1 ECU_ADDRESS 0x7F8754 /end MEASUREMENT
/begin MEASUREMENT Calculated.FIX_uint16_uint16.All_Curves_FIX.Curves_Raster_1 "" SBYTE ident 1 100 0 1 BIT_MASK 0x1 ECU_ADDRESS 0x7F863C /end MEASUREMENT
/begin MEASUREMENT Calculated.FIX_uint16_uint16.All_Curves_FIX.Curves_Raster_2 "" SBYTE ident 1 100 0 1 BIT_MASK 0x1 ECU_ADDRESS 0x7F86CC /end MEASUREMENT
/begin MEASUREMENT Calculated.FIX_uint16_uint16.All_Curves_FIX.Curves_Raster_3 "" SBYTE ident 1 100 0 1 BIT_MASK 0x1 ECU_ADDRESS 0x7F875C /end MEASUREMENT
/begin MEASUREMENT Calculated.FIX_uint32_uint32.All_Curves_FIX.Curves_Raster_1 "" SBYTE ident 1 100 0 1 BIT_MASK 0x1 ECU_ADDRESS 0x7F8648 /end MEASUREMENT
/begin MEASUREMENT Calculated.FIX_uint32_uint32.All_Curves_FIX.Curves_Raster_2 "" SBYTE ident 1 100 0 1 BIT_MASK 0x1 ECU_ADDRESS 0x7F86D8 /end MEASUREMENT
/begin MEASUREMENT Calculated.FIX_uint32_uint32.All_Curves_FIX.Curves_Raster_3 "" SBYTE ident 1 100 0 1 BIT_MASK 0x1 ECU_ADDRESS 0x7F8768 /end MEASUREMENT
/begin MEASUREMENT Calculated.FIX_uint8_uint8.All_Curves_FIX.Curves_Raster_1 "" SBYTE ident 1 100 0 1 BIT_MASK 0x1 ECU_ADDRESS 0x7F864C /end MEASUREMENT
/begin MEASUREMENT Calculated.FIX_uint8_uint8.All_Curves_FIX.Curves_Raster_2 "" SBYTE ident 1 100 0 1 BIT_MASK 0x1 ECU_ADDRESS 0x7F86DC /end MEASUREMENT
/begin MEASUREMENT Calculated.FIX_uint8_uint8.All_Curves_FIX.Curves_Raster_3 "" SBYTE ident 1 100 0 1 BIT_MASK 0x1 ECU_ADDRESS 0x7F876C /end MEASUREMENT
/begin MEASUREMENT Calculated.GRP_sint16_sint16.All_Curves_GRP.Curves_Raster_1 "" UBYTE ident 1 100 0 1 BIT_MASK 0x1 ECU_ADDRESS 0x7F8654 /end MEASUREMENT
/begin MEASUREMENT Calculated.GRP_sint16_sint16.All_Curves_GRP.Curves_Raster_2 "" UBYTE ident 1 100 0 1 BIT_MASK 0x1 ECU_ADDRESS 0x7F86E4 /end MEASUREMENT
/begin MEASUREMENT Calculated.GRP_sint16_sint16.All_Curves_GRP.Curves_Raster_3 "" UBYTE ident 1 100 0 1 BIT_MASK 0x1 ECU_ADDRESS 0x7F8774 /end MEASUREMENT
/begin MEASUREMENT Calculated.GRP_sint32_sint32.All_Curves_GRP.Curves_Raster_1 "" SBYTE ident 1 100 0 1 BIT_MASK 0x1 ECU_ADDRESS 0x7F8660 /end MEASUREMENT
/begin MEASUREMENT Calculated.GRP_sint32_sint32.All_Curves_GRP.Curves_Raster_2 "" SBYTE ident 1 100 0 1 BIT_MASK 0x1 ECU_ADDRESS 0x7F86F0 /end MEASUREMENT
/begin MEASUREMENT Calculated.GRP_sint32_sint32.All_Curves_GRP.Curves_Raster_3 "" SBYTE ident 1 100 0 1 BIT_MASK 0x1 ECU_ADDRESS 0x7F8780 /end MEASUREMENT
/begin MEASUREMENT Calculated.GRP_sint8_sint8.All_Curves_GRP.Curves_Raster_1 "" UBYTE ident 1 100 0 1 BIT_MASK 0x1 ECU_ADDRESS 0x7F8664 /end MEASUREMENT
/begin MEASUREMENT Calculated.GRP_sint8_sint8.All_Curves_GRP.Curves_Raster_2 "" UBYTE ident 1 100 0 1 BIT_MASK 0x1 ECU_ADDRESS 0x7F86F4 /end MEASUREMENT
/begin MEASUREMENT Calculated.GRP_sint8_sint8.All_Curves_GRP.Curves_Raster_3 "" UBYTE ident 1 100 0 1 BIT_MASK 0x1 ECU_ADDRESS 0x7F8784 /end MEASUREMENT
/begin MEASUREMENT Calculated.GRP_uint16_uint16.All_Curves_GRP.Curves_Raster_1 "" UBYTE ident 1 100 0 1 BIT_MASK 0x1 ECU_ADDRESS 0x7F866C /end MEASUREMENT
/begin MEASUREMENT Calculated.GRP_uint16_uint16.All_Curves_GRP.Curves_Raster_2 "" UBYTE ident 1 100 0 1 BIT_MASK 0x1 ECU_ADDRESS 0x7F86FC /end MEASUREMENT
/begin MEASUREMENT Calculated.GRP_uint16_uint16.All_Curves_GRP.Curves_Raster_3 "" UBYTE ident 1 100 0 1 BIT_MASK 0x1 ECU_ADDRESS 0x7F878C /end MEASUREMENT
/begin MEASUREMENT Calculated.GRP_uint32_uint32.All_Curves_GRP.Curves_Raster_1 "" SBYTE ident 1 100 0 1 BIT_MASK 0x1 ECU_ADDRESS 0x7F8678 /end MEASUREMENT
/begin MEASUREMENT Calculated.GRP_uint32_uint32.All_Curves_GRP.Curves_Raster_2 "" SBYTE ident 1 100 0 1 BIT_MASK 0x1 ECU_ADDRESS 0x7F8708 /end MEASUREMENT
/begin MEASUREMENT Calculated.GRP_uint32_uint32.All_Curves_GRP.Curves_Raster_3 "" SBYTE ident 1 100 0 1 BIT_MASK 0x1 ECU_ADDRESS 0x7F8798 /end MEASUREMENT
/begin MEASUREMENT Calculated.GRP_uint8_uint8.All_Curves_GRP.Curves_Raster_1 "" UBYTE ident 1 100 0 1 BIT_MASK 0x1 ECU_ADDRESS 0x7F867C /end MEASUREMENT
/begin MEASUREMENT Calculated.GRP_uint8_uint8.All_Curves_GRP.Curves_Raster_2 "" UBYTE ident 1 100 0 1 BIT_MASK 0x1 ECU_ADDRESS 0x7F870C /end MEASUREMENT
/begin MEASUREMENT Calculated.GRP_uint8_uint8.All_Curves_GRP.Curves_Raster_3 "" UBYTE ident 1 100 0 1 BIT_MASK 0x1 ECU_ADDRESS 0x7F879C /end MEASUREMENT
/begin MEASUREMENT Calculated.STD_sint16_sint16.All_Curves_STD.Curves_Raster_1 "" UBYTE ident 1 100 0 1 BIT_MASK 0x1 ECU_ADDRESS 0x7F8684 /end MEASUREMENT
/begin MEASUREMENT Calculated.STD_sint32_sint32.All_Curves_STD.Curves_Raster_1 "" UBYTE ident 1 100 0 1 BIT_MASK 0x1 ECU_ADDRESS 0x7F8690 /end MEASUREMENT
/begin MEASUREMENT Calculated.STD_sint8_sint8.All_Curves_STD.Curves_Raster_1 "" UBYTE ident 1 100 0 1 BIT_MASK 0x1 ECU_ADDRESS 0x7F8694 /end MEASUREMENT
/begin MEASUREMENT Calculated.STD_uint16_uint16.All_Curves_STD.Curves_Raster_1 "" UBYTE ident 1 100 0 1 BIT_MASK 0x1 ECU_ADDRESS 0x7F869C /end MEASUREMENT
/begin MEASUREMENT Calculated.STD_uint32_uint32.All_Curves_STD.Curves_Raster_1 "" UBYTE ident 1 100 0 1 BIT_MASK 0x1 ECU_ADDRESS 0x7F86A8 /end MEASUREMENT
/begin MEASUREMENT Calculated.STD_uint8_uint8.All_Curves_STD.Curves_Raster_1 "" UBYTE ident 1 100 0 1 BIT_MASK 0x1 ECU_ADDRESS 0x7F86AC /end MEASUREMENT
/begin MEASUREMENT Distr_Set.GRP_sint16_sint16.All_Curves_GRP.Curves_Raster_1 "" SBYTE ident 1 100 0 1 BIT_MASK 0x1 ECU_ADDRESS 0x7F8655 /end MEASUREMENT
/begin MEASUREMENT Distr_Set.GRP_sint16_sint16.All_Curves_GRP.Curves_Raster_2 "" SBYTE ident 1 100 0 1 BIT_MASK 0x1 ECU_ADDRESS 0x7F86E5 /end MEASUREMENT
/begin MEASUREMENT Distr_Set.GRP_sint16_sint16.All_Curves_GRP.Curves_Raster_3 "" SBYTE ident 1 100 0 1 BIT_MASK 0x1 ECU_ADDRESS 0x7F8775 /end MEASUREMENT
/begin MEASUREMENT Distr_Set.GRP_sint32_sint32.All_Curves_GRP.Curves_Raster_1 "" SBYTE ident 1 100 0 1 BIT_MASK 0x1 ECU_ADDRESS 0x7F8661 /end MEASUREMENT
/begin MEASUREMENT Distr_Set.GRP_sint32_sint32.All_Curves_GRP.Curves_Raster_2 "" SBYTE ident 1 100 0 1 BIT_MASK 0x1 ECU_ADDRESS 0x7F86F1 /end MEASUREMENT
/begin MEASUREMENT Distr_Set.GRP_sint32_sint32.All_Curves_GRP.Curves_Raster_3 "" SBYTE ident 1 100 0 1 BIT_MASK 0x1 ECU_ADDRESS 0x7F8781 /end MEASUREMENT
/begin MEASUREMENT Distr_Set.GRP_sint8_sint8.All_Curves_GRP.Curves_Raster_1 "" SBYTE ident 1 100 0 1 BIT_MASK 0x1 ECU_ADDRESS 0x7F8665 /end MEASUREMENT
/begin MEASUREMENT Distr_Set.GRP_sint8_sint8.All_Curves_GRP.Curves_Raster_2 "" SBYTE ident 1 100 0 1 BIT_MASK 0x1 ECU_ADDRESS 0x7F86F5 /end MEASUREMENT
/begin MEASUREMENT Distr_Set.GRP_sint8_sint8.All_Curves_GRP.Curves_Raster_3 "" SBYTE ident 1 100 0 1 BIT_MASK 0x1 ECU_ADDRESS 0x7F8785 /end MEASUREMENT
/begin MEASUREMENT Distr_Set.GRP_uint16_uint16.All_Curves_GRP.Curves_Raster_1 "" SBYTE ident 1 100 0 1 BIT_MASK 0x1 ECU_ADDRESS 0x7F866D /end MEASUREMENT
/begin MEASUREMENT Distr_Set.GRP_uint16_uint16.All_Curves_GRP.Curves_Raster_2 "" SBYTE ident 1 100 0 1 BIT_MASK 0x1 ECU_ADDRESS 0x7F86FD /end MEASUREMENT
/begin MEASUREMENT Distr_Set.GRP_uint16_uint16.All_Curves_GRP.Curves_Raster_3 "" SBYTE ident 1 100 0 1 BIT_MASK 0x1 ECU_ADDRESS 0x7F878D /end MEASUREMENT
/begin MEASUREMENT Distr_Set.GRP_uint32_uint32.All_Curves_GRP.Curves_Raster_1 "" SBYTE ident 1 100 0 1 BIT_MASK 0x1 ECU_ADDRESS 0x7F8679 /end MEASUREMENT
/begin MEASUREMENT Distr_Set.GRP_uint32_uint32.All_Curves_GRP.Curves_Raster_2 "" SBYTE ident 1 100 0 1 BIT_MASK 0x1 ECU_ADDRESS 0x7F8709 /end MEASUREMENT
/begin MEASUREMENT Distr_Set.GRP_uint32_uint32.All_Curves_GRP.Curves_Raster_3 "" SBYTE ident 1 100 0 1 BIT_MASK 0x1 ECU_ADDRESS 0x7F8799 /end MEASUREMENT
/begin MEASUREMENT Distr_Set.GRP_uint8_uint8.All_Curves_GRP.Curves_Raster_1 "" SBYTE ident 1 100 0 1 BIT_MASK 0x1 ECU_ADDRESS 0x7F867D /end MEASUREMENT
/begin MEASUREMENT Distr_Set.GRP_uint8_uint8.All_Curves_GRP.Curves_Raster_2 "" SBYTE ident 1 100 0 1 BIT_MASK 0x1 ECU_ADDRESS 0x7F870D /end MEASUREMENT
/begin MEASUREMENT Distr_Set.GRP_uint8_uint8.All_Curves_GRP.Curves_Raster_3 "" SBYTE ident 1 100 0 1 BIT_MASK 0x1 ECU_ADDRESS 0x7F879D /end MEASUREMENT
/begin MEASUREMENT dT_Raster.AT2ms.Restart_Raster_16T "" ULONG TickType2ms 1 100 0.0 1227133.51285714 ECU_ADDRESS 0x7FB7BC /end MEASUREMENT
/begin MEASUREMENT dT_Raster.ATRestartRaster.Restart_Raster_16T "" ULONG TickType2ms 1 100 0.0 1227133.51285714 ECU_ADDRESS 0x7FB7C4 /end MEASUREMENT
/begin MEASUREMENT ebCtrNewT_ASD.AS.BASE "" UBYTE identity 1 100 0 255 ECU_ADDRESS 0x822268 /end MEASUREMENT
/begin MEASUREMENT ebCtrNewY_ASD.AS.BASE "" UBYTE identity 1 100 0 255 ECU_ADDRESS 0x822269 /end MEASUREMENT
/begin MEASUREMENT ebCtrOldT_ASD.AS.BASE "" UBYTE identity 1 100 0 255 ECU_ADDRESS 0x82226A /end MEASUREMENT
/begin MEASUREMENT ebCtrOldY_ASD.AS.BASE "" UBYTE identity 1 100 0 255 ECU_ADDRESS 0x82226B /end MEASUREMENT
/begin MEASUREMENT g_checksum_u32.Checksum.ALL_PROT "" ULONG ident 1 100 0 4294967295 ECU_ADDRESS 0x7FB37C /end MEASUREMENT
/begin MEASUREMENT g_ChecksumByteOrder_u8.Checksum.ALL_PROT "" UBYTE enum_XCP_ByteOrder_e 1 100 0 1 ECU_ADDRESS 0x7FB378 /end MEASUREMENT
/begin MEASUREMENT g_ChecksumType_u8.Checksum.ALL_PROT "" UBYTE enum_XCP_ChecksumType_e 1 100 0 9 ECU_ADDRESS 0x7FB379 /end MEASUREMENT
/begin MEASUREMENT g_chksumlength_u8.Checksum.ALL_PROT "" UBYTE ident 1 100 0 255 ECU_ADDRESS 0x7FB37A /end MEASUREMENT
/begin MEASUREMENT g_FlashFake_u8.FlashFake.ALL_PROT "" UBYTE enum_ALL_FAKE_FLASHING_e 1 100 0 1 ECU_ADDRESS 0x7FB3B0 /end MEASUREMENT
/begin MEASUREMENT g_SlewInputCounter_u8.AllSlewsHelp "" UBYTE ident 1 100 0.0 255.0 ECU_ADDRESS 0x7FB30F /end MEASUREMENT
/begin MEASUREMENT g_SlewOutput_u8.AllSlewsHelp "" UBYTE ident 1 100 0.0 255.0 ECU_ADDRESS 0x7FB310 /end MEASUREMENT
/begin MEASUREMENT l_Output_u8.Slewing1.AllSlews "" UBYTE ident 1 100 0.0 255.0 ECU_ADDRESS 0x7FB30E /end MEASUREMENT
/begin MEASUREMENT M_In.FIX_sint16_sint16.All_Curves_FIX.Curves_Raster_1 "" SWORD ident 1 100 -32768.0 32767.0 ECU_ADDRESS 0x7F8620 /end MEASUREMENT
/begin MEASUREMENT M_In.FIX_sint16_sint16.All_Curves_FIX.Curves_Raster_2 "" SWORD ident 1 100 -32768.0 32767.0 ECU_ADDRESS 0x7F86B0 /end MEASUREMENT
/begin MEASUREMENT M_In.FIX_sint16_sint16.All_Curves_FIX.Curves_Raster_3 "" SWORD ident 1 100 -32768.0 32767.0 ECU_ADDRESS 0x7F8740 /end MEASUREMENT
/begin MEASUREMENT M_In.FIX_sint32_sint32.All_Curves_FIX.Curves_Raster_1 "" SLONG ident 1 100 -2147483648.0 2147483647.0 ECU_ADDRESS 0x7F8628 /end MEASUREMENT
/begin MEASUREMENT M_In.FIX_sint32_sint32.All_Curves_FIX.Curves_Raster_2 "" SLONG ident 1 100 -2147483648.0 2147483647.0 ECU_ADDRESS 0x7F86B8 /end MEASUREMENT
/begin MEASUREMENT M_In.FIX_sint32_sint32.All_Curves_FIX.Curves_Raster_3 "" SLONG ident 1 100 -2147483648.0 2147483647.0 ECU_ADDRESS 0x7F8748 /end MEASUREMENT
/begin MEASUREMENT M_In.FIX_sint8_sint8.All_Curves_FIX.Curves_Raster_1 "" SBYTE ident 1 100 -128.0 127.0 ECU_ADDRESS 0x7F8635 /end MEASUREMENT
/begin MEASUREMENT M_In.FIX_sint8_sint8.All_Curves_FIX.Curves_Raster_2 "" SBYTE ident 1 100 -128.0 127.0 ECU_ADDRESS 0x7F86C5 /end MEASUREMENT
/begin MEASUREMENT M_In.FIX_sint8_sint8.All_Curves_FIX.Curves_Raster_3 "" SBYTE ident 1 100 -128.0 127.0 ECU_ADDRESS 0x7F8755 /end MEASUREMENT
/begin MEASUREMENT M_In.FIX_uint16_uint16.All_Curves_FIX.Curves_Raster_1 "" UWORD ident 1 100 0.0 65535.0 ECU_ADDRESS 0x7F8638 /end MEASUREMENT
/begin MEASUREMENT M_In.FIX_uint16_uint16.All_Curves_FIX.Curves_Raster_2 "" UWORD ident 1 100 0.0 65535.0 ECU_ADDRESS 0x7F86C8 /end MEASUREMENT
/begin MEASUREMENT M_In.FIX_uint16_uint16.All_Curves_FIX.Curves_Raster_3 "" UWORD ident 1 100 0.0 65535.0 ECU_ADDRESS 0x7F8758 /end MEASUREMENT
/begin MEASUREMENT M_In.FIX_uint32_uint32.All_Curves_FIX.Curves_Raster_1 "" ULONG ident 1 100 0.0 4294967295.0 ECU_ADDRESS 0x7F8640 /end MEASUREMENT
/begin MEASUREMENT M_In.FIX_uint32_uint32.All_Curves_FIX.Curves_Raster_2 "" ULONG ident 1 100 0.0 4294967295.0 ECU_ADDRESS 0x7F86D0 /end MEASUREMENT
/begin MEASUREMENT M_In.FIX_uint32_uint32.All_Curves_FIX.Curves_Raster_3 "" ULONG ident 1 100 0.0 4294967295.0 ECU_ADDRESS 0x7F8760 /end MEASUREMENT
/begin MEASUREMENT M_In.FIX_uint8_uint8.All_Curves_FIX.Curves_Raster_1 "" UBYTE ident 1 100 0.0 255.0 ECU_ADDRESS 0x7F864D /end MEASUREMENT
/begin MEASUREMENT M_In.FIX_uint8_uint8.All_Curves_FIX.Curves_Raster_2 "" UBYTE ident 1 100 0.0 255.0 ECU_ADDRESS 0x7F86DD /end MEASUREMENT
/begin MEASUREMENT M_In.FIX_uint8_uint8.All_Curves_FIX.Curves_Raster_3 "" UBYTE ident 1 100 0.0 255.0 ECU_ADDRESS 0x7F876D /end MEASUREMENT
/begin MEASUREMENT M_In.GRP_sint16_sint16.All_Curves_GRP.Curves_Raster_1 "" SWORD ident 1 100 -32768.0 32767.0 ECU_ADDRESS 0x7F8650 /end MEASUREMENT
/begin MEASUREMENT M_In.GRP_sint16_sint16.All_Curves_GRP.Curves_Raster_2 "" SWORD ident 1 100 -32768.0 32767.0 ECU_ADDRESS 0x7F86E0 /end MEASUREMENT
/begin MEASUREMENT M_In.GRP_sint16_sint16.All_Curves_GRP.Curves_Raster_3 "" SWORD ident 1 100 -32768.0 32767.0 ECU_ADDRESS 0x7F8770 /end MEASUREMENT
/begin MEASUREMENT M_In.GRP_sint32_sint32.All_Curves_GRP.Curves_Raster_1 "" SLONG ident 1 100 -2147483648.0 2147483647.0 ECU_ADDRESS 0x7F8658 /end MEASUREMENT
/begin MEASUREMENT M_In.GRP_sint32_sint32.All_Curves_GRP.Curves_Raster_2 "" SLONG ident 1 100 -2147483648.0 2147483647.0 ECU_ADDRESS 0x7F86E8 /end MEASUREMENT
/begin MEASUREMENT M_In.GRP_sint32_sint32.All_Curves_GRP.Curves_Raster_3 "" SLONG ident 1 100 -2147483648.0 2147483647.0 ECU_ADDRESS 0x7F8778 /end MEASUREMENT
/begin MEASUREMENT M_In.GRP_sint8_sint8.All_Curves_GRP.Curves_Raster_1 "" SBYTE ident 1 100 -128.0 127.0 ECU_ADDRESS 0x7F8666 /end MEASUREMENT
/begin MEASUREMENT M_In.GRP_sint8_sint8.All_Curves_GRP.Curves_Raster_2 "" SBYTE ident 1 100 -128.0 127.0 ECU_ADDRESS 0x7F86F6 /end MEASUREMENT
/begin MEASUREMENT M_In.GRP_sint8_sint8.All_Curves_GRP.Curves_Raster_3 "" SBYTE ident 1 100 -128.0 127.0 ECU_ADDRESS 0x7F8786 /end MEASUREMENT
/begin MEASUREMENT M_In.GRP_uint16_uint16.All_Curves_GRP.Curves_Raster_1 "" UWORD ident 1 100 0.0 65535.0 ECU_ADDRESS 0x7F8668 /end MEASUREMENT
/begin MEASUREMENT M_In.GRP_uint16_uint16.All_Curves_GRP.Curves_Raster_2 "" UWORD ident 1 100 0.0 65535.0 ECU_ADDRESS 0x7F86F8 /end MEASUREMENT
/begin MEASUREMENT M_In.GRP_uint16_uint16.All_Curves_GRP.Curves_Raster_3 "" UWORD ident 1 100 0.0 65535.0 ECU_ADDRESS 0x7F8788 /end MEASUREMENT
/begin MEASUREMENT M_In.GRP_uint32_uint32.All_Curves_GRP.Curves_Raster_1 "" ULONG ident 1 100 0.0 4294967295.0 ECU_ADDRESS 0x7F8670 /end MEASUREMENT
/begin MEASUREMENT M_In.GRP_uint32_uint32.All_Curves_GRP.Curves_Raster_2 "" ULONG ident 1 100 0.0 4294967295.0 ECU_ADDRESS 0x7F8700 /end MEASUREMENT
/begin MEASUREMENT M_In.GRP_uint32_uint32.All_Curves_GRP.Curves_Raster_3 "" ULONG ident 1 100 0.0 4294967295.0 ECU_ADDRESS 0x7F8790 /end MEASUREMENT
/begin MEASUREMENT M_In.GRP_uint8_uint8.All_Curves_GRP.Curves_Raster_1 "" UBYTE ident 1 100 0.0 255.0 ECU_ADDRESS 0x7F867E /end MEASUREMENT
/begin MEASUREMENT M_In.GRP_uint8_uint8.All_Curves_GRP.Curves_Raster_2 "" UBYTE ident 1 100 0.0 255.0 ECU_ADDRESS 0x7F870E /end MEASUREMENT
/begin MEASUREMENT M_In.GRP_uint8_uint8.All_Curves_GRP.Curves_Raster_3 "" UBYTE ident 1 100 0.0 255.0 ECU_ADDRESS 0x7F879E /end MEASUREMENT
/begin MEASUREMENT M_In.STD_sint16_sint16.All_Curves_STD.Curves_Raster_1 "" SWORD ident 1 100 -32768.0 32767.0 ECU_ADDRESS 0x7F8680 /end MEASUREMENT
/begin MEASUREMENT M_In.STD_sint32_sint32.All_Curves_STD.Curves_Raster_1 "" SLONG ident 1 100 -2147483648.0 2147483647.0 ECU_ADDRESS 0x7F8688 /end MEASUREMENT
/begin MEASUREMENT M_In.STD_sint8_sint8.All_Curves_STD.Curves_Raster_1 "" SBYTE ident 1 100 -128.0 127.0 ECU_ADDRESS 0x7F8695 /end MEASUREMENT
/begin MEASUREMENT M_In.STD_uint16_uint16.All_Curves_STD.Curves_Raster_1 "" UWORD ident 1 100 0.0 65535.0 ECU_ADDRESS 0x7F8698 /end MEASUREMENT
/begin MEASUREMENT M_In.STD_uint32_uint32.All_Curves_STD.Curves_Raster_1 "" ULONG ident 1 100 0.0 4294967295.0 ECU_ADDRESS 0x7F86A0 /end MEASUREMENT
/begin MEASUREMENT M_In.STD_uint8_uint8.All_Curves_STD.Curves_Raster_1 "" UBYTE ident 1 100 0.0 255.0 ECU_ADDRESS 0x7F86AD /end MEASUREMENT
/begin MEASUREMENT M_out.FIX_sint16_sint16.All_Curves_FIX.Curves_Raster_1 "" SWORD ident 1 100 -32768.0 32767.0 ECU_ADDRESS 0x7F8622 /end MEASUREMENT
/begin MEASUREMENT M_out.FIX_sint16_sint16.All_Curves_FIX.Curves_Raster_2 "" SWORD ident 1 100 -32768.0 32767.0 ECU_ADDRESS 0x7F86B2 /end MEASUREMENT
/begin MEASUREMENT M_out.FIX_sint16_sint16.All_Curves_FIX.Curves_Raster_3 "" SWORD ident 1 100 -32768.0 32767.0 ECU_ADDRESS 0x7F8742 /end MEASUREMENT
/begin MEASUREMENT M_out.FIX_sint32_sint32.All_Curves_FIX.Curves_Raster_1 "" SLONG ident 1 100 -2147483648.0 2147483647.0 ECU_ADDRESS 0x7F862C /end MEASUREMENT
/begin MEASUREMENT M_out.FIX_sint32_sint32.All_Curves_FIX.Curves_Raster_2 "" SLONG ident 1 100 -2147483648.0 2147483647.0 ECU_ADDRESS 0x7F86BC /end MEASUREMENT
/begin MEASUREMENT M_out.FIX_sint32_sint32.All_Curves_FIX.Curves_Raster_3 "" SLONG ident 1 100 -2147483648.0 2147483647.0 ECU_ADDRESS 0x7F874C /end MEASUREMENT
/begin MEASUREMENT M_out.FIX_sint8_sint8.All_Curves_FIX.Curves_Raster_1 "" SBYTE ident 1 100 -128.0 127.0 ECU_ADDRESS 0x7F8636 /end MEASUREMENT
/begin MEASUREMENT M_out.FIX_sint8_sint8.All_Curves_FIX.Curves_Raster_2 "" SBYTE ident 1 100 -128.0 127.0 ECU_ADDRESS 0x7F86C6 /end MEASUREMENT
/begin MEASUREMENT M_out.FIX_sint8_sint8.All_Curves_FIX.Curves_Raster_3 "" SBYTE ident 1 100 -128.0 127.0 ECU_ADDRESS 0x7F8756 /end MEASUREMENT
/begin MEASUREMENT M_out.FIX_uint16_uint16.All_Curves_FIX.Curves_Raster_1 "" UWORD ident 1 100 0.0 65535.0 ECU_ADDRESS 0x7F863A /end MEASUREMENT
/begin MEASUREMENT M_out.FIX_uint16_uint16.All_Curves_FIX.Curves_Raster_2 "" UWORD ident 1 100 0.0 65535.0 ECU_ADDRESS 0x7F86CA /end MEASUREMENT
/begin MEASUREMENT M_out.FIX_uint16_uint16.All_Curves_FIX.Curves_Raster_3 "" UWORD ident 1 100 0.0 65535.0 ECU_ADDRESS 0x7F875A /end MEASUREMENT
/begin MEASUREMENT M_out.FIX_uint32_uint32.All_Curves_FIX.Curves_Raster_1 "" ULONG ident 1 100 0.0 4294967295.0 ECU_ADDRESS 0x7F8644 /end MEASUREMENT
/begin MEASUREMENT M_out.FIX_uint32_uint32.All_Curves_FIX.Curves_Raster_2 "" ULONG ident 1 100 0.0 4294967295.0 ECU_ADDRESS 0x7F86D4 /end MEASUREMENT
/begin MEASUREMENT M_out.FIX_uint32_uint32.All_Curves_FIX.Curves_Raster_3 "" ULONG ident 1 100 0.0 4294967295.0 ECU_ADDRESS 0x7F8764 /end MEASUREMENT
/begin MEASUREMENT M_out.FIX_uint8_uint8.All_Curves_FIX.Curves_Raster_1 "" UBYTE ident 1 100 0.0 255.0 ECU_ADDRESS 0x7F864E /end MEASUREMENT
/begin MEASUREMENT M_out.FIX_uint8_uint8.All_Curves_FIX.Curves_Raster_2 "" UBYTE ident 1 100 0.0 255.0 ECU_ADDRESS 0x7F86DE /end MEASUREMENT
/begin MEASUREMENT M_out.FIX_uint8_uint8.All_Curves_FIX.Curves_Raster_3 "" UBYTE ident 1 100 0.0 255.0 ECU_ADDRESS 0x7F876E /end MEASUREMENT
/begin MEASUREMENT M_out.GRP_sint16_sint16.All_Curves_GRP.Curves_Raster_1 "" SWORD ident 1 100 -32768.0 32767.0 ECU_ADDRESS 0x7F8652 /end MEASUREMENT
/begin MEASUREMENT M_out.GRP_sint16_sint16.All_Curves_GRP.Curves_Raster_2 "" SWORD ident 1 100 -32768.0 32767.0 ECU_ADDRESS 0x7F86E2 /end MEASUREMENT
/begin MEASUREMENT M_out.GRP_sint16_sint16.All_Curves_GRP.Curves_Raster_3 "" SWORD ident 1 100 -32768.0 32767.0 ECU_ADDRESS 0x7F8772 /end MEASUREMENT
/begin MEASUREMENT M_out.GRP_sint32_sint32.All_Curves_GRP.Curves_Raster_1 "" SLONG ident 1 100 -2147483648.0 2147483647.0 ECU_ADDRESS 0x7F865C /end MEASUREMENT
/begin MEASUREMENT M_out.GRP_sint32_sint32.All_Curves_GRP.Curves_Raster_2 "" SLONG ident 1 100 -2147483648.0 2147483647.0 ECU_ADDRESS 0x7F86EC /end MEASUREMENT
/begin MEASUREMENT M_out.GRP_sint32_sint32.All_Curves_GRP.Curves_Raster_3 "" SLONG ident 1 100 -2147483648.0 2147483647.0 ECU_ADDRESS 0x7F877C /end MEASUREMENT
/begin MEASUREMENT M_out.GRP_sint8_sint8.All_Curves_GRP.Curves_Raster_1 "" SBYTE ident 1 100 -128.0 127.0 ECU_ADDRESS 0x7F8667 /end MEASUREMENT
/begin MEASUREMENT M_out.GRP_sint8_sint8.All_Curves_GRP.Curves_Raster_2 "" SBYTE ident 1 100 -128.0 127.0 ECU_ADDRESS 0x7F86F7 /end MEASUREMENT
/begin MEASUREMENT M_out.GRP_sint8_sint8.All_Curves_GRP.Curves_Raster_3 "" SBYTE ident 1 100 -128.0 127.0 ECU_ADDRESS 0x7F8787 /end MEASUREMENT
/begin MEASUREMENT M_out.GRP_uint16_uint16.All_Curves_GRP.Curves_Raster_1 "" UWORD ident 1 100 0.0 65535.0 ECU_ADDRESS 0x7F866A /end MEASUREMENT
/begin MEASUREMENT M_out.GRP_uint16_uint16.All_Curves_GRP.Curves_Raster_2 "" UWORD ident 1 100 0.0 65535.0 ECU_ADDRESS 0x7F86FA /end MEASUREMENT
/begin MEASUREMENT M_out.GRP_uint16_uint16.All_Curves_GRP.Curves_Raster_3 "" UWORD ident 1 100 0.0 65535.0 ECU_ADDRESS 0x7F878A /end MEASUREMENT
/begin MEASUREMENT M_out.GRP_uint32_uint32.All_Curves_GRP.Curves_Raster_1 "" ULONG ident 1 100 0.0 4294967295.0 ECU_ADDRESS 0x7F8674 /end MEASUREMENT
/begin MEASUREMENT M_out.GRP_uint32_uint32.All_Curves_GRP.Curves_Raster_2 "" ULONG ident 1 100 0.0 4294967295.0 ECU_ADDRESS 0x7F8704 /end MEASUREMENT
/begin MEASUREMENT M_out.GRP_uint32_uint32.All_Curves_GRP.Curves_Raster_3 "" ULONG ident 1 100 0.0 4294967295.0 ECU_ADDRESS 0x7F8794 /end MEASUREMENT
/begin MEASUREMENT M_out.GRP_uint8_uint8.All_Curves_GRP.Curves_Raster_1 "" UBYTE ident 1 100 0.0 255.0 ECU_ADDRESS 0x7F867F /end MEASUREMENT
/begin MEASUREMENT M_out.GRP_uint8_uint8.All_Curves_GRP.Curves_Raster_2 "" UBYTE ident 1 100 0.0 255.0 ECU_ADDRESS 0x7F870F /end MEASUREMENT
/begin MEASUREMENT M_out.GRP_uint8_uint8.All_Curves_GRP.Curves_Raster_3 "" UBYTE ident 1 100 0.0 255.0 ECU_ADDRESS 0x7F879F /end MEASUREMENT
/begin MEASUREMENT M_out.STD_sint16_sint16.All_Curves_STD.Curves_Raster_1 "" SWORD ident 1 100 -32768.0 32767.0 ECU_ADDRESS 0x7F8682 /end MEASUREMENT
/begin MEASUREMENT M_out.STD_sint32_sint32.All_Curves_STD.Curves_Raster_1 "" SLONG ident 1 100 -2147483648.0 2147483647.0 ECU_ADDRESS 0x7F868C /end MEASUREMENT
/begin MEASUREMENT M_out.STD_sint8_sint8.All_Curves_STD.Curves_Raster_1 "" SBYTE ident 1 100 -128.0 127.0 ECU_ADDRESS 0x7F8696 /end MEASUREMENT
/begin MEASUREMENT M_out.STD_uint16_uint16.All_Curves_STD.Curves_Raster_1 "" UWORD ident 1 100 0.0 65535.0 ECU_ADDRESS 0x7F869A /end MEASUREMENT
/begin MEASUREMENT M_out.STD_uint32_uint32.All_Curves_STD.Curves_Raster_1 "" ULONG ident 1 100 0.0 4294967295.0 ECU_ADDRESS 0x7F86A4 /end MEASUREMENT
/begin MEASUREMENT M_out.STD_uint8_uint8.All_Curves_STD.Curves_Raster_1 "" UBYTE ident 1 100 0.0 255.0 ECU_ADDRESS 0x7F86AE /end MEASUREMENT
/begin MEASUREMENT mem_alarm_cycle.AT2ms.Restart_Raster_16T "" ULONG TickType2ms 1 100 0.0 46875.0 ECU_ADDRESS 0x7FB7C0 /end MEASUREMENT
/begin MEASUREMENT mem_alarm_cycle.ATRestartRaster.Restart_Raster_16T "" ULONG TickType2ms 1 100 0.0 46875.0 ECU_ADDRESS 0x7FB7C8 /end MEASUREMENT
/begin MEASUREMENT r100msTaskCtr.AS.BASE "" ULONG identity 1 100 0 2147483647 ECU_ADDRESS 0x7FB304 /end MEASUREMENT
/begin MEASUREMENT v_M9USystemTimeBg_ms.ALL_PROT "" ULONG Tick286ns2ms 1 100 0.0 1228360.64637 ECU_ADDRESS 0x7FB300 /end MEASUREMENT
/begin COMPU_METHOD enum_ALL_FAKE_FLASHING_e "" TAB_VERB "%8.4" "" COEFFS 0 1 0 0 0 1 COMPU_TAB_REF enum_ALL_FAKE_FLASHING_e_tab_ref /end COMPU_METHOD
/begin COMPU_METHOD enum_CCP_Page_ENUM "" TAB_VERB "%8.4" "" COEFFS 0 1 0 0 0 1 COMPU_TAB_REF enum_CCP_Page_ENUM_tab_ref /end COMPU_METHOD
/begin COMPU_METHOD enum_SLEWING_MODE_E "" TAB_VERB "%8.4" "" COEFFS 0 1 0 0 0 1 COMPU_TAB_REF enum_SLEWING_MODE_E_tab_ref /end COMPU_METHOD
/begin COMPU_METHOD enum_XCP_ByteOrder_e "" TAB_VERB "%8.4" "" COEFFS 0 1 0 0 0 1 COMPU_TAB_REF enum_XCP_ByteOrder_e_tab_ref /end COMPU_METHOD
/begin COMPU_METHOD enum_XCP_ChecksumType_e "" TAB_VERB "%8.4" "" COEFFS 0 1 0 0 0 1 COMPU_TAB_REF enum_XCP_ChecksumType_e_tab_ref /end COMPU_METHOD
/begin COMPU_METHOD ident "" RAT_FUNC "%12.4" "" COEFFS 0 1 0 0 0 1 /end COMPU_METHOD
/begin COMPU_METHOD identity "" RAT_FUNC "%12.4" "" COEFFS 0 1 0 0 0 1 /end COMPU_METHOD
/begin COMPU_METHOD Tick286ns2ms "" RAT_FUNC "%12.4" "ms" COEFFS 0 3496.503496503497 0 0 0 1 /end COMPU_METHOD
/begin COMPU_METHOD TickType2ms "" RAT_FUNC "%12.4" "ms" COEFFS 0 3500.0 0 0 0 1 /end COMPU_METHOD
/begin COMPU_VTAB enum_ALL_FAKE_FLASHING_e_tab_ref "" TAB_VERB 2 0 "NO_FAKE_FLASHING_0" 1 "ALL_FAKE_FLASHING_1" DEFAULT_VALUE "Error" /end COMPU_VTAB
/begin COMPU_VTAB enum_CCP_Page_ENUM_tab_ref "" TAB_VERB 3 0 "FLASH" 1 "RAM" 2 "ETK" DEFAULT_VALUE "Error" /end COMPU_VTAB
/begin COMPU_VTAB enum_SLEWING_MODE_E_tab_ref "" TAB_VERB 3 0 "SLEWING_OFF_0" 1 "SLEWING_ABSOLUTE_1" 2 "SLEWING_MODIFY_2" DEFAULT_VALUE "Error" /end COMPU_VTAB
/begin COMPU_VTAB enum_XCP_ByteOrder_e_tab_ref "" TAB_VERB 2 0 "INTEL_MSB_LAST_0" 1 "MOTOROLA_MSB_FIRST_1" DEFAULT_VALUE "Error" /end COMPU_VTAB
/begin COMPU_VTAB enum_XCP_ChecksumType_e_tab_ref "" TAB_VERB 10 0 "NOT_USED_0" 1 "XCP_ADD_11_1" 2 "XCP_ADD_12_2" 3 "XCP_ADD_14_3" 4 "XCP_ADD_22_4" 5 "XCP_ADD_24_5" 6 "XCP_ADD_44_6" 7 "XCP_CRC_16_7" 8 "XCP_CRC_16_CITT_8" 9 "XCP_CRC_32_9" DEFAULT_VALUE "Error" /end COMPU_VTAB
/begin GROUP ALL_PROT "" ROOT
 /begin REF_MEASUREMENT ActivePage.SERAM_PageControl.ALL_PROT g_ChecksumByteOrder_u8.Checksum.ALL_PROT g_ChecksumType_u8.Checksum.ALL_PROT g_FlashFake_u8.FlashFake.ALL_PROT g_checksum_u32.Checksum.ALL_PROT g_chksumlength_u8.Checksum.ALL_PROT v_M9USystemTimeBg_ms.ALL_PROT /end REF_MEASUREMENT
 /begin REF_CHARACTERISTIC P_PageSwitch.SERAM_PageControl.ALL_PROT p_ChecksumByteOrder_u8.Checksum.ALL_PROT p_ChecksumType_u8.Checksum.ALL_PROT p_FlashFake_u8.FlashFake.ALL_PROT p_HWE_IS01_fake_u8.ALL_PROT p_SeramCheckParamRange_u8.SERAM_PageControl.ALL_PROT /end REF_CHARACTERISTIC
 /begin SUB_GROUP Checksum.ALL_PROT FlashFake.ALL_PROT SERAM_PageControl.ALL_PROT /end SUB_GROUP
/end GROUP
/begin GROUP AS.BASE ""
 /begin REF_MEASUREMENT ebCtrNewT_ASD.AS.BASE ebCtrNewY_ASD.AS.BASE ebCtrOldT_ASD.AS.BASE ebCtrOldY_ASD.AS.BASE r100msTaskCtr.AS.BASE /end REF_MEASUREMENT
 /begin REF_CHARACTERISTIC EBEN_ASD.AS.BASE /end REF_CHARACTERISTIC
/end GROUP
/begin GROUP AT2ms.Restart_Raster_16T ""
 /begin REF_MEASUREMENT dT_Raster.AT2ms.Restart_Raster_16T mem_alarm_cycle.AT2ms.Restart_Raster_16T /end REF_MEASUREMENT
 /begin REF_CHARACTERISTIC Alarm_ID.AT2ms.Restart_Raster_16T P_alarm_cycle.AT2ms.Restart_Raster_16T P_alarm_cycle_delay.AT2ms.Restart_Raster_16T /end REF_CHARACTERISTIC
/end GROUP
/begin GROUP ATRestartRaster.Restart_Raster_16T ""
 /begin REF_MEASUREMENT dT_Raster.ATRestartRaster.Restart_Raster_16T mem_alarm_cycle.ATRestartRaster.Restart_Raster_16T /end REF_MEASUREMENT
 /begin REF_CHARACTERISTIC Alarm_ID.ATRestartRaster.Restart_Raster_16T P_alarm_cycle.ATRestartRaster.Restart_Raster_16T P_alarm_cycle_delay.ATRestartRaster.Restart_Raster_16T /end REF_CHARACTERISTIC
/end GROUP
/begin GROUP AllSlews "" ROOT /begin REF_MEASUREMENT l_Output_u8.Slewing1.AllSlews /end REF_MEASUREMENT
 /begin REF_CHARACTERISTIC p_1SlewingMode_e.Slewing1.AllSlews p_2SlewingAbsolute_u8.Slewing1.AllSlews p_3SlewingModify_u8.Slewing1.AllSlews /end REF_CHARACTERISTIC
 /begin SUB_GROUP Slewing1.AllSlews /end SUB_GROUP
/end GROUP
/begin GROUP AllSlewsHelp "" ROOT
 /begin REF_MEASUREMENT g_SlewInputCounter_u8.AllSlewsHelp g_SlewOutput_u8.AllSlewsHelp /end REF_MEASUREMENT
/end GROUP
/begin GROUP All_Curves_FIX.Curves_Raster_1 ""
 /begin REF_MEASUREMENT Calculated.FIX_sint16_sint16.All_Curves_FIX.Curves_Raster_1 Calculated.FIX_sint32_sint32.All_Curves_FIX.Curves_Raster_1 Calculated.FIX_sint8_sint8.All_Curves_FIX.Curves_Raster_1 Calculated.FIX_uint16_uint16.All_Curves_FIX.Curves_Raster_1 Calculated.FIX_uint32_uint32.All_Curves_FIX.Curves_Raster_1 Calculated.FIX_uint8_uint8.All_Curves_FIX.Curves_Raster_1 M_In.FIX_sint16_sint16.All_Curves_FIX.Curves_Raster_1 M_In.FIX_sint32_sint32.All_Curves_FIX.Curves_Raster_1 M_In.FIX_sint8_sint8.All_Curves_FIX.Curves_Raster_1 M_In.FIX_uint16_uint16.All_Curves_FIX.Curves_Raster_1 M_In.FIX_uint32_uint32.All_Curves_FIX.Curves_Raster_1 M_In.FIX_uint8_uint8.All_Curves_FIX.Curves_Raster_1 M_out.FIX_sint16_sint16.All_Curves_FIX.Curves_Raster_1 M_out.FIX_sint32_sint32.All_Curves_FIX.Curves_Raster_1 M_out.FIX_sint8_sint8.All_Curves_FIX.Curves_Raster_1 M_out.FIX_uint16_uint16.All_Curves_FIX.Curves_Raster_1 M_out.FIX_uint32_uint32.All_Curves_FIX.Curves_Raster_1 M_out.FIX_uint8_uint8.All_Curves_FIX.Curves_Raster_1 /end REF_MEASUREMENT
 /begin REF_CHARACTERISTIC One_D_Fix.FIX_sint16_sint16.All_Curves_FIX.Curves_Raster_1 One_D_Fix.FIX_sint32_sint32.All_Curves_FIX.Curves_Raster_1 One_D_Fix.FIX_sint8_sint8.All_Curves_FIX.Curves_Raster_1 One_D_Fix.FIX_uint16_uint16.All_Curves_FIX.Curves_Raster_1 One_D_Fix.FIX_uint32_uint32.All_Curves_FIX.Curves_Raster_1 One_D_Fix.FIX_uint8_uint8.All_Curves_FIX.Curves_Raster_1 P_Do_Active_Fix.FIX_sint16_sint16.All_Curves_FIX.Curves_Raster_1 P_Do_Active_Fix.FIX_sint32_sint32.All_Curves_FIX.Curves_Raster_1 P_Do_Active_Fix.FIX_sint8_sint8.All_Curves_FIX.Curves_Raster_1 P_Do_Active_Fix.FIX_uint16_uint16.All_Curves_FIX.Curves_Raster_1 P_Do_Active_Fix.FIX_uint32_uint32.All_Curves_FIX.Curves_Raster_1 P_Do_Active_Fix.FIX_uint8_uint8.All_Curves_FIX.Curves_Raster_1 P_Do_All_FIX_Curves.All_Curves_FIX.Curves_Raster_1 P_In.FIX_sint16_sint16.All_Curves_FIX.Curves_Raster_1 P_In.FIX_sint32_sint32.All_Curves_FIX.Curves_Raster_1 P_In.FIX_sint8_sint8.All_Curves_FIX.Curves_Raster_1 P_In.FIX_uint16_uint16.All_Curves_FIX.Curves_Raster_1 P_In.FIX_uint32_uint32.All_Curves_FIX.Curves_Raster_1 P_In.FIX_uint8_uint8.All_Curves_FIX.Curves_Raster_1 /end REF_CHARACTERISTIC
 /begin SUB_GROUP FIX_sint16_sint16.All_Curves_FIX.Curves_Raster_1 FIX_sint32_sint32.All_Curves_FIX.Curves_Raster_1 FIX_sint8_sint8.All_Curves_FIX.Curves_Raster_1 FIX_uint16_uint16.All_Curves_FIX.Curves_Raster_1 FIX_uint32_uint32.All_Curves_FIX.Curves_Raster_1 FIX_uint8_uint8.All_Curves_FIX.Curves_Raster_1 /end SUB_GROUP
/end GROUP
/begin GROUP All_Curves_FIX.Curves_Raster_2 ""
 /begin REF_MEASUREMENT Calculated.FIX_sint16_sint16.All_Curves_FIX.Curves_Raster_2 Calculated.FIX_sint32_sint32.All_Curves_FIX.Curves_Raster_2 Calculated.FIX_sint8_sint8.All_Curves_FIX.Curves_Raster_2 Calculated.FIX_uint16_uint16.All_Curves_FIX.Curves_Raster_2 Calculated.FIX_uint32_uint32.All_Curves_FIX.Curves_Raster_2 Calculated.FIX_uint8_uint8.All_Curves_FIX.Curves_Raster_2 M_In.FIX_sint16_sint16.All_Curves_FIX.Curves_Raster_2 M_In.FIX_sint32_sint32.All_Curves_FIX.Curves_Raster_2 M_In.FIX_sint8_sint8.All_Curves_FIX.Curves_Raster_2 M_In.FIX_uint16_uint16.All_Curves_FIX.Curves_Raster_2 M_In.FIX_uint32_uint32.All_Curves_FIX.Curves_Raster_2 M_In.FIX_uint8_uint8.All_Curves_FIX.Curves_Raster_2 M_out.FIX_sint16_sint16.All_Curves_FIX.Curves_Raster_2 M_out.FIX_sint32_sint32.All_Curves_FIX.Curves_Raster_2 M_out.FIX_sint8_sint8.All_Curves_FIX.Curves_Raster_2 M_out.FIX_uint16_uint16.All_Curves_FIX.Curves_Raster_2 M_out.FIX_uint32_uint32.All_Curves_FIX.Curves_Raster_2 M_out.FIX_uint8_uint8.All_Curves_FIX.Curves_Raster_2 /end REF_MEASUREMENT
 /begin REF_CHARACTERISTIC One_D_Fix.FIX_sint16_sint16.All_Curves_FIX.Curves_Raster_2 One_D_Fix.FIX_sint32_sint32.All_Curves_FIX.Curves_Raster_2 One_D_Fix.FIX_sint8_sint8.All_Curves_FIX.Curves_Raster_2 One_D_Fix.FIX_uint16_uint16.All_Curves_FIX.Curves_Raster_2 One_D_Fix.FIX_uint32_uint32.All_Curves_FIX.Curves_Raster_2 One_D_Fix.FIX_uint8_uint8.All_Curves_FIX.Curves_Raster_2 P_Do_Active_Fix.FIX_sint16_sint16.All_Curves_FIX.Curves_Raster_2 P_Do_Active_Fix.FIX_sint32_sint32.All_Curves_FIX.Curves_Raster_2 P_Do_Active_Fix.FIX_sint8_sint8.All_Curves_FIX.Curves_Raster_2 P_Do_Active_Fix.FIX_uint16_uint16.All_Curves_FIX.Curves_Raster_2 P_Do_Active_Fix.FIX_uint32_uint32.All_Curves_FIX.Curves_Raster_2 P_Do_Active_Fix.FIX_uint8_uint8.All_Curves_FIX.Curves_Raster_2 P_Do_All_FIX_Curves.All_Curves_FIX.Curves_Raster_2 P_In.FIX_sint16_sint16.All_Curves_FIX.Curves_Raster_2 P_In.FIX_sint32_sint32.All_Curves_FIX.Curves_Raster_2 P_In.FIX_sint8_sint8.All_Curves_FIX.Curves_Raster_2 P_In.FIX_uint16_uint16.All_Curves_FIX.Curves_Raster_2 P_In.FIX_uint32_uint32.All_Curves_FIX.Curves_Raster_2 P_In.FIX_uint8_uint8.All_Curves_FIX.Curves_Raster_2 /end REF_CHARACTERISTIC
 /begin SUB_GROUP FIX_sint16_sint16.All_Curves_FIX.Curves_Raster_2 FIX_sint32_sint32.All_Curves_FIX.Curves_Raster_2 FIX_sint8_sint8.All_Curves_FIX.Curves_Raster_2 FIX_uint16_uint16.All_Curves_FIX.Curves_Raster_2 FIX_uint32_uint32.All_Curves_FIX.Curves_Raster_2 FIX_uint8_uint8.All_Curves_FIX.Curves_Raster_2 /end SUB_GROUP
/end GROUP
/begin GROUP All_Curves_FIX.Curves_Raster_3 ""
 /begin REF_MEASUREMENT Calculated.FIX_sint16_sint16.All_Curves_FIX.Curves_Raster_3 Calculated.FIX_sint32_sint32.All_Curves_FIX.Curves_Raster_3 Calculated.FIX_sint8_sint8.All_Curves_FIX.Curves_Raster_3 Calculated.FIX_uint16_uint16.All_Curves_FIX.Curves_Raster_3 Calculated.FIX_uint32_uint32.All_Curves_FIX.Curves_Raster_3 Calculated.FIX_uint8_uint8.All_Curves_FIX.Curves_Raster_3 M_In.FIX_sint16_sint16.All_Curves_FIX.Curves_Raster_3 M_In.FIX_sint32_sint32.All_Curves_FIX.Curves_Raster_3 M_In.FIX_sint8_sint8.All_Curves_FIX.Curves_Raster_3 M_In.FIX_uint16_uint16.All_Curves_FIX.Curves_Raster_3 M_In.FIX_uint32_uint32.All_Curves_FIX.Curves_Raster_3 M_In.FIX_uint8_uint8.All_Curves_FIX.Curves_Raster_3 M_out.FIX_sint16_sint16.All_Curves_FIX.Curves_Raster_3 M_out.FIX_sint32_sint32.All_Curves_FIX.Curves_Raster_3 M_out.FIX_sint8_sint8.All_Curves_FIX.Curves_Raster_3 M_out.FIX_uint16_uint16.All_Curves_FIX.Curves_Raster_3 M_out.FIX_uint32_uint32.All_Curves_FIX.Curves_Raster_3 M_out.FIX_uint8_uint8.All_Curves_FIX.Curves_Raster_3 /end REF_MEASUREMENT
 /begin REF_CHARACTERISTIC One_D_Fix.FIX_sint16_sint16.All_Curves_FIX.Curves_Raster_3 One_D_Fix.FIX_sint32_sint32.All_Curves_FIX.Curves_Raster_3 One_D_Fix.FIX_sint8_sint8.All_Curves_FIX.Curves_Raster_3 One_D_Fix.FIX_uint16_uint16.All_Curves_FIX.Curves_Raster_3 One_D_Fix.FIX_uint32_uint32.All_Curves_FIX.Curves_Raster_3 One_D_Fix.FIX_uint8_uint8.All_Curves_FIX.Curves_Raster_3 P_Do_Active_Fix.FIX_sint16_sint16.All_Curves_FIX.Curves_Raster_3 P_Do_Active_Fix.FIX_sint32_sint32.All_Curves_FIX.Curves_Raster_3 P_Do_Active_Fix.FIX_sint8_sint8.All_Curves_FIX.Curves_Raster_3 P_Do_Active_Fix.FIX_uint16_uint16.All_Curves_FIX.Curves_Raster_3 P_Do_Active_Fix.FIX_uint32_uint32.All_Curves_FIX.Curves_Raster_3 P_Do_Active_Fix.FIX_uint8_uint8.All_Curves_FIX.Curves_Raster_3 P_Do_All_FIX_Curves.All_Curves_FIX.Curves_Raster_3 P_In.FIX_sint16_sint16.All_Curves_FIX.Curves_Raster_3 P_In.FIX_sint32_sint32.All_Curves_FIX.Curves_Raster_3 P_In.FIX_sint8_sint8.All_Curves_FIX.Curves_Raster_3 P_In.FIX_uint16_uint16.All_Curves_FIX.Curves_Raster_3 P_In.FIX_uint32_uint32.All_Curves_FIX.Curves_Raster_3 P_In.FIX_uint8_uint8.All_Curves_FIX.Curves_Raster_3 /end REF_CHARACTERISTIC
 /begin SUB_GROUP FIX_sint16_sint16.All_Curves_FIX.Curves_Raster_3 FIX_sint32_sint32.All_Curves_FIX.Curves_Raster_3 FIX_sint8_sint8.All_Curves_FIX.Curves_Raster_3 FIX_uint16_uint16.All_Curves_FIX.Curves_Raster_3 FIX_uint32_uint32.All_Curves_FIX.Curves_Raster_3 FIX_uint8_uint8.All_Curves_FIX.Curves_Raster_3 /end SUB_GROUP
/end GROUP
/begin GROUP All_Curves_GRP.Curves_Raster_1 ""
 /begin REF_MEASUREMENT Calculated.GRP_sint16_sint16.All_Curves_GRP.Curves_Raster_1 Calculated.GRP_sint32_sint32.All_Curves_GRP.Curves_Raster_1 Calculated.GRP_sint8_sint8.All_Curves_GRP.Curves_Raster_1 Calculated.GRP_uint16_uint16.All_Curves_GRP.Curves_Raster_1 Calculated.GRP_uint32_uint32.All_Curves_GRP.Curves_Raster_1 Calculated.GRP_uint8_uint8.All_Curves_GRP.Curves_Raster_1 Distr_Set.GRP_sint16_sint16.All_Curves_GRP.Curves_Raster_1 Distr_Set.GRP_sint32_sint32.All_Curves_GRP.Curves_Raster_1 Distr_Set.GRP_sint8_sint8.All_Curves_GRP.Curves_Raster_1 Distr_Set.GRP_uint16_uint16.All_Curves_GRP.Curves_Raster_1 Distr_Set.GRP_uint32_uint32.All_Curves_GRP.Curves_Raster_1 Distr_Set.GRP_uint8_uint8.All_Curves_GRP.Curves_Raster_1 M_In.GRP_sint16_sint16.All_Curves_GRP.Curves_Raster_1 M_In.GRP_sint32_sint32.All_Curves_GRP.Curves_Raster_1 M_In.GRP_sint8_sint8.All_Curves_GRP.Curves_Raster_1 M_In.GRP_uint16_uint16.All_Curves_GRP.Curves_Raster_1 M_In.GRP_uint32_uint32.All_Curves_GRP.Curves_Raster_1 M_In.GRP_uint8_uint8.All_Curves_GRP.Curves_Raster_1 M_out.GRP_sint16_sint16.All_Curves_GRP.Curves_Raster_1 M_out.GRP_sint32_sint32.All_Curves_GRP.Curves_Raster_1 M_out.GRP_sint8_sint8.All_Curves_GRP.Curves_Raster_1 M_out.GRP_uint16_uint16.All_Curves_GRP.Curves_Raster_1 M_out.GRP_uint32_uint32.All_Curves_GRP.Curves_Raster_1 M_out.GRP_uint8_uint8.All_Curves_GRP.Curves_Raster_1 /end REF_MEASUREMENT
 /begin REF_CHARACTERISTIC One_D_1.GRP_sint16_sint16.All_Curves_GRP.Curves_Raster_1 One_D_1.GRP_sint32_sint32.All_Curves_GRP.Curves_Raster_1 One_D_1.GRP_sint8_sint8.All_Curves_GRP.Curves_Raster_1 One_D_1.GRP_uint16_uint16.All_Curves_GRP.Curves_Raster_1 One_D_1.GRP_uint32_uint32.All_Curves_GRP.Curves_Raster_1 One_D_1.GRP_uint8_uint8.All_Curves_GRP.Curves_Raster_1 P_Do_Active_Grp.GRP_sint16_sint16.All_Curves_GRP.Curves_Raster_1 P_Do_Active_Grp.GRP_sint32_sint32.All_Curves_GRP.Curves_Raster_1 P_Do_Active_Grp.GRP_sint8_sint8.All_Curves_GRP.Curves_Raster_1 P_Do_Active_Grp.GRP_uint16_uint16.All_Curves_GRP.Curves_Raster_1 P_Do_Active_Grp.GRP_uint32_uint32.All_Curves_GRP.Curves_Raster_1 P_Do_Active_Grp.GRP_uint8_uint8.All_Curves_GRP.Curves_Raster_1 P_Do_All_GRP_Curves.All_Curves_GRP.Curves_Raster_1 P_Do_Grp_get.GRP_sint16_sint16.All_Curves_GRP.Curves_Raster_1 P_Do_Grp_get.GRP_sint32_sint32.All_Curves_GRP.Curves_Raster_1 P_Do_Grp_get.GRP_sint8_sint8.All_Curves_GRP.Curves_Raster_1 P_Do_Grp_get.GRP_uint16_uint16.All_Curves_GRP.Curves_Raster_1 P_Do_Grp_get.GRP_uint32_uint32.All_Curves_GRP.Curves_Raster_1 P_Do_Grp_get.GRP_uint8_uint8.All_Curves_GRP.Curves_Raster_1 P_Do_Grp_set.GRP_sint16_sint16.All_Curves_GRP.Curves_Raster_1 P_Do_Grp_set.GRP_sint32_sint32.All_Curves_GRP.Curves_Raster_1 P_Do_Grp_set.GRP_sint8_sint8.All_Curves_GRP.Curves_Raster_1 P_Do_Grp_set.GRP_uint16_uint16.All_Curves_GRP.Curves_Raster_1 P_Do_Grp_set.GRP_uint32_uint32.All_Curves_GRP.Curves_Raster_1 P_Do_Grp_set.GRP_uint8_uint8.All_Curves_GRP.Curves_Raster_1 P_In.GRP_sint16_sint16.All_Curves_GRP.Curves_Raster_1 P_In.GRP_sint32_sint32.All_Curves_GRP.Curves_Raster_1 P_In.GRP_sint8_sint8.All_Curves_GRP.Curves_Raster_1 P_In.GRP_uint16_uint16.All_Curves_GRP.Curves_Raster_1 P_In.GRP_uint32_uint32.All_Curves_GRP.Curves_Raster_1 P_In.GRP_uint8_uint8.All_Curves_GRP.Curves_Raster_1 /end REF_CHARACTERISTIC
 /begin SUB_GROUP GRP_sint16_sint16.All_Curves_GRP.Curves_Raster_1 GRP_sint32_sint32.All_Curves_GRP.Curves_Raster_1 GRP_sint8_sint8.All_Curves_GRP.Curves_Raster_1 GRP_uint16_uint16.All_Curves_GRP.Curves_Raster_1 GRP_uint32_uint32.All_Curves_GRP.Curves_Raster_1 GRP_uint8_uint8.All_Curves_GRP.Curves_Raster_1 /end SUB_GROUP
/end GROUP
/begin GROUP All_Curves_GRP.Curves_Raster_2 ""
 /begin REF_MEASUREMENT Calculated.GRP_sint16_sint16.All_Curves_GRP.Curves_Raster_2 Calculated.GRP_sint32_sint32.All_Curves_GRP.Curves_Raster_2 Calculated.GRP_sint8_sint8.All_Curves_GRP.Curves_Raster_2 Calculated.GRP_uint16_uint16.All_Curves_GRP.Curves_Raster_2 Calculated.GRP_uint32_uint32.All_Curves_GRP.Curves_Raster_2 Calculated.GRP_uint8_uint8.All_Curves_GRP.Curves_Raster_2 Distr_Set.GRP_sint16_sint16.All_Curves_GRP.Curves_Raster_2 Distr_Set.GRP_sint32_sint32.All_Curves_GRP.Curves_Raster_2 Distr_Set.GRP_sint8_sint8.All_Curves_GRP.Curves_Raster_2 Distr_Set.GRP_uint16_uint16.All_Curves_GRP.Curves_Raster_2 Distr_Set.GRP_uint32_uint32.All_Curves_GRP.Curves_Raster_2 Distr_Set.GRP_uint8_uint8.All_Curves_GRP.Curves_Raster_2 M_In.GRP_sint16_sint16.All_Curves_GRP.Curves_Raster_2 M_In.GRP_sint32_sint32.All_Curves_GRP.Curves_Raster_2 M_In.GRP_sint8_sint8.All_Curves_GRP.Curves_Raster_2 M_In.GRP_uint16_uint16.All_Curves_GRP.Curves_Raster_2 M_In.GRP_uint32_uint32.All_Curves_GRP.Curves_Raster_2 M_In.GRP_uint8_uint8.All_Curves_GRP.Curves_Raster_2 M_out.GRP_sint16_sint16.All_Curves_GRP.Curves_Raster_2 M_out.GRP_sint32_sint32.All_Curves_GRP.Curves_Raster_2 M_out.GRP_sint8_sint8.All_Curves_GRP.Curves_Raster_2 M_out.GRP_uint16_uint16.All_Curves_GRP.Curves_Raster_2 M_out.GRP_uint32_uint32.All_Curves_GRP.Curves_Raster_2 M_out.GRP_uint8_uint8.All_Curves_GRP.Curves_Raster_2 /end REF_MEASUREMENT
 /begin REF_CHARACTERISTIC One_D_1.GRP_sint16_sint16.All_Curves_GRP.Curves_Raster_2 One_D_1.GRP_sint32_sint32.All_Curves_GRP.Curves_Raster_2 One_D_1.GRP_sint8_sint8.All_Curves_GRP.Curves_Raster_2 One_D_1.GRP_uint16_uint16.All_Curves_GRP.Curves_Raster_2 One_D_1.GRP_uint32_uint32.All_Curves_GRP.Curves_Raster_2 One_D_1.GRP_uint8_uint8.All_Curves_GRP.Curves_Raster_2 P_Do_Active_Grp.GRP_sint16_sint16.All_Curves_GRP.Curves_Raster_2 P_Do_Active_Grp.GRP_sint32_sint32.All_Curves_GRP.Curves_Raster_2 P_Do_Active_Grp.GRP_sint8_sint8.All_Curves_GRP.Curves_Raster_2 P_Do_Active_Grp.GRP_uint16_uint16.All_Curves_GRP.Curves_Raster_2 P_Do_Active_Grp.GRP_uint32_uint32.All_Curves_GRP.Curves_Raster_2 P_Do_Active_Grp.GRP_uint8_uint8.All_Curves_GRP.Curves_Raster_2 P_Do_All_GRP_Curves.All_Curves_GRP.Curves_Raster_2 P_Do_Grp_get.GRP_sint16_sint16.All_Curves_GRP.Curves_Raster_2 P_Do_Grp_get.GRP_sint32_sint32.All_Curves_GRP.Curves_Raster_2 P_Do_Grp_get.GRP_sint8_sint8.All_Curves_GRP.Curves_Raster_2 P_Do_Grp_get.GRP_uint16_uint16.All_Curves_GRP.Curves_Raster_2 P_Do_Grp_get.GRP_uint32_uint32.All_Curves_GRP.Curves_Raster_2 P_Do_Grp_get.GRP_uint8_uint8.All_Curves_GRP.Curves_Raster_2 P_Do_Grp_set.GRP_sint16_sint16.All_Curves_GRP.Curves_Raster_2 P_Do_Grp_set.GRP_sint32_sint32.All_Curves_GRP.Curves_Raster_2 P_Do_Grp_set.GRP_sint8_sint8.All_Curves_GRP.Curves_Raster_2 P_Do_Grp_set.GRP_uint16_uint16.All_Curves_GRP.Curves_Raster_2 P_Do_Grp_set.GRP_uint32_uint32.All_Curves_GRP.Curves_Raster_2 P_Do_Grp_set.GRP_uint8_uint8.All_Curves_GRP.Curves_Raster_2 P_In.GRP_sint16_sint16.All_Curves_GRP.Curves_Raster_2 P_In.GRP_sint32_sint32.All_Curves_GRP.Curves_Raster_2 P_In.GRP_sint8_sint8.All_Curves_GRP.Curves_Raster_2 P_In.GRP_uint16_uint16.All_Curves_GRP.Curves_Raster_2 P_In.GRP_uint32_uint32.All_Curves_GRP.Curves_Raster_2 P_In.GRP_uint8_uint8.All_Curves_GRP.Curves_Raster_2 /end REF_CHARACTERISTIC
 /begin SUB_GROUP GRP_sint16_sint16.All_Curves_GRP.Curves_Raster_2 GRP_sint32_sint32.All_Curves_GRP.Curves_Raster_2 GRP_sint8_sint8.All_Curves_GRP.Curves_Raster_2 GRP_uint16_uint16.All_Curves_GRP.Curves_Raster_2 GRP_uint32_uint32.All_Curves_GRP.Curves_Raster_2 GRP_uint8_uint8.All_Curves_GRP.Curves_Raster_2 /end SUB_GROUP
/end GROUP
/begin GROUP All_Curves_GRP.Curves_Raster_3 ""
 /begin REF_MEASUREMENT Calculated.GRP_sint16_sint16.All_Curves_GRP.Curves_Raster_3 Calculated.GRP_sint32_sint32.All_Curves_GRP.Curves_Raster_3 Calculated.GRP_sint8_sint8.All_Curves_GRP.Curves_Raster_3 Calculated.GRP_uint16_uint16.All_Curves_GRP.Curves_Raster_3 Calculated.GRP_uint32_uint32.All_Curves_GRP.Curves_Raster_3 Calculated.GRP_uint8_uint8.All_Curves_GRP.Curves_Raster_3 Distr_Set.GRP_sint16_sint16.All_Curves_GRP.Curves_Raster_3 Distr_Set.GRP_sint32_sint32.All_Curves_GRP.Curves_Raster_3 Distr_Set.GRP_sint8_sint8.All_Curves_GRP.Curves_Raster_3 Distr_Set.GRP_uint16_uint16.All_Curves_GRP.Curves_Raster_3 Distr_Set.GRP_uint32_uint32.All_Curves_GRP.Curves_Raster_3 Distr_Set.GRP_uint8_uint8.All_Curves_GRP.Curves_Raster_3 M_In.GRP_sint16_sint16.All_Curves_GRP.Curves_Raster_3 M_In.GRP_sint32_sint32.All_Curves_GRP.Curves_Raster_3 M_In.GRP_sint8_sint8.All_Curves_GRP.Curves_Raster_3 M_In.GRP_uint16_uint16.All_Curves_GRP.Curves_Raster_3 M_In.GRP_uint32_uint32.All_Curves_GRP.Curves_Raster_3 M_In.GRP_uint8_uint8.All_Curves_GRP.Curves_Raster_3 M_out.GRP_sint16_sint16.All_Curves_GRP.Curves_Raster_3 M_out.GRP_sint32_sint32.All_Curves_GRP.Curves_Raster_3 M_out.GRP_sint8_sint8.All_Curves_GRP.Curves_Raster_3 M_out.GRP_uint16_uint16.All_Curves_GRP.Curves_Raster_3 M_out.GRP_uint32_uint32.All_Curves_GRP.Curves_Raster_3 M_out.GRP_uint8_uint8.All_Curves_GRP.Curves_Raster_3 /end REF_MEASUREMENT
 /begin REF_CHARACTERISTIC One_D_1.GRP_sint16_sint16.All_Curves_GRP.Curves_Raster_3 One_D_1.GRP_sint32_sint32.All_Curves_GRP.Curves_Raster_3 One_D_1.GRP_sint8_sint8.All_Curves_GRP.Curves_Raster_3 One_D_1.GRP_uint16_uint16.All_Curves_GRP.Curves_Raster_3 One_D_1.GRP_uint32_uint32.All_Curves_GRP.Curves_Raster_3 One_D_1.GRP_uint8_uint8.All_Curves_GRP.Curves_Raster_3 P_Do_Active_Grp.GRP_sint16_sint16.All_Curves_GRP.Curves_Raster_3 P_Do_Active_Grp.GRP_sint32_sint32.All_Curves_GRP.Curves_Raster_3 P_Do_Active_Grp.GRP_sint8_sint8.All_Curves_GRP.Curves_Raster_3 P_Do_Active_Grp.GRP_uint16_uint16.All_Curves_GRP.Curves_Raster_3 P_Do_Active_Grp.GRP_uint32_uint32.All_Curves_GRP.Curves_Raster_3 P_Do_Active_Grp.GRP_uint8_uint8.All_Curves_GRP.Curves_Raster_3 P_Do_All_GRP_Curves.All_Curves_GRP.Curves_Raster_3 P_Do_Grp_get.GRP_sint16_sint16.All_Curves_GRP.Curves_Raster_3 P_Do_Grp_get.GRP_sint32_sint32.All_Curves_GRP.Curves_Raster_3 P_Do_Grp_get.GRP_sint8_sint8.All_Curves_GRP.Curves_Raster_3 P_Do_Grp_get.GRP_uint16_uint16.All_Curves_GRP.Curves_Raster_3 P_Do_Grp_get.GRP_uint32_uint32.All_Curves_GRP.Curves_Raster_3 P_Do_Grp_get.GRP_uint8_uint8.All_Curves_GRP.Curves_Raster_3 P_Do_Grp_set.GRP_sint16_sint16.All_Curves_GRP.Curves_Raster_3 P_Do_Grp_set.GRP_sint32_sint32.All_Curves_GRP.Curves_Raster_3 P_Do_Grp_set.GRP_sint8_sint8.All_Curves_GRP.Curves_Raster_3 P_Do_Grp_set.GRP_uint16_uint16.All_Curves_GRP.Curves_Raster_3 P_Do_Grp_set.GRP_uint32_uint32.All_Curves_GRP.Curves_Raster_3 P_Do_Grp_set.GRP_uint8_uint8.All_Curves_GRP.Curves_Raster_3 P_In.GRP_sint16_sint16.All_Curves_GRP.Curves_Raster_3 P_In.GRP_sint32_sint32.All_Curves_GRP.Curves_Raster_3 P_In.GRP_sint8_sint8.All_Curves_GRP.Curves_Raster_3 P_In.GRP_uint16_uint16.All_Curves_GRP.Curves_Raster_3 P_In.GRP_uint32_uint32.All_Curves_GRP.Curves_Raster_3 P_In.GRP_uint8_uint8.All_Curves_GRP.Curves_Raster_3 /end REF_CHARACTERISTIC
 /begin SUB_GROUP GRP_sint16_sint16.All_Curves_GRP.Curves_Raster_3 GRP_sint32_sint32.All_Curves_GRP.Curves_Raster_3 GRP_sint8_sint8.All_Curves_GRP.Curves_Raster_3 GRP_uint16_uint16.All_Curves_GRP.Curves_Raster_3 GRP_uint32_uint32.All_Curves_GRP.Curves_Raster_3 GRP_uint8_uint8.All_Curves_GRP.Curves_Raster_3 /end SUB_GROUP
/end GROUP
/begin GROUP All_Curves_STD.Curves_Raster_1 ""
 /begin REF_MEASUREMENT Calculated.STD_sint16_sint16.All_Curves_STD.Curves_Raster_1 Calculated.STD_sint32_sint32.All_Curves_STD.Curves_Raster_1 Calculated.STD_sint8_sint8.All_Curves_STD.Curves_Raster_1 Calculated.STD_uint16_uint16.All_Curves_STD.Curves_Raster_1 Calculated.STD_uint32_uint32.All_Curves_STD.Curves_Raster_1 Calculated.STD_uint8_uint8.All_Curves_STD.Curves_Raster_1 M_In.STD_sint16_sint16.All_Curves_STD.Curves_Raster_1 M_In.STD_sint32_sint32.All_Curves_STD.Curves_Raster_1 M_In.STD_sint8_sint8.All_Curves_STD.Curves_Raster_1 M_In.STD_uint16_uint16.All_Curves_STD.Curves_Raster_1 M_In.STD_uint32_uint32.All_Curves_STD.Curves_Raster_1 M_In.STD_uint8_uint8.All_Curves_STD.Curves_Raster_1 M_out.STD_sint16_sint16.All_Curves_STD.Curves_Raster_1 M_out.STD_sint32_sint32.All_Curves_STD.Curves_Raster_1 M_out.STD_sint8_sint8.All_Curves_STD.Curves_Raster_1 M_out.STD_uint16_uint16.All_Curves_STD.Curves_Raster_1 M_out.STD_uint32_uint32.All_Curves_STD.Curves_Raster_1 M_out.STD_uint8_uint8.All_Curves_STD.Curves_Raster_1 /end REF_MEASUREMENT
 /begin REF_CHARACTERISTIC One_D.STD_sint16_sint16.All_Curves_STD.Curves_Raster_1 One_D.STD_sint32_sint32.All_Curves_STD.Curves_Raster_1 One_D.STD_sint8_sint8.All_Curves_STD.Curves_Raster_1 One_D.STD_uint16_uint16.All_Curves_STD.Curves_Raster_1 One_D.STD_uint32_uint32.All_Curves_STD.Curves_Raster_1 One_D.STD_uint8_uint8.All_Curves_STD.Curves_Raster_1 P_Do_Active_Std.STD_sint16_sint16.All_Curves_STD.Curves_Raster_1 P_Do_Active_Std.STD_sint32_sint32.All_Curves_STD.Curves_Raster_1 P_Do_Active_Std.STD_sint8_sint8.All_Curves_STD.Curves_Raster_1 P_Do_Active_Std.STD_uint16_uint16.All_Curves_STD.Curves_Raster_1 P_Do_Active_Std.STD_uint32_uint32.All_Curves_STD.Curves_Raster_1 P_Do_Active_Std.STD_uint8_uint8.All_Curves_STD.Curves_Raster_1 P_Do_All_STD_Curves.All_Curves_STD.Curves_Raster_1 P_In.STD_sint16_sint16.All_Curves_STD.Curves_Raster_1 P_In.STD_sint32_sint32.All_Curves_STD.Curves_Raster_1 P_In.STD_sint8_sint8.All_Curves_STD.Curves_Raster_1 P_In.STD_uint16_uint16.All_Curves_STD.Curves_Raster_1 P_In.STD_uint32_uint32.All_Curves_STD.Curves_Raster_1 P_In.STD_uint8_uint8.All_Curves_STD.Curves_Raster_1 /end REF_CHARACTERISTIC
 /begin SUB_GROUP STD_sint16_sint16.All_Curves_STD.Curves_Raster_1 STD_sint32_sint32.All_Curves_STD.Curves_Raster_1 STD_sint8_sint8.All_Curves_STD.Curves_Raster_1 STD_uint16_uint16.All_Curves_STD.Curves_Raster_1 STD_uint32_uint32.All_Curves_STD.Curves_Raster_1 STD_uint8_uint8.All_Curves_STD.Curves_Raster_1 /end SUB_GROUP
/end GROUP
/begin GROUP BASE "" ROOT
 /begin REF_MEASUREMENT ebCtrNewT_ASD.AS.BASE ebCtrNewY_ASD.AS.BASE ebCtrOldT_ASD.AS.BASE ebCtrOldY_ASD.AS.BASE r100msTaskCtr.AS.BASE /end REF_MEASUREMENT
 /begin REF_CHARACTERISTIC EBEN_ASD.AS.BASE /end REF_CHARACTERISTIC
/end GROUP
/begin GROUP Checksum.ALL_PROT ""
 /begin REF_MEASUREMENT g_ChecksumByteOrder_u8.Checksum.ALL_PROT g_ChecksumType_u8.Checksum.ALL_PROT g_checksum_u32.Checksum.ALL_PROT g_chksumlength_u8.Checksum.ALL_PROT /end REF_MEASUREMENT
 /begin REF_CHARACTERISTIC p_ChecksumByteOrder_u8.Checksum.ALL_PROT p_ChecksumType_u8.Checksum.ALL_PROT /end REF_CHARACTERISTIC
/end GROUP
/begin GROUP Curves_Raster_1 "" ROOT
 /begin REF_MEASUREMENT Calculated.FIX_sint16_sint16.All_Curves_FIX.Curves_Raster_1 Calculated.FIX_sint32_sint32.All_Curves_FIX.Curves_Raster_1 Calculated.FIX_sint8_sint8.All_Curves_FIX.Curves_Raster_1 Calculated.FIX_uint16_uint16.All_Curves_FIX.Curves_Raster_1 Calculated.FIX_uint32_uint32.All_Curves_FIX.Curves_Raster_1 Calculated.FIX_uint8_uint8.All_Curves_FIX.Curves_Raster_1 Calculated.GRP_sint16_sint16.All_Curves_GRP.Curves_Raster_1 Calculated.GRP_sint32_sint32.All_Curves_GRP.Curves_Raster_1 Calculated.GRP_sint8_sint8.All_Curves_GRP.Curves_Raster_1 Calculated.GRP_uint16_uint16.All_Curves_GRP.Curves_Raster_1 Calculated.GRP_uint32_uint32.All_Curves_GRP.Curves_Raster_1 Calculated.GRP_uint8_uint8.All_Curves_GRP.Curves_Raster_1 Calculated.STD_sint16_sint16.All_Curves_STD.Curves_Raster_1 Calculated.STD_sint32_sint32.All_Curves_STD.Curves_Raster_1 Calculated.STD_sint8_sint8.All_Curves_STD.Curves_Raster_1 Calculated.STD_uint16_uint16.All_Curves_STD.Curves_Raster_1 Calculated.STD_uint32_uint32.All_Curves_STD.Curves_Raster_1 Calculated.STD_uint8_uint8.All_Curves_STD.Curves_Raster_1 Distr_Set.GRP_sint16_sint16.All_Curves_GRP.Curves_Raster_1 Distr_Set.GRP_sint32_sint32.All_Curves_GRP.Curves_Raster_1 Distr_Set.GRP_sint8_sint8.All_Curves_GRP.Curves_Raster_1 Distr_Set.GRP_uint16_uint16.All_Curves_GRP.Curves_Raster_1 Distr_Set.GRP_uint32_uint32.All_Curves_GRP.Curves_Raster_1 Distr_Set.GRP_uint8_uint8.All_Curves_GRP.Curves_Raster_1 M_In.FIX_sint16_sint16.All_Curves_FIX.Curves_Raster_1 M_In.FIX_sint32_sint32.All_Curves_FIX.Curves_Raster_1 M_In.FIX_sint8_sint8.All_Curves_FIX.Curves_Raster_1 M_In.FIX_uint16_uint16.All_Curves_FIX.Curves_Raster_1 M_In.FIX_uint32_uint32.All_Curves_FIX.Curves_Raster_1 M_In.FIX_uint8_uint8.All_Curves_FIX.Curves_Raster_1 M_In.GRP_sint16_sint16.All_Curves_GRP.Curves_Raster_1 M_In.GRP_sint32_sint32.All_Curves_GRP.Curves_Raster_1 M_In.GRP_sint8_sint8.All_Curves_GRP.Curves_Raster_1 M_In.GRP_uint16_uint16.All_Curves_GRP.Curves_Raster_1 M_In.GRP_uint32_uint32.All_Curves_GRP.Curves_Raster_1 M_In.GRP_uint8_uint8.All_Curves_GRP.Curves_Raster_1 M_In.STD_sint16_sint16.All_Curves_STD.Curves_Raster_1 M_In.STD_sint32_sint32.All_Curves_STD.Curves_Raster_1 M_In.STD_sint8_sint8.All_Curves_STD.Curves_Raster_1 M_In.STD_uint16_uint16.All_Curves_STD.Curves_Raster_1 M_In.STD_uint32_uint32.All_Curves_STD.Curves_Raster_1 M_In.STD_uint8_uint8.All_Curves_STD.Curves_Raster_1 M_out.FIX_sint16_sint16.All_Curves_FIX.Curves_Raster_1 M_out.FIX_sint32_sint32.All_Curves_FIX.Curves_Raster_1 M_out.FIX_sint8_sint8.All_Curves_FIX.Curves_Raster_1 M_out.FIX_uint16_uint16.All_Curves_FIX.Curves_Raster_1 M_out.FIX_uint32_uint32.All_Curves_FIX.Curves_Raster_1 M_out.FIX_uint8_uint8.All_Curves_FIX.Curves_Raster_1 M_out.GRP_sint16_sint16.All_Curves_GRP.Curves_Raster_1 M_out.GRP_sint32_sint32.All_Curves_GRP.Curves_Raster_1 M_out.GRP_sint8_sint8.All_Curves_GRP.Curves_Raster_1 M_out.GRP_uint16_uint16.All_Curves_GRP.Curves_Raster_1 M_out.GRP_uint32_uint32.All_Curves_GRP.Curves_Raster_1 M_out.GRP_uint8_uint8.All_Curves_GRP.Curves_Raster_1 M_out.STD_sint16_sint16.All_Curves_STD.Curves_Raster_1 M_out.STD_sint32_sint32.All_Curves_STD.Curves_Raster_1 M_out.STD_sint8_sint8.All_Curves_STD.Curves_Raster_1 M_out.STD_uint16_uint16.All_Curves_STD.Curves_Raster_1 M_out.STD_uint32_uint32.All_Curves_STD.Curves_Raster_1 M_out.STD_uint8_uint8.All_Curves_STD.Curves_Raster_1 /end REF_MEASUREMENT
 /begin REF_CHARACTERISTIC One_D.STD_sint16_sint16.All_Curves_STD.Curves_Raster_1 One_D.STD_sint32_sint32.All_Curves_STD.Curves_Raster_1 One_D.STD_sint8_sint8.All_Curves_STD.Curves_Raster_1 One_D.STD_uint16_uint16.All_Curves_STD.Curves_Raster_1 One_D.STD_uint32_uint32.All_Curves_STD.Curves_Raster_1 One_D.STD_uint8_uint8.All_Curves_STD.Curves_Raster_1 One_D_1.GRP_sint16_sint16.All_Curves_GRP.Curves_Raster_1 One_D_1.GRP_sint32_sint32.All_Curves_GRP.Curves_Raster_1 One_D_1.GRP_sint8_sint8.All_Curves_GRP.Curves_Raster_1 One_D_1.GRP_uint16_uint16.All_Curves_GRP.Curves_Raster_1 One_D_1.GRP_uint32_uint32.All_Curves_GRP.Curves_Raster_1 One_D_1.GRP_uint8_uint8.All_Curves_GRP.Curves_Raster_1 One_D_Fix.FIX_sint16_sint16.All_Curves_FIX.Curves_Raster_1 One_D_Fix.FIX_sint32_sint32.All_Curves_FIX.Curves_Raster_1 One_D_Fix.FIX_sint8_sint8.All_Curves_FIX.Curves_Raster_1 One_D_Fix.FIX_uint16_uint16.All_Curves_FIX.Curves_Raster_1 One_D_Fix.FIX_uint32_uint32.All_Curves_FIX.Curves_Raster_1 One_D_Fix.FIX_uint8_uint8.All_Curves_FIX.Curves_Raster_1 P_Do_Active_Fix.FIX_sint16_sint16.All_Curves_FIX.Curves_Raster_1 P_Do_Active_Fix.FIX_sint32_sint32.All_Curves_FIX.Curves_Raster_1 P_Do_Active_Fix.FIX_sint8_sint8.All_Curves_FIX.Curves_Raster_1 P_Do_Active_Fix.FIX_uint16_uint16.All_Curves_FIX.Curves_Raster_1 P_Do_Active_Fix.FIX_uint32_uint32.All_Curves_FIX.Curves_Raster_1 P_Do_Active_Fix.FIX_uint8_uint8.All_Curves_FIX.Curves_Raster_1 P_Do_Active_Grp.GRP_sint16_sint16.All_Curves_GRP.Curves_Raster_1 P_Do_Active_Grp.GRP_sint32_sint32.All_Curves_GRP.Curves_Raster_1 P_Do_Active_Grp.GRP_sint8_sint8.All_Curves_GRP.Curves_Raster_1 P_Do_Active_Grp.GRP_uint16_uint16.All_Curves_GRP.Curves_Raster_1 P_Do_Active_Grp.GRP_uint32_uint32.All_Curves_GRP.Curves_Raster_1 P_Do_Active_Grp.GRP_uint8_uint8.All_Curves_GRP.Curves_Raster_1 P_Do_Active_Std.STD_sint16_sint16.All_Curves_STD.Curves_Raster_1 P_Do_Active_Std.STD_sint32_sint32.All_Curves_STD.Curves_Raster_1 P_Do_Active_Std.STD_sint8_sint8.All_Curves_STD.Curves_Raster_1 P_Do_Active_Std.STD_uint16_uint16.All_Curves_STD.Curves_Raster_1 P_Do_Active_Std.STD_uint32_uint32.All_Curves_STD.Curves_Raster_1 P_Do_Active_Std.STD_uint8_uint8.All_Curves_STD.Curves_Raster_1 P_Do_All_FIX_Curves.All_Curves_FIX.Curves_Raster_1 P_Do_All_GRP_Curves.All_Curves_GRP.Curves_Raster_1 P_Do_All_STD_Curves.All_Curves_STD.Curves_Raster_1 P_Do_Grp_get.GRP_sint16_sint16.All_Curves_GRP.Curves_Raster_1 P_Do_Grp_get.GRP_sint32_sint32.All_Curves_GRP.Curves_Raster_1 P_Do_Grp_get.GRP_sint8_sint8.All_Curves_GRP.Curves_Raster_1 P_Do_Grp_get.GRP_uint16_uint16.All_Curves_GRP.Curves_Raster_1 P_Do_Grp_get.GRP_uint32_uint32.All_Curves_GRP.Curves_Raster_1 P_Do_Grp_get.GRP_uint8_uint8.All_Curves_GRP.Curves_Raster_1 P_Do_Grp_set.GRP_sint16_sint16.All_Curves_GRP.Curves_Raster_1 P_Do_Grp_set.GRP_sint32_sint32.All_Curves_GRP.Curves_Raster_1 P_Do_Grp_set.GRP_sint8_sint8.All_Curves_GRP.Curves_Raster_1 P_Do_Grp_set.GRP_uint16_uint16.All_Curves_GRP.Curves_Raster_1 P_Do_Grp_set.GRP_uint32_uint32.All_Curves_GRP.Curves_Raster_1 P_Do_Grp_set.GRP_uint8_uint8.All_Curves_GRP.Curves_Raster_1 P_In.FIX_sint16_sint16.All_Curves_FIX.Curves_Raster_1 P_In.FIX_sint32_sint32.All_Curves_FIX.Curves_Raster_1 P_In.FIX_sint8_sint8.All_Curves_FIX.Curves_Raster_1 P_In.FIX_uint16_uint16.All_Curves_FIX.Curves_Raster_1 P_In.FIX_uint32_uint32.All_Curves_FIX.Curves_Raster_1 P_In.FIX_uint8_uint8.All_Curves_FIX.Curves_Raster_1 P_In.GRP_sint16_sint16.All_Curves_GRP.Curves_Raster_1 P_In.GRP_sint32_sint32.All_Curves_GRP.Curves_Raster_1 P_In.GRP_sint8_sint8.All_Curves_GRP.Curves_Raster_1 P_In.GRP_uint16_uint16.All_Curves_GRP.Curves_Raster_1 P_In.GRP_uint32_uint32.All_Curves_GRP.Curves_Raster_1 P_In.GRP_uint8_uint8.All_Curves_GRP.Curves_Raster_1 P_In.STD_sint16_sint16.All_Curves_STD.Curves_Raster_1 P_In.STD_sint32_sint32.All_Curves_STD.Curves_Raster_1 P_In.STD_sint8_sint8.All_Curves_STD.Curves_Raster_1 P_In.STD_uint16_uint16.All_Curves_STD.Curves_Raster_1 P_In.STD_uint32_uint32.All_Curves_STD.Curves_Raster_1 P_In.STD_uint8_uint8.All_Curves_STD.Curves_Raster_1 /end REF_CHARACTERISTIC
/end GROUP
/begin GROUP Curves_Raster_2 "" ROOT
 /begin REF_MEASUREMENT Calculated.FIX_sint16_sint16.All_Curves_FIX.Curves_Raster_2 Calculated.FIX_sint32_sint32.All_Curves_FIX.Curves_Raster_2 Calculated.FIX_sint8_sint8.All_Curves_FIX.Curves_Raster_2 Calculated.FIX_uint16_uint16.All_Curves_FIX.Curves_Raster_2 Calculated.FIX_uint32_uint32.All_Curves_FIX.Curves_Raster_2 Calculated.FIX_uint8_uint8.All_Curves_FIX.Curves_Raster_2 Calculated.GRP_sint16_sint16.All_Curves_GRP.Curves_Raster_2 Calculated.GRP_sint32_sint32.All_Curves_GRP.Curves_Raster_2 Calculated.GRP_sint8_sint8.All_Curves_GRP.Curves_Raster_2 Calculated.GRP_uint16_uint16.All_Curves_GRP.Curves_Raster_2 Calculated.GRP_uint32_uint32.All_Curves_GRP.Curves_Raster_2 Calculated.GRP_uint8_uint8.All_Curves_GRP.Curves_Raster_2 Distr_Set.GRP_sint16_sint16.All_Curves_GRP.Curves_Raster_2 Distr_Set.GRP_sint32_sint32.All_Curves_GRP.Curves_Raster_2 Distr_Set.GRP_sint8_sint8.All_Curves_GRP.Curves_Raster_2 Distr_Set.GRP_uint16_uint16.All_Curves_GRP.Curves_Raster_2 Distr_Set.GRP_uint32_uint32.All_Curves_GRP.Curves_Raster_2 Distr_Set.GRP_uint8_uint8.All_Curves_GRP.Curves_Raster_2 M_In.FIX_sint16_sint16.All_Curves_FIX.Curves_Raster_2 M_In.FIX_sint32_sint32.All_Curves_FIX.Curves_Raster_2 M_In.FIX_sint8_sint8.All_Curves_FIX.Curves_Raster_2 M_In.FIX_uint16_uint16.All_Curves_FIX.Curves_Raster_2 M_In.FIX_uint32_uint32.All_Curves_FIX.Curves_Raster_2 M_In.FIX_uint8_uint8.All_Curves_FIX.Curves_Raster_2 M_In.GRP_sint16_sint16.All_Curves_GRP.Curves_Raster_2 M_In.GRP_sint32_sint32.All_Curves_GRP.Curves_Raster_2 M_In.GRP_sint8_sint8.All_Curves_GRP.Curves_Raster_2 M_In.GRP_uint16_uint16.All_Curves_GRP.Curves_Raster_2 M_In.GRP_uint32_uint32.All_Curves_GRP.Curves_Raster_2 M_In.GRP_uint8_uint8.All_Curves_GRP.Curves_Raster_2 M_out.FIX_sint16_sint16.All_Curves_FIX.Curves_Raster_2 M_out.FIX_sint32_sint32.All_Curves_FIX.Curves_Raster_2 M_out.FIX_sint8_sint8.All_Curves_FIX.Curves_Raster_2 M_out.FIX_uint16_uint16.All_Curves_FIX.Curves_Raster_2 M_out.FIX_uint32_uint32.All_Curves_FIX.Curves_Raster_2 M_out.FIX_uint8_uint8.All_Curves_FIX.Curves_Raster_2 M_out.GRP_sint16_sint16.All_Curves_GRP.Curves_Raster_2 M_out.GRP_sint32_sint32.All_Curves_GRP.Curves_Raster_2 M_out.GRP_sint8_sint8.All_Curves_GRP.Curves_Raster_2 M_out.GRP_uint16_uint16.All_Curves_GRP.Curves_Raster_2 M_out.GRP_uint32_uint32.All_Curves_GRP.Curves_Raster_2 M_out.GRP_uint8_uint8.All_Curves_GRP.Curves_Raster_2 /end REF_MEASUREMENT
 /begin REF_CHARACTERISTIC One_D_1.GRP_sint16_sint16.All_Curves_GRP.Curves_Raster_2 One_D_1.GRP_sint32_sint32.All_Curves_GRP.Curves_Raster_2 One_D_1.GRP_sint8_sint8.All_Curves_GRP.Curves_Raster_2 One_D_1.GRP_uint16_uint16.All_Curves_GRP.Curves_Raster_2 One_D_1.GRP_uint32_uint32.All_Curves_GRP.Curves_Raster_2 One_D_1.GRP_uint8_uint8.All_Curves_GRP.Curves_Raster_2 One_D_Fix.FIX_sint16_sint16.All_Curves_FIX.Curves_Raster_2 One_D_Fix.FIX_sint32_sint32.All_Curves_FIX.Curves_Raster_2 One_D_Fix.FIX_sint8_sint8.All_Curves_FIX.Curves_Raster_2 One_D_Fix.FIX_uint16_uint16.All_Curves_FIX.Curves_Raster_2 One_D_Fix.FIX_uint32_uint32.All_Curves_FIX.Curves_Raster_2 One_D_Fix.FIX_uint8_uint8.All_Curves_FIX.Curves_Raster_2 P_Do_Active_Fix.FIX_sint16_sint16.All_Curves_FIX.Curves_Raster_2 P_Do_Active_Fix.FIX_sint32_sint32.All_Curves_FIX.Curves_Raster_2 P_Do_Active_Fix.FIX_sint8_sint8.All_Curves_FIX.Curves_Raster_2 P_Do_Active_Fix.FIX_uint16_uint16.All_Curves_FIX.Curves_Raster_2 P_Do_Active_Fix.FIX_uint32_uint32.All_Curves_FIX.Curves_Raster_2 P_Do_Active_Fix.FIX_uint8_uint8.All_Curves_FIX.Curves_Raster_2 P_Do_Active_Grp.GRP_sint16_sint16.All_Curves_GRP.Curves_Raster_2 P_Do_Active_Grp.GRP_sint32_sint32.All_Curves_GRP.Curves_Raster_2 P_Do_Active_Grp.GRP_sint8_sint8.All_Curves_GRP.Curves_Raster_2 P_Do_Active_Grp.GRP_uint16_uint16.All_Curves_GRP.Curves_Raster_2 P_Do_Active_Grp.GRP_uint32_uint32.All_Curves_GRP.Curves_Raster_2 P_Do_Active_Grp.GRP_uint8_uint8.All_Curves_GRP.Curves_Raster_2 P_Do_All_FIX_Curves.All_Curves_FIX.Curves_Raster_2 P_Do_All_GRP_Curves.All_Curves_GRP.Curves_Raster_2 P_Do_Grp_get.GRP_sint16_sint16.All_Curves_GRP.Curves_Raster_2 P_Do_Grp_get.GRP_sint32_sint32.All_Curves_GRP.Curves_Raster_2 P_Do_Grp_get.GRP_sint8_sint8.All_Curves_GRP.Curves_Raster_2 P_Do_Grp_get.GRP_uint16_uint16.All_Curves_GRP.Curves_Raster_2 P_Do_Grp_get.GRP_uint32_uint32.All_Curves_GRP.Curves_Raster_2 P_Do_Grp_get.GRP_uint8_uint8.All_Curves_GRP.Curves_Raster_2 P_Do_Grp_set.GRP_sint16_sint16.All_Curves_GRP.Curves_Raster_2 P_Do_Grp_set.GRP_sint32_sint32.All_Curves_GRP.Curves_Raster_2 P_Do_Grp_set.GRP_sint8_sint8.All_Curves_GRP.Curves_Raster_2 P_Do_Grp_set.GRP_uint16_uint16.All_Curves_GRP.Curves_Raster_2 P_Do_Grp_set.GRP_uint32_uint32.All_Curves_GRP.Curves_Raster_2 P_Do_Grp_set.GRP_uint8_uint8.All_Curves_GRP.Curves_Raster_2 P_In.FIX_sint16_sint16.All_Curves_FIX.Curves_Raster_2 P_In.FIX_sint32_sint32.All_Curves_FIX.Curves_Raster_2 P_In.FIX_sint8_sint8.All_Curves_FIX.Curves_Raster_2 P_In.FIX_uint16_uint16.All_Curves_FIX.Curves_Raster_2 P_In.FIX_uint32_uint32.All_Curves_FIX.Curves_Raster_2 P_In.FIX_uint8_uint8.All_Curves_FIX.Curves_Raster_2 P_In.GRP_sint16_sint16.All_Curves_GRP.Curves_Raster_2 P_In.GRP_sint32_sint32.All_Curves_GRP.Curves_Raster_2 P_In.GRP_sint8_sint8.All_Curves_GRP.Curves_Raster_2 P_In.GRP_uint16_uint16.All_Curves_GRP.Curves_Raster_2 P_In.GRP_uint32_uint32.All_Curves_GRP.Curves_Raster_2 P_In.GRP_uint8_uint8.All_Curves_GRP.Curves_Raster_2 /end REF_CHARACTERISTIC
/end GROUP
/begin GROUP Curves_Raster_3 "" ROOT
 /begin REF_MEASUREMENT Calculated.FIX_sint16_sint16.All_Curves_FIX.Curves_Raster_3 Calculated.FIX_sint32_sint32.All_Curves_FIX.Curves_Raster_3 Calculated.FIX_sint8_sint8.All_Curves_FIX.Curves_Raster_3 Calculated.FIX_uint16_uint16.All_Curves_FIX.Curves_Raster_3 Calculated.FIX_uint32_uint32.All_Curves_FIX.Curves_Raster_3 Calculated.FIX_uint8_uint8.All_Curves_FIX.Curves_Raster_3 Calculated.GRP_sint16_sint16.All_Curves_GRP.Curves_Raster_3 Calculated.GRP_sint32_sint32.All_Curves_GRP.Curves_Raster_3 Calculated.GRP_sint8_sint8.All_Curves_GRP.Curves_Raster_3 Calculated.GRP_uint16_uint16.All_Curves_GRP.Curves_Raster_3 Calculated.GRP_uint32_uint32.All_Curves_GRP.Curves_Raster_3 Calculated.GRP_uint8_uint8.All_Curves_GRP.Curves_Raster_3 Distr_Set.GRP_sint16_sint16.All_Curves_GRP.Curves_Raster_3 Distr_Set.GRP_sint32_sint32.All_Curves_GRP.Curves_Raster_3 Distr_Set.GRP_sint8_sint8.All_Curves_GRP.Curves_Raster_3 Distr_Set.GRP_uint16_uint16.All_Curves_GRP.Curves_Raster_3 Distr_Set.GRP_uint32_uint32.All_Curves_GRP.Curves_Raster_3 Distr_Set.GRP_uint8_uint8.All_Curves_GRP.Curves_Raster_3 M_In.FIX_sint16_sint16.All_Curves_FIX.Curves_Raster_3 M_In.FIX_sint32_sint32.All_Curves_FIX.Curves_Raster_3 M_In.FIX_sint8_sint8.All_Curves_FIX.Curves_Raster_3 M_In.FIX_uint16_uint16.All_Curves_FIX.Curves_Raster_3 M_In.FIX_uint32_uint32.All_Curves_FIX.Curves_Raster_3 M_In.FIX_uint8_uint8.All_Curves_FIX.Curves_Raster_3 M_In.GRP_sint16_sint16.All_Curves_GRP.Curves_Raster_3 M_In.GRP_sint32_sint32.All_Curves_GRP.Curves_Raster_3 M_In.GRP_sint8_sint8.All_Curves_GRP.Curves_Raster_3 M_In.GRP_uint16_uint16.All_Curves_GRP.Curves_Raster_3 M_In.GRP_uint32_uint32.All_Curves_GRP.Curves_Raster_3 M_In.GRP_uint8_uint8.All_Curves_GRP.Curves_Raster_3 M_out.FIX_sint16_sint16.All_Curves_FIX.Curves_Raster_3 M_out.FIX_sint32_sint32.All_Curves_FIX.Curves_Raster_3 M_out.FIX_sint8_sint8.All_Curves_FIX.Curves_Raster_3 M_out.FIX_uint16_uint16.All_Curves_FIX.Curves_Raster_3 M_out.FIX_uint32_uint32.All_Curves_FIX.Curves_Raster_3 M_out.FIX_uint8_uint8.All_Curves_FIX.Curves_Raster_3 M_out.GRP_sint16_sint16.All_Curves_GRP.Curves_Raster_3 M_out.GRP_sint32_sint32.All_Curves_GRP.Curves_Raster_3 M_out.GRP_sint8_sint8.All_Curves_GRP.Curves_Raster_3 M_out.GRP_uint16_uint16.All_Curves_GRP.Curves_Raster_3 M_out.GRP_uint32_uint32.All_Curves_GRP.Curves_Raster_3 M_out.GRP_uint8_uint8.All_Curves_GRP.Curves_Raster_3 /end REF_MEASUREMENT
 /begin REF_CHARACTERISTIC One_D_1.GRP_sint16_sint16.All_Curves_GRP.Curves_Raster_3 One_D_1.GRP_sint32_sint32.All_Curves_GRP.Curves_Raster_3 One_D_1.GRP_sint8_sint8.All_Curves_GRP.Curves_Raster_3 One_D_1.GRP_uint16_uint16.All_Curves_GRP.Curves_Raster_3 One_D_1.GRP_uint32_uint32.All_Curves_GRP.Curves_Raster_3 One_D_1.GRP_uint8_uint8.All_Curves_GRP.Curves_Raster_3 One_D_Fix.FIX_sint16_sint16.All_Curves_FIX.Curves_Raster_3 One_D_Fix.FIX_sint32_sint32.All_Curves_FIX.Curves_Raster_3 One_D_Fix.FIX_sint8_sint8.All_Curves_FIX.Curves_Raster_3 One_D_Fix.FIX_uint16_uint16.All_Curves_FIX.Curves_Raster_3 One_D_Fix.FIX_uint32_uint32.All_Curves_FIX.Curves_Raster_3 One_D_Fix.FIX_uint8_uint8.All_Curves_FIX.Curves_Raster_3 P_Do_Active_Fix.FIX_sint16_sint16.All_Curves_FIX.Curves_Raster_3 P_Do_Active_Fix.FIX_sint32_sint32.All_Curves_FIX.Curves_Raster_3 P_Do_Active_Fix.FIX_sint8_sint8.All_Curves_FIX.Curves_Raster_3 P_Do_Active_Fix.FIX_uint16_uint16.All_Curves_FIX.Curves_Raster_3 P_Do_Active_Fix.FIX_uint32_uint32.All_Curves_FIX.Curves_Raster_3 P_Do_Active_Fix.FIX_uint8_uint8.All_Curves_FIX.Curves_Raster_3 P_Do_Active_Grp.GRP_sint16_sint16.All_Curves_GRP.Curves_Raster_3 P_Do_Active_Grp.GRP_sint32_sint32.All_Curves_GRP.Curves_Raster_3 P_Do_Active_Grp.GRP_sint8_sint8.All_Curves_GRP.Curves_Raster_3 P_Do_Active_Grp.GRP_uint16_uint16.All_Curves_GRP.Curves_Raster_3 P_Do_Active_Grp.GRP_uint32_uint32.All_Curves_GRP.Curves_Raster_3 P_Do_Active_Grp.GRP_uint8_uint8.All_Curves_GRP.Curves_Raster_3 P_Do_All_FIX_Curves.All_Curves_FIX.Curves_Raster_3 P_Do_All_GRP_Curves.All_Curves_GRP.Curves_Raster_3 P_Do_Grp_get.GRP_sint16_sint16.All_Curves_GRP.Curves_Raster_3 P_Do_Grp_get.GRP_sint32_sint32.All_Curves_GRP.Curves_Raster_3 P_Do_Grp_get.GRP_sint8_sint8.All_Curves_GRP.Curves_Raster_3 P_Do_Grp_get.GRP_uint16_uint16.All_Curves_GRP.Curves_Raster_3 P_Do_Grp_get.GRP_uint32_uint32.All_Curves_GRP.Curves_Raster_3 P_Do_Grp_get.GRP_uint8_uint8.All_Curves_GRP.Curves_Raster_3 P_Do_Grp_set.GRP_sint16_sint16.All_Curves_GRP.Curves_Raster_3 P_Do_Grp_set.GRP_sint32_sint32.All_Curves_GRP.Curves_Raster_3 P_Do_Grp_set.GRP_sint8_sint8.All_Curves_GRP.Curves_Raster_3 P_Do_Grp_set.GRP_uint16_uint16.All_Curves_GRP.Curves_Raster_3 P_Do_Grp_set.GRP_uint32_uint32.All_Curves_GRP.Curves_Raster_3 P_Do_Grp_set.GRP_uint8_uint8.All_Curves_GRP.Curves_Raster_3 P_In.FIX_sint16_sint16.All_Curves_FIX.Curves_Raster_3 P_In.FIX_sint32_sint32.All_Curves_FIX.Curves_Raster_3 P_In.FIX_sint8_sint8.All_Curves_FIX.Curves_Raster_3 P_In.FIX_uint16_uint16.All_Curves_FIX.Curves_Raster_3 P_In.FIX_uint32_uint32.All_Curves_FIX.Curves_Raster_3 P_In.FIX_uint8_uint8.All_Curves_FIX.Curves_Raster_3 P_In.GRP_sint16_sint16.All_Curves_GRP.Curves_Raster_3 P_In.GRP_sint32_sint32.All_Curves_GRP.Curves_Raster_3 P_In.GRP_sint8_sint8.All_Curves_GRP.Curves_Raster_3 P_In.GRP_uint16_uint16.All_Curves_GRP.Curves_Raster_3 P_In.GRP_uint32_uint32.All_Curves_GRP.Curves_Raster_3 P_In.GRP_uint8_uint8.All_Curves_GRP.Curves_Raster_3 /end REF_CHARACTERISTIC
/end GROUP
/begin GROUP FIX_sint16_sint16.All_Curves_FIX.Curves_Raster_1 ""
 /begin REF_MEASUREMENT Calculated.FIX_sint16_sint16.All_Curves_FIX.Curves_Raster_1 M_In.FIX_sint16_sint16.All_Curves_FIX.Curves_Raster_1 M_out.FIX_sint16_sint16.All_Curves_FIX.Curves_Raster_1 /end REF_MEASUREMENT
 /begin REF_CHARACTERISTIC One_D_Fix.FIX_sint16_sint16.All_Curves_FIX.Curves_Raster_1 P_Do_Active_Fix.FIX_sint16_sint16.All_Curves_FIX.Curves_Raster_1 P_In.FIX_sint16_sint16.All_Curves_FIX.Curves_Raster_1 /end REF_CHARACTERISTIC
/end GROUP
/begin GROUP FIX_sint16_sint16.All_Curves_FIX.Curves_Raster_2 ""
 /begin REF_MEASUREMENT Calculated.FIX_sint16_sint16.All_Curves_FIX.Curves_Raster_2 M_In.FIX_sint16_sint16.All_Curves_FIX.Curves_Raster_2 M_out.FIX_sint16_sint16.All_Curves_FIX.Curves_Raster_2 /end REF_MEASUREMENT
 /begin REF_CHARACTERISTIC One_D_Fix.FIX_sint16_sint16.All_Curves_FIX.Curves_Raster_2 P_Do_Active_Fix.FIX_sint16_sint16.All_Curves_FIX.Curves_Raster_2 P_In.FIX_sint16_sint16.All_Curves_FIX.Curves_Raster_2 /end REF_CHARACTERISTIC
/end GROUP
/begin GROUP FIX_sint16_sint16.All_Curves_FIX.Curves_Raster_3 ""
 /begin REF_MEASUREMENT Calculated.FIX_sint16_sint16.All_Curves_FIX.Curves_Raster_3 M_In.FIX_sint16_sint16.All_Curves_FIX.Curves_Raster_3 M_out.FIX_sint16_sint16.All_Curves_FIX.Curves_Raster_3 /end REF_MEASUREMENT
 /begin REF_CHARACTERISTIC One_D_Fix.FIX_sint16_sint16.All_Curves_FIX.Curves_Raster_3 P_Do_Active_Fix.FIX_sint16_sint16.All_Curves_FIX.Curves_Raster_3 P_In.FIX_sint16_sint16.All_Curves_FIX.Curves_Raster_3 /end REF_CHARACTERISTIC
/end GROUP
/begin GROUP FIX_sint32_sint32.All_Curves_FIX.Curves_Raster_1 ""
 /begin REF_MEASUREMENT Calculated.FIX_sint32_sint32.All_Curves_FIX.Curves_Raster_1 M_In.FIX_sint32_sint32.All_Curves_FIX.Curves_Raster_1 M_out.FIX_sint32_sint32.All_Curves_FIX.Curves_Raster_1 /end REF_MEASUREMENT
 /begin REF_CHARACTERISTIC One_D_Fix.FIX_sint32_sint32.All_Curves_FIX.Curves_Raster_1 P_Do_Active_Fix.FIX_sint32_sint32.All_Curves_FIX.Curves_Raster_1 P_In.FIX_sint32_sint32.All_Curves_FIX.Curves_Raster_1 /end REF_CHARACTERISTIC
/end GROUP
/begin GROUP FIX_sint32_sint32.All_Curves_FIX.Curves_Raster_2 ""
 /begin REF_MEASUREMENT Calculated.FIX_sint32_sint32.All_Curves_FIX.Curves_Raster_2 M_In.FIX_sint32_sint32.All_Curves_FIX.Curves_Raster_2 M_out.FIX_sint32_sint32.All_Curves_FIX.Curves_Raster_2 /end REF_MEASUREMENT
 /begin REF_CHARACTERISTIC One_D_Fix.FIX_sint32_sint32.All_Curves_FIX.Curves_Raster_2 P_Do_Active_Fix.FIX_sint32_sint32.All_Curves_FIX.Curves_Raster_2 P_In.FIX_sint32_sint32.All_Curves_FIX.Curves_Raster_2 /end REF_CHARACTERISTIC
/end GROUP
/begin GROUP FIX_sint32_sint32.All_Curves_FIX.Curves_Raster_3 ""
 /begin REF_MEASUREMENT Calculated.FIX_sint32_sint32.All_Curves_FIX.Curves_Raster_3 M_In.FIX_sint32_sint32.All_Curves_FIX.Curves_Raster_3 M_out.FIX_sint32_sint32.All_Curves_FIX.Curves_Raster_3 /end REF_MEASUREMENT
 /begin REF_CHARACTERISTIC One_D_Fix.FIX_sint32_sint32.All_Curves_FIX.Curves_Raster_3 P_Do_Active_Fix.FIX_sint32_sint32.All_Curves_FIX.Curves_Raster_3 P_In.FIX_sint32_sint32.All_Curves_FIX.Curves_Raster_3 /end REF_CHARACTERISTIC
/end GROUP
/begin GROUP FIX_sint8_sint8.All_Curves_FIX.Curves_Raster_1 ""
 /begin REF_MEASUREMENT Calculated.FIX_sint8_sint8.All_Curves_FIX.Curves_Raster_1 M_In.FIX_sint8_sint8.All_Curves_FIX.Curves_Raster_1 M_out.FIX_sint8_sint8.All_Curves_FIX.Curves_Raster_1 /end REF_MEASUREMENT
 /begin REF_CHARACTERISTIC One_D_Fix.FIX_sint8_sint8.All_Curves_FIX.Curves_Raster_1 P_Do_Active_Fix.FIX_sint8_sint8.All_Curves_FIX.Curves_Raster_1 P_In.FIX_sint8_sint8.All_Curves_FIX.Curves_Raster_1 /end REF_CHARACTERISTIC
/end GROUP
/begin GROUP FIX_sint8_sint8.All_Curves_FIX.Curves_Raster_2 ""
 /begin REF_MEASUREMENT Calculated.FIX_sint8_sint8.All_Curves_FIX.Curves_Raster_2 M_In.FIX_sint8_sint8.All_Curves_FIX.Curves_Raster_2 M_out.FIX_sint8_sint8.All_Curves_FIX.Curves_Raster_2 /end REF_MEASUREMENT
 /begin REF_CHARACTERISTIC One_D_Fix.FIX_sint8_sint8.All_Curves_FIX.Curves_Raster_2 P_Do_Active_Fix.FIX_sint8_sint8.All_Curves_FIX.Curves_Raster_2 P_In.FIX_sint8_sint8.All_Curves_FIX.Curves_Raster_2 /end REF_CHARACTERISTIC
/end GROUP
/begin GROUP FIX_sint8_sint8.All_Curves_FIX.Curves_Raster_3 ""
 /begin REF_MEASUREMENT Calculated.FIX_sint8_sint8.All_Curves_FIX.Curves_Raster_3 M_In.FIX_sint8_sint8.All_Curves_FIX.Curves_Raster_3 M_out.FIX_sint8_sint8.All_Curves_FIX.Curves_Raster_3 /end REF_MEASUREMENT
 /begin REF_CHARACTERISTIC One_D_Fix.FIX_sint8_sint8.All_Curves_FIX.Curves_Raster_3 P_Do_Active_Fix.FIX_sint8_sint8.All_Curves_FIX.Curves_Raster_3 P_In.FIX_sint8_sint8.All_Curves_FIX.Curves_Raster_3 /end REF_CHARACTERISTIC
/end GROUP
/begin GROUP FIX_uint16_uint16.All_Curves_FIX.Curves_Raster_1 ""
 /begin REF_MEASUREMENT Calculated.FIX_uint16_uint16.All_Curves_FIX.Curves_Raster_1 M_In.FIX_uint16_uint16.All_Curves_FIX.Curves_Raster_1 M_out.FIX_uint16_uint16.All_Curves_FIX.Curves_Raster_1 /end REF_MEASUREMENT
 /begin REF_CHARACTERISTIC One_D_Fix.FIX_uint16_uint16.All_Curves_FIX.Curves_Raster_1 P_Do_Active_Fix.FIX_uint16_uint16.All_Curves_FIX.Curves_Raster_1 P_In.FIX_uint16_uint16.All_Curves_FIX.Curves_Raster_1 /end REF_CHARACTERISTIC
/end GROUP
/begin GROUP FIX_uint16_uint16.All_Curves_FIX.Curves_Raster_2 ""
 /begin REF_MEASUREMENT Calculated.FIX_uint16_uint16.All_Curves_FIX.Curves_Raster_2 M_In.FIX_uint16_uint16.All_Curves_FIX.Curves_Raster_2 M_out.FIX_uint16_uint16.All_Curves_FIX.Curves_Raster_2 /end REF_MEASUREMENT
 /begin REF_CHARACTERISTIC One_D_Fix.FIX_uint16_uint16.All_Curves_FIX.Curves_Raster_2 P_Do_Active_Fix.FIX_uint16_uint16.All_Curves_FIX.Curves_Raster_2 P_In.FIX_uint16_uint16.All_Curves_FIX.Curves_Raster_2 /end REF_CHARACTERISTIC
/end GROUP
/begin GROUP FIX_uint16_uint16.All_Curves_FIX.Curves_Raster_3 ""
 /begin REF_MEASUREMENT Calculated.FIX_uint16_uint16.All_Curves_FIX.Curves_Raster_3 M_In.FIX_uint16_uint16.All_Curves_FIX.Curves_Raster_3 M_out.FIX_uint16_uint16.All_Curves_FIX.Curves_Raster_3 /end REF_MEASUREMENT
 /begin REF_CHARACTERISTIC One_D_Fix.FIX_uint16_uint16.All_Curves_FIX.Curves_Raster_3 P_Do_Active_Fix.FIX_uint16_uint16.All_Curves_FIX.Curves_Raster_3 P_In.FIX_uint16_uint16.All_Curves_FIX.Curves_Raster_3 /end REF_CHARACTERISTIC
/end GROUP
/begin GROUP FIX_uint32_uint32.All_Curves_FIX.Curves_Raster_1 ""
 /begin REF_MEASUREMENT Calculated.FIX_uint32_uint32.All_Curves_FIX.Curves_Raster_1 M_In.FIX_uint32_uint32.All_Curves_FIX.Curves_Raster_1 M_out.FIX_uint32_uint32.All_Curves_FIX.Curves_Raster_1 /end REF_MEASUREMENT
 /begin REF_CHARACTERISTIC One_D_Fix.FIX_uint32_uint32.All_Curves_FIX.Curves_Raster_1 P_Do_Active_Fix.FIX_uint32_uint32.All_Curves_FIX.Curves_Raster_1 P_In.FIX_uint32_uint32.All_Curves_FIX.Curves_Raster_1 /end REF_CHARACTERISTIC
/end GROUP
/begin GROUP FIX_uint32_uint32.All_Curves_FIX.Curves_Raster_2 ""
 /begin REF_MEASUREMENT Calculated.FIX_uint32_uint32.All_Curves_FIX.Curves_Raster_2 M_In.FIX_uint32_uint32.All_Curves_FIX.Curves_Raster_2 M_out.FIX_uint32_uint32.All_Curves_FIX.Curves_Raster_2 /end REF_MEASUREMENT
 /begin REF_CHARACTERISTIC One_D_Fix.FIX_uint32_uint32.All_Curves_FIX.Curves_Raster_2 P_Do_Active_Fix.FIX_uint32_uint32.All_Curves_FIX.Curves_Raster_2 P_In.FIX_uint32_uint32.All_Curves_FIX.Curves_Raster_2 /end REF_CHARACTERISTIC
/end GROUP
/begin GROUP FIX_uint32_uint32.All_Curves_FIX.Curves_Raster_3 ""
 /begin REF_MEASUREMENT Calculated.FIX_uint32_uint32.All_Curves_FIX.Curves_Raster_3 M_In.FIX_uint32_uint32.All_Curves_FIX.Curves_Raster_3 M_out.FIX_uint32_uint32.All_Curves_FIX.Curves_Raster_3 /end REF_MEASUREMENT
 /begin REF_CHARACTERISTIC One_D_Fix.FIX_uint32_uint32.All_Curves_FIX.Curves_Raster_3 P_Do_Active_Fix.FIX_uint32_uint32.All_Curves_FIX.Curves_Raster_3 P_In.FIX_uint32_uint32.All_Curves_FIX.Curves_Raster_3 /end REF_CHARACTERISTIC
/end GROUP
/begin GROUP FIX_uint8_uint8.All_Curves_FIX.Curves_Raster_1 ""
 /begin REF_MEASUREMENT Calculated.FIX_uint8_uint8.All_Curves_FIX.Curves_Raster_1 M_In.FIX_uint8_uint8.All_Curves_FIX.Curves_Raster_1 M_out.FIX_uint8_uint8.All_Curves_FIX.Curves_Raster_1 /end REF_MEASUREMENT
 /begin REF_CHARACTERISTIC One_D_Fix.FIX_uint8_uint8.All_Curves_FIX.Curves_Raster_1 P_Do_Active_Fix.FIX_uint8_uint8.All_Curves_FIX.Curves_Raster_1 P_In.FIX_uint8_uint8.All_Curves_FIX.Curves_Raster_1 /end REF_CHARACTERISTIC
/end GROUP
/begin GROUP FIX_uint8_uint8.All_Curves_FIX.Curves_Raster_2 ""
 /begin REF_MEASUREMENT Calculated.FIX_uint8_uint8.All_Curves_FIX.Curves_Raster_2 M_In.FIX_uint8_uint8.All_Curves_FIX.Curves_Raster_2 M_out.FIX_uint8_uint8.All_Curves_FIX.Curves_Raster_2 /end REF_MEASUREMENT
 /begin REF_CHARACTERISTIC One_D_Fix.FIX_uint8_uint8.All_Curves_FIX.Curves_Raster_2 P_Do_Active_Fix.FIX_uint8_uint8.All_Curves_FIX.Curves_Raster_2 P_In.FIX_uint8_uint8.All_Curves_FIX.Curves_Raster_2 /end REF_CHARACTERISTIC
/end GROUP
/begin GROUP FIX_uint8_uint8.All_Curves_FIX.Curves_Raster_3 ""
 /begin REF_MEASUREMENT Calculated.FIX_uint8_uint8.All_Curves_FIX.Curves_Raster_3 M_In.FIX_uint8_uint8.All_Curves_FIX.Curves_Raster_3 M_out.FIX_uint8_uint8.All_Curves_FIX.Curves_Raster_3 /end REF_MEASUREMENT
 /begin REF_CHARACTERISTIC One_D_Fix.FIX_uint8_uint8.All_Curves_FIX.Curves_Raster_3 P_Do_Active_Fix.FIX_uint8_uint8.All_Curves_FIX.Curves_Raster_3 P_In.FIX_uint8_uint8.All_Curves_FIX.Curves_Raster_3 /end REF_CHARACTERISTIC
/end GROUP
/begin GROUP FlashFake.ALL_PROT "" /begin REF_MEASUREMENT g_FlashFake_u8.FlashFake.ALL_PROT /end REF_MEASUREMENT /begin REF_CHARACTERISTIC p_FlashFake_u8.FlashFake.ALL_PROT /end REF_CHARACTERISTIC /end GROUP
/begin GROUP GRP_sint16_sint16.All_Curves_GRP.Curves_Raster_1 ""
 /begin REF_MEASUREMENT Calculated.GRP_sint16_sint16.All_Curves_GRP.Curves_Raster_1 Distr_Set.GRP_sint16_sint16.All_Curves_GRP.Curves_Raster_1 M_In.GRP_sint16_sint16.All_Curves_GRP.Curves_Raster_1 M_out.GRP_sint16_sint16.All_Curves_GRP.Curves_Raster_1 /end REF_MEASUREMENT
 /begin REF_CHARACTERISTIC One_D_1.GRP_sint16_sint16.All_Curves_GRP.Curves_Raster_1 P_Do_Active_Grp.GRP_sint16_sint16.All_Curves_GRP.Curves_Raster_1 P_Do_Grp_get.GRP_sint16_sint16.All_Curves_GRP.Curves_Raster_1 P_Do_Grp_set.GRP_sint16_sint16.All_Curves_GRP.Curves_Raster_1 P_In.GRP_sint16_sint16.All_Curves_GRP.Curves_Raster_1 /end REF_CHARACTERISTIC
/end GROUP
/begin GROUP GRP_sint16_sint16.All_Curves_GRP.Curves_Raster_2 ""
 /begin REF_MEASUREMENT Calculated.GRP_sint16_sint16.All_Curves_GRP.Curves_Raster_2 Distr_Set.GRP_sint16_sint16.All_Curves_GRP.Curves_Raster_2 M_In.GRP_sint16_sint16.All_Curves_GRP.Curves_Raster_2 M_out.GRP_sint16_sint16.All_Curves_GRP.Curves_Raster_2 /end REF_MEASUREMENT
 /begin REF_CHARACTERISTIC One_D_1.GRP_sint16_sint16.All_Curves_GRP.Curves_Raster_2 P_Do_Active_Grp.GRP_sint16_sint16.All_Curves_GRP.Curves_Raster_2 P_Do_Grp_get.GRP_sint16_sint16.All_Curves_GRP.Curves_Raster_2 P_Do_Grp_set.GRP_sint16_sint16.All_Curves_GRP.Curves_Raster_2 P_In.GRP_sint16_sint16.All_Curves_GRP.Curves_Raster_2 /end REF_CHARACTERISTIC
/end GROUP
/begin GROUP GRP_sint16_sint16.All_Curves_GRP.Curves_Raster_3 ""
 /begin REF_MEASUREMENT Calculated.GRP_sint16_sint16.All_Curves_GRP.Curves_Raster_3 Distr_Set.GRP_sint16_sint16.All_Curves_GRP.Curves_Raster_3 M_In.GRP_sint16_sint16.All_Curves_GRP.Curves_Raster_3 M_out.GRP_sint16_sint16.All_Curves_GRP.Curves_Raster_3 /end REF_MEASUREMENT
 /begin REF_CHARACTERISTIC One_D_1.GRP_sint16_sint16.All_Curves_GRP.Curves_Raster_3 P_Do_Active_Grp.GRP_sint16_sint16.All_Curves_GRP.Curves_Raster_3 P_Do_Grp_get.GRP_sint16_sint16.All_Curves_GRP.Curves_Raster_3 P_Do_Grp_set.GRP_sint16_sint16.All_Curves_GRP.Curves_Raster_3 P_In.GRP_sint16_sint16.All_Curves_GRP.Curves_Raster_3 /end REF_CHARACTERISTIC
/end GROUP
/begin GROUP GRP_sint32_sint32.All_Curves_GRP.Curves_Raster_1 ""
 /begin REF_MEASUREMENT Calculated.GRP_sint32_sint32.All_Curves_GRP.Curves_Raster_1 Distr_Set.GRP_sint32_sint32.All_Curves_GRP.Curves_Raster_1 M_In.GRP_sint32_sint32.All_Curves_GRP.Curves_Raster_1 M_out.GRP_sint32_sint32.All_Curves_GRP.Curves_Raster_1 /end REF_MEASUREMENT
 /begin REF_CHARACTERISTIC One_D_1.GRP_sint32_sint32.All_Curves_GRP.Curves_Raster_1 P_Do_Active_Grp.GRP_sint32_sint32.All_Curves_GRP.Curves_Raster_1 P_Do_Grp_get.GRP_sint32_sint32.All_Curves_GRP.Curves_Raster_1 P_Do_Grp_set.GRP_sint32_sint32.All_Curves_GRP.Curves_Raster_1 P_In.GRP_sint32_sint32.All_Curves_GRP.Curves_Raster_1 /end REF_CHARACTERISTIC
/end GROUP
/begin GROUP GRP_sint32_sint32.All_Curves_GRP.Curves_Raster_2 ""
 /begin REF_MEASUREMENT Calculated.GRP_sint32_sint32.All_Curves_GRP.Curves_Raster_2 Distr_Set.GRP_sint32_sint32.All_Curves_GRP.Curves_Raster_2 M_In.GRP_sint32_sint32.All_Curves_GRP.Curves_Raster_2 M_out.GRP_sint32_sint32.All_Curves_GRP.Curves_Raster_2 /end REF_MEASUREMENT
 /begin REF_CHARACTERISTIC One_D_1.GRP_sint32_sint32.All_Curves_GRP.Curves_Raster_2 P_Do_Active_Grp.GRP_sint32_sint32.All_Curves_GRP.Curves_Raster_2 P_Do_Grp_get.GRP_sint32_sint32.All_Curves_GRP.Curves_Raster_2 P_Do_Grp_set.GRP_sint32_sint32.All_Curves_GRP.Curves_Raster_2 P_In.GRP_sint32_sint32.All_Curves_GRP.Curves_Raster_2 /end REF_CHARACTERISTIC
/end GROUP
/begin GROUP GRP_sint32_sint32.All_Curves_GRP.Curves_Raster_3 ""
 /begin REF_MEASUREMENT Calculated.GRP_sint32_sint32.All_Curves_GRP.Curves_Raster_3 Distr_Set.GRP_sint32_sint32.All_Curves_GRP.Curves_Raster_3 M_In.GRP_sint32_sint32.All_Curves_GRP.Curves_Raster_3 M_out.GRP_sint32_sint32.All_Curves_GRP.Curves_Raster_3 /end REF_MEASUREMENT
 /begin REF_CHARACTERISTIC One_D_1.GRP_sint32_sint32.All_Curves_GRP.Curves_Raster_3 P_Do_Active_Grp.GRP_sint32_sint32.All_Curves_GRP.Curves_Raster_3 P_Do_Grp_get.GRP_sint32_sint32.All_Curves_GRP.Curves_Raster_3 P_Do_Grp_set.GRP_sint32_sint32.All_Curves_GRP.Curves_Raster_3 P_In.GRP_sint32_sint32.All_Curves_GRP.Curves_Raster_3 /end REF_CHARACTERISTIC
/end GROUP
/begin GROUP GRP_sint8_sint8.All_Curves_GRP.Curves_Raster_1 ""
 /begin REF_MEASUREMENT Calculated.GRP_sint8_sint8.All_Curves_GRP.Curves_Raster_1 Distr_Set.GRP_sint8_sint8.All_Curves_GRP.Curves_Raster_1 M_In.GRP_sint8_sint8.All_Curves_GRP.Curves_Raster_1 M_out.GRP_sint8_sint8.All_Curves_GRP.Curves_Raster_1 /end REF_MEASUREMENT
 /begin REF_CHARACTERISTIC One_D_1.GRP_sint8_sint8.All_Curves_GRP.Curves_Raster_1 P_Do_Active_Grp.GRP_sint8_sint8.All_Curves_GRP.Curves_Raster_1 P_Do_Grp_get.GRP_sint8_sint8.All_Curves_GRP.Curves_Raster_1 P_Do_Grp_set.GRP_sint8_sint8.All_Curves_GRP.Curves_Raster_1 P_In.GRP_sint8_sint8.All_Curves_GRP.Curves_Raster_1 /end REF_CHARACTERISTIC
/end GROUP
/begin GROUP GRP_sint8_sint8.All_Curves_GRP.Curves_Raster_2 ""
 /begin REF_MEASUREMENT Calculated.GRP_sint8_sint8.All_Curves_GRP.Curves_Raster_2 Distr_Set.GRP_sint8_sint8.All_Curves_GRP.Curves_Raster_2 M_In.GRP_sint8_sint8.All_Curves_GRP.Curves_Raster_2 M_out.GRP_sint8_sint8.All_Curves_GRP.Curves_Raster_2 /end REF_MEASUREMENT
 /begin REF_CHARACTERISTIC One_D_1.GRP_sint8_sint8.All_Curves_GRP.Curves_Raster_2 P_Do_Active_Grp.GRP_sint8_sint8.All_Curves_GRP.Curves_Raster_2 P_Do_Grp_get.GRP_sint8_sint8.All_Curves_GRP.Curves_Raster_2 P_Do_Grp_set.GRP_sint8_sint8.All_Curves_GRP.Curves_Raster_2 P_In.GRP_sint8_sint8.All_Curves_GRP.Curves_Raster_2 /end REF_CHARACTERISTIC
/end GROUP
/begin GROUP GRP_sint8_sint8.All_Curves_GRP.Curves_Raster_3 ""
 /begin REF_MEASUREMENT Calculated.GRP_sint8_sint8.All_Curves_GRP.Curves_Raster_3 Distr_Set.GRP_sint8_sint8.All_Curves_GRP.Curves_Raster_3 M_In.GRP_sint8_sint8.All_Curves_GRP.Curves_Raster_3 M_out.GRP_sint8_sint8.All_Curves_GRP.Curves_Raster_3 /end REF_MEASUREMENT
 /begin REF_CHARACTERISTIC One_D_1.GRP_sint8_sint8.All_Curves_GRP.Curves_Raster_3 P_Do_Active_Grp.GRP_sint8_sint8.All_Curves_GRP.Curves_Raster_3 P_Do_Grp_get.GRP_sint8_sint8.All_Curves_GRP.Curves_Raster_3 P_Do_Grp_set.GRP_sint8_sint8.All_Curves_GRP.Curves_Raster_3 P_In.GRP_sint8_sint8.All_Curves_GRP.Curves_Raster_3 /end REF_CHARACTERISTIC
/end GROUP
/begin GROUP GRP_uint16_uint16.All_Curves_GRP.Curves_Raster_1 ""
 /begin REF_MEASUREMENT Calculated.GRP_uint16_uint16.All_Curves_GRP.Curves_Raster_1 Distr_Set.GRP_uint16_uint16.All_Curves_GRP.Curves_Raster_1 M_In.GRP_uint16_uint16.All_Curves_GRP.Curves_Raster_1 M_out.GRP_uint16_uint16.All_Curves_GRP.Curves_Raster_1 /end REF_MEASUREMENT
 /begin REF_CHARACTERISTIC One_D_1.GRP_uint16_uint16.All_Curves_GRP.Curves_Raster_1 P_Do_Active_Grp.GRP_uint16_uint16.All_Curves_GRP.Curves_Raster_1 P_Do_Grp_get.GRP_uint16_uint16.All_Curves_GRP.Curves_Raster_1 P_Do_Grp_set.GRP_uint16_uint16.All_Curves_GRP.Curves_Raster_1 P_In.GRP_uint16_uint16.All_Curves_GRP.Curves_Raster_1 /end REF_CHARACTERISTIC
/end GROUP
/begin GROUP GRP_uint16_uint16.All_Curves_GRP.Curves_Raster_2 ""
 /begin REF_MEASUREMENT Calculated.GRP_uint16_uint16.All_Curves_GRP.Curves_Raster_2 Distr_Set.GRP_uint16_uint16.All_Curves_GRP.Curves_Raster_2 M_In.GRP_uint16_uint16.All_Curves_GRP.Curves_Raster_2 M_out.GRP_uint16_uint16.All_Curves_GRP.Curves_Raster_2 /end REF_MEASUREMENT
 /begin REF_CHARACTERISTIC One_D_1.GRP_uint16_uint16.All_Curves_GRP.Curves_Raster_2 P_Do_Active_Grp.GRP_uint16_uint16.All_Curves_GRP.Curves_Raster_2 P_Do_Grp_get.GRP_uint16_uint16.All_Curves_GRP.Curves_Raster_2 P_Do_Grp_set.GRP_uint16_uint16.All_Curves_GRP.Curves_Raster_2 P_In.GRP_uint16_uint16.All_Curves_GRP.Curves_Raster_2 /end REF_CHARACTERISTIC
/end GROUP
/begin GROUP GRP_uint16_uint16.All_Curves_GRP.Curves_Raster_3 ""
 /begin REF_MEASUREMENT Calculated.GRP_uint16_uint16.All_Curves_GRP.Curves_Raster_3 Distr_Set.GRP_uint16_uint16.All_Curves_GRP.Curves_Raster_3 M_In.GRP_uint16_uint16.All_Curves_GRP.Curves_Raster_3 M_out.GRP_uint16_uint16.All_Curves_GRP.Curves_Raster_3 /end REF_MEASUREMENT
 /begin REF_CHARACTERISTIC One_D_1.GRP_uint16_uint16.All_Curves_GRP.Curves_Raster_3 P_Do_Active_Grp.GRP_uint16_uint16.All_Curves_GRP.Curves_Raster_3 P_Do_Grp_get.GRP_uint16_uint16.All_Curves_GRP.Curves_Raster_3 P_Do_Grp_set.GRP_uint16_uint16.All_Curves_GRP.Curves_Raster_3 P_In.GRP_uint16_uint16.All_Curves_GRP.Curves_Raster_3 /end REF_CHARACTERISTIC
/end GROUP
/begin GROUP GRP_uint32_uint32.All_Curves_GRP.Curves_Raster_1 ""
 /begin REF_MEASUREMENT Calculated.GRP_uint32_uint32.All_Curves_GRP.Curves_Raster_1 Distr_Set.GRP_uint32_uint32.All_Curves_GRP.Curves_Raster_1 M_In.GRP_uint32_uint32.All_Curves_GRP.Curves_Raster_1 M_out.GRP_uint32_uint32.All_Curves_GRP.Curves_Raster_1 /end REF_MEASUREMENT
 /begin REF_CHARACTERISTIC One_D_1.GRP_uint32_uint32.All_Curves_GRP.Curves_Raster_1 P_Do_Active_Grp.GRP_uint32_uint32.All_Curves_GRP.Curves_Raster_1 P_Do_Grp_get.GRP_uint32_uint32.All_Curves_GRP.Curves_Raster_1 P_Do_Grp_set.GRP_uint32_uint32.All_Curves_GRP.Curves_Raster_1 P_In.GRP_uint32_uint32.All_Curves_GRP.Curves_Raster_1 /end REF_CHARACTERISTIC
/end GROUP
/begin GROUP GRP_uint32_uint32.All_Curves_GRP.Curves_Raster_2 ""
 /begin REF_MEASUREMENT Calculated.GRP_uint32_uint32.All_Curves_GRP.Curves_Raster_2 Distr_Set.GRP_uint32_uint32.All_Curves_GRP.Curves_Raster_2 M_In.GRP_uint32_uint32.All_Curves_GRP.Curves_Raster_2 M_out.GRP_uint32_uint32.All_Curves_GRP.Curves_Raster_2 /end REF_MEASUREMENT
 /begin REF_CHARACTERISTIC One_D_1.GRP_uint32_uint32.All_Curves_GRP.Curves_Raster_2 P_Do_Active_Grp.GRP_uint32_uint32.All_Curves_GRP.Curves_Raster_2 P_Do_Grp_get.GRP_uint32_uint32.All_Curves_GRP.Curves_Raster_2 P_Do_Grp_set.GRP_uint32_uint32.All_Curves_GRP.Curves_Raster_2 P_In.GRP_uint32_uint32.All_Curves_GRP.Curves_Raster_2 /end REF_CHARACTERISTIC
/end GROUP
/begin GROUP GRP_uint32_uint32.All_Curves_GRP.Curves_Raster_3 ""
 /begin REF_MEASUREMENT Calculated.GRP_uint32_uint32.All_Curves_GRP.Curves_Raster_3 Distr_Set.GRP_uint32_uint32.All_Curves_GRP.Curves_Raster_3 M_In.GRP_uint32_uint32.All_Curves_GRP.Curves_Raster_3 M_out.GRP_uint32_uint32.All_Curves_GRP.Curves_Raster_3 /end REF_MEASUREMENT
 /begin REF_CHARACTERISTIC One_D_1.GRP_uint32_uint32.All_Curves_GRP.Curves_Raster_3 P_Do_Active_Grp.GRP_uint32_uint32.All_Curves_GRP.Curves_Raster_3 P_Do_Grp_get.GRP_uint32_uint32.All_Curves_GRP.Curves_Raster_3 P_Do_Grp_set.GRP_uint32_uint32.All_Curves_GRP.Curves_Raster_3 P_In.GRP_uint32_uint32.All_Curves_GRP.Curves_Raster_3 /end REF_CHARACTERISTIC
/end GROUP
/begin GROUP GRP_uint8_uint8.All_Curves_GRP.Curves_Raster_1 ""
 /begin REF_MEASUREMENT Calculated.GRP_uint8_uint8.All_Curves_GRP.Curves_Raster_1 Distr_Set.GRP_uint8_uint8.All_Curves_GRP.Curves_Raster_1 M_In.GRP_uint8_uint8.All_Curves_GRP.Curves_Raster_1 M_out.GRP_uint8_uint8.All_Curves_GRP.Curves_Raster_1 /end REF_MEASUREMENT
 /begin REF_CHARACTERISTIC One_D_1.GRP_uint8_uint8.All_Curves_GRP.Curves_Raster_1 P_Do_Active_Grp.GRP_uint8_uint8.All_Curves_GRP.Curves_Raster_1 P_Do_Grp_get.GRP_uint8_uint8.All_Curves_GRP.Curves_Raster_1 P_Do_Grp_set.GRP_uint8_uint8.All_Curves_GRP.Curves_Raster_1 P_In.GRP_uint8_uint8.All_Curves_GRP.Curves_Raster_1 /end REF_CHARACTERISTIC
/end GROUP
/begin GROUP GRP_uint8_uint8.All_Curves_GRP.Curves_Raster_2 ""
 /begin REF_MEASUREMENT Calculated.GRP_uint8_uint8.All_Curves_GRP.Curves_Raster_2 Distr_Set.GRP_uint8_uint8.All_Curves_GRP.Curves_Raster_2 M_In.GRP_uint8_uint8.All_Curves_GRP.Curves_Raster_2 M_out.GRP_uint8_uint8.All_Curves_GRP.Curves_Raster_2 /end REF_MEASUREMENT
 /begin REF_CHARACTERISTIC One_D_1.GRP_uint8_uint8.All_Curves_GRP.Curves_Raster_2 P_Do_Active_Grp.GRP_uint8_uint8.All_Curves_GRP.Curves_Raster_2 P_Do_Grp_get.GRP_uint8_uint8.All_Curves_GRP.Curves_Raster_2 P_Do_Grp_set.GRP_uint8_uint8.All_Curves_GRP.Curves_Raster_2 P_In.GRP_uint8_uint8.All_Curves_GRP.Curves_Raster_2 /end REF_CHARACTERISTIC
/end GROUP
/begin GROUP GRP_uint8_uint8.All_Curves_GRP.Curves_Raster_3 ""
 /begin REF_MEASUREMENT Calculated.GRP_uint8_uint8.All_Curves_GRP.Curves_Raster_3 Distr_Set.GRP_uint8_uint8.All_Curves_GRP.Curves_Raster_3 M_In.GRP_uint8_uint8.All_Curves_GRP.Curves_Raster_3 M_out.GRP_uint8_uint8.All_Curves_GRP.Curves_Raster_3 /end REF_MEASUREMENT
 /begin REF_CHARACTERISTIC One_D_1.GRP_uint8_uint8.All_Curves_GRP.Curves_Raster_3 P_Do_Active_Grp.GRP_uint8_uint8.All_Curves_GRP.Curves_Raster_3 P_Do_Grp_get.GRP_uint8_uint8.All_Curves_GRP.Curves_Raster_3 P_Do_Grp_set.GRP_uint8_uint8.All_Curves_GRP.Curves_Raster_3 P_In.GRP_uint8_uint8.All_Curves_GRP.Curves_Raster_3 /end REF_CHARACTERISTIC
/end GROUP
/begin GROUP Restart_Raster_16T "" ROOT
 /begin REF_MEASUREMENT dT_Raster.AT2ms.Restart_Raster_16T dT_Raster.ATRestartRaster.Restart_Raster_16T mem_alarm_cycle.AT2ms.Restart_Raster_16T mem_alarm_cycle.ATRestartRaster.Restart_Raster_16T /end REF_MEASUREMENT
 /begin REF_CHARACTERISTIC Alarm_ID.AT2ms.Restart_Raster_16T Alarm_ID.ATRestartRaster.Restart_Raster_16T P_alarm_cycle.AT2ms.Restart_Raster_16T P_alarm_cycle.ATRestartRaster.Restart_Raster_16T P_alarm_cycle_delay.AT2ms.Restart_Raster_16T P_alarm_cycle_delay.ATRestartRaster.Restart_Raster_16T /end REF_CHARACTERISTIC
/end GROUP
/begin GROUP SERAM_PageControl.ALL_PROT "" /begin REF_MEASUREMENT ActivePage.SERAM_PageControl.ALL_PROT /end REF_MEASUREMENT
 /begin REF_CHARACTERISTIC P_PageSwitch.SERAM_PageControl.ALL_PROT p_SeramCheckParamRange_u8.SERAM_PageControl.ALL_PROT /end REF_CHARACTERISTIC
/end GROUP
/begin GROUP STD_sint16_sint16.All_Curves_STD.Curves_Raster_1 ""
 /begin REF_MEASUREMENT Calculated.STD_sint16_sint16.All_Curves_STD.Curves_Raster_1 M_In.STD_sint16_sint16.All_Curves_STD.Curves_Raster_1 M_out.STD_sint16_sint16.All_Curves_STD.Curves_Raster_1 /end REF_MEASUREMENT
 /begin REF_CHARACTERISTIC One_D.STD_sint16_sint16.All_Curves_STD.Curves_Raster_1 P_Do_Active_Std.STD_sint16_sint16.All_Curves_STD.Curves_Raster_1 P_In.STD_sint16_sint16.All_Curves_STD.Curves_Raster_1 /end REF_CHARACTERISTIC
/end GROUP
/begin GROUP STD_sint32_sint32.All_Curves_STD.Curves_Raster_1 ""
 /begin REF_MEASUREMENT Calculated.STD_sint32_sint32.All_Curves_STD.Curves_Raster_1 M_In.STD_sint32_sint32.All_Curves_STD.Curves_Raster_1 M_out.STD_sint32_sint32.All_Curves_STD.Curves_Raster_1 /end REF_MEASUREMENT
 /begin REF_CHARACTERISTIC One_D.STD_sint32_sint32.All_Curves_STD.Curves_Raster_1 P_Do_Active_Std.STD_sint32_sint32.All_Curves_STD.Curves_Raster_1 P_In.STD_sint32_sint32.All_Curves_STD.Curves_Raster_1 /end REF_CHARACTERISTIC
/end GROUP
/begin GROUP STD_sint8_sint8.All_Curves_STD.Curves_Raster_1 ""
 /begin REF_MEASUREMENT Calculated.STD_sint8_sint8.All_Curves_STD.Curves_Raster_1 M_In.STD_sint8_sint8.All_Curves_STD.Curves_Raster_1 M_out.STD_sint8_sint8.All_Curves_STD.Curves_Raster_1 /end REF_MEASUREMENT
 /begin REF_CHARACTERISTIC One_D.STD_sint8_sint8.All_Curves_STD.Curves_Raster_1 P_Do_Active_Std.STD_sint8_sint8.All_Curves_STD.Curves_Raster_1 P_In.STD_sint8_sint8.All_Curves_STD.Curves_Raster_1 /end REF_CHARACTERISTIC
/end GROUP
/begin GROUP STD_uint16_uint16.All_Curves_STD.Curves_Raster_1 ""
 /begin REF_MEASUREMENT Calculated.STD_uint16_uint16.All_Curves_STD.Curves_Raster_1 M_In.STD_uint16_uint16.All_Curves_STD.Curves_Raster_1 M_out.STD_uint16_uint16.All_Curves_STD.Curves_Raster_1 /end REF_MEASUREMENT
 /begin REF_CHARACTERISTIC One_D.STD_uint16_uint16.All_Curves_STD.Curves_Raster_1 P_Do_Active_Std.STD_uint16_uint16.All_Curves_STD.Curves_Raster_1 P_In.STD_uint16_uint16.All_Curves_STD.Curves_Raster_1 /end REF_CHARACTERISTIC
/end GROUP
/begin GROUP STD_uint32_uint32.All_Curves_STD.Curves_Raster_1 ""
 /begin REF_MEASUREMENT Calculated.STD_uint32_uint32.All_Curves_STD.Curves_Raster_1 M_In.STD_uint32_uint32.All_Curves_STD.Curves_Raster_1 M_out.STD_uint32_uint32.All_Curves_STD.Curves_Raster_1 /end REF_MEASUREMENT
 /begin REF_CHARACTERISTIC One_D.STD_uint32_uint32.All_Curves_STD.Curves_Raster_1 P_Do_Active_Std.STD_uint32_uint32.All_Curves_STD.Curves_Raster_1 P_In.STD_uint32_uint32.All_Curves_STD.Curves_Raster_1 /end REF_CHARACTERISTIC
/end GROUP
/begin GROUP STD_uint8_uint8.All_Curves_STD.Curves_Raster_1 ""
 /begin REF_MEASUREMENT Calculated.STD_uint8_uint8.All_Curves_STD.Curves_Raster_1 M_In.STD_uint8_uint8.All_Curves_STD.Curves_Raster_1 M_out.STD_uint8_uint8.All_Curves_STD.Curves_Raster_1 /end REF_MEASUREMENT
 /begin REF_CHARACTERISTIC One_D.STD_uint8_uint8.All_Curves_STD.Curves_Raster_1 P_Do_Active_Std.STD_uint8_uint8.All_Curves_STD.Curves_Raster_1 P_In.STD_uint8_uint8.All_Curves_STD.Curves_Raster_1 /end REF_CHARACTERISTIC
/end GROUP
/begin GROUP Slewing1.AllSlews "" /begin REF_MEASUREMENT l_Output_u8.Slewing1.AllSlews /end REF_MEASUREMENT
 /begin REF_CHARACTERISTIC p_1SlewingMode_e.Slewing1.AllSlews p_2SlewingAbsolute_u8.Slewing1.AllSlews p_3SlewingModify_u8.Slewing1.AllSlews /end REF_CHARACTERISTIC
/end GROUP
/begin RECORD_LAYOUT STANDARD_CURVE_S16S16 FNC_VALUES 3 SWORD COLUMN_DIR DIRECT AXIS_PTS_X 2 SWORD INDEX_INCR DIRECT NO_AXIS_PTS_X 1 UWORD /end RECORD_LAYOUT
/begin RECORD_LAYOUT STANDARD_CURVE_S32S32 FNC_VALUES 3 SLONG COLUMN_DIR DIRECT AXIS_PTS_X 2 SLONG INDEX_INCR DIRECT NO_AXIS_PTS_X 1 UWORD /end RECORD_LAYOUT
/begin RECORD_LAYOUT STANDARD_CURVE_S8S8 FNC_VALUES 3 SBYTE COLUMN_DIR DIRECT AXIS_PTS_X 2 SBYTE INDEX_INCR DIRECT NO_AXIS_PTS_X 1 UBYTE /end RECORD_LAYOUT
/begin RECORD_LAYOUT STANDARD_CURVE_U16U16 FNC_VALUES 3 UWORD COLUMN_DIR DIRECT AXIS_PTS_X 2 UWORD INDEX_INCR DIRECT NO_AXIS_PTS_X 1 UWORD /end RECORD_LAYOUT
/begin RECORD_LAYOUT STANDARD_CURVE_U32U32 FNC_VALUES 3 ULONG COLUMN_DIR DIRECT AXIS_PTS_X 2 ULONG INDEX_INCR DIRECT NO_AXIS_PTS_X 1 UWORD /end RECORD_LAYOUT
/begin RECORD_LAYOUT STANDARD_CURVE_U8U8 FNC_VALUES 3 UBYTE COLUMN_DIR DIRECT AXIS_PTS_X 2 UBYTE INDEX_INCR DIRECT NO_AXIS_PTS_X 1 UBYTE /end RECORD_LAYOUT
/begin RECORD_LAYOUT STANDARD_DIST_S16 AXIS_PTS_X 2 SWORD INDEX_INCR DIRECT NO_AXIS_PTS_X 1 UWORD /end RECORD_LAYOUT
/begin RECORD_LAYOUT STANDARD_DIST_S32 AXIS_PTS_X 2 SLONG INDEX_INCR DIRECT NO_AXIS_PTS_X 1 UWORD /end RECORD_LAYOUT
/begin RECORD_LAYOUT STANDARD_DIST_S8 AXIS_PTS_X 2 SBYTE INDEX_INCR DIRECT NO_AXIS_PTS_X 1 UBYTE /end RECORD_LAYOUT
/begin RECORD_LAYOUT STANDARD_DIST_U16 AXIS_PTS_X 2 UWORD INDEX_INCR DIRECT NO_AXIS_PTS_X 1 UWORD /end RECORD_LAYOUT
/begin RECORD_LAYOUT STANDARD_DIST_U32 AXIS_PTS_X 2 ULONG INDEX_INCR DIRECT NO_AXIS_PTS_X 1 UWORD /end RECORD_LAYOUT
/begin RECORD_LAYOUT STANDARD_DIST_U8 AXIS_PTS_X 2 UBYTE INDEX_INCR DIRECT NO_AXIS_PTS_X 1 UBYTE /end RECORD_LAYOUT
/begin RECORD_LAYOUT STANDARD_FIXED_S16 FNC_VALUES 1 SWORD COLUMN_DIR DIRECT /end RECORD_LAYOUT
/begin RECORD_LAYOUT STANDARD_FIXED_S32 FNC_VALUES 1 SLONG COLUMN_DIR DIRECT /end RECORD_LAYOUT
/begin RECORD_LAYOUT STANDARD_FIXED_S8 FNC_VALUES 1 SBYTE COLUMN_DIR DIRECT /end RECORD_LAYOUT
/begin RECORD_LAYOUT STANDARD_FIXED_U16 FNC_VALUES 1 UWORD COLUMN_DIR DIRECT /end RECORD_LAYOUT
/begin RECORD_LAYOUT STANDARD_FIXED_U32 FNC_VALUES 1 ULONG COLUMN_DIR DIRECT /end RECORD_LAYOUT
/begin RECORD_LAYOUT STANDARD_FIXED_U8 FNC_VALUES 1 UBYTE COLUMN_DIR DIRECT /end RECORD_LAYOUT
/begin RECORD_LAYOUT STANDARD_GROUP_S16 FNC_VALUES 1 SWORD COLUMN_DIR DIRECT /end RECORD_LAYOUT
/begin RECORD_LAYOUT STANDARD_GROUP_S32 FNC_VALUES 1 SLONG COLUMN_DIR DIRECT /end RECORD_LAYOUT
/begin RECORD_LAYOUT STANDARD_GROUP_S8 FNC_VALUES 1 SBYTE COLUMN_DIR DIRECT /end RECORD_LAYOUT
/begin RECORD_LAYOUT STANDARD_GROUP_U16 FNC_VALUES 1 UWORD COLUMN_DIR DIRECT /end RECORD_LAYOUT
/begin RECORD_LAYOUT STANDARD_GROUP_U32 FNC_VALUES 1 ULONG COLUMN_DIR DIRECT /end RECORD_LAYOUT
/begin RECORD_LAYOUT STANDARD_GROUP_U8 FNC_VALUES 1 UBYTE COLUMN_DIR DIRECT /end RECORD_LAYOUT
/begin RECORD_LAYOUT STANDARD_VALUE_S16 FNC_VALUES 1 SWORD COLUMN_DIR DIRECT /end RECORD_LAYOUT
/begin RECORD_LAYOUT STANDARD_VALUE_S32 FNC_VALUES 1 SLONG COLUMN_DIR DIRECT /end RECORD_LAYOUT
/begin RECORD_LAYOUT STANDARD_VALUE_S8 FNC_VALUES 1 SBYTE COLUMN_DIR DIRECT /end RECORD_LAYOUT
/begin RECORD_LAYOUT STANDARD_VALUE_U16 FNC_VALUES 1 UWORD COLUMN_DIR DIRECT /end RECORD_LAYOUT
/begin RECORD_LAYOUT STANDARD_VALUE_U32 FNC_VALUES 1 ULONG COLUMN_DIR DIRECT /end RECORD_LAYOUT
/begin RECORD_LAYOUT STANDARD_VALUE_U8 FNC_VALUES 1 UBYTE COLUMN_DIR DIRECT /end RECORD_LAYOUT
/end MODULE
/end PROJECT
