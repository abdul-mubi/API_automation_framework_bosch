VERSION ""

NS_ :

BS_:

BU_: New_Node_1

BO_ 2566843906 Message_1_J1939: 8 New_Node_1
 SG_ Normal_Signal_1 : 16|8@1+ (1,0) [0|255] "" Vector__XXX
 SG_ Multiplexed_Signal_J1939_4 m4 : 8|8@1+ (1,0) [0|255] "" Vector__XXX
 SG_ Multiplexed_Signal_J1939_3 m2 : 8|8@1+ (1,0) [0|255] "" Vector__XXX
 SG_ Multiplexed_Signal_J1939_2 m1 : 8|8@1+ (1,0) [0|255] "" Vector__XXX
 SG_ Multiplexed_Signal_J1939_1 m0 : 8|8@1+ (1,0) [0|255] "" Vector__XXX
 SG_ Multiplexor_J1939 M : 0|4@1+ (1,0) [0|15] "" Vector__XXX

BA_DEF_ BO_  "VFrameFormat" ENUM  "StandardCAN","ExtendedCAN","reserved","J1939PG";
BA_DEF_DEF_  "VFrameFormat" "J1939PG";
