VERSION ""

NS_ :

BS_:

BU_: New_Node_1

BO_ 291 Message_1_CAN: 8 New_Node_1
 SG_ Normal_Signal_1 : 16|8@1+ (1,0) [0|255] "" Vector__XXX
 SG_ Multiplexed_Signal_4 m4 : 8|8@1+ (1,0) [0|255] "" Vector__XXX
 SG_ Multiplexed_Signal_3 m2 : 8|8@1+ (1,0) [0|255] "" Vector__XXX
 SG_ Multiplexed_Signal_2 m1 : 8|8@1+ (1,0) [0|255] "" Vector__XXX
 SG_ Multiplexed_Signal_1 m0 : 8|8@1+ (1,0) [0|255] "" Vector__XXX
 SG_ Multiplexor M : 0|4@1+ (1,0) [0|15] "" Vector__XXX

BA_DEF_  "BusType" STRING ;
BA_DEF_DEF_  "BusType" "CAN";
