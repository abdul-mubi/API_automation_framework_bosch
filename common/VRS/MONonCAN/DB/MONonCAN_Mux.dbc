VERSION ""

NS_ :

BS_:

BU_: AUT REF_ECU

BO_ 16 F_STD_0x10: 8 REF_ECU
 SG_ S_STD_0x10_MUX3_1_S8 m32 : 56|8@1- (1,0) [0|0] ""  AUT
 SG_ S_STD_0x10_MUX3_0_S8 m0 : 48|8@1+ (1,0) [0|0] ""  AUT
 SG_ S_STD_0x10_MUX3 M : 40|8@1+ (1,0) [0|0] ""  AUT
 SG_ S_STD_0x10_MUX2_1_S7 m1 : 32|7@1+ (1,0) [0|0] ""  AUT
 SG_ S_STD_0x10_MUX2_0_S7 m0 : 32|7@1+ (1,0) [0|0] ""  AUT
 SG_ S_STD_0x10_MUX2 M : 39|1@1+ (1,0) [0|0] ""  AUT
 SG_ S_STD_0x10_COUNTER_S8 : 0|8@1+ (1,0) [0|0] ""  AUT
 SG_ S_STD_0x10_MUX1_3_S6 m3 : 8|6@1+ (1,0) [0|0] ""  AUT
 SG_ S_STD_0x10_MUX1_3_S16 m3 : 16|16@1- (1,0) [0|0] ""  AUT
 SG_ S_STD_0x10_MUX1_2_S6 m2 : 8|6@1+ (1,0) [0|0] ""  AUT
 SG_ S_STD_0x10_MUX1_2_S16 m2 : 16|16@1- (1,0) [0|0] ""  AUT
 SG_ S_STD_0x10_MUX1_1_S6 m1 : 8|6@1+ (1,0) [0|0] ""  AUT
 SG_ S_STD_0x10_MUX1_1_S16 m1 : 16|16@1- (1,0) [0|0] ""  AUT
 SG_ S_STD_0x10_MUX1_0_S6 m0 : 8|6@1+ (1,0) [0|0] ""  AUT
 SG_ S_STD_0x10_MUX1_0_S16 m0 : 16|16@1- (1,0) [0|0] ""  AUT
 SG_ S_STD_0x10_MUX1 M : 14|2@1+ (1,0) [0|0] ""  AUT

BA_DEF_ SG_  "SigType" ENUM  "Default","Range","RangeSigned","ASCII","Discrete","Control","ReferencePGN","DTC","StringDelimiter","StringLength","StringLengthControl","MessageCounter","MessageChecksum";
BA_DEF_ SG_  "GenSigEVName" STRING ;
BA_DEF_ SG_  "GenSigILSupport" ENUM  "No","Yes";
BA_DEF_ SG_  "GenSigSendType" ENUM  "Cyclic","OnWrite","OnWriteWithRepetition","OnChange","OnChangeWithRepetition","IfActive","IfActiveWithRepetition","NoSigSendType";
BA_DEF_ BO_  "GenMsgILSupport" ENUM  "No","Yes";
BA_DEF_ BU_  "NmStationAddress" INT 0 255;
BA_DEF_ BO_  "GenMsgSendType" ENUM  "cyclic","NotUsed","IfActive","NotUsed","NotUsed","NotUsed","NotUsed","NotUsed","noMsgSendType";
BA_DEF_ BO_  "GenMsgRequestable" INT 0 1;
BA_DEF_  "DBName" STRING ;
BA_DEF_  "BusType" STRING ;
BA_DEF_  "ProtocolType" STRING ;
BA_DEF_ BO_  "VFrameFormat" ENUM  "StandardCAN","ExtendedCAN","reserved","J1939PG";
BA_DEF_DEF_  "SigType" "Default";
BA_DEF_DEF_  "GenSigEVName" "Env@Nodename_@Signame";
BA_DEF_DEF_  "GenSigILSupport" "Yes";
BA_DEF_DEF_  "GenSigSendType" "NoSigSendType";
BA_DEF_DEF_  "GenMsgILSupport" "Yes";
BA_DEF_DEF_  "NmStationAddress" 254;
BA_DEF_DEF_  "GenMsgSendType" "noMsgSendType";
BA_DEF_DEF_  "GenMsgRequestable" 1;
BA_DEF_DEF_  "DBName" "";
BA_DEF_DEF_  "BusType" "CAN";
BA_DEF_DEF_  "ProtocolType" "J1939";
BA_DEF_DEF_  "VFrameFormat" "J1939PG";
BA_ "DBName" "MONonCAN_Default";
BA_ "NmStationAddress" BU_ AUT 2;
BA_ "NmStationAddress" BU_ REF_ECU 1;
BA_ "VFrameFormat" BO_ 16 0;

SG_MUL_VAL_ 16 S_STD_0x10_MUX3_1_S8 S_STD_0x10_MUX3 32-63, 96-127, 160-191, 224-255;
SG_MUL_VAL_ 16 S_STD_0x10_MUX3_0_S8 S_STD_0x10_MUX3 0-0, 32-32, 64-64, 96-96, 128-128, 160-160, 192-192, 224-224;
SG_MUL_VAL_ 16 S_STD_0x10_MUX2_1_S7 S_STD_0x10_MUX2 1-1;
SG_MUL_VAL_ 16 S_STD_0x10_MUX2_0_S7 S_STD_0x10_MUX2 0-0;
SG_MUL_VAL_ 16 S_STD_0x10_MUX1_3_S6 S_STD_0x10_MUX1 3-3;
SG_MUL_VAL_ 16 S_STD_0x10_MUX1_3_S16 S_STD_0x10_MUX1 3-3;
SG_MUL_VAL_ 16 S_STD_0x10_MUX1_2_S6 S_STD_0x10_MUX1 2-2;
SG_MUL_VAL_ 16 S_STD_0x10_MUX1_2_S16 S_STD_0x10_MUX1 2-2;
SG_MUL_VAL_ 16 S_STD_0x10_MUX1_1_S6 S_STD_0x10_MUX1 1-1;
SG_MUL_VAL_ 16 S_STD_0x10_MUX1_1_S16 S_STD_0x10_MUX1 1-1;
SG_MUL_VAL_ 16 S_STD_0x10_MUX1_0_S6 S_STD_0x10_MUX1 0-0;
SG_MUL_VAL_ 16 S_STD_0x10_MUX1_0_S16 S_STD_0x10_MUX1 0-0;
