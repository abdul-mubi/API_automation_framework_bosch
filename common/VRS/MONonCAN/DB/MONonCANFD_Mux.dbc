VERSION ""

NS_ :

BS_:

BU_: REF_ECU AUT

BO_ 2164260864 F_FD_EXT_0x1000000: 32 REF_ECU
 SG_ S_FD_EXT_0x1000000_MUX1_3_S16 m3 : 240|16@1- (1,0) [-32768|32767] ""  AUT
 SG_ S_FD_EXT_0x1000000_MUX1_2_S16 m2 : 240|16@1- (1,0) [-32768|32767] ""  AUT
 SG_ S_FD_EXT_0x1000000_MUX1_1_S16 m1 : 240|16@1- (1,0) [-32768|32767] ""  AUT
 SG_ S_FD_EXT_0x1000000_MUX1_0_S16 m0 : 240|16@1- (1,0) [-32768|32767] ""  AUT
 SG_ S_FD_EXT_0x1000000_S32_7 : 208|32@1- (1,0) [-2147483648|2147483647] ""  AUT
 SG_ S_FD_EXT_0x1000000_S32_6 : 176|32@1- (1,0) [-2147483648|2147483647] ""  AUT
 SG_ S_FD_EXT_0x1000000_MUX1_0_U6 m0 : 168|6@1+ (1,0) [0|63] ""  AUT
 SG_ S_FD_EXT_0x1000000_MUX1 M : 174|2@1+ (1,0) [0|3] ""  AUT
 SG_ S_FD_EXT_0x1000000_MUX1_3_U6 m3 : 168|6@1+ (1,0) [0|63] ""  AUT
 SG_ S_FD_EXT_0x1000000_MUX1_2_U6 m2 : 168|6@1+ (1,0) [0|63] ""  AUT
 SG_ S_FD_EXT_0x1000000_MUX1_1_U6 m1 : 168|6@1+ (1,0) [0|63] ""  AUT
 SG_ S_FD_EXT_0x1000000_COUNTER_U8 : 160|8@1+ (1,0) [0|255] ""  AUT
 SG_ S_FD_EXT_0x1000000_U32_5 : 128|32@1+ (1,0) [0|4294967295] ""  AUT
 SG_ S_FD_EXT_0x1000000_U32_4 : 96|32@1+ (1,0) [0|4294967295] ""  AUT
 SG_ S_FD_EXT_0x1000000_U32_3 : 64|32@1+ (1,0) [0|4294967295] ""  AUT
 SG_ S_FD_EXT_0x1000000_U32_2 : 32|32@1+ (1,0) [0|4294967295] ""  AUT
 SG_ S_FD_EXT_0x1000000_U32_1 : 0|32@1+ (1,0) [0|4294967295] ""  AUT

BO_ 16 F_FD_STD_0x10: 64 REF_ECU
 SG_ S_FD_STD_0x10_S32_9 : 303|32@0- (1,0) [-2147483648|2147483647] ""  AUT
 SG_ S_FD_STD_0x10_S32_8 : 271|32@0- (1,0) [-2147483648|2147483647] ""  AUT
 SG_ S_FD_STD_0x10_S32_7 : 239|32@0- (1,0) [-2147483648|2147483647] ""  AUT
 SG_ S_FD_STD_0x10_U32_14 : 479|32@0+ (1,0) [0|4294970000] ""  AUT
 SG_ S_FD_STD_0x10_U32_13 : 447|32@0+ (1,0) [0|4294970000] ""  AUT
 SG_ S_FD_STD_0x10_U32_12 : 415|32@0+ (1,0) [0|4294970000] ""  AUT
 SG_ S_FD_STD_0x10_U32_11 : 383|32@0+ (1,0) [0|4294970000] ""  AUT
 SG_ S_FD_STD_0x10_U32_10 : 335|32@0+ (1,0) [0|4294970000] ""  AUT
 SG_ S_FD_STD_0x10_S32_6 : 207|32@0- (1,0) [-2147483648|2147483647] ""  AUT
 SG_ S_FD_STD_0x10_S32_5 : 175|32@0- (1,0) [-2147483648|2147483647] ""  AUT
 SG_ S_FD_STD_0x10_S32_4 : 127|32@0- (1,0) [-2147483648|2147483647] ""  AUT
 SG_ S_FD_STD_0x10_S32_3 : 79|32@0- (1,0) [-2147483648|2147483647] ""  AUT
 SG_ S_FD_STD_0x10_U32_2 : 47|32@0+ (1,0) [0|4294970000] ""  AUT
 SG_ S_FD_STD_0x10_U32_1 : 15|32@0+ (1,0) [0|4294970000] ""  AUT
 SG_ S_FD_STD_0x10_MUX1_3_U16 m768 : 367|16@0+ (1,0) [0|65535] ""  AUT
 SG_ S_FD_STD_0x10_MUX1_3_S16 m768 : 159|16@0- (1,0) [-32768|32767] ""  AUT
 SG_ S_FD_STD_0x10_MUX1_2_U16 m512 : 367|16@0+ (1,0) [0|65535] ""  AUT
 SG_ S_FD_STD_0x10_MUX1_2_S16 m512 : 159|16@0- (1,0) [-32768|32767] ""  AUT
 SG_ S_FD_STD_0x10_MUX1_1_U16 m256 : 367|16@0+ (1,0) [0|65535] ""  AUT
 SG_ S_FD_STD_0x10_MUX1_1_S16 m256 : 159|16@0- (1,0) [-32768|32767] ""  AUT
 SG_ S_FD_STD_0x10_MUX1_0_U16 m0 : 367|16@0+ (1,0) [0|65535] ""  AUT
 SG_ S_FD_STD_0x10_MUX1_0_S16 m0 : 159|16@0- (1,0) [-32768|32767] ""  AUT
 SG_ S_FD_STD_0x10_COUNTER_U8 : 7|8@0+ (1,0) [0|255] ""  AUT
 SG_ S_FD_STD_0x10_MUX1 M : 111|16@0+ (1,0) [0|65535] ""  AUT

BA_DEF_ BO_  "CANFD_BRS" ENUM  "0","1";
BA_DEF_  "DBName" STRING ;
BA_DEF_  "BusType" STRING ;
BA_DEF_ BO_  "VFrameFormat" ENUM  "StandardCAN","ExtendedCAN","reserved","reserved","reserved","reserved","reserved","reserved","reserved","reserved","reserved","reserved","reserved","reserved","StandardCAN_FD","ExtendedCAN_FD";
BA_DEF_DEF_  "CANFD_BRS" "1";
BA_DEF_DEF_  "DBName" "";
BA_DEF_DEF_  "BusType" "";
BA_DEF_DEF_  "VFrameFormat" "StandardCAN";
BA_ "BusType" "CAN FD";
BA_ "DBName" "MONonCANFD_Mux";
BA_ "VFrameFormat" BO_ 2164260864 15;
BA_ "VFrameFormat" BO_ 16 14;
